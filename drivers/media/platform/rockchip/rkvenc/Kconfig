## drivers/media/platform/rockchip/rkvenc/Kconfig
```kconfig
# SPDX-License-Identifier: GPL-2.0
config VIDEO_ROCKCHIP_VEPU510
	tristate "Rockchip VEPU510 Video Encoder driver"
	depends on ARCH_ROCKCHIP || COMPILE_TEST
	depends on VIDEO_DEV
	select VIDEOBUF2_DMA_CONTIG
	select V4L2_MEM2MEM_DEV
	help
	  Support for the Rockchip VEPU510 hardware video encoder IP
	  present on the RK3576 SoC, which accelerates H.264 video
	  encoding.

	  To compile this driver as a module, choose M here: the module
	  will be called rockchip-vepu510.
```

## drivers/media/platform/synopsys/hdmirx/Kconfig
```kconfig
# SPDX-License-Identifier: GPL-2.0

config VIDEO_SYNOPSYS_HDMIRX
	tristate "Synopsys DesignWare HDMI Receiver driver"
	depends on VIDEO_DEV
	depends on ARCH_ROCKCHIP
	select MEDIA_CONTROLLER
	select VIDEO_V4L2_SUBDEV_API
	select VIDEOBUF2_DMA_CONTIG
	select CEC_CORE
	select CEC_NOTIFIER
	select HDMI
	help
	  Support for Synopsys HDMI HDMI RX Controller.
	  This driver supports HDMI 2.0 version.

	  To compile this driver as a module, choose M here. The module
	  will be called synopsys_hdmirx.
```

## drivers/motion/Kconfig
```kconfig
# SPDX-License-Identifier: GPL-2.0

menuconfig MOTION
	bool "Linux Motion Control support"
	select IIO
	help
	  The Linux Motion Control subsystem contains drivers for different
	  types of motion control hardware, like (stepper-)motor drivers and
	  linear actuators.
	  Say Y here if you want to chose motion control devices.

if MOTION


config TMC5240
	tristate "TMC5240 stepper motor driver"
	depends on SPI
	select REGMAP_SPI
	help
	  Say Y here if you have an Analog Devices TMC5240 stepper
	  motor controller.

	  To compile this driver as a module, choose M here: the
	  module will be called tmc5240.

config MOTION_HELPERS
	bool
	depends on MOTION

endif # MOTION
```

## drivers/mux/Kconfig
```kconfig
# SPDX-License-Identifier: GPL-2.0
#
# Multiplexer devices
#

config MULTIPLEXER
	tristate

menu "Multiplexer drivers"
	depends on MULTIPLEXER

config MUX_ADG792A
	tristate "Analog Devices ADG792A/ADG792G Multiplexers"
	depends on I2C
	help
	  ADG792A and ADG792G Wide Bandwidth Triple 4:1 Multiplexers

	  The driver supports both operating the three multiplexers in
	  parallel and operating them independently.

	  To compile the driver as a module, choose M here: the module will
	  be called mux-adg792a.

config MUX_ADGS1408
	tristate "Analog Devices ADGS1408/ADGS1409 Multiplexers"
	depends on SPI
	help
	  ADGS1408 8:1 multiplexer and ADGS1409 double 4:1 multiplexer
	  switches.

	  To compile the driver as a module, choose M here: the module will
	  be called mux-adgs1408.

config MUX_GPIO
	tristate "GPIO-controlled Multiplexer"
	depends on GPIOLIB || COMPILE_TEST
	help
	  GPIO-controlled Multiplexer controller.

	  The driver builds a single multiplexer controller using a number
	  of gpio pins. For N pins, there will be 2^N possible multiplexer
	  states. The GPIO pins can be connected (by the hardware) to several
	  multiplexers, which in that case will be operated in parallel.

	  To compile the driver as a module, choose M here: the module will
	  be called mux-gpio.

config MUX_MMIO
	tristate "MMIO/Regmap register bitfield-controlled Multiplexer"
	depends on OF
	select REGMAP_MMIO
	help
	  MMIO/Regmap register bitfield-controlled Multiplexer controller.

	  The driver builds multiplexer controllers for bitfields in either
	  a syscon register or a driver regmap register. For N bit wide
	  bitfields, there will be 2^N possible multiplexer states.

	  To compile the driver as a module, choose M here: the module will
	  be called mux-mmio.

config MUX_TI_K3_EVENT_ROUTER
	tristate "TI Event Mux Router using MMIO registers"
	depends on OF && (REGMAP_MMIO || COMPILE_TEST)
	help
	  This is extension of MMIO mux for  timesync router and gpiomux
	  routers on TI K3 SoCs. This driver supports the 3-field format for
	  mux control: <register-offset mask value>.

	  The driver allows configuration of hardware mux routers using
	  memory-mapped registers. It's based on the mmio-mux driver but
	  supports the extended 3-field format for more precise control.

	  To compile the driver as a module, choose M here: the module will
	  be called mux-ti-k3-event.

endmenu
```

## drivers/net/phy/qcom/Kconfig
```kconfig
# SPDX-License-Identifier: GPL-2.0-only
config AT803X_PHY
	tristate "Qualcomm Atheros AR803X PHYs"
	depends on REGULATOR
	help
	  Currently supports the AR8030, AR8031, AR8033, AR8035 and internal
	  QCA8337(Internal qca8k PHY) model

config QCA83XX_PHY
	tristate "Qualcomm Atheros QCA833x PHYs"
	help
	  Currently supports the internal QCA8337(Internal qca8k PHY) model

config QCA808X_PHY
	tristate "Qualcomm QCA808x PHYs"
	help
	  Currently supports the QCA8081 model
```

## drivers/phy/axiado/Kconfig
```kconfig
#
# PHY drivers for Axiado platforms
#

config PHY_AX3000_EMMC
	tristate "Axiado eMMC PHY driver"
	select GENERIC_PHY
	help
	  This enables support for the eMMC PHY block found on the
	  Axiado AX3000 SoCs. The PHY provides the physical layer
	  interface used by the Arasan SDHCI host controller for emmc
	  signaling and timing adjustment.

	  If you are building a kernel for AX3000 platform with
	  eMMC storage, say Y or N.
```

## drivers/phy/spacemit/Kconfig
```kconfig
# SPDX-License-Identifier: GPL-2.0-only
#
# Phy drivers for SpacemiT platforms
#
config PHY_SPACEMIT_K1_USB2
	tristate "SpacemiT K1 USB 2.0 PHY support"
	depends on (ARCH_SPACEMIT || COMPILE_TEST) && OF
	depends on COMMON_CLK
	depends on USB_COMMON
	select GENERIC_PHY
	help
	  Enable this to support K1 USB 2.0 PHY driver. This driver takes care of
	  enabling and clock setup and will be used by K1 udc/ehci/otg/xhci driver.

config PHY_SPACEMIT_K1_COMBPHY
	tristate "SpacemiT K1 PCIe/USB3 combo PHY support"
	depends on (ARCH_SPACEMIT || COMPILE_TEST) && OF
	depends on COMMON_CLK
	select GENERIC_PHY
	help
	  USB3/PCIe Combo PHY Support for SpacemiT K1 SoC
```

## drivers/scsi/aacraid/Kconfig
```kconfig
# SPDX-License-Identifier: GPL-2.0-only
#
# Kernel configuration file for the aacraid driver.
#
# Copyright (c) 2025 Microchip Technology Inc. and its subsidiaries
#  (mailto:storagedev@microchip.com)
#
config SCSI_AACRAID_MULTIQ
	bool "AACRAID Multiq support"
	depends on SCSI_AACRAID
	default n
	help
	  This option enables MultiQ support in the aacraid driver.

	  Enabling MultiQ allows the driver to safely handle CPU offlining.
	  However, it may cause a performance drop in certain configurations.

	  Enable this option only if your system requires CPU offlining support.

	  If unsure, say N.
```

## drivers/soc/airoha/Kconfig
```kconfig
# SPDX-License-Identifier: GPL-2.0-only

config AIROHA_SCU_SSR
	tristate "Airoha SCU SSR Driver"
	depends on ARCH_AIROHA || COMPILE_TEST
	depends on OF
	help
	  Say 'Y' here to add support for Airoha SCU SSR driver.

	  Airoha SoC pheriperal (like USB/PCIe/Ethernet port) are
	  selected by toggling specific bit. Serdes Port line
	  are mutually exclusive such as selecting PCIe port 2
	  disable support for USB port 2 3.0 mode.

	  This driver is used to configure such bit and expose
	  an API to read the current status from a user of such
	  Serdes lines.
```

## drivers/vfio/pci/nvme/Kconfig
```kconfig
# SPDX-License-Identifier: GPL-2.0-only
config NVME_VFIO_PCI
	tristate "VFIO support for NVMe PCI devices"
	depends on NVME_CORE
	depends on VFIO_PCI_CORE
	help
	  This provides migration support for NVMe devices using the
	  VFIO framework.

	  If you don't know what to do here, say N.
```

## drivers/virt/coco/host/Kconfig
```kconfig
# SPDX-License-Identifier: GPL-2.0-only
#
# TSM (TEE Security Manager) Common infrastructure and host drivers
#
config TSM
	tristate
```

## drivers/virt/pvmemcontrol/Kconfig
```kconfig
# SPDX-License-Identifier: GPL-2.0
config PVMEMCONTROL
	tristate "pvmemcontrol Guest Service Module"
	depends on KVM_GUEST
	help
	  pvmemcontrol is a guest kernel module that allows to communicate
	  with hypervisor / VMM and control the guest memory backing.

	  To compile as a module, choose M, the module will be called
	  pvmemcontrol. If unsure, say N.
```

## kernel/api/Kconfig
```kconfig
# SPDX-License-Identifier: GPL-2.0-only
#
# Kernel API Specification Framework Configuration
#

config KAPI_SPEC
	bool "Kernel API Specification Framework"
	help
	  This option enables the kernel API specification framework,
	  which provides formal documentation of kernel APIs in both
	  human and machine-readable formats.

	  The framework allows developers to document APIs inline with
	  their implementation, including parameter specifications,
	  return values, error conditions, locking requirements, and
	  execution context constraints.

	  When enabled, API specifications can be queried at runtime
	  and exported in various formats (JSON, XML) through debugfs.

	  If unsure, say N.

config KAPI_RUNTIME_CHECKS
	bool "Runtime API specification checks"
	depends on KAPI_SPEC
	depends on DEBUG_KERNEL
	help
	  Enable runtime validation of API usage against specifications.
	  This includes checking execution context requirements, parameter
	  validation, and lock state verification.

	  This adds overhead and should only be used for debugging and
	  development. The checks use WARN_ONCE to report violations.

	  If unsure, say N.
```

## kernel/multikernel/Kconfig
```kconfig
# SPDX-License-Identifier: GPL-2.0-only
#
# Multikernel configuration
#

config MULTIKERNEL
	bool "Multikernel support"
	depends on KEXEC_CORE
	depends on KEXEC_HANDOVER
	select LIBFDT
	help
	  Enable multikernel support, which allows running multiple kernel
	  instances simultaneously with resource isolation and inter-kernel
	  communication capabilities.

	  This feature provides:
	  - Sysfs interface for multikernel instance management
	  - Device tree based resource specification
	  - Memory pool management for kernel instances
	  - Integration with kexec for kernel loading
	  - KHO (Kexec HandOver) support for seamless DTB transfer

	  Requires KEXEC_HANDOVER for preserving device trees and instance
	  state across kernel boundaries.

	  If unsure, say N.
```

## virt/pvsched/Kconfig
```kconfig
# SPDX-License-Identifier: GPL-2.0-only
config PARAVIRT_SCHED_HOST
	bool "Paravirt scheduling framework in the host kernel"
	default n
	help
	  Paravirtualized scheduling facilitates the exchange of scheduling
	  related information between the host and guest through shared memory,
	  enhancing the efficiency of vCPU thread scheduling by the hypervisor.
	  An illustrative use case involves dynamically boosting the priority of
	  a vCPU thread when the guest is executing a latency-sensitive workload
	  on that specific vCPU.
	  This config enables paravirt scheduling framework in the host kernel.
```
