## drivers/media/platform/google/chameleonv3/Kconfig
```kconfig
# SPDX-License-Identifier: GPL-2.0-only

config VIDEO_CHV3_FB
	tristate "Google Chameleon v3 framebuffer video driver"
	depends on V4L_PLATFORM_DRIVERS
	depends on VIDEO_DEV
	select VIDEOBUF2_DMA_CONTIG
	select V4L2_FWNODE
	help
	  v4l2 driver for the video interface present on the Google
	  Chameleon v3. The Chameleon v3 uses the framebuffer IP core
	  to take the video signal from different sources and directly
	  write frames into memory.
```

## drivers/media/platform/intel/Kconfig
```kconfig
# SPDX-License-Identifier: GPL-2.0-only

comment "Intel media platform drivers"

config VIDEO_PXA27x
	tristate "PXA27x Quick Capture Interface driver"
	depends on V4L_PLATFORM_DRIVERS
	depends on VIDEO_DEV
	depends on PXA27x || COMPILE_TEST
	select VIDEOBUF2_DMA_SG
	select SG_SPLIT
	select V4L2_FWNODE
	help
	  This is a v4l2 driver for the PXA27x Quick Capture Interface

config VIDEO_INTEL_DPRX
	tristate "Intel DisplayPort RX IP driver"
	depends on V4L_PLATFORM_DRIVERS
	depends on VIDEO_DEV
	select V4L2_FWNODE
	select CRC_DP
	help
	  v4l2 subdev driver for Intel Displayport receiver FPGA IP.
	  It is a part of the DisplayPort Intel FPGA IP Core.
	  It implements a DisplayPort 1.4 receiver capable of HBR3
	  video capture and Multi-Stream Transport.
```

## drivers/media/platform/qcom/jpeg/Kconfig
```kconfig
# SPDX-License-Identifier: GPL-2.0-only
config VIDEO_QCOM_JENC
	tristate "Qualcomm V4L2 JPEG Encoder driver"
	depends on V4L_MEM2MEM_DRIVERS
	depends on (ARCH_QCOM && IOMMU_DMA) || COMPILE_TEST
	depends on VIDEO_DEV
	select VIDEOBUF2_DMA_SG
	select V4L2_JPEG_HELPER
	select V4L2_MEM2MEM_DEV
	help
	  Qualcomm JPEG memory-to-memory V4L2 encoder driver.

	  Provides:
	    - qcom-jenc (encode)

	  To compile this driver as a module, choose M here: the
	  module will be called qcom-jenc
```

## drivers/media/platform/renesas/rzv2h-ivc/Kconfig
```kconfig
# SPDX-License-Identifier: GPL-2.0-only

config VIDEO_RZV2H_IVC
	tristate "Renesas RZ/V2H Input Video Control block driver"
	depends on V4L_PLATFORM_DRIVERS
	depends on VIDEO_DEV
	select VIDEOBUF2_DMA_CONTIG
	help
	  Support for the Video Input Block found in the RZ/V2H SoC. Enable this
	  to support the block, and by extension the Arm Mali-C55 ISP to which
	  it feeds data.
```

## drivers/media/platform/rockchip/rkjpegd/Kconfig
```kconfig
# SPDX-License-Identifier: GPL-2.0
config VIDEO_ROCKCHIP_JPEGD
	tristate "Rockchip JPEG decoder driver"
	depends on V4L_MEM2MEM_DRIVERS
	depends on ARCH_ROCKCHIP || COMPILE_TEST
	depends on VIDEO_DEV
	depends on PM
	select V4L2_JPEG_HELPER
	select V4L2_MEM2MEM_DEV
	select VIDEOBUF2_DMA_CONTIG
	help
	  Support for the VDPU720 JPEG decoder found on Rockchip SoCs such
	  as the RK3568 and RK3588, decoding JPEG and MJPEG frames to NV12,
	  or to GREY for grayscale frames.
	  To compile this driver as a module, choose M here: the module
	  will be called rockchip-jpegd.
```

## drivers/media/platform/rockchip/vip/Kconfig
```kconfig
config VIDEO_ROCKCHIP_VIP
	tristate "Rockchip VIP (Video InPut) Camera Interface"
	depends on VIDEO_DEV
	depends on ARCH_ROCKCHIP || COMPILE_TEST
	select VIDEOBUF2_DMA_SG
	select VIDEOBUF2_DMA_CONTIG
	select V4L2_FWNODE
	select V4L2_MEM2MEM_DEV
	help
	  This is a v4l2 driver for Rockchip SOC Camera interface. It supports
	  BT.656 and CSI2 inputs.

	  To compile this driver as a module choose m here : the module will
	  be called video_rkvip.
```

## drivers/media/platform/samsung/v920-scaler/Kconfig
```kconfig
# SPDX-License-Identifier: GPL-2.0-only
#
# Platform drivers
#	Most drivers here are currently for webcam supporit

config VIDEO_EXYNOS_SCALER
	tristate "EXYNOS Scaler Driver"
	depends on VIDEO_DEV && HAS_DMA && !SAMSUNG_SCALER_EXYNOSAUTO_KUNIT_TEST
	select V4L2_MEM2MEM_DEV
	select VIDEOBUF2_DMA_SG
	default n
	help
	  This is a v4l2 driver for EXYNOS Scaler (MSCL) device.
	  This option provides Exynos Scaler device driver support for
	  ExynosAutoV920 SoC.
	  When eanbled, the Scaler device will be detected and corresponding /dev/video50
	  node will be created.
```

## drivers/media/platform/synopsys/Kconfig
```kconfig
# SPDX-License-Identifier: GPL-2.0-only

source "drivers/media/platform/synopsys/dw-mipi-csi2/Kconfig"
source "drivers/media/platform/synopsys/hdmirx/Kconfig"
```

## drivers/media/platform/toshiba/Kconfig
```kconfig
# SPDX-License-Identifier: GPL-2.0-only

comment "Toshiba media platform drivers"

source "drivers/media/platform/toshiba/visconti/Kconfig"
```

## drivers/media/platform/toshiba/visconti/Kconfig
```kconfig
# SPDX-License-Identifier: GPL-2.0-only
config VIDEO_VISCONTI_VIIF
	tristate "Visconti Camera Interface driver"
	depends on V4L_PLATFORM_DRIVERS
	depends on VIDEO_DEV && OF
	depends on ARCH_VISCONTI || COMPILE_TEST
	select MEDIA_CONTROLLER
	select V4L2_ASYNC
	select V4L2_FWNODE
	select VIDEOBUF2_DMA_CONTIG
	select VIDEO_V4L2_SUBDEV_API
	help
	  This is V4L2 driver for Toshiba Visconti Camera Interface hardware

	  This driver yields 3 video device nodes
	  and 1 media device node for a hardware instance.
	  To compile this driver as a module, choose M here: the
	  module will be called visconti-viif.
```

## drivers/memory/mediatek/Kconfig
```kconfig
# SPDX-License-Identifier: GPL-2.0-only
config HAVE_MTK_MC
	bool "MediaTek Memory Controller support"
	help
	  This option allows to enable MediaTek memory controller drivers,
	  which may include controllers for DRAM or others.
	  Select Y here if you need support for MediaTek memory controller.
	  If you don't need, select N.

if HAVE_MTK_MC

config MTK_DRAMC
	tristate "MediaTek DRAMC driver"
	depends on HAVE_MTK_MC
	help
	  This option selects the MediaTek DRAMC driver, which provides
	  an interface for reporting the current data rate of DRAM.
	  Select Y here if you need support for the MediaTek DRAMC driver.
	  If you don't need, select N.

endif
```

## drivers/memory/scrub/Kconfig
```kconfig
# SPDX-License-Identifier: GPL-2.0-only
#
# Memory scrub driver configurations
#

config SCRUB
	bool "Memory scrub driver"
	help
	  This option selects the memory scrub subsystem, supports
	  configuring the parameters of underlying scrubbers in the
	  system for the DRAM memories.
```

## drivers/misc/amd/Kconfig
```kconfig
# SPDX-License-Identifier: GPL-2.0-only

config AMD_VERSAL_PCI
	tristate "AMD Versal PCIe Management Driver"
	select FW_LOADER
	select CONFIGFS_FS
	depends on HAS_IOMEM
	depends on PCI
	default m
	help
	  AMD Versal PCIe Management Driver provides management services,
	  including download firmware, program bitstream, and communicate with
	  the User function.

	  If "M" is selected, the driver module will be versal-pci
```

## drivers/misc/arm-cla/Kconfig
```kconfig
config ARM_CLA
	tristate "Arm Core Local Accelerator"
	default n
	depends on ARM64
	help
	  Arm Core Local Accelerator (CLA) is coupled with a specific CPU and
	  provides an interface to enumerate and access attached hardware
	  accelerators. It is only accessible from its associated CPU.

	  If unsure, say N.
```

## drivers/misc/mei/late_bind/Kconfig
```kconfig
# SPDX-License-Identifier: GPL-2.0
# Copyright (c) 2025, Intel Corporation. All rights reserved.
#
config INTEL_MEI_LATE_BIND
	tristate "Intel late binding support on ME Interface"
	select INTEL_MEI_ME
	depends on DRM_XE
	help
	  MEI Support for Late Binding for Intel graphics card.

	  Enables the ME FW interfaces for Late Binding feature,
	  allowing loading of firmware for the devices like Fan
	  Controller during by Intel Xe driver.
```

## drivers/misc/mlx5ctl/Kconfig
```kconfig
# SPDX-License-Identifier: GPL-2.0
#

config MLX5CTL
	tristate "mlx5 ConnectX control misc driver"
	depends on MLX5_CORE
	help
	  MLX5CTL provides interface for the user process to access the debug and
          configuration registers of the ConnectX hardware family
          (NICs, PCI switches and SmartNIC SoCs).
          This will allow configuration and debug tools to work out of the box on
          mainstream kernel.

	  If you don't know what to do here, say N.
```

## drivers/misc/qrc/Kconfig
```kconfig
# SPDX-License-Identifier: GPL-2.0-only
#
# QRC device driver configuration
#

menu "QCOM QRC device driver"

config QCOM_QRC
	tristate "QCOM QRC device driver for Robotic SDK MCU"
	help
	  This kernel configuration is used to enable robotic controller
	  device driver. Say M here if you want to enable robotic
	  controller device driver.
	  When in doubt, say N.

endmenu
```

## drivers/mmc/Kconfig
```kconfig
# SPDX-License-Identifier: GPL-2.0-only
#
# MMC subsystem configuration
#

menuconfig MMC
	tristate "MMC/SD/SDIO card support"
	depends on HAS_IOMEM
	help
	  This selects MultiMediaCard, Secure Digital and Secure
	  Digital I/O support.

	  If you want MMC/SD/SDIO support, you should say Y here and
	  also to your specific host controller driver.

config MMC_SDIO_CDEV
	bool "SDIO userspace passthrough character device"
	depends on MMC
	default y
	help
	  Expose a character device (/dev/mmcX:YYYY:FN) for every SDIO
	  function, providing CMD52/CMD53 register access to userspace
	  via ioctl. Intended for debugging and factory test tools;
	  raw access requires CAP_SYS_ADMIN and can disturb the state
	  a bound function driver maintains.

if MMC

source "drivers/mmc/core/Kconfig"

source "drivers/mmc/host/Kconfig"

endif # MMC
```

## drivers/mtd/spi-nor/Kconfig
```kconfig
# SPDX-License-Identifier: GPL-2.0-only
menuconfig MTD_SPI_NOR
	tristate "SPI NOR device support"
	depends on MTD && SPI_MASTER
	select SPI_MEM
	help
	  This is the framework for the SPI NOR which can be used by the SPI
	  device drivers and the SPI NOR device driver.

if MTD_SPI_NOR

config MTD_SPI_NOR_USE_4K_SECTORS
	bool "Use small 4096 B erase sectors"
	default y
	help
	  Many flash memories support erasing small (4096 B) sectors. Depending
	  on the usage this feature may provide performance gain in comparison
	  to erasing whole blocks (32/64 KiB).
	  Changing a small part of the flash's contents is usually faster with
	  small sectors. On the other hand erasing should be faster when using
	  64 KiB block instead of 16 × 4 KiB sectors.
	  If MTD_SPI_NOR_MULTI_ERASE_SIZE is also enabled, the flash erasesize
	  is reported as 4096 B, but large erase requests may still use larger
	  erase sizes internally to improve performance.

	  Please note that some tools/drivers/filesystems may not work with
	  4096 B erase size (e.g. UBIFS requires 15 KiB as a minimum).

config MTD_SPI_NOR_MULTI_ERASE_SIZE
	bool "Use multiple erase sizes on uniform flashes"
	default n
	help
	  Uniform SPI NOR flashes (whose erase map spans the whole device) may
	  still advertise several erase sizes, e.g. 4 KiB, 32 KiB and 64 KiB.
	  By default the driver collapses such a flash to a single erase size
	  and uses that one size for every erase request.

	  Say Y here to let those flashes use multiple erase sizes for a single
	  erase request, exactly like non-uniform flashes already do: larger
	  blocks are used for the aligned bulk of the range, while smaller
	  blocks are used for the unaligned head and tail. This improves erase
	  performance when a smaller erasesize is exposed to userspace.

	  This option interacts with MTD_SPI_NOR_USE_4K_SECTORS: when both are
	  enabled, the 4096 B erase size is exposed through mtd->erasesize, but
	  the driver still uses multiple erase sizes internally to improve
	  performance.

	  If unsure, say N.

choice
	prompt "Software write protection at boot"
	default MTD_SPI_NOR_SWP_DISABLE_ON_VOLATILE

config MTD_SPI_NOR_SWP_DISABLE
	bool "Disable SWP on any flashes (legacy behavior)"
	help
	  This option disables the software write protection on any SPI
	  flashes at boot-up.

	  Depending on the flash chip this either clears the block protection
	  bits or does a "Global Unprotect" command.

	  Don't use this if you intent to use the software write protection
	  of your SPI flash. This is only to keep backwards compatibility.

config MTD_SPI_NOR_SWP_DISABLE_ON_VOLATILE
	bool "Disable SWP on flashes w/ volatile protection bits"
	help
	  Some SPI flashes have volatile block protection bits, ie. after a
	  power-up or a reset the flash is software write protected by
	  default.

	  This option disables the software write protection for these kind
	  of flashes while keeping it enabled for any other SPI flashes
	  which have non-volatile write protection bits.

	  If the software write protection will be disabled depending on
	  the flash either the block protection bits are cleared or a
	  "Global Unprotect" command is issued.

	  If you are unsure, select this option.

config MTD_SPI_NOR_SWP_KEEP
	bool "Keep software write protection as is"
	help
	  If you select this option the software write protection of any
	  SPI flashes will not be changed. If your flash is software write
	  protected or will be automatically software write protected after
	  power-up you have to manually unlock it before you are able to
	  write to it.

endchoice

source "drivers/mtd/spi-nor/controllers/Kconfig"

endif # MTD_SPI_NOR
```

## drivers/mtd/spi-nor/controllers/Kconfig
```kconfig
# SPDX-License-Identifier: GPL-2.0-only
config SPI_HISI_SFC
	tristate "Hisilicon FMC SPI NOR Flash Controller(SFC)"
	depends on ARCH_HISI || COMPILE_TEST
	depends on HAS_IOMEM
	help
	  This enables support for HiSilicon FMC SPI NOR flash controller.

config SPI_NXP_SPIFI
	tristate "NXP SPI Flash Interface (SPIFI)"
	depends on OF && (ARCH_LPC18XX || COMPILE_TEST)
	depends on HAS_IOMEM
	help
	  Enable support for the NXP LPC SPI Flash Interface controller.

	  SPIFI is a specialized controller for connecting serial SPI
	  Flash. Enable this option if you have a device with a SPIFI
	  controller and want to access the Flash as a mtd device.

config SPI_WMT_SFLASH
	tristate "VIA/WonderMedia serial flash controller"
	depends on ARCH_VT8500 || COMPILE_TEST
	depends on OF
	depends on HAS_IOMEM
	help
	  Enable support for the VIA/WonderMedia serial flash controller.

	  This is the specialized controller driving SPI NOR flash chips
	  inside VIA/WonderMedia SoCs. Most if not all VIA/WonderMedia
	  based devices use SPI NOR flash as their boot storage, so select
	  this if you need to access the primary or secondary bootloader
	  and their environment partitions.
```

## drivers/net/cpc/Kconfig
```kconfig
# SPDX-License-Identifier: GPL-2.0

menuconfig CPC
	tristate "Silicon Labs Co-Processor Communication (CPC) Protocol"
	depends on NET && SPI
	select CRC_ITU_T
	help
	  Provide support for the CPC protocol to Silicon Labs EFR32 devices.

	  CPC provides a way to multiplex data channels over a shared physical
	  link. These data channels can carry Bluetooth, Wi-Fi, or any arbitrary
	  data. Depending on the part and the firmware, the set of available
	  channels may differ.

	  Say Y here to compile support for CPC into the kernel or say M to
	  compile as a module.
```

## drivers/net/dsa/hms/Kconfig
```kconfig
# SPDX-License-Identifier: GPL-2.0-only
config NET_DSA_HMS_SWITCH
	tristate "NXP HMS DSA switch driver"
	depends on NET_DSA
	depends on SPI
	select NET_DSA_TAG_HMS
	select NET_DSA_TAG_8021Q
	help
	  This enables support for the NXP i.MX RT1180 NETC Ethernet
	  switch managed through the Heterogeneous Multi-SoC (HMS)
	  interface over SPI.

	  Say Y or M if your system uses an i.MX RT1180 as a companion
	  switch controller and exposes its switch ports through DSA.
```

## drivers/net/dsa/mxl862xx/Kconfig
```kconfig
# SPDX-License-Identifier: GPL-2.0-only
config NET_DSA_MXL862
	tristate "MaxLinear MxL862xx"
	depends on NET_DSA
	select MAXLINEAR_GPHY
	select NET_DSA_TAG_MXL862
	help
	  This enables support for the MaxLinear MxL862xx switch family.
	  These switches got two 10GE SerDes interfaces, one typically
	  used as CPU port.
	   MxL86282 Eight 2.5 Gigabit PHYs
	   MxL86252 Five 2.5 Gigabit PHYs
```
