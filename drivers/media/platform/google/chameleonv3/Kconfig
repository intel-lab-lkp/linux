## drivers/net/dsa/xilinx/Kconfig
```kconfig
# SPDX-License-Identifier: GPL-2.0-or-later
config NET_DSA_XILINX_TSN
	tristate "AMD/Xilinx TSN Endpoint Ethernet MAC switch support"
	depends on OF && HAS_IOMEM
	depends on NET_DSA
	depends on PTP_1588_CLOCK
	select NET_DSA_TAG_XLNX_TSN
	help
	  This enables DSA switch support for the three-port switch
	  block of the AMD/Xilinx TSN Endpoint Ethernet MAC IP. Port 0
	  is the CPU port, wired internally to the endpoint MAC; ports 1
	  and 2 are external Ethernet ports backed by MAC1 and MAC2.
```

## drivers/net/ethernet/airoha/Kconfig
```kconfig
# SPDX-License-Identifier: GPL-2.0-only
config NET_VENDOR_AIROHA
	bool "Airoha devices"
	depends on ARCH_AIROHA || COMPILE_TEST
	help
	  If you have a Airoha SoC with ethernet, say Y.

if NET_VENDOR_AIROHA

config NET_AIROHA_NPU
	tristate "Airoha NPU support"
	select WANT_DEV_COREDUMP
	select REGMAP_MMIO
	help
	  This driver supports Airoha Network Processor (NPU) available
	  on the Airoha Soc family.

config NET_AIROHA
	tristate "Airoha SoC Gigabit Ethernet support"
	depends on NET_DSA || !NET_DSA
	select NET_AIROHA_NPU
	select PAGE_POOL
	help
	  This driver supports the gigabit ethernet MACs in the
	  Airoha SoC family.

config NET_AIROHA_FLOW_STATS
	default y
	bool "Airoha flow stats"
	depends on NET_AIROHA && NET_AIROHA_NPU
	help
	  Enable Aiorha flowtable statistic counters.

config NET_AIROHA_XFRM
	bool "Airoha ESP XFRM offload support"
	depends on NET_AIROHA
	default y
	help
	  Enable ESP XFRM offload support for Airoha Ethernet netdevs.

	  If unsure, say Y. Say N to opt out of advertising ESP hardware
	  offload from the Airoha Ethernet driver even when the EIP93 IPsec
	  packet backend and XFRM offload support are available.

endif #NET_VENDOR_AIROHA
```
