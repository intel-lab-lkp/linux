// SPDX-License-Identifier: GPL-2.0
/dts-v1/;
/plugin/;

/*
 * overlay_alias - declare an /aliases entry that points, via label, at a
 * node grafted under the run-time target base (empty target-path).
 */

/ {
	fragment@0 {
		target-path = "";
		__overlay__ {
			testcase_target: alias-target {
			};
		};
	};

	fragment@1 {
		target-path = "/aliases";
		__overlay__ {
			testcase-alias99 = &testcase_target;
		};
	};
};
