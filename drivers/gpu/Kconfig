## drivers/gpu/drm/sysfb/Kconfig
```kconfig
# SPDX-License-Identifier: GPL-2.0-only

menu "Drivers for system framebuffers"

config DRM_SYSFB_HELPER
	tristate

config DRM_COREBOOTDRM
	tristate "Coreboot framebuffer driver"
	depends on MMU
	depends on GOOGLE_FRAMEBUFFER_COREBOOT
	select APERTURE_HELPERS
	select DRM_CLIENT_SELECTION
	select DRM_GEM_SHMEM_HELPER
	select DRM_KMS_HELPER
	select DRM_SYSFB_HELPER
	help
	  DRM driver for coreboot-provided framebuffers.

	  This driver assumes that the display hardware has been initialized
	  by coreboot firmware before the kernel boots. Scanout buffer, size,
	  and display format must be provided via coreboot framebuffer device.

config DRM_EFIDRM
	tristate "EFI framebuffer driver"
	depends on MMU && EFI && (!SYSFB_SIMPLEFB || COMPILE_TEST)
	select APERTURE_HELPERS
	select DRM_CLIENT_SELECTION
	select DRM_GEM_SHMEM_HELPER
	select DRM_KMS_HELPER
	select DRM_SYSFB_HELPER
	select SYSFB
	help
	  DRM driver for EFI framebuffers.

	  This driver assumes that the display hardware has been initialized
	  by the firmware or bootloader before the kernel boots. Scanout
	  buffer, size, and display format must be provided via EFI interfaces.

config DRM_OFDRM
	tristate "Open Firmware display driver"
	depends on MMU && OF && (PPC || COMPILE_TEST)
	select APERTURE_HELPERS
	select DRM_CLIENT_SELECTION
	select DRM_GEM_SHMEM_HELPER
	select DRM_KMS_HELPER
	select DRM_SYSFB_HELPER
	help
	  DRM driver for Open Firmware framebuffers.

	  This driver assumes that the display hardware has been initialized
	  by the Open Firmware before the kernel boots. Scanout buffer, size,
	  and display format must be provided via device tree.

config DRM_SIMPLEDRM
	tristate "Simple framebuffer driver"
	depends on MMU
	select APERTURE_HELPERS
	select DRM_CLIENT_SELECTION
	select DRM_GEM_SHMEM_HELPER
	select DRM_KMS_HELPER
	select DRM_SYSFB_HELPER
	help
	  DRM driver for simple platform-provided framebuffers.

	  This driver assumes that the display hardware has been initialized
	  by the firmware or bootloader before the kernel boots. Scanout
	  buffer, size, and display format must be provided via device tree,
	  UEFI, VESA, etc.

	  On x86 BIOS or UEFI systems, you should also select SYSFB_SIMPLEFB
	  to use UEFI and VESA framebuffers.

config DRM_VESADRM
	tristate "VESA framebuffer driver"
	depends on MMU && X86 && (!SYSFB_SIMPLEFB || COMPILE_TEST)
	select APERTURE_HELPERS
	select DRM_CLIENT_SELECTION
	select DRM_GEM_SHMEM_HELPER
	select DRM_KMS_HELPER
	select DRM_SYSFB_HELPER
	select SYSFB
	help
	  DRM driver for VESA framebuffers.

	  This driver assumes that the display hardware has been initialized
	  by the firmware or bootloader before the kernel boots. Scanout
	  buffer, size, and display format must be provided via VBE interfaces.

endmenu
```

## drivers/gpu/drm/trigger5/Kconfig
```kconfig
# SPDX-License-Identifier: GPL-2.0-only
config DRM_TRIGGER5
	tristate "MCT Trigger 5 USB display adapters"
	depends on DRM && USB && MMU
	select DRM_CLIENT_SELECTION
	select DRM_GEM_SHMEM_HELPER
	select DRM_KMS_HELPER
	help
	  DRM driver for USB display adapters based on the MCT Trigger 5
	  chipset, including the StarTech USB32VGAES and USB32HDES and the
	  j5create JUA310 and JUA350.

	  To compile this driver as a module, choose M here: the module
	  will be called trigger5.
```

## drivers/gpu/drm/v3d/Kconfig
```kconfig
# SPDX-License-Identifier: GPL-2.0-only
config DRM_V3D
	tristate "Broadcom V3D 3.x and newer"
	depends on ARCH_BCM || ARCH_BRCMSTB || ARCH_BCM2835 || COMPILE_TEST
	depends on DRM
	depends on COMMON_CLK
	depends on MMU
	select DRM_SCHED
	select DRM_GEM_SHMEM_HELPER
	help
	  Choose this option if you have a system that has a Broadcom
	  V3D 3.x or newer GPUs. SoCs supported include the BCM2711,
	  BCM7268 and BCM7278.

config DRM_V3D_COPY_QUERY_KUNIT_TEST
	bool "KUnit test for V3D CPU-job copy-query bounds"
	depends on DRM_V3D && KUNIT=y
	select DRM_KUNIT_TEST_HELPERS
	help
	  Builds a KUnit suite that drives the V3D CPU-job copy-timestamp-query
	  handler over a real shmem-backed BO to exercise the destination-buffer
	  bounds. Used to reproduce the copy-query out-of-bounds write under
	  KASAN. If in doubt, say N.
```

## drivers/gpu/drm/vino/Kconfig
```kconfig
# SPDX-License-Identifier: GPL-2.0
config DRM_VINO
	tristate "DisplayLink DL3 (Vino) open driver"
	depends on USB = y
	depends on DRM
	depends on RUST
	select DRM_KMS_HELPER
	select DRM_GEM_SHMEM_HELPER
	select RUST_DRM_GEM_SHMEM_HELPER
	help
	  Open in-kernel Rust driver for DisplayLink DL3 USB docks (Dell
	  Universal Dock D6000 and relatives), reverse-engineered in this tree
	  (see vino-re/docs/00-canonical-guide.md).

	  Phase 0 binds the dock over USB only. USB data transfer, the HDCP 2.2
	  control plane, mode-set, the Vino codec and the DRM/KMS sink are added
	  in later phases (see vino-kmod/README.md).

	  To compile this as a module, choose M here: the module is called vino.

	  If unsure, say N.
```

## drivers/gpu/drm/yhgch/Kconfig
```kconfig
config DRM_YHGCH
    tristate "DRM Support for YHGCH BMC"
    depends on DRM && PCI && MMU
    select DRM_CLIENT_SELECTION
    select DRM_KMS_HELPER
    select DRM_GEM_SHMEM_HELPER
    help
        Choose this option if you have a YHGCH ZX1000 chipset.
        If M is selected the module will be called yhgch-drm.
        IF Y is selected the module will be built into the kernel.
        IF N is selected the module will be excluded from the kernel.
```

## drivers/gpu/nova-core/Kconfig
```kconfig
config NOVA_CORE
	tristate "Nova Core GPU driver"
	depends on 64BIT
	depends on PCI
	depends on RUST
	depends on !CPU_BIG_ENDIAN
	select AUXILIARY_BUS
	select RUST_FW_LOADER_ABSTRACTIONS
	default n
	help
	  Choose this if you want to build the Nova Core driver for Nvidia
	  GPUs based on the GPU System Processor (GSP). This is true for Turing
	  and later GPUs.

	  This driver is work in progress and may not be functional.

	  If M is selected, the module will be called nova-core.

config NOVA_CORE_KEEP_GSP_LOGS
	bool "Retain the GSP-RM log buffers after the GPU is gone"
	depends on NOVA_CORE
	depends on DEBUG_FS
	help
	  The GSP-RM log buffers are exposed through debugfs for as long as the
	  GPU they belong to is bound to the driver. They are of most interest
	  when the GSP fails to boot, but that is also when the driver tears
	  everything down again, so the buffers are removed before anyone gets
	  a chance to read them.

	  Say Y here to copy the buffers into memory owned by the module once
	  the GPU goes away, and expose the copies under a "retained" directory
	  that stays until the module is unloaded. Buffers the GSP never wrote
	  to are skipped; the rest cost 64 KiB each, for up to 192 KiB per GPU.

	  If unsure, say N.
```

## drivers/gpu/trace/Kconfig
```kconfig
# SPDX-License-Identifier: GPL-2.0-only

config TRACE_GPU_MEM
	bool "Enable GPU memory usage tracepoints"
	default n
	help
	  Choose this option to enable tracepoints for tracking
	  global and per-process GPU memory usage. Intended for
	  performance profiling and required for Android.

	  Tracepoint availability varies by GPU driver.

	  If in doubt, say "N".

config TRACE_GPU_WORK_PERIOD
        bool "Enable GPU work period tracepoint"
        default n
        help
          Choose this option to enable tracepoint for tracking
          GPU usage based on the UID. Intended for performance
          profiling and required for Android.

          Tracepoint availability varies by GPU driver.

          If in doubt, say "N".
```

## drivers/greybus/Kconfig
```kconfig
# SPDX-License-Identifier: GPL-2.0
menuconfig GREYBUS
	tristate "Greybus support"
	depends on SYSFS
	help
	  This option enables the Greybus driver core.  Greybus is a
	  hardware protocol that was designed to provide Unipro with a
	  sane application layer.  It was originally designed for the
	  ARA project, a module phone system, but has shown up in other
	  phones, and can be tunneled over other busses in order to
	  control hardware devices.

	  Say Y here to enable support for these types of drivers.

	  To compile this code as a module, choose M here: the module
	  will be called greybus.ko

if GREYBUS

config GREYBUS_BEAGLEPLAY
	tristate "Greybus BeaglePlay driver"
	depends on SERIAL_DEV_BUS
	select CRC_CCITT
	select FW_LOADER
	select FW_UPLOAD
	help
	  Select this option if you have a BeaglePlay where CC1352
	  co-processor acts as Greybus SVC.

	  To compile this code as a module, chose M here: the module
	  will be called gb-beagleplay.ko

config GREYBUS_ES2
	tristate "Greybus ES3 USB host controller"
	depends on USB
	help
	  Select this option if you have a Toshiba ES3 USB device that
	  acts as a Greybus "host controller".  This device is a bridge
	  from a USB device to a Unipro network.

	  To compile this code as a module, choose M here: the module
	  will be called gb-es2.ko

config GREYBUS_SOFTSVC
	tristate "Greybus software SVC"
	depends on RUST
	help
	  Select this option to enable a software implementation of the
	  Greybus SVC (Supervisory Controller) running in the kernel. It can
	  be used by host drivers that talk to a Greybus network which does
	  not provide an SVC of its own.

	  To compile this code as a module, choose M here: the module
	  will be called gb-softsvc.ko

config GREYBUS_UART_NODE
	tristate "Greybus UART node transport"
	depends on RUST
	depends on GREYBUS_SOFTSVC
	depends on RUST_SERIAL_DEV_BUS_ABSTRACTIONS
	select RUST_CRC_CCITT_ABSTRACTIONS
	help
	  Select this option if you have a Greybus node connected over a
	  serial port. The node is registered with the software SVC, which
	  handles the SVC protocol on behalf of the AP, so no dedicated
	  coprocessor running SVC firmware is required.

	  To compile this code as a module, choose M here: the module
	  will be called gb-uart-node.ko

endif	# GREYBUS
```

## drivers/greybus/cpc/Kconfig
```kconfig
# SPDX-License-Identifier: GPL-2.0

config GREYBUS_CPC
	tristate "Greybus CPC driver"
	help
	  CPC (Co-Processor Communication) is a protocol for sharing a single
	  physical link to a coprocessor between multiple users. CPC adds
	  checksumming, retransmissions and flow control to Greybus to transmit
	  messages as reliably as possible.

	  To compile this code as a module, chose M here: the module will be
	  called gb-cpc.ko

config GREYBUS_CPC_SDIO
	tristate "Greybus CPC over SDIO"
	depends on GREYBUS_CPC && MMC
	help
	  This driver provides Greybus CPC host support for devices
	  connected via SDIO interface.

	  To compile this driver as a module, choose M here: the module
	  will be called gb-cpc-sdio.

	  If unsure, say N.
```

## drivers/hid/dockchannel/Kconfig
```kconfig
# SPDX-License-Identifier: GPL-2.0-only OR MIT

config APPLE_DOCKCHANNEL_HID
	tristate "HID over Apple DockChannel"
	depends on APPLE_DOCKCHANNEL
	depends on APPLE_RTKIT
	depends on HID
	depends on INPUT
	depends on OF
	help
	  This provides a HID transport layer over the Apple DockChannel
	  mailbox interface. It is required to support the internal keyboard
	  and trackpad on M2 and later MacBook models.

	  Say Y here if you have an M2 or later Apple MacBook.
```

## drivers/hid/hx-hid/Kconfig
```kconfig
config HX_HID
	tristate "Himax HID simulator for SPI"
	default n
	depends on SPI && INPUT
	select HID
	help
	  Say Y here if you have Himax touch chipset,
	  which is connected to your computer via SPI
	  and you want to use it as a HID device.
	  Revalent Firmware is required, whether from
	  Firmware binary or in IC's flash memory.

	  If unsure, say N.

	  This support is also available as a module.

config HX_HID_IC_83102J
	bool "Himax IC_83012J for Himax HID simulator"
	default y
	depends on HX_HID
	help
	  Say Y here if you have Himax touch IC HX83102J,
	  which is connected to your computer via SPI
	  and you want to use it as a HID device. Please
	  note only one type of IC can be initiated at
	  the same time.

	  If unsure, say Y.

config HX_HID_HEATMAP
	bool "Transferring HEATMAP after coordinate data"
	default y
	depends on HX_HID
	help
	  Say Y here if you need heatmap after coord
	  data. The data can be acquired from hidraw
	  interface. The firmware bundled need to
	  have the ability to send heatmap to make
	  this driver act normally. When enabled,
	  all HX_HID_IC modules are effected.

	  If unsure, say Y.
```

## drivers/hid/rust/Kconfig
```kconfig
# SPDX-License-Identifier: GPL-2.0-only
menu "Rust HID support"

config RUST_HID_ABSTRACTIONS
	bool "Rust HID abstractions support"
	depends on RUST
	depends on HID=y
	help
	  Adds support needed for HID drivers written in Rust. It provides a
	  wrapper around the C hid core.

endmenu # Rust HID support
```

## drivers/i3c/Kconfig
```kconfig
# SPDX-License-Identifier: GPL-2.0

menuconfig I3C
	tristate "I3C support"
	select I2C
	help
	  I3C is a serial protocol standardized by the MIPI alliance.

	  It's supposed to be backward compatible with I2C while providing
	  support for high speed transfers and native interrupt support
	  without the need for extra pins.

	  The I3C protocol also standardizes the target device types and is
	  mainly designed to communicate with sensors.

	  If you want I3C support, you should say Y here and also to the
	  specific driver for your bus adapter(s) below.

	  This I3C support can also be built as a module.  If so, the module
	  will be called i3c.

if I3C
source "drivers/i3c/master/Kconfig"
endif # I3C

config I3C_TARGET
	bool "I3C Target Support"
	help
	  Support I3C Target Mode.

	  Enable this configuration option to support configurable I3C target.
	  This should be enabled if the platform has a I3C controller that can
	  operate in target mode.

	  Enabling this option will build the I3C target library, which includes
	  target controller library and target function library.

	  If in doubt, say "N" to disable target support.

config I3C_TARGET_CONFIGFS
	bool "I3C Target Configfs Support"
	depends on I3C_TARGET
	select CONFIGFS_FS
	help
	  Configfs entry for target function and controller.

	  This will enable the configfs entry that can be used to configure
	  the target function and used to bind the function with a target
	  controller.
```
