## drivers/gpu/Kconfig
```kconfig
# SPDX-License-Identifier: GPL-2.0

config GPU_BUDDY
       bool "Page based buddy allocator for GPU memory" if KUNIT
       depends on DRM || COMPILE_TEST
       help
         A page based buddy allocator for GPU memory.

config GPU_BUDDY_KUNIT_TEST
       tristate "KUnit tests for GPU buddy allocator" if !KUNIT_ALL_TESTS
       depends on KUNIT
       depends on GPU_BUDDY
       default KUNIT_ALL_TESTS
       help
         KUnit tests for the GPU buddy allocator.
```

## drivers/gpu/drm/bridge/tda/Kconfig
```kconfig
# SPDX-License-Identifier: GPL-2.0-only
config DRM_I2C_NXP_TDA998X
	tristate "NXP Semiconductors TDA998X HDMI encoder"
	default m if DRM_TILCDC
	select CEC_CORE if CEC_NOTIFIER
	select SND_SOC_HDMI_CODEC if SND_SOC
	help
	  Support for NXP Semiconductors TDA998X HDMI encoders.

config DRM_I2C_NXP_TDA9950
	tristate "NXP Semiconductors TDA9950/TDA998X HDMI CEC"
	select CEC_NOTIFIER
	select CEC_CORE
```

## drivers/gpu/drm/chipwealth/Kconfig
```kconfig
# SPDX-License-Identifier: GPL-2.0-only
config DRM_CH1115_I2C
	tristate "DRM support for Ch1115 OLED panels (I2C BUS)"
	depends on DRM && I2C
	select DRM_CLIENT_SELECTION
	select DRM_GEM_SHMEM_HELPER
	select DRM_KMS_HELPER
	select REGMAP_I2C
	select VIDEOMODE_HELPERS
	help
	  Chipwealth CH1115 is a controller for monochrome dot matrix OLED
	  panels.

	  DRM Driver for Ch1115 OLED panels connected via I2C.

	  If M is selected the module will be called ch1115-i2c.
```

## drivers/gpu/drm/clients/Kconfig
```kconfig
# SPDX-License-Identifier: GPL-2.0-only

config DRM_CLIENT_LIB
	tristate
	depends on DRM
	select DRM_KMS_HELPER if DRM_FBDEV_EMULATION
	select FB_CORE if DRM_FBDEV_EMULATION
	help
	  This option enables the DRM client library and selects all
	  modules and components according to the enabled clients.

config DRM_CLIENT_SELECTION
	tristate
	depends on DRM
	select DRM_CLIENT_LIB if DRM_CLIENT_SPLASH
	select DRM_CLIENT_LIB if DRM_CLIENT_LOG
	select DRM_CLIENT_LIB if DRM_FBDEV_EMULATION
	help
	  Drivers that support in-kernel DRM clients have to select this
	  option.

config DRM_CLIENT_SETUP
	bool
	depends on DRM_CLIENT_SELECTION
	help
	  Enables the DRM client selection. DRM drivers that support the
	  default clients should select DRM_CLIENT_SELECTION instead.

menu "Supported DRM clients"
	depends on DRM_CLIENT_SELECTION

config DRM_FBDEV_EMULATION
	bool "Enable legacy fbdev support for your modesetting driver"
	depends on DRM_CLIENT_SELECTION
	select DRM_CLIENT
	select DRM_CLIENT_SETUP
	select FRAMEBUFFER_CONSOLE_DETECT_PRIMARY if FRAMEBUFFER_CONSOLE
	default FB
	help
	  Choose this option if you have a need for the legacy fbdev
	  support. Note that this support also provides the linux console
	  support on top of your modesetting driver.

	  If in doubt, say "Y".

config DRM_FBDEV_OVERALLOC
	int "Overallocation of the fbdev buffer"
	depends on DRM_FBDEV_EMULATION
	default 100
	help
	  Defines the fbdev buffer overallocation in percent. Default
	  is 100. Typical values for double buffering will be 200,
	  triple buffering 300.

config DRM_FBDEV_LEAK_PHYS_SMEM
	bool "Shamelessly allow leaking of fbdev physical address (DANGEROUS)"
	depends on DRM_FBDEV_EMULATION && EXPERT
	default n
	help
	  In order to keep user-space compatibility, we want in certain
	  use-cases to keep leaking the fbdev physical address to the
	  user-space program handling the fbdev buffer.
	  This affects, not only, Amlogic, Allwinner or Rockchip devices
	  with ARM Mali GPUs using a userspace Blob.
	  This option is not supported by upstream developers and should be
	  removed as soon as possible and be considered as a broken and
	  legacy behaviour from a modern fbdev device driver.

	  Please send any bug reports when using this to your proprietary
	  software vendor that requires this.

	  If in doubt, say "N" or spread the word to your closed source
	  library vendor.

config DRM_CLIENT_LOG
	bool "Print the kernel boot message on the screen"
	depends on DRM_CLIENT_SELECTION
	select DRM_CLIENT
	select DRM_CLIENT_SETUP
	select DRM_DRAW
	select FONT_SUPPORT
	help
	  This enable a drm logger, that will print the kernel messages to the
	  screen until the userspace is ready to take over.

	  If you only need logs, but no terminal, or if you prefer userspace
	  terminal, say "Y".

config DRM_CLIENT_SPLASH
	bool "Display graphic splash"
	depends on DRM_CLIENT_SELECTION
	select DRM_CLIENT
	select DRM_CLIENT_SETUP
	select DRM_DRAW
	help
	  This enables a splash drm client, able to display either a plain
	  color or a static image until the userspace is ready to take over.
	  The splash will be displayed on all screens available at boot, if
	  any, or on the ones part of the first hotplug event.

config DRM_CLIENT_SPLASH_BACKGROUND_COLOR
	hex "Splash background color"
	depends on DRM_CLIENT_SPLASH
	default 0x000000
	help
	  The default splash background color, in RGB888 format.

	  The color can be overridden through the drm_client_lib.splash_color
	  kernel command line parameter.

config DRM_CLIENT_SPLASH_BMP_SUPPORT
	bool

choice
	prompt "Splash source"
	depends on DRM_CLIENT_SPLASH
	default DRM_CLIENT_SPLASH_SRC_COLOR
	help
	  Selects the source for the splash graphic.

config DRM_CLIENT_SPLASH_SRC_COLOR
	bool "Solid color"
	help
	  Use a solid color as splash. The color is selected through the
	  DRM_CLIENT_SPLASH_BACKGROUND_COLOR config option.

	  The image will be loaded using the firmware loading facility the
	  kernel provides.

config DRM_CLIENT_SPLASH_SRC_BMP
	bool "BMP image"
	select DRM_CLIENT_SPLASH_BMP_SUPPORT
	select FW_LOADER
	help
	  Use a BMP (bitmap) image as splash. If the image is smaller than the
	  display(s), it will be centered and the color specified through the
	  DRM_CLIENT_SPLASH_BACKGROUND_COLOR config option will be used as
	  background.

	  The image will be loaded using the firmware loading facility the
	  kernel provides; it shall use 24 bits per pixel and shall not be
	  compressed. The name of the file can be set through the
	  drm_client_lib.splash_bmp command line parameter, with the default
	  being 'drm_splash.bmp'.

config DRM_CLIENT_SPLASH_SRC_BGRT
	bool "EFI BGRT"
	select DRM_CLIENT_SPLASH_BMP_SUPPORT
	depends on EFI
	help
	  Use the BGRT image provided by the EFI bootloader. If the image is
	  smaller than the display(s), it will be centered and the color
	  specified through the DRM_CLIENT_SPLASH_BACKGROUND_COLOR config
	  option will be used as background.

endchoice

choice
	prompt "Default DRM Client"
	depends on DRM_CLIENT_SELECTION
	depends on DRM_FBDEV_EMULATION || DRM_CLIENT_LOG || DRM_CLIENT_SPLASH
	default DRM_CLIENT_DEFAULT_FBDEV
	help
	  Selects the default drm client.

	  The selection made here can be overridden by using the kernel
	  command line 'drm_client_lib.active=fbdev' option.

config DRM_CLIENT_DEFAULT_FBDEV
	bool "fbdev"
	depends on DRM_FBDEV_EMULATION
	help
	  Use fbdev emulation as default drm client. This is needed to have
	  fbcon on top of a drm driver.

config DRM_CLIENT_DEFAULT_LOG
	bool "log"
	depends on DRM_CLIENT_LOG
	help
	  Use drm log as default drm client. This will display boot logs on the
	  screen, but doesn't implement a full terminal. For that you will need
	  a userspace terminal using drm/kms.

config DRM_CLIENT_DEFAULT_SPLASH
	bool "splash"
	depends on DRM_CLIENT_SPLASH
	help
	  Use splash as default drm client.

endchoice

config DRM_CLIENT_DEFAULT
       string
       depends on DRM_CLIENT
       default "fbdev" if DRM_CLIENT_DEFAULT_FBDEV
       default "log" if DRM_CLIENT_DEFAULT_LOG
       default "splash" if DRM_CLIENT_DEFAULT_SPLASH
       default ""

endmenu
```

## drivers/gpu/drm/gma500/Kconfig
```kconfig
# SPDX-License-Identifier: GPL-2.0-only
config DRM_GMA500
	tristate "Intel GMA500/600/3600/3650 KMS Framebuffer"
	depends on DRM && PCI && X86 && MMU
	depends on ACPI_VIDEO || !ACPI
	select DRM_KMS_HELPER
	select FB_IOMEM_HELPERS if DRM_FBDEV_EMULATION
	select I2C
	select I2C_ALGOBIT
	help
	  Say yes for an experimental 2D KMS framebuffer driver for the
	  Intel GMA500 (Poulsbo), Intel GMA600 (Moorestown/Oak Trail) and
	  Intel GMA3600/3650 (Cedar Trail).
```

## drivers/gpu/drm/gud/Kconfig
```kconfig
# SPDX-License-Identifier: GPL-2.0

config DRM_GUD
	tristate "GUD USB Display"
	depends on DRM && USB && MMU
	depends on BACKLIGHT_CLASS_DEVICE
	select LZ4_COMPRESS
	select DRM_KMS_HELPER
	select DRM_GEM_SHMEM_HELPER
	help
	  This is a DRM display driver for GUD USB Displays or display
	  adapters.

	  If M is selected the module will be called gud.
```

## drivers/gpu/drm/imx/dcif/Kconfig
```kconfig
config DRM_IMX_DCIF
	tristate "DRM support for NXP i.MX94 DCIF"
	select DRM_KMS_HELPER
	select VIDEOMODE_HELPERS
	select DRM_GEM_DMA_HELPER
	select DRM_DISPLAY_HELPER
	select DRM_BRIDGE_CONNECTOR
	select DRM_CLIENT_SELECTION
	depends on DRM && OF && ARCH_MXC
	depends on COMMON_CLK
	help
	  Enable NXP i.MX94 Display Control Interface(DCIF) support. The DCIF is
	  a system master that fetches graphics stored in memory and displays
	  them on a TFT LCD panel or connects to a display interface depending
	  on the chip configuration.
```

## drivers/gpu/drm/mgag200/Kconfig
```kconfig
# SPDX-License-Identifier: GPL-2.0-only
config DRM_MGAG200
	tristate "Matrox G200"
	depends on DRM && PCI && MMU
	select DRM_GEM_SHMEM_HELPER
	select DRM_KMS_HELPER
	select I2C
	select I2C_ALGOBIT
	help
	 This is a KMS driver for Matrox G200 chips. It supports the original
	 MGA G200 desktop chips and the server variants. It requires 0.3.0
	 of the modesetting userspace driver, and a version of mga driver
	 that will fail on KMS enabled devices.

config DRM_MGAG200_DISABLE_WRITECOMBINE
	bool "Disable Write Combine mapping of VRAM"
	depends on DRM_MGAG200 && PREEMPT_RT
	help
	  The VRAM of the G200 is mapped with Write-Combine, to improve
	  performances. However this increases the system latency a lot, even
	  for realtime tasks running on other CPU cores. Typically 40us-80us
	  latencies are measured with hwlat when Write Combine is enabled.
	  Recommended if you run realtime tasks on a server with a Matrox G200.
```

## drivers/gpu/drm/nova/Kconfig
```kconfig
config DRM_NOVA_STUB
	tristate "Nova GPU driver stub"
	depends on DRM
	depends on PCI
	depends on RUST
	default n
	help
	  Choose this if you want to build the Nova stub driver for Nvidia
	  GSP-based GPUs.

	  If M is selected, the module will be called nova.
```

## drivers/gpu/drm/panthor/Kconfig
```kconfig
# SPDX-License-Identifier: GPL-2.0 or MIT

config DRM_PANTHOR
	tristate "Panthor (DRM support for ARM Mali CSF-based GPUs)"
	depends on DRM
	depends on ARM || ARM64 || COMPILE_TEST
	depends on !GENERIC_ATOMIC64  # for IOMMU_IO_PGTABLE_LPAE
	depends on MMU
	select DEVFREQ_GOV_SIMPLE_ONDEMAND
	select DRM_EXEC
	select DRM_GPUVM
	select DRM_SCHED
	select IOMMU_IO_PGTABLE_LPAE
	select IOMMU_SUPPORT
	select PM_DEVFREQ
	help
	  DRM driver for ARM Mali CSF-based GPUs.

	  This driver is for Mali (or Immortalis) Valhall Gxxx GPUs.

	  Note that the Mali-G68 and Mali-G78, while Valhall architecture, will
	  be supported with the panfrost driver as they are not CSF GPUs.

config DRM_PANTHOR_SYSTEM
	tristate "GPU-wide configuration for Arm Mali 5th Gen AM GPUs"
	depends on DRM_PANTHOR
	depends on OF
	help
	  Enable support for the AM_SYSTEM block found on Arm Mali 5th Gen
	  AM GPUs. This block provides GPU-wide control outside the main GPU
	  register window, including reset handling and management of shared
	  clock and regulator resources.

config DRM_PANTHOR_ARBITRATION
	tristate "HW-assisted virtualization for Mali 5th Gen AM GPUs"
	depends on DRM_PANTHOR
	depends on OF
	help
	  Enable support for the arbitration blocks found on Arm Mali 5th Gen
	  AM GPUs. These blocks manage partition controls, resource groups and
	  access-window scheduling, allowing multiple access windows to share
	  GPU resources under hardware-assisted arbitration.
```

## drivers/gpu/drm/solomon/Kconfig
```kconfig
config DRM_SSD130X
	tristate "DRM support for Solomon SSD13xx OLED displays"
	depends on DRM && MMU
	select BACKLIGHT_CLASS_DEVICE
	select DRM_CLIENT_SELECTION
	select DRM_GEM_SHMEM_HELPER
	select DRM_KMS_HELPER
	help
	  DRM driver for the SSD13xx Solomon and SINO WEALTH SH110x OLED
	  controllers. This is only for the core driver, a driver for the
	  appropriate bus transport in your chip also must be selected.

	  If M is selected the module will be called ssd130x.

config DRM_SSD130X_I2C
	tristate "DRM support for Solomon SSD13xx OLED displays (I2C bus)"
	depends on DRM_SSD130X && I2C
	select REGMAP_I2C
	help
	  Say Y here if the SSD13xx or SH110x OLED display is connected via
	  I2C bus.

	  If M is selected the module will be called ssd130x-i2c.

config DRM_SSD130X_SPI
	tristate "DRM support for Solomon SSD13xx OLED displays (SPI bus)"
	depends on DRM_SSD130X && SPI
	select REGMAP
	help
	  Say Y here if the SSD13xx OLED display is connected via SPI bus.

	  If M is selected the module will be called ssd130x-spi.

config DRM_SSD1351
	tristate "DRM support for Solomon SSD1351 OLED displays"
	depends on DRM && SPI && MMU
	select DRM_CLIENT_SELECTION
	select DRM_GEM_SHMEM_HELPER
	select DRM_KMS_HELPER
	help
	  DRM driver for the Solomon SSD1351 RGB565 color OLED controller
	  connected via 4-wire SPI. It drives up to a 128x128 65k-color
	  panel and uploads pixels in the controller's native RGB565
	  format, exposing a standard DRM/KMS device to userspace.

	  If M is selected the module will be called ssd1351.
```
