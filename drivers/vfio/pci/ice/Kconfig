## kernel/gcov/Kconfig
```kconfig
# SPDX-License-Identifier: GPL-2.0-only
menu "GCOV-based kernel profiling"

config GCOV_KERNEL
	bool "Enable gcov-based kernel profiling"
	depends on DEBUG_FS
	depends on !ARCH_WANTS_NO_INSTR || CC_HAS_NO_PROFILE_FN_ATTR
	select CONSTRUCTORS
	default n
	help
	This option enables gcov-based code profiling (e.g. for code coverage
	measurements).

	If unsure, say N.

	Additionally specify CONFIG_GCOV_PROFILE_ALL=y to get profiling data
	for the entire kernel. To enable profiling for specific files or
	directories, add a line similar to the following to the respective
	Makefile:

	For a single file (e.g. main.o):
	        GCOV_PROFILE_main.o := y

	For all files in one directory:
	        GCOV_PROFILE := y

	To exclude files from being profiled even when CONFIG_GCOV_PROFILE_ALL
	is specified, use:

	        GCOV_PROFILE_main.o := n
	and:
	        GCOV_PROFILE := n

	Note that the debugfs filesystem has to be mounted to access
	profiling data.

config ARCH_HAS_GCOV_PROFILE_ALL
	def_bool n

config GCOV_PROFILE_ALL
	bool "Profile entire Kernel"
	depends on !COMPILE_TEST
	depends on GCOV_KERNEL
	depends on ARCH_HAS_GCOV_PROFILE_ALL
	default n
	help
	This options activates profiling for the entire kernel.

	If unsure, say N.

	Note that a kernel compiled with profiling flags will be significantly
	larger and run slower. Also be sure to exclude files from profiling
	which are not linked to the kernel image to prevent linker errors.

config GCOV_CONDITION_COVERAGE
	bool "Enable MC/DC condition coverage instrumentation"
	depends on GCOV_KERNEL
	depends on CC_HAS_CONDITION_COVERAGE
	default n
	help
	This option adds Modified Condition/Decision Coverage (MC/DC)
	instrumentation using GCC's -fcondition-coverage flag. MC/DC
	coverage data can be viewed using gcov --conditions.

	MC/DC is required by safety standards such as DO-178C (avionics)
	and ISO 26262 (automotive).

	This increases instrumentation overhead. If unsure, say N.

endmenu
```

## kernel/livepatch/Kconfig
```kconfig
# SPDX-License-Identifier: GPL-2.0-only
config HAVE_LIVEPATCH
	bool
	help
	  Arch supports kernel live patching

config LIVEPATCH
	bool "Kernel Live Patching"
	depends on DYNAMIC_FTRACE_WITH_REGS || DYNAMIC_FTRACE_WITH_ARGS
	depends on MODULES
	depends on SYSFS
	depends on KALLSYMS_ALL
	depends on HAVE_LIVEPATCH
	depends on !TRIM_UNUSED_KSYMS
	help
	  Say Y here if you want to support kernel live patching.
	  This option has no runtime impact until a kernel "patch"
	  module uses the interface provided by this option to register
	  a patch, causing calls to patched functions to be redirected
	  to new function code contained in the patch module.

config LIVEPATCH_DEBUG
	bool "Kernel Live Patching debug"
	depends on LIVEPATCH
	help
	  Say Y here to print a debug level message with pr_debug() for
	  the Kernel Live Patching code, it is a easy way to get debug
	  information without dynamic debugging.
```

## kernel/liveupdate/Kconfig
```kconfig
# SPDX-License-Identifier: GPL-2.0-only

menu "Live Update"

config KEXEC_HANDOVER
	bool "kexec handover"
	depends on ARCH_SUPPORTS_KEXEC_HANDOVER && ARCH_SUPPORTS_KEXEC_FILE
	depends on !DEFERRED_STRUCT_PAGE_INIT
	select MEMBLOCK_KHO_SCRATCH
	select KEXEC_FILE
	select DEBUG_FS
	select LIBFDT
	select CMA
	help
	  Allow kexec to hand over state across kernels by generating and
	  passing additional metadata to the target kernel. This is useful
	  to keep data or state alive across the kexec. For this to work,
	  both source and target kernels need to have this option enabled.

config KEXEC_HANDOVER_DEBUGFS
	bool "kexec handover debugfs interface"
	depends on KEXEC_HANDOVER
	depends on DEBUG_FS
	help
	  Allow to control kexec handover device tree via debugfs
	  interface, i.e. finalize the state or aborting the finalization.
	  Also, enables inspecting the KHO fdt trees with the debugfs binary
	  blobs.

config KEXEC_HANDOVER_DEBUG
	bool "Enable Kexec Handover debug checks"
	depends on KEXEC_HANDOVER_DEBUGFS
	help
	  This option enables extra sanity checks for the Kexec Handover
	  subsystem.

	  These checks verify that neither preserved memory regions nor KHO's
	  internal metadata are allocated from within a KHO scratch area.
	  An overlap can lead to memory corruption during a subsequent kexec
	  operation.

	  If an overlap is detected, the kernel will print a warning and the
	  offending operation will fail. This should only be enabled for
	  debugging purposes due to runtime overhead.
endmenu
```

## kernel/llvm-cov/Kconfig
```kconfig
# SPDX-License-Identifier: GPL-2.0-only
menu "Clang's source-based kernel coverage measurement (EXPERIMENTAL)"

config ARCH_HAS_LLVM_COV
	bool
	help
	  An architecture should select this option if it supports Clang's
	  source-based code coverage. To enable this for your architecture:

	  1. Exclude files that must be uninstrumented from profiling:
	     - Early boot code before instrumentation is initialized
	     - Interrupt and exception handlers
	     - Any code running at EL2 or higher privilege levels

	  2. Add llvm-cov sections to your linker script (vmlinux.lds.S):
	     - Add the __llvm_prf_data, __llvm_prf_cnts, __llvm_prf_names,
	       and __llvm_prf_bits sections
	     - See arch/x86/kernel/vmlinux.lds.S for reference

	  3. Ensure your architecture handles:
	     - Large kernel image size increases (2-3x)
	     - Performance overhead from instrumentation

config ARCH_HAS_LLVM_COV_PROFILE_ALL
	bool

config LLVM_COV_KERNEL
	bool "Enable Clang's source-based kernel coverage measurement"
	depends on DEBUG_FS
	depends on ARCH_HAS_LLVM_COV
	depends on CC_IS_CLANG && CLANG_VERSION >= 180000
	depends on !GCOV_KERNEL
	help
	  This option enables Clang's Source-based Code Coverage.

	  LLVM Coverage and GCOV are mutually exclusive profiling methods.
	  LLVM Coverage provides more accurate source-level coverage data
	  and better handling of C++ features, while GCOV may have broader
	  architecture support.

	  If unsure, say N.

	  On a kernel compiled with this option, run your test suites, and
	  download the raw profile from /sys/kernel/debug/llvm-cov/profraw.
	  This file can then be converted into the indexed format with
	  llvm-profdata and used to generate coverage reports with llvm-cov.

	  Additionally specify CONFIG_LLVM_COV_PROFILE_ALL=y to get profiling
	  data for the entire kernel. To enable profiling for specific files or
	  directories, add a line similar to the following to the respective
	  Makefile:

	  For a single file (e.g. main.o):
	          LLVM_COV_PROFILE_main.o := y

	  For all files in one directory:
	          LLVM_COV_PROFILE := y

	  To exclude files from being profiled even when
	  CONFIG_LLVM_COV_PROFILE_ALL is specified, use:

	          LLVM_COV_PROFILE_main.o := n
	  and:
	          LLVM_COV_PROFILE := n

	  Note that a kernel compiled with coverage flags will be significantly
	  larger and run slower.

	  Note that the debugfs filesystem has to be mounted to access the raw
	  profile.

config LLVM_COV_PROFILE_ALL
	bool "Profile entire Kernel"
	depends on !COMPILE_TEST
	depends on LLVM_COV_KERNEL
	depends on ARCH_HAS_LLVM_COV_PROFILE_ALL
	help
	  This options activates profiling for the entire kernel.

	  If unsure, say N.

	  Note that a kernel compiled with profiling flags will be significantly
	  larger and run slower.

endmenu
```

## kernel/meminspect/Kconfig
```kconfig
# SPDX-License-Identifier: GPL-2.0

config MEMINSPECT
	bool "Allow the kernel to register memory regions for inspection purpose"
	help
	  Inspection mechanism allows registration of a specific memory
	  area(or object) for later inspection purpose.
	  Ranges are being added into an inspection table, which can be
	  requested and analyzed by specific drivers.
	  Drivers would interface any hardware mechanism that will allow
	  inspection of the data, including but not limited to: dumping
	  for debugging, creating a coredump, analysis, or statistical
	  information.
	  Inspection table is created ahead of time such that it can be later
	  used regardless of the state of the kernel (running, frozen, crashed,
	  or any particular state).

	  Note that modules using this feature must be rebuilt if option
	  changes.

config MEMINSPECT_KINFO
	tristate "Shared memory KInfo compatible driver"
	depends on MEMINSPECT
	help
	  Say y here to enable the Shared memory KInfo compatible driver
	  With this driver, the registered regions are copied to a shared
	  memory zone at register time.
	  The shared memory zone is supplied via OF.
	  This driver will select only regions that are of interest,
	  and keep only addresses. The format of the list is Kinfo compatible.
```

## kernel/trace/rv/Kconfig
```kconfig
# SPDX-License-Identifier: GPL-2.0-only
#
config DA_MON_EVENTS
	bool

config DA_MON_EVENTS_IMPLICIT
	select DA_MON_EVENTS
	bool

config DA_MON_EVENTS_ID
	select DA_MON_EVENTS
	bool

menuconfig RV
	bool "Runtime Verification"
	select TRACING
	help
	  Enable the kernel runtime verification infrastructure. RV is a
	  lightweight (yet rigorous) method that complements classical
	  exhaustive verification techniques (such as model checking and
	  theorem proving). RV works by analyzing the trace of the system's
	  actual execution, comparing it against a formal specification of
	  the system behavior.

	  For further information, see:
	    Documentation/trace/rv/runtime-verification.rst

source "kernel/trace/rv/monitors/wip/Kconfig"
source "kernel/trace/rv/monitors/wwnr/Kconfig"
# Add new monitors here

config RV_MON_RTAPP_BLOCK
	depends on RV
	select DA_MON_EVENTS
	select TRACE_IRQFLAGS
	select TRACE_RT_MUTEX_WAKE_WAITER
	bool "rtapp_block monitor"
	help
	  Enable rtapp_wakeup which monitors that realtime tasks are not blocked.
	  For details, see Documentation/trace/rv/monitor_rtapp_block.rst.

config RV_MON_RTAPP_PAGEFAULT
	depends on RV
	select DA_MON_EVENTS
	bool "rtapp_pagefault monitor"
	help
	  Enable rtapp_pagefault which monitors that real-time tasks do not raise page faults.
	  See Documentation/trace/rv/monitor_rtapp_pagefault.rst for full details.

config RV_REACTORS
	bool "Runtime verification reactors"
	default y
	depends on RV
	help
	  Enables the online runtime verification reactors. A runtime
	  monitor can cause a reaction to the detection of an exception
	  on the model's execution. By default, the monitors have
	  tracing reactions, printing the monitor output via tracepoints,
	  but other reactions can be added (on-demand) via this interface.

config RV_REACT_PRINTK
	bool "Printk reactor"
	depends on RV_REACTORS
	default y
	help
	  Enables the printk reactor. The printk reactor emits a printk()
	  message if an exception is found.

config RV_REACT_PANIC
	bool "Panic reactor"
	depends on RV_REACTORS
	default y
	help
	  Enables the panic reactor. The panic reactor emits a printk()
	  message if an exception is found and panic()s the system.
```
