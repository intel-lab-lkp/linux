## drivers/vfio/pci/ice/Kconfig
```kconfig
# SPDX-License-Identifier: GPL-2.0-only
config ICE_VFIO_PCI
	tristate "VFIO support for Intel(R) Ethernet Connection E800 Series"
	depends on ICE
	select VFIO_PCI_CORE
	help
	  This provides migration support for Intel(R) Ethernet connection E800
	  series devices using the VFIO framework.
```

## drivers/vfio/pci/qcom/Kconfig
```kconfig
# SPDX-License-Identifier: GPL-2.0-only
config QCOM_VFIO_PCI
	tristate "VFIO support for Qualcomm PCI devices"
	depends on PCI
	select VFIO_PCI_CORE
	help
	  This provides VFIO support for Qualcomm PCI devices with device-specific
	  quirks. Currently supports:
	  - Qualcomm ath11k WiFi (Device ID 0x1103)
	  - Qualcomm ath12k WiFi (Device ID 0x1107)

	  These devices require special handling for MSI address/data passthrough
	  when used with VFIO. The firmware expects physical host MSI addresses
	  rather than guest IOVA addresses.

	  The VM must have IOMMU interrupt remapping and caching mode enabled.
	  For example, with libvirt/QEMU on Intel, add to the domain XML:
	    <iommu model="intel">
	      <driver intremap="on" caching_mode="on"/>
	    </iommu>

	  If you don't know what to do here, say N.
```

## drivers/vfio/pci/virtio/Kconfig
```kconfig
# SPDX-License-Identifier: GPL-2.0-only
config VIRTIO_VFIO_PCI
        tristate "VFIO support for VIRTIO PCI devices"
        depends on VIRTIO_PCI
        select VFIO_PCI_CORE
        help
          This provides support for exposing VIRTIO VF devices using the VFIO
          framework that can work with a legacy virtio driver in the guest.
          Based on PCIe spec, VFs do not support I/O Space; thus, VF BARs shall
          not indicate I/O Space.
          As of that this driver emulated I/O BAR in software to let a VF be
          seen as a transitional device in the guest and let it work with
          a legacy driver.

          If you don't know what to do here, say N.
```

## drivers/vfio/pci/xe/Kconfig
```kconfig
# SPDX-License-Identifier: GPL-2.0-only
config XE_VFIO_PCI
	tristate "VFIO support for Intel Graphics"
	depends on DRM_XE
	select VFIO_PCI_CORE
	help
	  This option enables vendor-specific VFIO driver for Intel Graphics.
	  In addition to generic VFIO PCI functionality, it implements VFIO
	  migration uAPI allowing userspace to enable migration for
	  Intel Graphics SR-IOV Virtual Functions supported by the Xe driver.

	  If you don't know what to do here, say N.
```

## drivers/virt/coco/Kconfig
```kconfig
# SPDX-License-Identifier: GPL-2.0-only
#
# Confidential computing related collateral
#

config TSM_REPORTS
	select CONFIGFS_FS
	select CRYPTO_HASH_INFO
	select CRYPTO
	tristate "Trusted Security Module (TSM) support"

if TSM_REPORTS

config TSM_MR_MAXBANKS
	int "Max number of banks of Measurement Registers"
	range 1 8
	default 1
	help
	  A "bank" is a group of MRs that use the same hash algorithm. This
	  option specifies the maximal number of banks each Measurement
	  Register (MR) can support.

endif

source "drivers/virt/coco/efi_secret/Kconfig"

source "drivers/virt/coco/pkvm-guest/Kconfig"

source "drivers/virt/coco/sev-guest/Kconfig"

source "drivers/virt/coco/tdx-guest/Kconfig"

source "drivers/virt/coco/arm-cca-guest/Kconfig"
```

## drivers/virt/coco/tdx-guest/Kconfig
```kconfig
config TDX_GUEST_DRIVER
	tristate "TDX Guest driver"
	depends on INTEL_TDX_GUEST
	select TSM_REPORTS
	help
	  The driver provides userspace interface to communicate with the TDX
	  module to request the TDX guest details like attestation report.

	  To compile this driver as module, choose M here. The module will be
	  called tdx-guest.

if TDX_GUEST_DRIVER

config TDX_GUEST_DRIVER_TSM_REPORT
	bool "tdx-guest: Enable TSM raw TDREPORT interface"
	default y
	help
	  This option adds 2 files, namely report0 and reportdata, to the TSM
	  sysfs directory tree (/sys/kernel/tsm/tdx/).

	  To request a TDREPORT, set REPORTDATA by writing to
	  /sys/kernel/tsm/tdx/reportdata, then read
	  /sys/kernel/tsm/tdx/report0.

endif
```

## drivers/virt/coco/tdx-host/Kconfig
```kconfig
config TDX_HOST_SERVICES
	tristate "TDX host user interface driver"
	depends on INTEL_TDX_HOST
	select FW_LOADER
	select FW_UPLOAD
	default m
	help
	  See INTEL_TDX_HOST for details.

	  If unsure, say N.
```

## drivers/virt/steal_governor/Kconfig
```kconfig
# SPDX-License-Identifier: GPL-2.0-only
config STEAL_GOVERNOR
	tristate "Dynamic vCPU management based on steal time"
	depends on PARAVIRT && SMP
	select PREFERRED_CPU
	default m
	help
	  This driver helps to reduce the steal time in paravirtualised
	  environment, thereby reducing vCPU preemption. Reducing vCPU
	  preemption provides improved lock holder preemption and reduces
	  cost of vCPU preemption in the host.

	  By default preferred CPUs will be same as active CPUs. Depending
	  on the steal time when steal_governor driver is enabled,
	  preferred CPUs could become subset of active CPUs.

	  It is recommended to build it as module and load the module
	  to enable it.
```

## fs/dlm/Kconfig
```kconfig
# SPDX-License-Identifier: GPL-2.0-only
menuconfig DLM
	tristate "Distributed Lock Manager (DLM)"
	depends on INET
	depends on SYSFS && CONFIGFS_FS && (IPV6 || IPV6=n)
	help
	A general purpose distributed lock manager for kernel or userspace
	applications.

config DLM_DEBUG
	bool "DLM debugging"
	depends on DLM
	help
	Under the debugfs mount point, the name of each lockspace will
	appear as a file in the "dlm" directory.  The output is the
	list of resource and locks the local node knows about.

config DLM_DLMPFS
	tristate "DLM locking filesystem"
	depends on DLM
	help
	Offers DLM locking API over filesystem operations locking callbacks
	each node needs to create the same named file under this filesystem
	and do locking API as flock or fcntl on it. It can be used if
	using an applications that already use file locking for distributed
	locking operations.
```

## fs/famfs/Kconfig
```kconfig
config FAMFS
       tristate "famfs: shared memory file system"
       depends on 64BIT
       depends on DEV_DAX && FS_DAX && DEV_DAX_FSDEV
       default m if DEV_DAX && FS_DAX && DEV_DAX_FSDEV
       help
	  Support for the famfs file system. Famfs is a dax file system that
	  can support scale-out shared access to fabric-attached memory
	  (e.g. CXL shared memory). Famfs is not a general purpose file system;
	  it is an enabler for data sets in shared memory.
```

## fs/ftrfs/Kconfig
```kconfig
# SPDX-License-Identifier: GPL-2.0-only
#
# FTRFS filesystem configuration
#

config FTRFS_FS
	tristate "FTRFS fault-tolerant radiation-robust filesystem"
	depends on BLOCK
	select CRC32
	select REED_SOLOMON
	select REED_SOLOMON_ENC8
	select REED_SOLOMON_DEC8
	help
	  FTRFS is a POSIX-compatible filesystem designed for dependable
	  storage in radiation-intensive environments. It provides:

	    - CRC32 checksumming per block and per inode
	    - Reed-Solomon forward error correction (FEC)
	    - EDAC-compatible error tracking

	  Originally described in:
	  Fuchs, Langer, Trinitis - ARCS 2015, TU Munich.
	  Targeting embedded Linux on MRAM/NOR flash for space applications.

	  To compile this filesystem support as a module, choose M here.
	  The module will be called ftrfs.

	  If unsure, say N.

config FTRFS_FS_XATTR
	bool "FTRFS extended attributes"
	depends on FTRFS_FS
	help
	  Extended attributes are name:value pairs associated with inodes.
	  They are required for SELinux, POSIX ACLs, and other security
	  frameworks that store per-file metadata outside the inode.
	  FTRFS xattrs follow the same namespace model as ext2/ext4.

	  If you are not using SELinux or POSIX ACLs, say N.
config FTRFS_FS_SECURITY
	bool "FTRFS Security Labels"
	depends on FTRFS_FS_XATTR
	help
	  Extended attributes are name:value pairs associated with inodes.
	  They are required for SELinux, POSIX ACLs, and other security
	  frameworks that store per-file metadata outside the inode.
	  FTRFS xattrs follow the same namespace model as ext2/ext4.

	  If you are not using SELinux or POSIX ACLs, say N.
```

## fs/hpfs/Kconfig
```kconfig
# SPDX-License-Identifier: GPL-2.0-only
config HPFS_FS
	tristate "OS/2 HPFS file system support"
	depends on BLOCK
	select BUFFER_HEAD
	select FS_IOMAP
	help
	  OS/2 is IBM's operating system for PC's, the same as Warp, and HPFS
	  is the file system used for organizing files on OS/2 hard disk
	  partitions. Say Y if you want to be able to read files from and
	  write files to an OS/2 HPFS partition on your hard drive. OS/2
	  floppies however are in regular MSDOS format, so you don't need this
	  option in order to be able to read them. Read
	  <file:Documentation/filesystems/hpfs.rst>.

	  To compile this file system support as a module, choose M here: the
	  module will be called hpfs.  If unsure, say N.

config HPFS_FS_ALLOW_NO_ERROR_CHECK_MODE
	bool "Allow no-error-check mode for maximum speed"
	depends on HPFS_FS
	default n
	help
	  This option enables check=none mount option. If check=none is
	  specified, users can expect maximum speed at the cost of minimum
	  robustness. Sane users should not specify check=none option, for e.g.
	  use-after-free bug will happen when the filesystem is corrupted or
	  crafted.
```

## fs/smb/Kconfig
```kconfig
# SPDX-License-Identifier: GPL-2.0-only
#
# smbfs configuration

source "fs/smb/client/Kconfig"
source "fs/smb/server/Kconfig"

config SMBFS
	tristate
	default y if CIFS=y || SMB_SERVER=y
	default m if CIFS=m || SMB_SERVER=m

config SMB_KUNIT_TEST
	bool "SMB KUnit tests" if !KUNIT_ALL_TESTS
	depends on KUNIT
	default KUNIT_ALL_TESTS
	help
	  Only useful for kernel devs running KUnit test harness and are not
	  for inclusion into a production build.

	  For more information on KUnit and unit tests in general please refer
	  to the KUnit documentation in Documentation/dev-tools/kunit/.

	  If unsure, say N.
```

## fs/vmufat/Kconfig
```kconfig
config VMUFAT_FS
	tristate "Dreamcast VMU FAT filesystem"
	depends on BLOCK
	help
	  This implements the simple FAT type filesystem found on SEGA
	  Dreamcast visual memory units.

	  Dreamcast users who want to mount their VMUs to view the native
	  filesystem will say 'Y' here. The filesystem is hardware independent
	  but is not recommended for use in other circumstances, so just about
	  everyone else should say 'N'.

	  To compile this as a module say 'M' here. The module will be called
	  vmufat.
```

## init/Kconfig.nolibc
```kconfig
# SPDX-License-Identifier: GPL-2.0

config ARCH_HAS_NOLIBC
	bool
	default y if ARM
	default y if ARM64
	default y if LOONGARCH
	default y if M68K
	default y if MIPS
	default y if PPC
	default y if RISCV
	default y if S390
	default y if SPARC
	default y if UML_X86
	default y if X86
```

## io_uring/Kconfig
```kconfig
# SPDX-License-Identifier: GPL-2.0-only
#
# io_uring configuration
#

config IO_URING_ZCRX
	def_bool y
	depends on IO_URING
	depends on PAGE_POOL
	depends on INET
	depends on NET_RX_BUSY_POLL

config IO_URING_BPF
	def_bool y
	depends on BPF
	depends on NET

config IO_URING_IPC
	bool "io_uring IPC support"
	depends on IO_URING
	default y
	help
	  Enable io_uring-based inter-process communication.

	  This provides high-performance IPC channels that leverage
	  io_uring's shared memory infrastructure and async notification
	  model. Supports broadcast and multicast patterns with
	  zero-copy capabilities.

	  If unsure, say Y.
```

## kernel/Kconfig.killswitch
```kconfig
# SPDX-License-Identifier: GPL-2.0
#
# Killswitch: per-function short-circuit mitigation primitive.
#
# Copyright (C) 2026 Sasha Levin <sashal@kernel.org>
#

config KILLSWITCH
	bool "Killswitch: short-circuit a kernel function as a CVE mitigation"
	depends on SECURITYFS
	depends on KPROBES && HAVE_KPROBES_ON_FTRACE
	depends on HAVE_FUNCTION_ERROR_INJECTION
	select FUNCTION_ERROR_INJECTION
	help
	  Provide an admin-facing mechanism to make a chosen kernel function
	  return a fixed value without executing its body, as a temporary
	  mitigation for a security bug before a real fix is available.

	  Operators write "engage <symbol> <retval>" to
	  /sys/kernel/security/killswitch/control. The function entry is
	  redirected via a kprobe whose pre-handler sets the chosen return
	  value and short-circuits the call. There is no allowlist,
	  denylist, or return-type validation: if the kprobe layer accepts
	  the symbol the engagement proceeds, otherwise its error is
	  returned to userspace.

	  This is *not* livepatch: there is no replacement implementation,
	  the function simply returns the chosen value. Engaging a killswitch
	  taints the kernel (TAINT_KILLSWITCH, 'H'). Requires CAP_SYS_ADMIN.

	  If unsure, say N.
```

## kernel/Kconfig.numalocks
```kconfig
# SPDX-License-Identifier: GPL-2.0-only

menu "NUMA Lock Supporting (OSQ)"

config LOCK_SPIN_ON_OWNER_NUMA
	bool "Enable dynamic numa-aware osq lock"
	depends on LOCK_SPIN_ON_OWNER && X86_64
	default n
	help
	  According the cpu numa architecture, the numa-aware lock
	  always unlocks the process waiting on the same numa node
	  first. It is different from the kernel inbox osq_lock.
	  The dynamic numa-aware osq lock switchies between osq_lock and
	  numa-aware lock automatically, according contention level.
	  Enable: echo 1 > /proc/zx_numa_lock/dynamic_enable.

endmenu #  NUMA Lock Supporting
```

## kernel/Kconfig.sbm
```kconfig
# SPDX-License-Identifier: GPL-2.0
#
# Copyright (C) 2023-2024 Huawei Technologies Duesseldorf GmbH
#
# Author: Petr Tesarik <petr.tesarik1@huawei-partners.com>
#
# SandBox Mode (SBM) config options.
#

config HAVE_ARCH_SBM
       def_bool n

config SANDBOX_MODE
	bool "SandBox Mode (SBM)"
	default n
	help
	  SandBox Mode provides kernel API to run native kernel functions in a
	  sandbox, preventing out-of-bounds memory accesses. On targets which
	  implement SBM arch hooks, the isolation is strong, preventing all
	  memory accesses outside the sandbox; after a protection violation,
	  the affected kernel thread can continue running. On all other
	  targets, the isolation is weak, preventing only buffer overflows
	  within a guard page; after a violation, the kernel thread usually
	  terminates.

	  This is an opt-in self-defense mechanism, i.e. kernel source code
	  must be modified to run in SandBox Mode. For such code, there is
	  some run-time overhead (CPU time, memory) associated with entering
	  and leaving the sandbox.

	  If unsure, say N.

config SBM_KUNIT_TEST
	tristate "Unit tests for SandBox Mode" if !KUNIT_ALL_TESTS
	depends on KUNIT && SANDBOX_MODE
	default KUNIT_ALL_TESTS
	help
	  Build unit tests for SandBox Mode.

	  For more information on KUnit and unit tests in general, please refer
	  to the KUnit documentation in Documentation/dev-tools/kunit/.

	  If unsure, say N.
```
