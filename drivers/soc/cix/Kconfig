## drivers/soc/cix/Kconfig
```kconfig
config CIX_SOC_SYSCONS
	bool "Cix SoC syscon drivers"
	default y
	depends on ARCH_CIX
	select MFD_CORE
	help
	  The drivers add support for the syscons on Cix SoC. Without
	  the drivers core parts of the kernel such as resets will not
	  function correctly.

	  If unsure, and on a Cix SoC, say y.
```

## drivers/soc/hisilicon/Kconfig
```kconfig
# SPDX-License-Identifier: GPL-2.0-only

menu "Hisilicon SoC drivers"
	depends on ARCH_HISI || COMPILE_TEST

config KUNPENG_HCCS
	tristate "HCCS driver on Kunpeng SoC"
	depends on ACPI
	depends on PCC
	depends on ARM64 || COMPILE_TEST
	help
	  The Huawei Cache Coherence System (HCCS) is a multi-chip
	  interconnection bus protocol.
	  The performance of application may be affected if some HCCS
	  ports are not in full lane status, have a large number of CRC
	  errors and so on. This may support for reducing system power
	  consumption if there are HCCS ports supported low power feature
	  on platform.

	  Say M here if you want to include support for querying the
	  health status and port information of HCCS, or reducing system
	  power consumption on Kunpeng SoC.

config KUNPENG_HBMCACHE
	tristate "HBM cache memory device"
	depends on ACPI
	help
	  This driver provids methods to control the power of High Bandwidth
	  Memory (HBM) cache device in Kunpeng SoC. Use HBM as a cache can
	  take advantage of the high bandwidth of HBM in normal memory access.

	  To compile the driver as a module, choose M here:
	  the module will be called kunpeng_hbmcache.

config KUNPENG_HBMDEV
	bool "add extra support for hbm memory device"
	depends on ACPI_HOTPLUG_MEMORY
	select ACPI_CONTAINER
	help
	  The driver provides methods for userpace to control the power
	  of HBM memory devices on Kunpeng soc, which can help to save
	  energy. The functionality of the driver would require dedicated
	  BIOS configuration.

	  If not sure, say N.

endmenu
```

## drivers/soc/nxp/Kconfig
```kconfig
# SPDX-License-Identifier: GPL-2.0-only

if ARCH_LPC32XX || COMPILE_TEST

menu "NXP LPC32xx SoC drivers"

config LPC32XX_SOCINFO
	tristate "NXP LPC32xx SoC information driver"
	default ARCH_LPC32XX
	select SOC_BUS
	help
	  NXP LPC32xx specific driver to get unique SoC ID from SCB registers.

endmenu

endif
```

## drivers/soc/realtek/Kconfig
```kconfig
# SPDX-License-Identifier: GPL-2.0-only
#
# Realtek SoC drivers
#
menu "Realtek SoC drivers"
        depends on ARCH_REALTEK || COMPILE_TEST

config RTD_IO_LEVEL_DETECT
	tristate "Realtek DHC I/O Level Detector"
	depends on PINCTRL_RTD
	select MFD_SYSCON
	default ARCH_REALTEK
	help
	  Enable support for the Realtek DHC I/O level detector.

	  This driver handles the auto-detection of I/O signaling levels
	  (such as 1.8V and 3.3V) and dynamically configures the pad states
	  for specific IP blocks.

endmenu
```

## drivers/soc/sophgo/Kconfig
```kconfig
# SPDX-License-Identifier: GPL-2.0-only
#
# Sophgo/Cvitek SoC drivers
#

if ARCH_SOPHGO || COMPILE_TEST
menu "Sophgo/Cvitek SoC drivers"

config SOPHGO_CV1800_RTCSYS
	tristate "Sophgo CV1800 RTC MFD"
	default y if COMPILE_TEST
	select MFD_CORE
	help
	  If you say yes here you get support the RTC MFD driver for Sophgo
	  CV1800 series SoC. The RTC module comprises a 32kHz oscillator,
	  Power-on-Reset (PoR) sub-module, HW state machine to control chip
	  power-on, power-off and reset. Furthermore, the 8051 subsystem is
	  located within RTCSYS including associated SRAM block.

	  This driver can also be built as a module. If so, the module will be
	  called cv1800-rtcsys.

endmenu
endif
```

## drivers/soc/st/Kconfig
```kconfig
if ARCH_STM32 || COMPILE_TEST

config STM32_RISAB
	tristate "STM32 RISAB"
	depends on (ARM64  || COMPILE_TEST) && DEBUG_FS
	default y
	help
	  Say y to enable RISAB dump debug helper driver. This creates an entry
	  in the debugfs to dump RISAB pages and blocks RIF configurations.

endif # ARCH_STM32 || COMPILE_TEST
```

## drivers/soc/starfive/Kconfig
```kconfig
# SPDX-License-Identifier: GPL-2.0-only
#
# Starfive SoC drivers
#

if ARCH_STARFIVE || COMPILE_TEST
menu "Starfive SoC drivers"

config SOC_STARFIVE_JH7110_VOUT_SUBSYSTEM
	tristate "StarFive JH7110 video output subsystem driver"
	depends on OF
	select PM
	help
	  This option enables the parent driver for the StarFive JH7110
	  video output subsystem, which the documentation calls dom_vout_top.

	  The subsystem covers the DC8200 display controller, the HDMI
	  transmitter, the video output clock generator and the video output
	  system controller. They share one NoC port whose clock and reset
	  gate access to the whole register region, and the region sits in
	  the PD_VOUT power domain. This driver owns those resources and
	  holds them for as long as any of its children exist.

config SOC_STARFIVE_JH7110_HDMI_SUBSYSTEM
	tristate "StarFive JH7110 HDMI subsystem driver"
	depends on OF
	select REGMAP_MMIO
	help
	  This option enables the parent driver
	  for the monolithic StarFive JH7110 HDMI peripheral.

	  The JH7110 HDMI IP block contains both the digital controller
	  (DRM bridge) and the analog PHY (clock/phy provider) logic within
	  a single shared register space.

	  This driver acts as a wrapper. Its only job is to map the
	  shared registers and create separate logical child devices
	  for the "PHY" and the "controller". This is required to
	  correctly manage resources and break a circular clock dependency
	  between the PHY and the VOUT clock generator at probe time.

endmenu
endif
```

## drivers/soc/zte/Kconfig
```kconfig
# SPDX-License-Identifier: GPL-2.0-only

if HAS_IOMEM && (ARCH_ZTE || COMPILE_TEST)

menu "ZTE SoC drivers"

config ZTE_ZX297520V3_CRM
	tristate "ZTE zx297520v3 Clock and Reset Manager"
	select MFD_CORE
	default SOC_ZX297520V3
	help
	  Say yes here to enable the driver for the ZTE zx297520v3 clock and
	  reset manager MFD driver. This driver provides the host device for
	  the clock and reset drivers and is required to boot the SoC. You
	  will also need to enable CLK_ZTE_ZX297520V3 and RESET_ZTE_ZX297520V3
	  to build the actual clock and reset submodule drivers.

endmenu

endif
```

## drivers/staging/iio/magnetometer/Kconfig
```kconfig
# SPDX-License-Identifier: GPL-2.0-only
#
# Magnetometer sensors
#
# When adding new entries keep the list in alphabetical order

menu "Magnetometer sensors"

config QMC5883P
	tristate "QMC5883P 3-Axis Magnetometer"
	depends on I2C
	select REGMAP_I2C
	help
	  Say yes here to build support for QMC5883P I2C-based
	  3-axis magnetometer chip.

	  To compile this driver as a module, choose M here: the
	  module will be called qmc5883p.

endmenu
```

## drivers/staging/media/usb3hdcap/Kconfig
```kconfig
# SPDX-License-Identifier: GPL-2.0
config VIDEO_USB3HDCAP
	tristate "USB3HDCAP video capture support"
	depends on VIDEO_DEV && SND
	select SND_PCM
	select VIDEOBUF2_VMALLOC

	help
	  This is a video4linux2 driver for the StarTech USB3HDCAP video/audio
	  capture device.

	  To compile this driver as a module, choose M here; the
	  module will be called usb3hdcap.
```

## drivers/staging/rts490x/Kconfig
```kconfig
# SPDX-License-Identifier: GPL-2.0-only
config RTS490X_I3C_HUB
	tristate "Realtek RTS490x I3C HUB driver"
	depends on I3C
	depends on REGMAP_I3C
	select GPIOLIB
	help
	  Support for Realtek RTS490x series I3C HUB devices (RTS4900,
	  RTS4901, RTS4902, RTS4903, RTS4904, RTS4906).

	  The I3C HUB provides port expansion, voltage level translation,
	  bus capacitance isolation, address conflict isolation, SMBus
	  agent functionality and GPIO expansion.

	  This driver can also be built as a module. If so, the module
	  will be called rts490xa-i3c-hub.
```

## drivers/staging/rts5208/Kconfig
```kconfig
# SPDX-License-Identifier: GPL-2.0
config RTS5208
	tristate "Realtek PCI-E Card Reader RTS5208/5288 support"
	depends on PCI && SCSI
	help
      Choose Y here to enable support for the Realtek PCI-E card reader RTS5208/5288.
	  This driver facilitates communication between the Linux kernel and the Realtek
	  PCI-E card reader.

	  If you opt to compile this driver as a module, it will be named rts5208. Selecting
	  N will exclude this driver from the kernel build. Choose option Y if your system includes
	  the Realtek PCI-E card reader rts5208/rts5288. When in doubt, it is generally safe
	  to select N.
```

## drivers/staging/serial_esp32/Kconfig
```kconfig
# SPDX-License-Identifier: GPL-2.0
config SERIAL_ESP32
	tristate "Espressif ESP32 UART support"
	depends on HAS_IOMEM
	depends on XTENSA_PLATFORM_ESP32 || (COMPILE_TEST && OF)
	select SERIAL_CORE
	select SERIAL_CORE_CONSOLE
	select SERIAL_EARLYCON
	help
	  Driver for the UART controllers of the Espressif ESP32xx SoCs.
	  When earlycon option is enabled the following kernel command line
	  snippets may be used:
	    earlycon=esp32s3uart,mmio32,0x60000000,115200n8,40000000
	    earlycon=esp32uart,mmio32,0x3ff40000,115200n8

config SERIAL_ESP32_ACM
	tristate "Espressif ESP32 USB ACM gadget support"
	depends on HAS_IOMEM
	depends on XTENSA_PLATFORM_ESP32 || (COMPILE_TEST && OF)
	select SERIAL_CORE
	select SERIAL_CORE_CONSOLE
	select SERIAL_EARLYCON
	help
	  Driver for the CDC ACM gadget controller of the Espressif ESP32S3
	  SoCs that share separate USB controller with the JTAG adapter.
	  When earlycon option is enabled the following kernel command line
	  snippet may be used:
	    earlycon=esp32s3acm,mmio32,0x60038000
```

## drivers/staging/vt6656/Kconfig
```kconfig
# SPDX-License-Identifier: GPL-2.0
config VT6656
	tristate "VIA Technologies VT6656 support"
	depends on MAC80211 && USB && WLAN && m
	select FW_LOADER
	help
	  This is a vendor-written driver for VIA VT6656. VIA Technology VT6656
	  is a wireless network controller that operates on the 2.4GHz band.

	  If you have this hardware and wish to use it, set 'Y' or 'M' here to
	  compile the driver either directly in the kernel or as a module
	  respectively. If you are unsure, it is safe to set it to 'M'.
	  If enabled it loads the firmware for the mentioned device.
```

## drivers/staging/wireless/Kconfig
```kconfig
# SPDX-License-Identifier: GPL-2.0
if WIRELESS

source "drivers/staging/wireless/atmel/Kconfig"
source "drivers/staging/wireless/cisco/Kconfig"
source "drivers/staging/wireless/hostap/Kconfig"
source "drivers/staging/wireless/legacy/Kconfig"
source "drivers/staging/wireless/orinoco/Kconfig"
source "drivers/staging/wireless/zydas/Kconfig"

endif
```

## drivers/staging/wireless/atmel/Kconfig
```kconfig
# SPDX-License-Identifier: GPL-2.0-only
config ATMEL
	tristate "Atmel at76c50x chipset  802.11b support"
	depends on CFG80211 && (PCI || PCMCIA) && HAS_IOPORT
	select WIRELESS_EXT
	select WEXT_PRIV
	select FW_LOADER
	select CRC32
	help
	  A driver 802.11b wireless cards based on the Atmel fast-vnet
	  chips. This driver supports standard Linux wireless extensions.

	  Many  cards based on this chipset do not have flash memory
	  and need their firmware loaded at start-up. If yours is
	  one of these, you will need to provide a firmware image
	  to be loaded into the card by the driver. The Atmel
	  firmware package can be downloaded from
	  <http://www.thekelleys.org.uk/atmel>

config PCI_ATMEL
	tristate "Atmel at76c506 PCI cards"
	depends on ATMEL && PCI
	help
	  Enable support for PCI and mini-PCI cards containing the
	  Atmel at76c506 chip.

config PCMCIA_ATMEL
	tristate "Atmel at76c502/at76c504 PCMCIA cards"
	depends on ATMEL && PCMCIA
	select WIRELESS_EXT
	select FW_LOADER
	select CRC32
	help
	  Enable support for PCMCIA cards containing the
	  Atmel at76c502 and at76c504 chips.
```

## drivers/staging/wireless/zydas/Kconfig
```kconfig
# SPDX-License-Identifier: GPL-2.0-only

config USB_ZD1201
	tristate "USB ZD1201 based Wireless device support"
	depends on CFG80211 && USB
	select WIRELESS_EXT
	select WEXT_PRIV
	select FW_LOADER
	help
	  Say Y if you want to use wireless LAN adapters based on the ZyDAS
	  ZD1201 chip.

	  This driver makes the adapter appear as a normal Ethernet interface,
	  typically on wlan0.

	  The zd1201 device requires external firmware to be loaded.
	  This can be found at http://linux-lc100020.sourceforge.net/

	  To compile this driver as a module, choose M here: the
	  module will be called zd1201.
```

## drivers/tee/mbedtee/Kconfig
```kconfig
# SPDX-License-Identifier: GPL-2.0-only
# MbedTEE Trusted Execution Environment Configuration
config MBEDTEE
	tristate "MbedTEE"
	depends on MMU && OF
	depends on ((ARM || ARM64) && HAVE_ARM_SMCCC) || (RISCV && GENERIC_MSI_IRQ)
	help
	  This enables the MbedTEE Trusted Execution Environment (TEE)
	  driver.

	  The driver supports ARM TrustZone (SMC calls, GIC SPI notifications)
	  and RISC-V IMSIC (shared-memory polling, MSI notifications), with
	  GlobalPlatform client API via /dev/tee*.

	  The DT node should be under a firmware node and have compatible =
	  "mbedtee,tee" with the RPC ring buffer addresses and,
	  for ARM/ARM64, an interrupt property for TEE-to-REE notifications.
	  See Documentation/tee/mbedtee.rst for protocol details.

	  If unsure, say N.
```

## drivers/tee/qcomtee/Kconfig
```kconfig
# SPDX-License-Identifier: GPL-2.0-only
# Qualcomm Trusted Execution Environment Configuration
config QCOMTEE
	tristate "Qualcomm TEE Support"
	select QCOM_SCM
	help
	  This option enables the Qualcomm Trusted Execution Environment (QTEE)
	  driver. It provides an API to access services offered by QTEE and any
	  loaded Trusted Applications (TAs), as well as exporting kernel
	  services to QTEE.
```

## drivers/thermal/samsung/Kconfig
```kconfig
# SPDX-License-Identifier: GPL-2.0-only
config EXYNOS_THERMAL
	tristate "Exynos thermal management unit driver"
	depends on THERMAL_OF
	depends on HAS_IOMEM
	help
	  If you say yes here you get support for the TMU (Thermal Management
	  Unit) driver for Samsung Exynos series of SoCs. This driver initialises
	  the TMU, reports temperature and handles cooling action if defined.
	  This driver uses the Exynos core thermal APIs and TMU configuration
	  data from the supported SoCs.

config EXYNOS_ACPM_THERMAL
	tristate "Exynos ACPM thermal management unit driver"
	depends on THERMAL_OF
	depends on EXYNOS_ACPM_PROTOCOL || (COMPILE_TEST && !EXYNOS_ACPM_PROTOCOL)
	help
	  Support for the Thermal Management Unit (TMU) on Google GS101 SoC.

	  The TMU on GS101 is managed through a hybrid architecture. This driver
	  handles direct register access for thermal interrupt status monitoring
	  and communicates with the Alive Clock and Power Manager (ACPM)
	  firmware via the ACPM IPC protocol for functional sensor control and
	  configuration.

	  Select this if you want to monitor device temperature and enable
	  thermal mitigation on GS101 based devices.
```
