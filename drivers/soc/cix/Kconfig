## drivers/tty/tests/Kconfig
```kconfig
# SPDX-License-Identifier: GPL-2.0
menu "TTY KUnit tests"
	depends on KUNIT && TTY

config TTY_KUNIT_TESTS
	bool "TTY KUnit test infrastructure"
	depends on KUNIT && TTY
	default KUNIT_ALL_TESTS
	help
	  Enable KUnit test infrastructure for TTY drivers.

	  This enables test helper functions that are included directly
	  into tty_io.c to provide access to internal TTY functions for
	  testing. The helpers are only available when KUNIT is enabled.

	  This option provides the foundation for TTY testing but does not
	  run any tests by itself. Enable specific test suites below.

config TTY_KUNIT_CORE_TESTS
	bool "TTY core functionality tests"
	depends on TTY_KUNIT_TESTS
	default KUNIT_ALL_TESTS
	help
	  Enable KUnit tests for TTY core functionality.

	  Tests cover basic TTY operations including open/close lifecycle,
	  write operations, buffer management, line discipline integration,
	  and error handling through real kernel code paths.

	  If unsure, say N.

config TTY_KUNIT_NULL_TTY_TESTS
	tristate "TTY null driver tests" if !KUNIT_ALL_TESTS
	depends on TTY_KUNIT_TESTS && NULL_TTY
	default KUNIT_ALL_TESTS
	help
	  Enable KUnit tests for the TTY null driver.

	  Tests validate ttynull behavior as a data sink, including write
	  operations, data discarding, and error handling. The ttynull
	  driver discards all written data while providing minimal overhead.

	  If unsure, say N.
endmenu
```

## drivers/ultraeth/Kconfig
```kconfig
# SPDX-License-Identifier: GPL-2.0-only

config ULTRAETH
	tristate "Ultra Ethernet core"
	depends on INET
	depends on IPV6 || !IPV6
	select NET_UDP_TUNNEL
	select GRO_CELLS
	help
	  To compile this driver as a module, choose M here: the module
	  will be called ultraeth.
```

## drivers/usb/typec/tipd/Kconfig
```kconfig
config TYPEC_TPS6598X
	tristate "TI TPS6598x USB Power Delivery controller driver"
	depends on I2C
	select POWER_SUPPLY
	select REGMAP_I2C
	select USB_ROLE_SWITCH
	help
	  Say Y or M here if your system has TI TPS65982 or TPS65983 USB Power
	  Delivery controller.

	  If you choose to build this driver as a dynamically linked module, the
	  module will be called tps6598x.ko.

config TYPEC_SN201202X
	tristate "TI SN201202x USB Power Delivery controller support"
	select POWER_SUPPLY
	select REGMAP_I2C
	select USB_ROLE_SWITCH
	select REGMAP_SPMI
	help
	  Say Y here to enable support for SN201202x, a TPS6598x variant
	  that uses SPMI as a host bus, and is found on Apple devices starting
	  from the M3 series.

	  If you choose to build this driver as a dynamically linked module, the
	  module will be called sn201202x.ko.
```

## drivers/usb/virtio_usb/Kconfig
```kconfig
config USB_VIRTIO
	tristate "Virtio USB device support"
	depends on USB_SUPPORT && VIRTIO
	depends on USB || USB_GADGET
	depends on USB if !USB_GADGET
	depends on USB_GADGET if !USB
	select USB_ROLE_SWITCH
	help
	  Say Y here if you want to support a virtio-usb device: a virtio
	  transport for USB that can present itself to the guest as a USB
	  host controller, a USB device controller (UDC), or both, with
	  each port independently configurable and, on ports where the
	  virtio-usb device advertises support for it, capable of
	  switching between the host and device role at runtime (USB
	  OTG-style role switching), backed by the standard USB Role
	  Switch class.

	  To compile this driver as a module, choose M here: the module
	  will be called virtio-usb.

	  If unsure, say N.
```

## drivers/vfio/mdev/Kconfig
```kconfig
# SPDX-License-Identifier: GPL-2.0-only

config VFIO_MDEV
	tristate "Mediated device driver framework"
	help
	  Provides the mediated device (mdev) framework, which allows
	  physical devices to create virtual instances for use with
	  VFIO-based passthrough.
```
