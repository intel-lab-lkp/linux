## drivers/phy/sprd/Kconfig
```kconfig
# SPDX-License-Identifier: GPL-2.0
#
# Phy drivers for Spreadtrum platforms
#

config SPRD_USB20_HSPHY
	tristate "Spreadtrum USB20 HSPHY Driver"
	select USB_PHY
	depends on ARCH_SPRD || COMPILE_TEST
	help
	  Enable this to support the SPRD USB20 High Speed PHY that is part of SOC.
	  This driver takes care of all the PHY functionality,
	  normally paired with DesignWare USB20 (DRD) Controller or
	  Spreadtrum musb phy (DRD )controller.
```

## drivers/phy/starfive/Kconfig
```kconfig
# SPDX-License-Identifier: GPL-2.0-only
#
# Phy drivers for StarFive platforms
#

if ARCH_STARFIVE || COMPILE_TEST

config PHY_STARFIVE_JH7110_DPHY_RX
	tristate "StarFive JH7110 D-PHY RX support"
	depends on HAS_IOMEM
	select GENERIC_PHY
	select GENERIC_PHY_MIPI_DPHY
	help
	  Choose this option if you have a StarFive D-PHY in your
	  system. If M is selected, the module will be called
	  phy-jh7110-dphy-rx.ko.

config PHY_STARFIVE_JH7110_DPHY_TX
	tristate "StarFive JH7110 D-PHY TX Support"
	depends on HAS_IOMEM
	select GENERIC_PHY
	select GENERIC_PHY_MIPI_DPHY
	help
	  Choose this option if you have a StarFive D-PHY TX in your
	  system. If M is selected, the module will be called
	  phy-jh7110-dphy-tx.ko.

config PHY_STARFIVE_JH7110_INNO_HDMI
	tristate "Starfive JH7110 INNO HDMI PHY"
	select PHY_INNO_HDMI
	depends on COMMON_CLK
	select GENERIC_PHY
	help
	  This option enables the driver for the analog HDMI PHY (Physical
	  Layer) on the StarFive JH7110 SoC.

	  This driver binds to a child node of the 'starfive,jh7110-hdmi-subsystem'
	  parent driver and gets its register map from that parent.

	  It is responsible for two main functions:
	  1. PHY Provider: It provides standard PHY operations (.power_on,
	     .power_off) for the HDMI controller (bridge) driver. This
	     involves configuring the Post-PLL and analog TMDS blocks.
	  2. Clock Provider: It registers as a clock provider to supply the
	     variable pixel clock (hdmi_pclk) to the HDMI controller and
	     the VOUT subsystem, which it generates using the Pre-PLL.

config PHY_STARFIVE_JH7110_PCIE
	tristate "Starfive JH7110 PCIE 2.0/USB 3.0 PHY support"
	depends on HAS_IOMEM
	select GENERIC_PHY
	help
	  Enable this to support the StarFive PCIe 2.0 PHY,
	  or used as USB 3.0 PHY.
	  If M is selected, the module will be called
	  phy-jh7110-pcie.ko.

config PHY_STARFIVE_JH7110_USB
	tristate "Starfive JH7110 USB 2.0 PHY support"
	depends on USB_SUPPORT
	select GENERIC_PHY
	help
	  Enable this to support the StarFive USB 2.0 PHY,
	  used with the Cadence USB controller.
	  If M is selected, the module will be called
	  phy-jh7110-usb.ko.

endif # ARCH_STARFIVE || COMPILE_TEST
```

## drivers/phy/tegra/Kconfig
```kconfig
# SPDX-License-Identifier: GPL-2.0-only
config PHY_TEGRA_XUSB
	tristate "NVIDIA Tegra XUSB pad controller driver"
	depends on ARCH_TEGRA && USB_SUPPORT
	select USB_COMMON
	select USB_CONN_GPIO
	select USB_PHY
	help
	  Choose this option if you have an NVIDIA Tegra SoC.

	  To compile this driver as a module, choose M here: the module will
	  be called phy-tegra-xusb.

config PHY_TEGRA194_P2U
	tristate "NVIDIA Tegra194 PIPE2UPHY PHY driver"
	depends on ARCH_TEGRA || COMPILE_TEST
	select GENERIC_PHY
	help
	  Enable this to support the P2U (PIPE to UPHY) that is part of Tegra 19x
	  and 234 SOCs.

config PHY_TEGRA_XMM6260
	tristate "NVIDIA Tegra XMM6260 PHY driver"
	depends on ARCH_TEGRA && USB_NET_XMM6260 && USB_SUPPORT
	select GENERIC_PHY
	help
	  Enable this to support XMM6260 modem found in various Tegra devices
	  with cellular capabilities, like LG Optimus 4X P880, LG Optimus Vu
	  P895, Google Nexus 7 (2012) 3G and ASUS Transformer Pad 3G TF300TG.

	  To compile this driver as a module, choose M here: the module will
	  be called phy-tegra-xmm6260.
```

## drivers/pinctrl/airoha/Kconfig
```kconfig
# SPDX-License-Identifier: GPL-2.0-only
menu "Airoha pinctrl drivers"
	depends on ARCH_AIROHA || COMPILE_TEST

config PINCTRL_AIROHA
	tristate "Airoha pin control"
	depends on OF
	depends on ARCH_AIROHA || COMPILE_TEST
	select PINMUX
	select GENERIC_PINCONF
	select GENERIC_PINCTRL_GROUPS
	select GENERIC_PINMUX_FUNCTIONS
	select GPIOLIB
	select GPIOLIB_IRQCHIP
	select REGMAP_MMIO
	imply PINCTRL_AIROHA_AN7581
	imply PINCTRL_AIROHA_AN7583
	imply PINCTRL_AIROHA_EN7523
	help
	  Say yes here to support pin controller and gpio driver
	  on Airoha SoC.

config PINCTRL_AIROHA_AN7581
	tristate "AN7581 pinctrl"
	depends on ARM64 || COMPILE_TEST
	depends on PINCTRL_AIROHA

config PINCTRL_AIROHA_AN7583
	tristate "AN7583 pinctrl"
	depends on ARM64 || COMPILE_TEST
	depends on PINCTRL_AIROHA

config PINCTRL_AIROHA_EN7523
	tristate "EN7523 pinctrl"
	depends on ARM || COMPILE_TEST
	depends on PINCTRL_AIROHA

endmenu
```

## drivers/pinctrl/sprd/Kconfig
```kconfig
# SPDX-License-Identifier: GPL-2.0-only
#
# Spreadtrum pin control drivers
#

config PINCTRL_SPRD
	tristate
	select PINMUX
	select PINCONF
	select GENERIC_PINCONF
	select GENERIC_PINMUX_FUNCTIONS
	help
	  Say Y here to enable Spreadtrum pinctrl driver

config PINCTRL_SPRD_SC9860
	tristate "Spreadtrum SC9860 pinctrl driver"
	depends on OF
	depends on ARCH_SPRD || COMPILE_TEST
	select PINCTRL_SPRD
	help
	  Say Y here to enable Spreadtrum SC9860 pinctrl driver

config PINCTRL_SPRD_UMS512
	tristate "Spreadtrum ums512 pinctrl driver"
	depends on OF
	depends on ARCH_SPRD || COMPILE_TEST
	select PINCTRL_SPRD
	help
	  Say Y here to enable Spreadtrum ums512 pinctrl driver
	  Support pin function switching
	  Support pin drive capability configuration
	  Support pin pull-up and pull-down configuration
	  Support pin pull-up and pull-down configuration during sleep

config PINCTRL_SPRD_UMS9621
	tristate "Spreadtrum ums9621 pinctrl driver"
	depends on OF
	depends on ARCH_SPRD || COMPILE_TEST
	select PINCTRL_SPRD
	help
	  Say Y here to enable Spreadtrum ums512 pinctrl driver
	  Support pin function switching
	  Support pin drive capability configuration
	  Support pin pull-up and pull-down configuration
	  Support pin pull-up and pull-down configuration during sleep
```

## drivers/pinctrl/ultrarisc/Kconfig
```kconfig
# SPDX-License-Identifier: GPL-2.0-only

config PINCTRL_ULTRARISC
	tristate
	depends on OF
	select PINMUX
	select GENERIC_PINCTRL_GROUPS
	select GENERIC_PINCONF
	select GENERIC_PINMUX_FUNCTIONS
	select GPIOLIB
	select IRQ_DOMAIN_HIERARCHY
	select MFD_SYSCON

config PINCTRL_ULTRARISC_DP1000
	tristate "UltraRISC DP1000 SoC Pinctrl driver"
	select PINCTRL_ULTRARISC
	depends on OF && HAS_IOMEM
	default ARCH_ULTRARISC
	help
	  Say Y to select the pinctrl driver for UltraRISC DP1000 SoC.
	  This pin controller allows selecting the mux function for
	  each pin. This driver can also be built as a module called
	  pinctrl-dp1000.
```

## drivers/platform/goldfish/Kconfig
```kconfig
# SPDX-License-Identifier: GPL-2.0-only
menuconfig GOLDFISH
	bool "Platform support for Goldfish virtual devices"
	depends on HAS_IOMEM && HAS_DMA
	default X86_GOLDFISH
	help
	  Say Y here to get to see options for the Goldfish virtual platform.
	  This option alone does not add any kernel code.

	  Unless you are building for the Android Goldfish emulator say N here.

if GOLDFISH

config GOLDFISH_PIPE
	tristate "Goldfish virtual device for QEMU pipes"
	help
	  This is a virtual device to drive the QEMU pipe interface used by
	  the Goldfish Android Virtual Device.

config GOLDFISH_ADDRESS_SPACE
	tristate "Goldfish address space driver in Rust"
	depends on PCI && RUST && MMU
	help
	  Adds a Rust implementation of the Goldfish address space driver
	  used by the Android Goldfish emulator.

	  This implementation uses typed Rust abstractions for PCI resource
	  setup, miscdevice registration, page-backed ping state, and the
	  userspace ioctl interface.

endif # GOLDFISH
```

## drivers/platform/misc/Kconfig
```kconfig
# SPDX-License-Identifier: GPL-2.0-only
#
# Platform miscellaneous drivers configuration
#

config MC33978_CORE
	tristate
	depends on SPI
	select IRQ_DOMAIN_HIERARCHY
	select REGMAP
```

## drivers/platform/synology_microp/Kconfig
```kconfig
# SPDX-License-Identifier: GPL-2.0

config SYNOLOGY_MICROP
	tristate "Synology Microp driver"
	depends on LEDS_CLASS && LEDS_CLASS_MULTICOLOR
	depends on RUST_SERIAL_DEV_BUS_ABSTRACTIONS
	help
	  Enable support for the MCU found in Synology NAS devices.

	  This is needed to properly shutdown and reboot the device, as well as
	  additional functionality like fan and LED control.

	  This driver is work in progress and may not be fully functional.
```

## drivers/platform/x86/amd/Kconfig
```kconfig
# SPDX-License-Identifier: GPL-2.0-only
#
# AMD x86 Platform Specific Drivers
#

source "drivers/platform/x86/amd/hsmp/Kconfig"
source "drivers/platform/x86/amd/pmf/Kconfig"
source "drivers/platform/x86/amd/pmc/Kconfig"

config AMD_3D_VCACHE
	tristate "AMD 3D V-Cache Performance Optimizer Driver"
	depends on X86_64 && ACPI
	help
	  The driver provides a sysfs interface, enabling the setting of a bias
	  that alters CPU core reordering. This bias prefers cores with higher
	  frequencies or larger L3 caches on processors supporting AMD 3D V-Cache
	  technology.

	  If you choose to compile this driver as a module the module will be
	  called amd_3d_vcache.

config AMD_WBRF
	bool "AMD Wifi RF Band mitigations (WBRF)"
	depends on ACPI
	help
	  WBRF(Wifi Band RFI mitigation) mechanism allows Wifi drivers
	  to notify the frequencies they are using so that other hardware
	  can be reconfigured to avoid harmonic conflicts.

	  AMD provides an ACPI based mechanism to support WBRF on platform with
	  appropriate underlying support.

	  This mechanism will only be activated on platforms that advertise a
	  need for it.

config AMD_ISP_PLATFORM
	bool "AMD platform with ISP4 that supports Camera sensor device"
	depends on I2C && X86_64 && AMD_ISP4
	help
	  For AMD platform that support Image signal processor generation 4, it
	  is necessary to add platform specific camera sensor module board info
	  which includes the sensor driver device id and the i2c address.

	  If you have a AMD platform that support ISP4 and with a sensor
	  connected to it, say Y here
```

## drivers/platform/x86/goodix-ec-mailbox/Kconfig
```kconfig
config GOODIX_EC_MAILBOX
	tristate "Goodix fingerprint EC mailbox transport"
	depends on X86
	depends on ACPI
	depends on GPIOLIB
	help
	  Enable transport support for Goodix fingerprint sensors connected
	  through an ACPI-described embedded-controller shared-memory mailbox.

	  The driver exposes the opaque mailbox transport through /dev/gxfp.
	  Sensor configuration, TLS, capture and image processing remain in
	  userspace.

	  To compile this driver as a module, choose M here. The module will be
	  called goodix_ec_mailbox.
```

## drivers/platform/x86/tuxedo/Kconfig
```kconfig
# SPDX-License-Identifier: GPL-2.0-only
#
# TUXEDO X86 Platform Specific Drivers
#

menuconfig TUXEDO_NB04_WMI_AB
	tristate "TUXEDO NB04 WMI AB Platform Driver"
	default m
	help
	  This driver implements the WMI AB device found on TUXEDO Notebooks
	  with board vendor NB04. For the time being only the keyboard backlight
	  control is implemented.

	  When compiled as a module it will be called tuxedo_nb04_wmi_ab.
```

## drivers/platform/x86/wmi/Kconfig
```kconfig
# SPDX-License-Identifier: GPL-2.0-only
#
# ACPI WMI Core
#

config ACPI_WMI
	tristate "WMI"
	depends on ACPI
	help
	  This driver adds support for the ACPI-WMI (Windows Management
	  Instrumentation) mapper device (PNP0C14) found on some systems.

	  ACPI-WMI is a proprietary extension to ACPI to expose parts of the
	  ACPI firmware to userspace - this is done through various vendor
	  defined methods and data blocks in a PNP0C14 device, which are then
	  made available for userspace to call.

	  The implementation of this in Linux currently only exposes this to
	  other kernel space drivers.

	  This driver is a required dependency to build the firmware specific
	  drivers needed on many machines, including Acer and HP laptops.

	  It is safe to enable this driver even if your DSDT doesn't define
	  any ACPI-WMI devices.

config ACPI_WMI_LEGACY_DEVICE_NAMES
	bool "Use legacy WMI device naming scheme"
	depends on ACPI_WMI
	help
	  Say Y here to force the WMI driver core to use the old WMI device naming
	  scheme when creating WMI devices. Doing so might be necessary for some
	  userspace applications but will cause the registration of WMI devices with
	  the same GUID to fail in some corner cases.
```

## drivers/pmdomain/marvell/Kconfig
```kconfig
# SPDX-License-Identifier: GPL-2.0-only

menu "Marvell PM Domains"
	depends on ARCH_MMP || COMPILE_TEST

config PXA1908_PM_DOMAINS
	tristate "Marvell PXA1908 power domains"
	depends on OF
	depends on PM
	default ARCH_MMP && ARM64
	select REGMAP
	select PM_GENERIC_DOMAINS
	help
	  Say Y here to enable support for Marvell PXA1908's power domains.

endmenu
```

## drivers/pmdomain/riscv/Kconfig
```kconfig
# SPDX-License-Identifier: GPL-2.0-only

config RISCV_RPMI_DEVICE_POWER
	bool "RISC-V RPMI Based Device Power driver"
	depends on RISCV || COMPILE_TEST
	depends on MAILBOX
	depends on PM
	default RISCV
	select PM_GENERIC_DOMAINS
	help
	  Support for device power domains based on the device power service
	  group defined by the RISC-V platform management interface (RPMI)
	  specification. The power domains advertised by the platform
	  microcontroller are registered as generic power domains, so that
	  devices can reference them through the "power-domains" property.

config RISCV_RPMI_PERF_DOMAIN
	tristate "RISC-V RPMI performance domains as power domains"
	depends on RISCV_RPMI_PERFORMANCE
	depends on PM
	default RISCV
	select PM_GENERIC_DOMAINS
	help
	  Register the performance domains of the RISC-V platform management
	  interface (RPMI) performance service group as generic power domains,
	  with a performance state for each level the platform microcontroller
	  advertises. A device that is not a CPU references its domain through
	  the "power-domains" property and drives it through the OPP library.

	  To compile this driver as a module, choose M here: the module will
	  be called riscv-rpmi-perf-domain.
```

## drivers/pps/generators/Kconfig
```kconfig
# SPDX-License-Identifier: GPL-2.0-only
#
# PPS generators configuration
#

comment "PPS generators support"

config PPS_GENERATOR_PARPORT
	tristate "Parallel port PPS signal generator"
	depends on PARPORT && BROKEN
	help
	  If you say yes here you get support for a PPS signal generator which
	  utilizes STROBE pin of a parallel port to send PPS signals. It uses
	  parport abstraction layer and hrtimers to precisely control the signal.

config PPS_GENERATOR_TIO
	tristate "TIO PPS signal generator"
	depends on X86 && CPU_SUP_INTEL
	help
	  If you say yes here you get support for a PPS TIO signal generator
	  which generates a pulse at a prescribed time based on the system clock.
	  It uses time translation and hrtimers to precisely generate a pulse.
	  This hardware is present on 2019 and newer Intel CPUs. However, this
	  driver is not useful without adding highly specialized hardware outside
	  the Linux system to observe these pulses.

	  To compile this driver as a module, choose M here: the module
	  will be called pps_gen_tio.

	  If unsure, say N.
```
