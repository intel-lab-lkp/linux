## drivers/resctrl/Kconfig
```kconfig
menuconfig ARM64_MPAM_DRIVER
	bool "MPAM driver"
	depends on ARM64 && ARM64_MPAM
	select ACPI_MPAM if ACPI
	help
	  Memory System Resource Partitioning and Monitoring (MPAM) driver for
	  System IP, e.g. caches and memory controllers.

if ARM64_MPAM_DRIVER

config ARM64_MPAM_DRIVER_DEBUG
	bool "Enable debug messages from the MPAM driver"
	help
	  Say yes here to enable debug messages from the MPAM driver.

config MPAM_KUNIT_TEST
	bool "KUnit tests for MPAM driver " if !KUNIT_ALL_TESTS
	depends on KUNIT=y
	default KUNIT_ALL_TESTS
	help
	  Enable this option to run tests in the MPAM driver.

	  If unsure, say N.

endif

config ARM64_MPAM_RESCTRL_FS
	bool
	default y if ARM64_MPAM_DRIVER && RESCTRL_FS
	select RESCTRL_RMID_DEPENDS_ON_CLOSID
	select RESCTRL_ASSIGN_FIXED

menuconfig RISCV_CBQRI_DRIVER
	bool "RISC-V CBQRI driver"
	depends on RISCV && RISCV_ISA_SSQOSID
	help
	  Capacity QoS Register Interface (CBQRI) driver for RISC-V cache
	  QoS resources. CBQRI exposes cache capacity allocation through
	  the resctrl filesystem at /sys/fs/resctrl when RESCTRL_FS is also
	  enabled.

	  RISCV_ISA_SSQOSID provides the srmcfg CSR that tags each hart's
	  memory traffic with the RCID consumed by CBQRI controllers.

if RISCV_CBQRI_DRIVER

config RISCV_CBQRI_DRIVER_DEBUG
	bool "Enable debug messages from the CBQRI driver"
	help
	  Say yes here to enable debug messages from the CBQRI driver.

	  This adds pr_debug() output covering controller probe and
	  per-controller registration steps.  Useful when bringing up a
	  new platform; otherwise leave disabled to avoid log noise.

endif
```

## drivers/reset/realtek/Kconfig
```kconfig
# SPDX-License-Identifier: GPL-2.0-only
config RESET_RTK_COMMON
	bool
	select AUXILIARY_BUS
	default COMMON_CLK_RTD1625
```

## drivers/reset/spacemit/Kconfig
```kconfig
# SPDX-License-Identifier: GPL-2.0-only

config RESET_SPACEMIT
	bool

config RESET_SPACEMIT_K1
	tristate "SpacemiT K1 reset driver"
	depends on ARCH_SPACEMIT || COMPILE_TEST
	select RESET_SPACEMIT
	default ARCH_SPACEMIT
	help
	  This enables the reset controller driver for the SpacemiT K1 SoC.
```

## drivers/rpmsg/Kconfig
```kconfig
# SPDX-License-Identifier: GPL-2.0

menu "Rpmsg drivers"

# RPMSG always gets selected by whoever wants it
config RPMSG
	tristate

config RPMSG_CHAR
	tristate "RPMSG device interface"
	depends on RPMSG
	depends on NET
	help
	  Say Y here to export rpmsg endpoints as device files, usually found
	  in /dev. They make it possible for user-space programs to send and
	  receive rpmsg packets.

config RPMSG_CTRL
	tristate "RPMSG control interface"
	depends on RPMSG && ( RPMSG_CHAR || RPMSG_CHAR=n )
	help
	  Say Y here to enable the support of the /dev/rpmsg_ctrlX API. This API
	  allows user-space programs to create endpoints with specific service name,
	  source and destination addresses.

config RPMSG_NS
	tristate "RPMSG name service announcement"
	depends on RPMSG
	help
	  Say Y here to enable the support of the name service announcement
	  channel that probes the associated RPMsg device on remote endpoint
	  service announcement.

config RPMSG_MTK_SCP
	tristate "MediaTek SCP"
	depends on MTK_SCP
	select RPMSG
	help
	  Say y here to enable support providing communication channels to
	  remote processors in MediaTek platforms.
	  This use IPI and IPC to communicate with remote processors.

config RPMSG_QCOM_GLINK
	tristate
	select RPMSG

config RPMSG_QCOM_GLINK_RPM
	tristate "Qualcomm RPM Glink driver"
	select RPMSG_QCOM_GLINK
	depends on HAS_IOMEM
	depends on MAILBOX
	help
	  Say y here to enable support for the GLINK RPM communication driver,
	  which serves as a channel for communication with the RPM in GLINK
	  enabled systems.

config RPMSG_QCOM_GLINK_SMEM
	tristate "Qualcomm SMEM Glink driver"
	select RPMSG_QCOM_GLINK
	depends on MAILBOX
	depends on QCOM_SMEM
	help
	  Say y here to enable support for the GLINK SMEM communication driver,
	  which provides support for using the GLINK communication protocol
	  over SMEM.

config RPMSG_QCOM_SMD
	tristate "Qualcomm Shared Memory Driver (SMD)"
	depends on MAILBOX
	depends on QCOM_SMEM
	select RPMSG
	help
	  Say y here to enable support for the Qualcomm Shared Memory Driver
	  providing communication channels to remote processors in Qualcomm
	  platforms.

config RPMSG_VIRTIO
	tristate "Virtio RPMSG bus driver"
	depends on HAS_DMA
	select RPMSG
	select RPMSG_NS
	select VIRTIO

config RPMSG_VIRTIO_MAX_BUF_SIZE
	int "Virtio RPMSG max buffer size (in bytes)"
	default 512
	depends on RPMSG_VIRTIO
	help
	  This option allows you to configure the maximum buffer size (in bytes)
	  for Virtio RPMSG communications. The number of buffers will be computed
	  based on the number of buffers (CONFIG_RPMSG_VIRTIO_MAX_NUM_BUFS)
	  supported by the vring. By default, it supports up to a maximum of 512
	  buffers (256 in each direction). Each buffer consists of 16 bytes for the
	  message header and the remaining bytes for the payload.The default values
	  will utilize a maximum total space of 256KB for the buffers.

config RPMSG_VIRTIO_MAX_NUM_BUFS
	int "Virtio RPMSG max buffer count (even number for TX and Rx)"
	default 512
	depends on RPMSG_VIRTIO
	help
	  This option allows you to configure the maximum number of buffers used
	  for Virtio RPMSG communication. By default, it supports up to a maximum
	  of 512 buffers (256 in each direction). Please note that this value
	  should be an even number, as it accounts for both transmit (TX) and
	  receive (Rx) buffers.
endmenu
```

## drivers/scsi/Kconfig.kunit
```kconfig
config SCSI_ERROR_TEST
	tristate "scsi_error.c unit tests" if !KUNIT_ALL_TESTS
	depends on SCSI && KUNIT
	default KUNIT_ALL_TESTS
```

## drivers/scsi/bht/Kconfig
```kconfig
# SPDX-License-Identifier: GPL-2.0-only
config SCSI_BHT
	tristate "Bayhub's SD/MMC Card Interface Driver"
	depends on PCI && SCSI
	help
	  This driver supports the Bayhub's SD/MMC host controllers.

	  If you have the Bayhub's SD/MMC host controllers, say Y or M here.

	  If unsure, say N.
```

## drivers/scsi/leapraid/Kconfig
```kconfig
# SPDX-License-Identifier: GPL-2.0-or-later

config SCSI_LEAPRAID
		tristate "LeapIO RAID Adapter"
		depends on PCI && SCSI
		select SCSI_SAS_ATTRS
		help
		  Driver for LeapIO Storage & RAID
		  Controllers.
		  To compile this driver as a module, choose M here: the
		  module will be called leapraid.
```

## drivers/soc/aspeed/Kconfig
```kconfig
# SPDX-License-Identifier: GPL-2.0-only

if ARCH_ASPEED || COMPILE_TEST

menu "ASPEED SoC drivers"

config ASPEED_LPC_CTRL
	tristate "ASPEED LPC firmware cycle control"
	select REGMAP
	select MFD_SYSCON
	default ARCH_ASPEED
	help
	  Control LPC firmware cycle mappings through ioctl()s. The driver
	  also provides a read/write interface to a BMC ram region where the
	  host LPC read/write region can be buffered.

config ASPEED_LPC_SNOOP
	tristate "ASPEED LPC snoop support"
	select REGMAP
	select MFD_SYSCON
	default ARCH_ASPEED
	help
	  Provides a driver to control the LPC snoop interface which
	  allows the BMC to listen on and save the data written by
	  the host to an arbitrary LPC I/O port.

config ASPEED_UART_ROUTING
	tristate "ASPEED uart routing control"
	select REGMAP
	select MFD_SYSCON
	default ARCH_ASPEED
	help
	  Provides a driver to control the UART routing paths, allowing
	  users to perform runtime configuration of the RX muxes among
	  the UART controllers and I/O pins.

config ASPEED_P2A_CTRL
	tristate "ASPEED P2A (VGA MMIO to BMC) bridge control"
	select REGMAP
	select MFD_SYSCON
	default ARCH_ASPEED
	help
	  Control ASPEED P2A VGA MMIO to BMC mappings through ioctl()s.  The
	  driver also provides an interface for userspace mappings to a
	  pre-defined region.

config ASPEED_SOCINFO
	bool "ASPEED SoC Information driver"
	default ARCH_ASPEED
	select SOC_BUS
	default ARCH_ASPEED
	help
	  Say yes to support decoding of ASPEED BMC information.

endmenu

endif

menu "ASPEED host-side drivers"
	depends on PCI

config ASPEED_HOST_BMC_DEV
	tristate "ASPEED host-side BMC PCIe device"
	depends on SERIAL_8250
	help
	  Host-side driver for the ASPEED AST2600 BMC PCIe device found on
	  BMC expansion cards. Exposes two 8250-compatible VUART
	  ports.

	  If unsure, say N. Choose M to build aspeed-host-bmc-dev.

endmenu
```

## drivers/soc/cadence/Kconfig
```kconfig
# SPDX-License-Identifier: GPL-2.0

config CDNS_MHDP_HELPER
	tristate
	help
	  Enable Cadence MHDP helpers for mailbox, HDMI and DP.
	  This driver provides a foundational layer of mailbox communication for
	  various Cadence MHDP IP implementations, such as HDMI and DisplayPort.
```
