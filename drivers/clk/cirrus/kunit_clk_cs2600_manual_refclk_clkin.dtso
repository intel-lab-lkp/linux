// SPDX-License-Identifier: GPL-2.0
/dts-v1/;
/plugin/;

#include "kunit_clk_cs2600.dtsi"

&cs2600_kunit_i2c {
	cs2600: cs2600@2c {
		compatible = "cirrus,cs2600";
		reg = <0x2c>;
		#clock-cells = <1>;
		clocks = <&cs2600_kunit_refclk>, <&cs2600_kunit_clkin>;
		clock-names = "ref_clk_in", "clk_in";
		vdd-supply = <&dummy_vreg>;
	};
};
