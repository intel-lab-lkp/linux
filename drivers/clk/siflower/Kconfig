## drivers/firmware/mediatek/Kconfig
```kconfig
# SPDX-License-Identifier: GPL-2.0-only

menu "MediaTek firmware drivers"

config MTK_ADSP_IPC
	tristate "MTK ADSP IPC Protocol driver"
	depends on MTK_ADSP_MBOX
	help
	  Say yes here to add support for the MediaTek ADSP IPC
	  between host AP (Linux) and the firmware running on ADSP.
	  ADSP exists on some mtk processors.
	  Client might use shared memory to exchange information with ADSP.

config MTK_HARDWARE_VOTER
	tristate "MediaTek Hardware Resources Voter"
	depends on MTK_ADSP_MBOX
	help
	  Say yes here to add support for the MediaTek Hardware Voter (HWV),
	  an interface to the HWV MCU which is used to synchronize requests
	  for hardware resources between host AP (Linux) and the firmwares
	  that are running on various integrated remote processors.

endmenu
```

## drivers/firmware/riscv/Kconfig
```kconfig
# SPDX-License-Identifier: GPL-2.0-only
menu "RISC-V Firmware Drivers"
	depends on RISCV || COMPILE_TEST

config RISCV_RPMI_PERFORMANCE
	tristate "RISC-V RPMI performance service group"
	depends on RISCV || COMPILE_TEST
	depends on MAILBOX
	default RISCV
	select PM_OPP
	help
	  Support for the performance service group defined by the RISC-V
	  platform management interface (RPMI) specification. The performance
	  domains advertised by the platform microcontroller are enumerated
	  here and made available to the front-end drivers that control them.

endmenu
```

## drivers/firmware/riscv_rpmi_tee/Kconfig
```kconfig
# SPDX-License-Identifier: GPL-2.0-only

config RISCV_RPMI_TEE_TRANSPORT
	tristate "RISC-V RPMI TEE service group transport"
	depends on RISCV && OF && RISCV_SBI_MPXY_MBOX
	help
	  Say Y or M here to enable the transport for services provided by the
	  RISC-V RPMI TEE service group.
```

## drivers/firmware/ti/Kconfig
```kconfig
# SPDX-License-Identifier: GPL-2.0-only

config TI_SCI_PROTOCOL
	tristate "TI System Control Interface (TISCI) Message Protocol"
	depends on TI_MESSAGE_MANAGER
	default ARCH_K3
	help
	  TI System Control Interface (TISCI) Message Protocol is used to manage
	  compute systems such as ARM, DSP etc with the system controller in
	  complex System on Chip(SoC) such as those found on certain keystone
	  generation SoC from TI.

	  System controller provides various facilities including power
	  management function support.

	  This protocol library is used by client drivers to use the features
	  provided by the system controller.
```

## drivers/fpga/amd/Kconfig
```kconfig
# SPDX-License-Identifier: GPL-2.0-only

config AMD_VERSAL_PCI
	tristate "AMD Versal PCIe Management Driver"
	select FW_LOADER
	select FW_UPLOAD
	depends on FPGA
	depends on HAS_IOMEM
	depends on PCI
	help
	  AMD Versal PCIe Management Driver provides management services to
	  download firmware, program bitstream, and communicate with the User
	  function.

	  If "M" is selected, the driver module will be versal-pci
```
