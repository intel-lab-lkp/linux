## drivers/clk/siflower/Kconfig
```kconfig
# SPDX-License-Identifier: GPL-2.0

menuconfig CLK_SIFLOWER
	bool "Clock driver for Siflower SoCs"
	depends on ARCH_SIFLOWER || COMPILE_TEST
	default ARCH_SIFLOWER
	help
	  Clock drivers for Siflower Linux-capable SoCs.

if CLK_SIFLOWER

config CLK_SF21_TOPCRM
	tristate "Clock driver for Siflower SF21 toplevel clock & reset module"
	depends on ARCH_SIFLOWER || COMPILE_TEST
	default ARCH_SIFLOWER
	select RESET_CONTROLLER
	select RATIONAL
	help
	  Supports the toplevel clock and reset module in Siflower SF21 SoCs.
	  If this kernel is meant to run on Siflower SF21A6826 or SF21H8898,
	  enable this driver.

endif
```

## drivers/clk/sprd/Kconfig
```kconfig
# SPDX-License-Identifier: GPL-2.0-only
config SPRD_COMMON_CLK
	tristate "Clock support for Spreadtrum SoCs"
	depends on ARCH_SPRD || COMPILE_TEST
	default ARCH_SPRD
	select REGMAP_MMIO

if SPRD_COMMON_CLK

# SoC Drivers
config SPRD_SC9832E_CLK
	tristate "Support for the Spreadtrum SC9832E clocks"
	depends on (ARM64 && ARCH_SPRD) || COMPILE_TEST
	default ARM64 && ARCH_SPRD
	help
	  This driver provides support for the clock controller on the
	  Unisoc SC9832E SoC. The SC9832E is a quad-core LTE platform.

	  This driver adds support for the PLLs and various clock gates
	  required for peripheral devices. Say Y if you want to use
	  peripheral devices on sc9832e SoC.

config SPRD_SC9860_CLK
	tristate "Support for the Spreadtrum SC9860 clocks"
	depends on (ARM64 && ARCH_SPRD) || COMPILE_TEST
	default ARM64 && ARCH_SPRD

config SPRD_SC9863A_CLK
	tristate "Support for the Spreadtrum SC9863A clocks"
	depends on (ARM64 && ARCH_SPRD) || COMPILE_TEST
	default ARM64 && ARCH_SPRD
	help
	  Support for the global clock controller on sc9863a devices.
	  Say Y if you want to use peripheral devices on sc9863a SoC.

config SPRD_UMS512_CLK
	tristate "Support for the Spreadtrum UMS512 clocks"
	depends on (ARM64 && ARCH_SPRD) || COMPILE_TEST
	default ARM64 && ARCH_SPRD
	help
	  Support for the global clock controller on ums512 devices.
	  Say Y if you want to use peripheral devices on ums512 SoC.
endif
```

## drivers/clk/zte/Kconfig
```kconfig
# SPDX-License-Identifier: GPL-2.0-only
config CLK_ZX279128S
	bool "ZTE zx279128s clock driver"
	depends on SOC_ZX279128S || COMPILE_TEST
	depends on OF
	default SOC_ZX279128S
	select RESET_CONTROLLER
	select RESET_SIMPLE
	help
	  This driver supports the clocks of the ZTE zx279128s SoC: the
	  top clock and reset module (CRM) with the PLLs, the CPU, bus and
	  peripheral group clocks, and the CRPMs of the two groups of low
	  speed peripherals (UARTs, SPI flash controller, GPIO, MDIO).
	  Say Y if you build a kernel for a board with this SoC.
```

## drivers/cpufreq/Kconfig.riscv
```kconfig
# SPDX-License-Identifier: GPL-2.0-only
#
# RISC-V CPU Frequency scaling drivers
#

config RISCV_SPACEMIT_K1_CPUFREQ
	tristate "SpacemiT K1 CPUFreq driver"
	depends on ARCH_SPACEMIT || COMPILE_TEST
	depends on OF && COMMON_CLK
	select PM_OPP
	help
	  Enable CPU frequency scaling for SpacemiT K1 SoC.
	  K1 has two CPU cluster clocks and one shared CPU voltage rail.
	  The driver keeps all CPUs in one policy and updates both cluster
	  clocks with the shared OPP transition.
```

## drivers/cpuidle/Kconfig.riscv
```kconfig
# SPDX-License-Identifier: GPL-2.0-only
#
# RISC-V CPU Idle drivers
#

config RISCV_SBI_CPUIDLE
	bool "RISC-V SBI CPU idle Driver"
	depends on RISCV_SBI
	select DT_IDLE_STATES
	select CPU_IDLE_MULTIPLE_DRIVERS
	help
	  Select this option to enable RISC-V SBI firmware based CPU idle
	  driver for RISC-V systems.

config RISCV_SBI_CPUIDLE_DOMAIN
	bool "RISC-V SBI CPU idle Domain"
	depends on RISCV_SBI_CPUIDLE
	depends on PM_GENERIC_DOMAINS_OF
	select DT_IDLE_GENPD
	default y
	help
	  Select this option to enable RISC-V SBI firmware based CPU idle
	  driver to use PM domains, which is needed to support the hierarchical
	  DT based layout of the idle state.
```

## drivers/crypto/dwc-spacc/Kconfig
```kconfig
# SPDX-License-Identifier: GPL-2.0-only

config CRYPTO_DEV_SPACC
	tristate "Support for dwc_spacc Security Protocol Accelerator"
	depends on HAS_DMA
	depends on HAS_IOMEM
	select CRYPTO_ENGINE
	select CRYPTO_HASH if CRYPTO_DEV_SPACC_HASH
	select CRYPTO_SHA1 if CRYPTO_DEV_SPACC_HASH
	select CRYPTO_MD5 if CRYPTO_DEV_SPACC_HASH
	select CRYPTO_SHA256 if CRYPTO_DEV_SPACC_HASH
	select CRYPTO_SHA512 if CRYPTO_DEV_SPACC_HASH
	select CRYPTO_HMAC if CRYPTO_DEV_SPACC_HASH
	select CRYPTO_CMAC if CRYPTO_DEV_SPACC_HASH
	select CRYPTO_XCBC if CRYPTO_DEV_SPACC_HASH
	select CRYPTO_AES if CRYPTO_DEV_SPACC_HASH
	select CRYPTO_SM4_GENERIC if CRYPTO_DEV_SPACC_HASH
	default n

	help
	  This enables support for SPAcc Hardware Accelerator.

if CRYPTO_DEV_SPACC

config CRYPTO_DEV_SPACC_HASH
	bool "Enable HASH functionality"
	default CRYPTO_DEV_SPACC
	help
	  Say y to enable Hash functionality of SPAcc.

config CRYPTO_DEV_SPACC_AUTODETECT
	bool "Enable Autodetect functionality"
	default n
	help
	  Say y to enable Autodetect functionality of SPAcc.

config CRYPTO_DEV_SPACC_DEBUG_TRACE_IO
	bool "Enable Trace MMIO reads/writes stats"
	default n
	help
	  Say y to enable Trace MMIO reads/writes stats.
	  To Debug and trace IO register read/write operations.

config CRYPTO_DEV_SPACC_DEBUG_TRACE_DDT
	bool "Enable Trace DDT entries stats"
	default n
	help
	  Say y to enable Enable DDT entry stats.
	  To Debug and trace DDT operation

config CRYPTO_DEV_SPACC_SECURE_MODE
	bool "Enable Spacc secure mode stats"
	default n
	help
	  Say y to enable SPAcc secure modes stats.

config CRYPTO_DEV_SPACC_CONFIG_DEBUG
	bool "Enable SPAcc debug logs"
	default n
	help
	  Say y to enable additional debug prints and diagnostics in the
	  SPAcc driver. Disable this for production builds.

endif # CRYPTO_DEV_SPACC
```

## drivers/crypto/loongson/Kconfig
```kconfig
# SPDX-License-Identifier: GPL-2.0
config CRYPTO_DEV_LS6000SE_RNG
        tristate "Support for Loongson 6000SE RNG Driver"
        depends on MFD_LS6000SE
        help
          Support for Loongson 6000SE RNG Driver.
```

## drivers/debug/Kconfig
```kconfig
# SPDX-License-Identifier: GPL-2.0
menu "Generic Debug Options"

config KMEMDUMP
	bool "Allow the kernel to register memory regions for dumping purpose"
	help
	  Kmemdump mechanism allows any driver to register a specific memory
	  area for later dumping purpose, depending on the functionality
	  of the attached backend. The backend would interface any hardware
	  mechanism that will allow dumping to happen regardless of the
	  state of the kernel (running, frozen, crashed, or any particular
	  state).

	  Note that modules using this feature must be rebuilt if option
	  changes.

config KMEMDUMP_COREIMAGE
	depends on KMEMDUMP
	select VMCORE_INFO
	bool "Assemble memory regions into a coredump readable with debuggers"
	help
	  Enabling this will assemble all the memory regions into a
	  core ELF file. The first region will include program headers for
	  all the regions. The second region is the vmcoreinfo and specific
	  coredump structures.
	  All the other regions follow. Specific kernel variables required
	  for debug tools are being registered.
	  The coredump file can then be loaded into GDB or crash  tool and
	  further inspected.

config KMEMDUMP_QCOM_MINIDUMP_BACKEND
	tristate "Qualcomm Minidump kmemdump backend driver"
	depends on ARCH_QCOM || COMPILE_TEST
	depends on KMEMDUMP
	help
	  Say y here to enable the Qualcomm Minidump kmemdump backend
	  driver.
	  With this backend, the registered regions are being linked
	  into the minidump table of contents. Further on, the firmware
	  will be able to read the table of contents and extract the
	  memory regions on case-by-case basis.

config KMEMDUMP_KINFO_BACKEND
	tristate "Shared memory KInfo compatible backend"
	depends on KMEMDUMP
	help
	  Say y here to enable the Shared memory KInfo compatible backend
	  driver.
	  With this backend, the registered regions are copied to a shared
	  memory zone at register time.
	  The shared memory zone is supplied via OF.
	  This backend will select only regions that are of interest,
	  and keep only addresses. The format of the list is Kinfo compatible.

endmenu
```

## drivers/dibs/Kconfig
```kconfig
# SPDX-License-Identifier: GPL-2.0
config DIBS
	tristate "Direct Internal Buffer Sharing support"
	default n
	help
	  Direct Internal Buffer Sharing (DIBS) is a communication method that
	  uses common physical (internal) memory for synchronous direct access
	  into a remote buffer.

	  Select this option to provide the abstraction layer between
	  DIBS devices and DIBS clients like the SMC protocol.
	  The module name is DIBS.

config DIBS_LO
	bool "Intra-OS shortcut with DIBS loopback"
	depends on DIBS
	default n
	help
	  DIBS_LO enables the creation of an software-emulated DIBS device
	  named lo which can be used for transferring data when communication
	  occurs within the same OS. This helps in convenient testing of
	  DIBS clients, since DIBS loopback is independent of architecture or
	  hardware.
```

## drivers/dma-buf/heaps/Kconfig
```kconfig
config DMABUF_HEAPS_SYSTEM
	bool "DMA-BUF System Heap"
	depends on DMABUF_HEAPS
	help
	  Choose this option to enable the system dmabuf heap. The system heap
	  is backed by pages from the buddy allocator. If in doubt, say Y.

config DMABUF_HEAPS_CMA
	bool "DMA-BUF CMA Heap"
	depends on DMABUF_HEAPS && DMA_CMA
	help
	  Choose this option to enable dma-buf CMA heap. This heap is backed
	  by the Contiguous Memory Allocator (CMA). If your system has these
	  regions, you should say Y here.

config DMABUF_HEAPS_TEGRA_VPR
	bool "NVIDIA Tegra Video-Protected-Region DMA-BUF Heap"
	depends on DMABUF_HEAPS && DMA_CMA
	help
	  Choose this option to enable Video-Protected-Region (VPR) support on
	  a range of NVIDIA Tegra devices.
```

## drivers/dma/amd/Kconfig
```kconfig
# SPDX-License-Identifier: GPL-2.0-only
#
# AMD DMA Drivers

source "drivers/dma/amd/ptdma/Kconfig"
```

## drivers/dma/dcbm/Kconfig
```kconfig
config DCBM_DMA
	bool "DMA Core Batch Migrator"
	depends on DMA_ENGINE
	default n
	help
	  Interface driver for batch page migration offloading. Say Y
	  if you want to try offloading with DMAEngine APIs.
```

## drivers/dma/hsu/Kconfig
```kconfig
# SPDX-License-Identifier: GPL-2.0-only
# DMA engine configuration for hsu
config HSU_DMA
	bool "HSU_DMA"
	select DMA_ENGINE
	select DMA_VIRTUAL_CHANNELS

config HSU_DMA_PCI
	bool "HSU_DMA_PCI"
	depends on HSU_DMA && PCI
```

## drivers/dma/loongson/Kconfig
```kconfig
# SPDX-License-Identifier: GPL-2.0-only
#
# Loongson DMA controllers drivers
#
if MACH_LOONGSON32 || MACH_LOONGSON64 || COMPILE_TEST

config LOONGSON1_APB_DMA
	tristate "Loongson1 APB DMA support"
	depends on MACH_LOONGSON32 || COMPILE_TEST
	select DMA_ENGINE
	select DMA_VIRTUAL_CHANNELS
	help
	  This selects support for the APB DMA controller in Loongson1 SoCs,
	  which is required by Loongson1 NAND and audio support.

config LOONGSON2_APB_DMA
	tristate "Loongson2 APB DMA support"
	depends on MACH_LOONGSON64 || COMPILE_TEST
	select DMA_ENGINE
	select DMA_VIRTUAL_CHANNELS
	help
	  Support for the Loongson2 APB DMA controller driver. The
	  DMA controller is having single DMA channel which can be
	  configured for different peripherals like audio, nand, sdio
	  etc which is in APB bus.

	  This DMA controller transfers data from memory to peripheral fifo.
	  It does not support memory to memory data transfer.

config LOONGSON2_APB_CMC_DMA
	tristate "Loongson2 Chain Multi-Channel DMA support"
	depends on MACH_LOONGSON64 || COMPILE_TEST
	select DMA_ENGINE
	select DMA_VIRTUAL_CHANNELS
	help
	  Support for the Loongson Chain Multi-Channel DMA controller driver.
	  It is discovered on the Loongson-2K chip (Loongson-2K0300/Loongson-2K3000),
	  which has 4/8 channels internally, enabling bidirectional data transfer
	  between devices and memory.

config LOONGSON2_APB_DMAMUX
	tristate "Loongson2 APB DMA Router (dmamux) support"
	depends on LOONGSON2_APB_CMC_DMA
	help
	  Support for the DMA Mux controller found on Loongson-2 SoCs.

	  On Loongson-2K0300, the DMA Mux routes peripheral DMA requests to
	  one of the 8 physical channels of the on-chip CMC DMA controller
	  by programming the CHIP_CTRL13/14/15 registers.

	  To compile this driver as a module, choose M here: the module
	  will be called loongson2-apb-dmamux.

endif
```

## drivers/dma/sdxi/Kconfig
```kconfig
config SDXI
	tristate "SDXI support"
	select DMA_ENGINE
	help
	  Enable support for Smart Data Accelerator Interface (SDXI)
	  Platform Data Mover devices. SDXI is a vendor-neutral
	  standard for a memory-to-memory data mover and acceleration
	  interface.

config SDXI_KUNIT_TEST
	tristate "SDXI unit tests" if !KUNIT_ALL_TESTS
	depends on SDXI && KUNIT
	default KUNIT_ALL_TESTS
	help
	  KUnit tests for parts of the SDXI driver. Does not require
	  SDXI hardware.
```

## drivers/dpll/Kconfig
```kconfig
# SPDX-License-Identifier: GPL-2.0-only
#
# Generic DPLL drivers configuration
#

menu "DPLL support"

config DPLL
	bool

config DPLL_ZL3073X
	tristate "Microchip Azurite DPLL driver"
	depends on MFD_ZL3073X_CORE
	select DPLL
	help
	  This driver adds support for DPLL exposed by Microchip Azurite
	  chip family.

	  The devices handled by this driver are created by MFD zl3073x
	  driver as sub-devices for each DPLL channel that is present
	  in the device.

endmenu
```

## drivers/espi/Kconfig
```kconfig
# SPDX-License-Identifier: GPL-2.0-or-later
#
# eSPI (Enhanced Serial Peripheral Interface) bus configuration
#

menuconfig ESPI
	bool "eSPI (Enhanced Serial Peripheral Interface) bus support"
	help
	  Enhanced Serial Peripheral Interface (eSPI) bus framework.

	  eSPI is a serial bus specification by Intel that replaces the
	  legacy Low Pin Count (LPC) bus. It connects a host controller to
	  one or more slave devices (for example an EC or BMC) over a
	  low-pin-count link clocked up to 66 MHz with single, dual or quad
	  I/O, and carries traffic on four logically independent channels
	  over a shared physical link: Peripheral (I/O and memory), Virtual
	  Wire, OOB (Out-of-Band) messaging, and Flash Access.

	  Includes slave device registration and a blocking-notifier event
	  chain for delivering hardware events to slave drivers.

	  If unsure, say N.
```

## drivers/firmware/arm_rmm/Kconfig
```kconfig
config ARCH_SUPPORTS_RMM
	bool

config ARM_RMM
	bool "Realm Management Monitor (RMM) Support"
	depends on ARCH_SUPPORTS_RMM
	default y
	help
	  Support the Realm Management Monitor (RMM) on Arm systems that
	  implement the Realm Management Extension (RME), as defined by the
	  Arm Confidential Compute Architecture.

	  The RMM provides the Realm Management Interface (RMI) for use by
	  the Normal World host and the Realm Service Interface (RSI) for
	  use by Realm guests. The RSI is used to negotiate the RSI version
	  and Realm configuration with the RMM and manage the protected
	  state of memory.
```

## drivers/firmware/arm_scmi/vendors/mediatek/Kconfig
```kconfig
# SPDX-License-Identifier: GPL-2.0-only
menu "ARM SCMI MediaTek Vendor Protocols"

config MTK_SCMI_TINYSYS
	tristate "MediaTek SCMI TinySYS Extension"
	depends on ARM_SCMI_PROTOCOL || (COMPILE_TEST && OF)
	default y if ARCH_MEDIATEK
	help
	  This enables communication with the MediaTek TinySYS MCU
	  to control the power status of various SoC sub-devices
	  other than passing other messages for initialization.

	  To compile this driver as a module, choose M here: the
	  module will be called mtk-tinysys.

endmenu
```
