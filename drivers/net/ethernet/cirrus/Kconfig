## drivers/net/ethernet/cirrus/Kconfig
```kconfig
# SPDX-License-Identifier: GPL-2.0-only
#
# Cirrus network device configuration
#

config NET_VENDOR_CIRRUS
	bool "Cirrus devices"
	default y
	depends on ISA || EISA || ARM || MAC || COMPILE_TEST
	help
	  If you have a network (Ethernet) card belonging to this class, say Y.

	  Note that the answer to this question doesn't directly affect the
	  kernel: saying N will just cause the configurator to skip all
	  the questions about Cirrus cards. If you say Y, you will be asked
	  for your specific card in the following questions.

if NET_VENDOR_CIRRUS

config EP93XX_ETH
	tristate "EP93xx Ethernet support"
	depends on (ARM && ARCH_EP93XX) || COMPILE_TEST
	select MII
	help
	  This is a driver for the ethernet hardware included in EP93xx CPUs.
	  Say Y if you are building a kernel for EP93xx based devices.

config MAC89x0
	tristate "Macintosh CS89x0 based ethernet cards"
	depends on MAC
	help
	  Support for CS89x0 chipset based Ethernet cards.  If you have a
	  Nubus or LC-PDS network (Ethernet) card of this type, say Y here.

	  To compile this driver as a module, choose M here. This module will
	  be called mac89x0.

endif # NET_VENDOR_CIRRUS
```

## drivers/net/ethernet/huawei/hinic3/Kconfig
```kconfig
# SPDX-License-Identifier: GPL-2.0-only
#
# Huawei driver configuration
#

config HINIC3
	tristate "Huawei Intelligent Network Interface Card 3rd"
	# Fields of HW and management structures are little endian and will not
	# be explicitly converted
	depends on !CPU_BIG_ENDIAN
	depends on X86 || ARM64 || COMPILE_TEST
	depends on PCI_MSI && 64BIT
	help
	  This driver supports HiNIC PCIE Ethernet cards.
	  To compile this driver as part of the kernel, choose Y here.
	  If unsure, choose N.
	  The default is N.
```

## drivers/net/ethernet/intel/idpf/Kconfig
```kconfig
# SPDX-License-Identifier: GPL-2.0-only
# Copyright (C) 2024 Intel Corporation

config IDPF
	tristate "Intel(R) Infrastructure Data Path Function Support"
	depends on PCI_MSI
	depends on PTP_1588_CLOCK_OPTIONAL
	select DIMLIB
	select LIBIE_CP
	select LIBETH_XDP
	help
	  This driver supports Intel(R) Infrastructure Data Path Function
	  devices.

	  To compile this driver as a module, choose M here. The module
	  will be called idpf.

if IDPF

config IDPF_SINGLEQ
	bool "idpf singleq support"
	help
	  This option enables support for legacy single Rx/Tx queues w/no
	  completion and fill queues. Only enable if you have hardware which
	  wants to work in this mode as it increases the driver size and adds
	  runtme checks on hotpath.

config IDPF_KUNIT_TEST
	tristate "KUnit tests for the IDPF driver" if !KUNIT_ALL_TESTS
	depends on KUNIT
	default KUNIT_ALL_TESTS
	help
	  Enable KUnit-based unit tests for the Intel IDPF driver.
	  This builds the idpf_kunit test module used to validate internal
	  helper logic and edge-case behavior in a controlled environment.
	  The tests are intended to run without physical hardware and can be
	  executed under KUnit test runners (for example in QEMU).

	  If unsure, say N.

endif # IDPF
```

## drivers/net/ethernet/maxlinear/Kconfig
```kconfig
# SPDX-License-Identifier: GPL-2.0-only
config NET_VENDOR_MAXLINEAR
	bool "MaxLinear devices"
	help
	  If you have a MaxLinear SoC with ethernet, say Y.

if NET_VENDOR_MAXLINEAR

config MXL_NPU
	tristate "MaxLinear NPU Ethernet driver"
	help
	  This driver supports the MaxLinear NPU Ethernet.

endif #NET_VENDOR_MAXLINEAR
```

## drivers/net/ethernet/xilinx/Kconfig
```kconfig
# SPDX-License-Identifier: GPL-2.0-only
#
# Xilinx device configuration
#

config NET_VENDOR_XILINX
	bool "Xilinx devices"
	default y
	help
	  If you have a network (Ethernet) card belonging to this class, say Y.

	  Note that the answer to this question doesn't directly affect the
	  kernel: saying N will just cause the configurator to skip all
	  the questions about Xilinx devices. If you say Y, you will be asked
	  for your specific card in the following questions.

if NET_VENDOR_XILINX

config XILINX_EMACLITE
	tristate "Xilinx 10/100 Ethernet Lite support"
	depends on HAS_IOMEM
	select PHYLIB
	help
	  This driver supports the 10/100 Ethernet Lite from Xilinx.

config XILINX_AXI_EMAC
	tristate "Xilinx 10/100/1000 AXI Ethernet support"
	depends on HAS_IOMEM
	depends on XILINX_DMA
	select MDIO_BUS
	select OF_DYNAMIC
	select PHYLINK
	select DIMLIB
	help
	  This driver supports the 10/100/1000 Ethernet from Xilinx for the
	  AXI bus interface used in Xilinx Virtex FPGAs and Soc's.

config XILINX_AXI_EMAC_PCS_COMPAT
	bool "Xilinx AXI Ethernet PCS compatibility shim"
	default PCS_XILINX
	depends on XILINX_AXI_EMAC
	select OF_DYNAMIC
	help
	  Enable support for older devicetrees which do not have compatibles
	  for the Xilinx PCS/PMA. If you enable this option, you should
	  probably enable PCS_XILINX too. If you do not use 1G speeds, or you
	  do not have a (Xilinx) PCS, say n. If unsure, say y.

config XILINX_LL_TEMAC
	tristate "Xilinx LL TEMAC (LocalLink Tri-mode Ethernet MAC) driver"
	depends on HAS_IOMEM
	select PHYLIB
	help
	  This driver supports the Xilinx 10/100/1000 LocalLink TEMAC
	  core used in Xilinx Spartan and Virtex FPGAs

endif # NET_VENDOR_XILINX
```

## drivers/net/ethernet/xilinx/tsn/Kconfig
```kconfig
# SPDX-License-Identifier: GPL-2.0-only
#
# Xilinx TSN device configuration
#

config XILINX_TSN
	tristate "Xilinx TSN Ethernet driver"
	depends on OF && HAS_IOMEM
	help
	  This driver supports the AMD/Xilinx Time-Sensitive Networking
	  (TSN) Endpoint Ethernet MAC IP. It provides the wrapper device
	  and the endpoint MAC that connects the IP to the host CPU. The
	  three-port switch is supported by NET_DSA_XILINX_TSN.

	  If unsure, say N.
```

## drivers/net/ethernet/zte/Kconfig
```kconfig
# SPDX-License-Identifier: GPL-2.0-only
#
# ZTE driver configuration
#

config NET_VENDOR_ZTE
    bool "ZTE devices"
    default y
    help
      If you have a network (Ethernet) card belonging to this class, say Y.
      Note that the answer to this question doesn't directly affect the
      kernel: saying N will just cause the configurator to skip all
      the questions about Zte cards. If you say Y, you will be asked
      for your specific card in the following questions.

if NET_VENDOR_ZTE

source "drivers/net/ethernet/zte/dinghai/Kconfig"

config ZX279128S_ETH
	bool "ZTE zx279128s Ethernet switch support"
	depends on ARCH_ZTE || COMPILE_TEST
	depends on OF
	depends on BRIDGE=y || BRIDGE=n
	select NET_SWITCHDEV
	select PHYLINK
	help
	  This driver supports the five-port gigabit switch of the ZTE
	  zx279128s SoC and the DMA engine that connects it to the CPU.
	  Each switch port becomes its own network interface, such as the
	  four LAN ports and the WAN port of the ZTE ZXHN H3600.

endif # NET_VENDOR_ZTE
```

## drivers/net/hyperv/Kconfig
```kconfig
# SPDX-License-Identifier: GPL-2.0-only
config HYPERV_NET
	tristate "Microsoft Hyper-V virtual network driver"
	depends on HYPERV_VMBUS
	select UCS2_STRING
	select NLS
	help
	  Select this option to enable the Hyper-V virtual network driver.

config HYPERV_NET_KUNIT_TEST
	bool "Build Hyper-V netvsc KUnit tests"
	depends on HYPERV_NET && KUNIT
	default KUNIT_ALL_TESTS
	help
	  Build the netvsc KUnit test suites into the hv_netvsc object.
	  Built into the module rather than as a separate one so the
	  cases can reach the internal helpers declared in hyperv_net.h
	  without exporting them.

	  If unsure, say N.
```

## drivers/net/pcs/Kconfig
```kconfig
# SPDX-License-Identifier: GPL-2.0-only
#
# PCS Layer Configuration
#

menu "PCS device drivers"

config PCS_XPCS
	tristate "Synopsys DesignWare Ethernet XPCS"
	select PHYLINK
	help
	  This module provides a driver and helper functions for Synopsys
	  DesignWare XPCS controllers.

config PCS_NXP_SERDES_XPCS
	tristate "NXP SerDes XPCS shared core"
	select PHYLINK
	select REGMAP
	help
	  Transport agnostic phylink PCS core for the Synopsys DesignWare
	  Ethernet XPCS and Ethernet PHY of the SerDes subsystems found on
	  NXP S32G and i.MX SoCs. The platform specific register transport
	  (indirect MMIO on S32G, Clause 45 MDIO on i.MX) is implemented as
	  regmap callbacks by the platform drivers selecting this core.

config PCS_LYNX
	tristate
	help
	  This module provides helpers to phylink for managing the Lynx PCS
	  which is part of the Layerscape and QorIQ Ethernet SERDES.

config PCS_MTK_LYNXI
	tristate
	select PHY_COMMON_PROPS
	select REGMAP
	help
	  This module provides helpers to phylink for managing the LynxI PCS
	  which is part of MediaTek's SoC and Ethernet switch ICs.

config PCS_RZN1_MIIC
	tristate "Renesas RZ/N1, RZ/N2H, RZ/T2H MII converter"
	depends on OF
	depends on ARCH_RENESAS || COMPILE_TEST
	help
	  This module provides a driver for the MII converter available on
	  Renesas RZ/N1, RZ/N2H, and RZ/T2H SoCs. This PCS converts MII to
	  RMII/RGMII, or can be set in pass-through mode for MII.

config PCS_NXP_S32G_XPCS
	tristate "NXP S32G XPCS support"
	select PHYLINK
	select REGMAP
	select PCS_NXP_SERDES_XPCS
	help
	  This option enables the NXP S32G SerDes XPCS platform glue. It
	  provides the indirect-MMIO register transport and the S32G PMA/PLL
	  bring-up sequences on top of the shared NXP SerDes xPCS core
	  (PCS_NXP_SERDES_XPCS), which supplies the phylink PCS layer for the
	  SGMII / 2500BASE-X lanes of the shared SerDes combo PHY. It is
	  driven by the S32G SerDes PHY driver. Say Y or M here if you need
	  SGMII Ethernet on an NXP S32G2 or S32G3 SoC.

endmenu
```

## drivers/net/pcs/airoha/Kconfig
```kconfig
# SPDX-License-Identifier: GPL-2.0-only

config PCS_AIROHA
	tristate
	select FWNODE_PCS

config PCS_AIROHA_AN7581
	tristate "Airoha AN7581 PCS driver"
	select PCS_AIROHA
	help
	  This module provides helper to phylink for managing the Airoha
	  AN7581 PCS for SoC Ethernet and PON SERDES.
```

## drivers/net/phy/realtek/Kconfig
```kconfig
# SPDX-License-Identifier: GPL-2.0-only
config REALTEK_PHY
	tristate "Realtek PHYs"
	select PHY_PACKAGE
	help
	  Currently supports RTL821x/RTL822x and fast ethernet PHYs

if REALTEK_PHY

config REALTEK_PHY_HWMON
	bool "HWMON support for Realtek PHYs"
	depends on HWMON && !(REALTEK_PHY=y && HWMON=m)
	help
	  Optional hwmon support for the temperature sensor

endif # REALTEK_PHY

config REALTEK_RTL8211F_RUST_PHY
	tristate "Rust Realtek RTL8211F PHY driver"
	depends on RUST && RUST_PHYLIB_ABSTRACTIONS && !REALTEK_PHY
	help
	  Rust driver for the Realtek RTL8211F Gigabit Ethernet PHY.
	  This is a Rust implementation demonstrating the extended PHY
	  abstraction with config_init, paged register access, and
	  interrupt support.

	  To compile this driver as a module, choose M here: the
	  module will be called rtl8211f_rust.
```

## drivers/net/sipa/Kconfig
```kconfig
# SPDX-License-Identifier: GPL-2.0-only
#
# SIPA network device configuration
#

config SPRD_IPA
	tristate "SPREADTRUM IP PACKET ACCELERATOR"
	depends on ARCH_SPRD
	help
	  IPA is a hardware block present in some Unisoc SoCs, choose
	  Y or M to enabel it if you are sure current Soc include it.
	  IP Packet Accelerator(IPA) is a programmable protocol processor
	  which can process L2/L3 network packets, its mainly used in
	  5g scenarios.

	  If unsure, say N.
```

## drivers/net/wireless/nordic/Kconfig
```kconfig
# SPDX-License-Identifier: GPL-2.0-only

config WLAN_VENDOR_NORDIC
	bool "Nordic Semiconductor devices"
	default y
	help
	  If you have a wireless card belonging to this class, say Y.

	  Note that the answer to this question doesn't directly affect the
	  kernel: saying N will just cause the configurator to skip all the
	  questions about these cards. If you say Y, you will be asked for
	  your specific card in the following questions.

if WLAN_VENDOR_NORDIC

config NRF70
	tristate "Nordic Semiconductor nRF70 series wireless companion IC"
	depends on CFG80211 && INET && SPI_MEM && CPU_LITTLE_ENDIAN
	help
	  This enables support for the Nordic Semiconductor nRF70 family of
	  wireless companion ICs.

	  To compile this driver as a module, choose M here: the module will
	  be called nrf70.

endif # WLAN_VENDOR_NORDIC
```

## drivers/nfc/pn7160/Kconfig
```kconfig
# SPDX-License-Identifier: GPL-2.0-or-later
#
# near field communication configuration
#

config NXP_NFC_I2C
	tristate "NFC I2C Slave driver for NXP-NFCC"
	depends on I2C
	help
	  This enables the NFC driver for PN71xx based devices.
	  This is for I2C connected version. NCI protocol logic
	  resides in the usermode and it has no other NFC dependencies.

	  If unsure, say N.

config NXP_NFC_SPI
	tristate "NFC SPI Slave driver for NXP-NFCC"
	depends on SPI
	help
	  This enables the NFC driver for PN71xx based devices.
	  This is for SPI connected version. NCI protocol logic
	  resides in the usermode and it has no other NFC dependencies.

	  If unsure, say N.

config NXP_NFC_RECOVERY
	bool "NXP based NFC minimal FW update support"
	depends on NXP_NFC_I2C && I2C
	default y
	help
	  This enables NFC minimal FW update.
	  This feature allows updating the firmware of NXP NFC controllers
	  in recovery mode. It is required for field updates and bug fixes.
	  The driver will handle the download mode and firmware transfer
	  when this option is enabled.

	  If unsure, say N.

source "drivers/nfc/pn7160/Kconfig"
endif
```

## drivers/nvme/Kconfig
```kconfig
# SPDX-License-Identifier: GPL-2.0-only
menuconfig NVME_SUPPORT
	bool "NVME Support"
	default y
	help
	  Support for Non-Volatile Memory Express.

	  The answer to this question will not directly affect the
	  kernel: saying N will just cause the configurator to skip all
	  the questions about NVME.

if NVME_SUPPORT

source "drivers/nvme/common/Kconfig"
source "drivers/nvme/host/Kconfig"
source "drivers/nvme/target/Kconfig"

endif
```

## drivers/pci/endpoint/Kconfig
```kconfig
# SPDX-License-Identifier: GPL-2.0
#
# PCI Endpoint Support
#

menu "PCI Endpoint"

config PCI_ENDPOINT
	bool "PCI Endpoint Support"
	depends on HAVE_PCI
	help
	   Enable this configuration option to support configurable PCI
	   endpoint. This should be enabled if the platform has a PCI
	   controller that can operate in endpoint mode.

	   Enabling this option will build the endpoint library, which
	   includes endpoint controller library and endpoint function
	   library.

	   If in doubt, say "N" to disable Endpoint support.

config PCI_ENDPOINT_CONFIGFS
	bool "PCI Endpoint Configfs Support"
	depends on PCI_ENDPOINT
	select CONFIGFS_FS
	help
	   This will enable the configfs entry that can be used to
	   configure the endpoint function and used to bind the
	   function with an endpoint controller.

config PCI_ENDPOINT_MSI_DOORBELL
	bool "PCI Endpoint MSI Doorbell Support"
	depends on PCI_ENDPOINT && GENERIC_MSI_IRQ
	help
	  This enables the EP's MSI interrupt controller to function as a
	  doorbell. The RC can trigger doorbell in EP by writing data to a
	  dedicated BAR, which the EP maps to the controller's message address.

config PCI_ENDPOINT_DOE
	bool "PCI Endpoint Data Object Exchange (DOE) support"
	depends on PCI_ENDPOINT
	help
	  This enables support for Data Object Exchange (DOE) protocol
	  on PCI Endpoint controllers. It provides a communication
	  mechanism through mailboxes, primarily used for PCIe security
	  features.

	  Say Y here if you want be able to communicate using PCIe DOE
	  mailboxes.

	  If unsure, say N.

source "drivers/pci/endpoint/functions/Kconfig"

endmenu
```

## drivers/pci/pwrctrl/Kconfig
```kconfig
# SPDX-License-Identifier: GPL-2.0-only

config HAVE_PWRCTL
	bool

config PCI_PWRCTL
	tristate

config PCI_PWRCTL_PWRSEQ
	tristate
	select POWER_SEQUENCING
	select PCI_PWRCTL

config PCI_PWRCTRL_TC956X
	tristate "PCI Power Control driver for TC956x PCIe switch"
	select PCI_PWRCTL
	help
	  Say Y here to enable the pwrctrl driver for TC956x PCIe switch.
```
