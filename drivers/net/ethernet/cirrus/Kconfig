## drivers/pci/switch/Kconfig
```kconfig
# SPDX-License-Identifier: GPL-2.0

menu "PCI switch controller drivers"
	depends on PCI

config PCI_SW_SWITCHTEC
	tristate "MicroSemi Switchtec PCIe Switch Management Driver"
	help
	 Enables support for the management interface for the MicroSemi
	 Switchtec series of PCIe switches. Supports userspace access
	 to submit MRPC commands to the switch via /dev/switchtecX
	 devices. See <file:Documentation/driver-api/switchtec.rst> for more
	 information.

config PCI_SW_DISCOVERY
	depends on PCI
	tristate "PCI Switch discovery module"
	help
	 This kernel module discovers the PCI-to-PCI bridges of PCIe switches
	 and forms the virtual switch links if the bridges belong to the same
	 Physical switch. The switch links help to identify shorter distances
	 for P2P configurations.

endmenu
```

## drivers/perf/samsung/Kconfig
```kconfig
# SPDX-License-Identifier: GPL-2.0-only
#
# Programmable Performance Monitoring Unit (PPMU) driver
#

config SAMSUNG_PPMU24
	tristate "Samsung PPMU24 drivers"
	depends on ARM64 && ARCH_EXYNOS
	help
	 The Platform Performance Measuring Unit (PPMU) is an AMBA-compliant
	 performance measurement tool designed to provide observability into
	 system-level operations. It provides performance statistics such as
	 as bandwidth, read and write request, transactions count for AXI masters.
```

## drivers/phy/airoha/Kconfig
```kconfig
# SPDX-License-Identifier: GPL-2.0-only

config PHY_AIROHA_AN7583_USB
	tristate "Airoha AN7583 USB PHY Driver"
	depends on ARCH_AIROHA || COMPILE_TEST
	depends on OF
	select GENERIC_PHY
	help
	  Say 'Y' here to add support for Airoha AN7583 USB PHY driver.
 	  This driver create the basic PHY instance and provides initialize
 	  callback for USB port.
```

## drivers/phy/aspeed/Kconfig
```kconfig
# SPDX-License-Identifier: GPL-2.0-only

#
# PHY drivers for ASPEED
#

config PHY_ASPEED_USB3
	tristate "ASPEED USB3 PHY driver"
	select GENERIC_PHY
	depends on (ARCH_ASPEED || COMPILE_TEST)
	help
	  Enable driver support for Aspeed AST2700 USB3 PHY.
```

## drivers/phy/cix/Kconfig
```kconfig
# SPDX-License-Identifier: GPL-2.0-only
#
# Phy drivers for CIX PHYs
#

config PHY_CIX_DP
	tristate "CIX Sky1 DP PHY driver"
	depends on OF && HAS_IOMEM
	depends on ARCH_CIX || COMPILE_TEST
	select GENERIC_PHY
	help
	  Say Y here to enable the dedicated DisplayPort PHY used by the CIX
	  Sky1 DisplayPort controller. The PHY provides the physical layer
	  used by the dedicated DisplayPort output and supports link rates
	  up to HBR3.

	  To compile this driver as a module, choose M here. The module will
	  be called phy-cix-dp.
```

## drivers/phy/google/Kconfig
```kconfig
# SPDX-License-Identifier: GPL-2.0
#
# Phy drivers for Google platforms
#
config PHY_GOOGLE_USB
	tristate "Google Tensor SoC series USB PHY driver"
	depends on HAS_IOMEM
	depends on OF
	depends on TYPEC
	depends on USB_DWC3_GOOGLE
	select GENERIC_PHY
	default y
	help
	  Add support for the USB PHY on Google SoC series, providing
	  the PHY interface for the integrated USB DRD controller.
```

## drivers/phy/nuvoton/Kconfig
```kconfig
# SPDX-License-Identifier: GPL-2.0-only
#
# PHY drivers for Nuvoton MA35 platforms
#
config PHY_MA35_USB
	tristate "Nuvoton MA35 USB2.0 PHY driver"
	depends on ARCH_MA35 || COMPILE_TEST
	depends on OF
	select GENERIC_PHY
	help
	  Enable this to support the USB2.0 PHY on the Nuvoton MA35
	  series SoCs.

config PHY_MA35_USB_OTG
	tristate "Nuvoton MA35 USB2.0 OTG PHY driver"
	depends on ARCH_MA35 || COMPILE_TEST
	depends on OF
	select GENERIC_PHY
	select MFD_SYSCON
	select USB_ROLE_SWITCH
	help
	  Enable this to support the USB2.0 OTG PHY on the Nuvoton MA35
	  series SoCs.  This driver handles PHY initialization for the
	  EHCI/OHCI host controllers, including per-PHY power-on reset,
	  resistor calibration trim, and over-current polarity
	  configuration.  For the OTG port (PHY0), it also monitors the
	  USB ID pin and registers a USB role switch.
```

## drivers/phy/realtek/Kconfig
```kconfig
# SPDX-License-Identifier: GPL-2.0
#
# Phy drivers for Realtek platforms
#

if MACH_REALTEK_RTL || COMPILE_TEST

config PHY_RTK_OTTO_SERDES
	tristate "Realtek Otto Platform SerDes driver"
	depends on OF
	select GENERIC_PHY
	help
	  Enable this to support Realtek SerDes in the RTL83xx and
	  RTL93xx network SoCs. These are based on MIPS32 architecture
	  and the SerDes connect to one to octa transceivers to build
	  up switches with up to 52 ports.

endif # MACH_REALTEK_RTL || COMPILE_TEST

if ARCH_REALTEK || COMPILE_TEST

config PHY_RTK_RTD_USB2PHY
	tristate "Realtek RTD USB2 PHY Transceiver Driver"
	depends on USB_SUPPORT
	select GENERIC_PHY
	select USB_PHY
	select USB_COMMON
	help
	  Enable this to support Realtek SoC USB2 phy transceiver.
	  The DHC (digital home center) RTD series SoCs used the Synopsys
	  DWC3 USB IP. This driver will do the PHY initialization
	  of the parameters.

config PHY_RTK_RTD_USB3PHY
	tristate "Realtek RTD USB3 PHY Transceiver Driver"
	depends on USB_SUPPORT
	select GENERIC_PHY
	select USB_PHY
	select USB_COMMON
	help
	  Enable this to support Realtek SoC USB3 phy transceiver.
	  The DHC (digital home center) RTD series SoCs used the Synopsys
	  DWC3 USB IP. This driver will do the PHY initialization
	  of the parameters.

endif # ARCH_REALTEK || COMPILE_TEST
```
