## drivers/media/pci/facetimehd/Kconfig
```kconfig
# SPDX-License-Identifier: GPL-2.0
#
# "Broadcom Facetime HD camera driver
#
config VIDEO_FACETIMEHD
	tristate "Broadcom Facetime HD camera"
	select VIDEOBUF2_CORE
	select VIDEOBUF2_DMA_SG
	select VIDEO_DEV
	help
	  This adds support for the Apple Facetime HD camera using the Broadcom
	  PCIe controller (14e4:1570) found on Macbooks from around 2013-2017.
```

## drivers/media/pci/hws/Kconfig
```kconfig
# SPDX-License-Identifier: GPL-2.0-only
config VIDEO_HWS
	tristate "AVMatrix HWS capture driver"
	depends on VIDEO_DEV && PCI
	select VIDEOBUF2_DMA_CONTIG
	help
	  This is a Video4Linux2 driver for AVMatrix HWS PCIe capture cards.
	  It provides a PCIe capture interface with V4L2 streaming, DV timings,
	  and per-input controls for the supported HWS boards.

	  To compile this driver as a module, choose M here: the module will
	  be called hws.
```

## drivers/media/platform/allegro-dvt/Kconfig
```kconfig
# SPDX-License-Identifier: GPL-2.0-only

comment "Allegro DVT media platform drivers"

source "drivers/media/platform/allegro-dvt/al300/Kconfig"
source "drivers/media/platform/allegro-dvt/zynqmp/Kconfig"
```

## drivers/media/platform/allegro-dvt/al300/Kconfig
```kconfig
# SPDX-License-Identifier: GPL-2.0-only

config VIDEO_ALLEGRO_DVT_D300
	tristate "Allegro DVT Video IP Decode Gen 3"
	depends on V4L_MEM2MEM_DRIVERS
	depends on VIDEO_DEV && OF && HAS_DMA
	select V4L2_MEM2MEM_DEV
	select VIDEOBUF2_DMA_CONTIG
	help
	  This is a video4linux2 driver for the Allegro DVT IP Decode Gen 3,
	  that support codecs : AVC (H.264), HEVC (H.265), and JPEG.

	  The driver provides hardware acceleration for video decoding operations,
	  enabling efficient processing of compressed video streams on platforms
	  featuring this IP block. It handles memory management, buffer allocation,
	  and decoder command sequencing to deliver optimized performance.

	  The driver integrates with the V4L2 framework and videobuf2 subsystem
	  to provide a standard interface for applications requiring video
	  decoding capabilities.

	  To compile this driver as a module, choose M here. The module
	  will be called al300-vdec.
```

## drivers/media/platform/arm/mali-c55/Kconfig
```kconfig
# SPDX-License-Identifier: GPL-2.0-only
config VIDEO_MALI_C55
	tristate "ARM Mali-C55 Image Signal Processor driver"
	depends on V4L_PLATFORM_DRIVERS
	depends on VIDEO_DEV && OF
	depends on ARCH_VEXPRESS || COMPILE_TEST
	select MEDIA_CONTROLLER
	select VIDEO_V4L2_SUBDEV_API
	select VIDEOBUF2_DMA_CONTIG
	select VIDEOBUF2_VMALLOC
	select V4L2_FWNODE
	select GENERIC_PHY_MIPI_DPHY
	default n
	help
	  Enable this to support Arm's Mali-C55 Image Signal Processor.

	  To compile this driver as a module, choose M here: the module
	  will be called mali-c55.
```

## drivers/media/platform/axiado/Kconfig
```kconfig
# SPDX-License-Identifier: GPL-2.0-only
comment "Axiado media platform drivers"

config VIDEO_AXIADO
	tristate "Axiado AX3000 video capture driver"
	depends on ARCH_AXIADO || COMPILE_TEST
	depends on V4L_PLATFORM_DRIVERS
	depends on VIDEO_DEV
	select VIDEOBUF2_VMALLOC
	help
	  V4L2 capture driver for the Axiado AX3000 SoC display capture
	  controller. The controller has no MMIO registers; frames written
	  by the display engine into a reserved memory region are exposed
	  as a V4L2 capture device.

	  To compile this driver as a module, choose M here. The module
	  will be called axiado-video.
```

## drivers/media/platform/chips-media/wave6/Kconfig
```kconfig
# SPDX-License-Identifier: GPL-2.0

config VIDEO_WAVE6_VPU
	tristate "Chips&Media Wave6 Codec Driver"
	depends on V4L_MEM2MEM_DRIVERS
	depends on VIDEO_DEV && OF
	depends on ARCH_MXC || COMPILE_TEST
	select VIDEOBUF2_DMA_CONTIG
	select V4L2_MEM2MEM_DEV
	select GENERIC_ALLOCATOR
	help
	  Chips&Media Wave6 stateful codec driver.
	  The wave6 driver manages shared resources such as firmware memory.
	  The wave6-core driver provides encoding and decoding capabilities
	  for H.264, HEVC, and other video formats.
	  To compile this driver as modules, choose M here: the
	  modules will be called wave6 and wave6-core.
```

## drivers/media/platform/google/Kconfig
```kconfig
# SPDX-License-Identifier: GPL-2.0-only

source "drivers/media/platform/google/chameleonv3/Kconfig"
```
