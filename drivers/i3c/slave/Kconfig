## drivers/i3c/slave/Kconfig
```kconfig
# SPDX-License-Identifier: GPL-2.0

config I3C_SLAVE_CTRL_SVC
	tristate "Silvaco I3C Dual-Role Slave driver"
	depends on I3C
	depends on HAS_IOMEM
	depends on !(ALPHA || PARISC)
	help
	  Support for Silvaco I3C Dual-Role Slave Controller.
```

## drivers/i3c/target/Kconfig
```kconfig
# SPDX-License-Identifier: GPL-2.0

config I3C_TARGET_CTRL_SVC
	tristate "Silvaco I3C Dual-Role Target driver"
	depends on I3C
	depends on HAS_IOMEM
	depends on !(ALPHA || PARISC)
	help
	  Support for Silvaco I3C Dual-Role Target Controller.
```

## drivers/iio/flow/Kconfig
```kconfig
# SPDX-License-Identifier: GPL-2.0-only
#
# Liquid / gas flow sensor drivers
#
# When adding new entries keep the list in alphabetical order

menu "Flow sensors"

config SENSIRION_SLF3S
	tristate "Sensirion SLF3S liquid flow sensor"
	depends on I2C
	select CRC8
	help
	  Say yes here to build support for the Sensirion SLF3S family of
	  digital liquid-flow sensors (SLF3S-0600F, SLF3S-1300F and
	  SLF3S-4000B).  The driver reports the volumetric flow rate and the
	  embedded temperature reading via the standard IIO interface.

	  To compile this driver as a module, choose M here: the module
	  will be called slf3s.

config SENSIRION_SLF3S_KUNIT_TEST
	tristate "KUnit tests for the Sensirion SLF3S driver" if !KUNIT_ALL_TESTS
	depends on KUNIT && SENSIRION_SLF3S && REGULATOR
	default KUNIT_ALL_TESTS
	help
	  Build KUnit tests for the Sensirion SLF3S driver.  The tests bind
	  the driver to an emulated sensor and check that its suspend and
	  resume callbacks keep the supply regulator balanced, including on
	  the error paths.

	  For more information on KUnit and unit tests in general, please
	  refer to the KUnit documentation in Documentation/dev-tools/kunit/.

	  If unsure, say N.

endmenu
```

## drivers/iio/health/Kconfig
```kconfig
# SPDX-License-Identifier: GPL-2.0-only
#
# Health sensors
#
# When adding new entries keep the list in alphabetical order

menu "Health Sensors"

menu "Heart Rate Monitors"

config AFE4403
	tristate "TI AFE4403 Heart Rate Monitor"
	depends on SPI_MASTER
	select REGMAP_SPI
	select IIO_BUFFER
	select IIO_TRIGGERED_BUFFER
	help
	  Say yes to choose the Texas Instruments AFE4403
	  heart rate monitor and low-cost pulse oximeter.

	  To compile this driver as a module, choose M here: the
	  module will be called afe4403.

config AFE4404
	tristate "TI AFE4404 heart rate and pulse oximeter sensor"
	depends on I2C
	select REGMAP_I2C
	select IIO_BUFFER
	select IIO_TRIGGERED_BUFFER
	help
	  Say yes to choose the Texas Instruments AFE4404
	  heart rate monitor and low-cost pulse oximeter.

	  To compile this driver as a module, choose M here: the
	  module will be called afe4404.

config MAX30100
	tristate "MAX30100 heart rate and pulse oximeter sensor"
	depends on I2C
	select REGMAP_I2C
	select IIO_BUFFER
	select IIO_KFIFO_BUF
	help
	  Say Y here to build I2C interface support for the Maxim
	  MAX30100 heart rate, and pulse oximeter sensor.

	  To compile this driver as a module, choose M here: the
	  module will be called max30100.

config MAX30102
	tristate "MAX30102 heart rate and pulse oximeter sensor"
	depends on I2C
	select REGMAP_I2C
	select IIO_BUFFER
	select IIO_KFIFO_BUF
	help
	  Say Y here to build I2C interface support for the Maxim
	  MAX30102 heart rate, and pulse oximeter sensor.

	  To compile this driver as a module, choose M here: the
	  module will be called max30102.

endmenu


config MAX86150
	tristate "MAX86150 ECG and PPG biosensor"
	depends on I2C
	select IIO_BUFFER
	select IIO_KFIFO_BUF
	select REGMAP_I2C
	help
	  Say Y here to enable support for the Maxim MAX86150 combined
	  ECG and photoplethysmography (PPG) biosensor.

	  The driver exposes three IIO channels: two PPG optical channels
	  (Red and IR LED) for heart rate and SpO2 monitoring, and one
	  ECG channel for biopotential recording.

	  This driver can also be built as a module. If so, the module
	  will be called max86150.

endmenu
```

## drivers/iio/imu/inv_icm20948/Kconfig
```kconfig
# SPDX-License-Identifier: GPL-2.0-or-later

config INV_ICM20948
	tristate

config INV_ICM20948_I2C
	tristate "InvenSense ICM-20948 I2C driver"
	depends on I2C
	select INV_ICM20948
	select REGMAP_I2C
	help
	  This driver supports the InvenSense ICM-20948 motion tracking
	  device over I2C.

	  This driver can be built as a module. The module will be called
	  inv-icm20948-i2c.
```

## drivers/iio/imu/smi240/Kconfig
```kconfig
config SMI240
	tristate "Bosch Sensor SMI240 Inertial Measurement Unit"
	depends on SPI
	select REGMAP_SPI
	select IIO_BUFFER
	select IIO_TRIGGERED_BUFFER
	help
	  If you say yes here you get support for SMI240 IMU on SPI with
	  accelerometer and gyroscope.

	  This driver can also be built as a module. If so, the module will be
	  called smi240.
```

## drivers/iio/opensensorfusion/Kconfig
```kconfig
# SPDX-License-Identifier: GPL-2.0-only

config OPEN_SENSOR_FUSION
	tristate "Open Sensor Fusion UART IIO driver"
	depends on SERIAL_DEV_BUS
	select CRC32
	select IIO_BUFFER
	select IIO_KFIFO_BUF
	help
	  Build the Open Sensor Fusion UART IIO driver.

	  The driver receives OSF protocol frames over a serdev UART and
	  registers IIO devices for supported capability entries. It exposes
	  accelerometer, gyroscope, magnetometer, and temperature samples
	  through IIO direct reads and software buffers.

config OPEN_SENSOR_FUSION_KUNIT_TEST
	bool "KUnit tests for Open Sensor Fusion" if !KUNIT_ALL_TESTS
	depends on OPEN_SENSOR_FUSION=y && KUNIT=y
	default KUNIT_ALL_TESTS
	help
	  Build focused unit tests for the Open Sensor Fusion core sample
	  acceptance, direct-read cache, and IIO buffer paths. The tests
	  exercise accepted, ignored, and rejected sample handling without
	  exposing additional production interfaces.

	  If unsure, say N.
```

## drivers/iio/pressure/bmp390/Kconfig
```kconfig
#
# Kconfig for Bosch BMP390 sensors driver.
#
config BMP3_SUPPORT_DYNAMIC_KO_MODULE
    bool "BMP390 driver build dynamic .ko module"
    depends on I2C && SYSFS
    help
      Enable this option to build the Bosch Sensortec BMP390 sensor driver as a dynamic kernel module (.ko).
      This allows the driver to be loaded and unloaded dynamically at runtime, providing flexibility in managing
      the driver without requiring a reboot. This is particularly useful for development, testing, and systems
      that need to manage kernel modules dynamically.

      This option depends on I2C and SYSFS support being enabled in the kernel configuration. If you are unsure,
      it is safe to say 'N' here.

      Say 'Y' here if you want to support dynamic loading and unloading of the BMP390 sensor driver.

config BMP3_SUPPORT_SPI_BUS
    bool "BMP390 driver build for SPI interface"
    depends on SPI_MASTER && SYSFS
    help
      Enable this option to build the Bosch Sensortec BMP390 sensor driver with support for the SPI interface.
      This allows the BMP390 sensor to communicate with the host system using the SPI bus, which can provide
      faster data transfer rates compared to I2C.

      This option depends on SPI_MASTER and SYSFS support being enabled in the kernel configuration. If you are unsure,
      it is safe to say 'N' here.

      Say 'Y' here if you want to enable SPI interface support for the BMP390 sensor driver.
```

## drivers/iio/temperature/p3t/Kconfig
```kconfig
# SPDX-License-Identifier: GPL-2.0-only

config IIO_P3T1755
	tristate
	depends on (I2C || I3C)

config IIO_P3T1755_I2C
	tristate "NXP P3T1755 temperature sensor I2C driver"
	select IIO_P3T1755
	select REGMAP_I2C
	help
	  Say yes here to build support for NXP P3T1755 I2C temperature
	  sensor.

	  To compile this driver as a module, choose M here: the module
	  will be called p3t1755_i2c

config IIO_P3T1755_I3C
	tristate "NXP P3T1755 temperature sensor I3C driver"
	select IIO_P3T1755
	select REGMAP_I3C
	depends on I3C
	help
	  Say yes here to build support for NXP P3T1755 I3C temperature
	  sensor.

	  To compile this driver as a module, choose M here: the module
	  will be called p3t1755_i3c
```

## drivers/infiniband/hw/hfi2/Kconfig
```kconfig
# SPDX-License-Identifier: GPL-2.0-only
# Copyright(c) 2025-2026 Cornelis Networks, Inc.
config INFINIBAND_HFI2
	tristate "Cornelis OPX Gen2 (JKR) support"
	depends on X86_64 && INFINIBAND_RDMAVT && I2C && !UML
	depends on PCI_IOV
	select MMU_NOTIFIER
	select CRC32
	select I2C_ALGOBIT
	help
	This is a low-level driver for Cornelis OPX Gen2 (JKR) adapters.
	For Gen1 (WFR) adapters use INFINIBAND_HFI1. This separation is
	temporary; hfi2 will eventually support both WFR and JKR hardware
	at which point hfi1 will be removed.
config HFI2_DEBUG_SDMA_ORDER
	bool "HFI2 SDMA Order debug"
	depends on INFINIBAND_HFI2
	default n
	help
	  Enable this debug flag to test for out-of-order SDMA completions
	  during unit testing. This option adds extra tracking to detect
	  when SDMA completions arrive out of sequence, which should not
	  happen in normal operation.
config HFI2_SDMA_VERBOSITY
	bool "Config SDMA Verbosity"
	depends on INFINIBAND_HFI2
	default n
	help
	  Enable this flag to turn on verbose SDMA debug logging. This
	  produces additional diagnostic output useful for debugging SDMA
	  issues. Should not be enabled in production as it generates
	  significant log output.
```

## drivers/infiniband/hw/zrdma/Kconfig
```kconfig
# SPDX-License-Identifier: GPL-2.0 OR Linux-OpenIB
config INFINIBAND_ZRDMA
	tristate "ZTE Ethernet Protocol Driver for RDMA"
	depends on PCI
	depends on NETDEVICES
	select AUXILIARY_BUS
	help
	  Say Y or M here to enable support for the ZTE DingHai (ZXDH) Ethernet
	  Protocol Driver for RDMA. This driver provides RDMA over Converged
	  Ethernet (RoCE) functionality for ZTE DingHai network adapters.
	  If you choose to build this driver as a module, it will be built as
	  a module named zrdma.
```

## drivers/infiniband/sw/siw/Kconfig
```kconfig
config RDMA_SIW
	tristate "Software RDMA over TCP/IP (iWARP) driver"
	depends on INET && INFINIBAND
	depends on INFINIBAND_VIRT_DMA
	select CRC32
	select NET_CRC32C
	help
	This driver implements the iWARP RDMA transport over
	the Linux TCP/IP network stack. It enables a system with a
	standard Ethernet adapter to interoperate with a iWARP
	adapter or with another system running the SIW driver.
	(See also RXE which is a similar software driver for RoCE.)

	The driver interfaces with the Linux RDMA stack and
	implements both a kernel and user space RDMA verbs API.
	The user space verbs API requires a support
	library named libsiw which is loaded by the generic user
	space verbs API, libibverbs. To implement RDMA over
	TCP/IP, the driver further interfaces with the Linux
	in-kernel TCP socket layer.

config SIW_MPA_RX_KUNIT_TEST
	bool "KUnit tests for Soft-iWARP MPA receive parsing" if !KUNIT_ALL_TESTS
	depends on KUNIT && RDMA_SIW
	default KUNIT_ALL_TESTS
	help
	  Build KUnit regression tests for the Soft-iWARP MPA receive
	  state machine. The tests cover the MPA length consistency
	  check in siw_get_hdr(): malformed FPDUs whose mpa_len is
	  below the opcode's fixed DDP/RDMAP header must be rejected
	  with TERM(LLP/MPA/FPDU_START); the minimum-valid mpa_len
	  (zero-length WRITE) must still be accepted. One case drives
	  the real kernel TCP receive path via a loopback socketpair
	  so the same softirq sk_data_ready -> tcp_read_sock ->
	  siw_tcp_rx_data chain a remote peer would exercise is
	  covered.

	  If unsure, say N.
```

## drivers/infiniband/ulp/rmr/Kconfig
```kconfig
# SPDX-License-Identifier: GPL-2.0-or-later

config INFINIBAND_RMR
	tristate
	depends on INFINIBAND_ADDR_TRANS

config INFINIBAND_RMR_CLIENT
	tristate "RMR client module"
	depends on INFINIBAND_ADDR_TRANS
	depends on INFINIBAND_RTRS_CLIENT
	select INFINIBAND_RMR
	help
	  Reliable Multicast over RTRS (RMR) client module.

	  RMR is an RDMA ULP that provides active-active block-level
	  replication on top of the RTRS transport.  It guarantees
	  delivery of an I/O to a group of storage nodes and handles
	  resynchronization of data between storage nodes without
	  involving the compute client.  This option builds the client
	  side, intended to be used by an upper-layer initiator such
	  as BRMR.

	  If unsure, say N.

config INFINIBAND_RMR_SERVER
	tristate "RMR server module"
	depends on INFINIBAND_ADDR_TRANS
	depends on INFINIBAND_RTRS_SERVER
	select INFINIBAND_RMR
	help
	  RMR server module processing connection, IO and replication
	  requests from RMR clients on top of RTRS.  It will pass IO
	  requests to its consumer, e.g. BRMR_server.

	  If unsure, say N.
```

## drivers/iommu/hyperv/Kconfig
```kconfig
# SPDX-License-Identifier: GPL-2.0-only
# Hyper-V IOMMU support

config HYPERV_IOMMU
	bool "Hyper-V IOMMU Device"
	depends on HYPERV && X86
	select IOMMU_API
	default HYPERV
	help
	  This enables Hyper-V pseudo IOMMU device. When running as privileged
          VM aka root on Microsoft Hyper-V hypervisor, this must be enabled
          for doing any PCI passthru of devices to guest VMs. This applies to
          both PFs and VFs. When enabling this, it is best to disable amd/intel
          iommus via: intel_iommu=off amd_iommu=off as the hypervisor really
          owns the iommu.
```

## drivers/iommu/riscv/Kconfig
```kconfig
# SPDX-License-Identifier: GPL-2.0-only
# RISC-V IOMMU support

config RISCV_IOMMU
	bool "RISC-V IOMMU Support"
	default RISCV
	depends on GENERIC_MSI_IRQ
	depends on (RISCV || COMPILE_TEST) && 64BIT
	select IOMMU_API
	select GENERIC_PT
	select IOMMU_PT
	select IOMMU_PT_RISCV64
	help
	  Support for implementations of the RISC-V IOMMU architecture that
	  complements the RISC-V MMU capabilities, providing similar address
	  translation and protection functions for accesses from I/O devices.

	  Say Y here if your SoC includes an IOMMU device implementing
	  the RISC-V IOMMU architecture.

config RISCV_IOMMU_PCI
	def_bool y if RISCV_IOMMU && PCI_MSI
	help
	  Support for the PCIe implementation of RISC-V IOMMU architecture.

config RISCV_IOMMU_32BIT_ACCESS
	bool "Use 32-bit accesses for RISC-V IOMMU registers"
	depends on RISCV_IOMMU
	help
	  Say Y when the RISC-V IOMMU MMIO window cannot be accessed
	  using naturally aligned 64-bit loads and stores.

	  When enabled, 64-bit IOMMU registers are accessed as paired
	  32-bit MMIO operations. This option does not describe an RV32
	  kernel or a 32-bit IOMMU architecture.
```

## drivers/media/i2c/cvs/Kconfig
```kconfig
# SPDX-License-Identifier: GPL-2.0-only

config VIDEO_INTEL_CVS
	tristate "Intel CVS CSI-2 bridge support"
	depends on I2C && ACPI && VIDEO_DEV
	depends on IPU_BRIDGE || !IPU_BRIDGE
	select MEDIA_CONTROLLER
	select VIDEO_V4L2_SUBDEV_API
	select V4L2_FWNODE
	help
	  This adds support for the Intel Computer Vision Sensing (CVS).

	  The driver registers a V4L2 sub-device to arbitrate sensor ownership,
	  performs firmware download, applies per-VID/PID quirks, and configures
	  the device and CSI-2 link.

	  The driver can operate with full I2C transport or in a reduced
	  platform (GPIO-only) mode when I2C is unavailable.

	  Say Y to build into the kernel, or M to build as a module.
	  The module will be named intel_cvs. If unsure, say N.
```

## drivers/media/i2c/ox05b1s/Kconfig
```kconfig
config VIDEO_OX05B1S
	tristate "OmniVision raw sensor support OX05B1S"
	depends on OF
	depends on GPIOLIB
	select REGMAP_I2C
	help
	  This is a Video4Linux2 sensor driver for the Omnivision OX05B1S RGB-IR sensor.
	  This is a 1/2.5-Inch CMOS image sensor with an active array size of 2592 x 1944.
	  It is programmable through I2C interface.
	  The output is on MIPI CSI-2 interface.
```
