// SPDX-License-Identifier: GPL-2.0 OR MIT
/*
 * Copyright (C) 2025 Andes Technology Corporation. All rights reserved.
 */

#include "qilai.dtsi"

/ {
	model = "Voyager";
	compatible = "andestech,voyager", "andestech,qilai";

	chosen {
		stdout-path = "serial0:115200n8";
	};
};

&uart0 {
	status = "okay";
};
