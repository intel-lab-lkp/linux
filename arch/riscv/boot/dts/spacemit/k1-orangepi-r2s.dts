// SPDX-License-Identifier: (GPL-2.0 OR MIT)
/*
 * Copyright (C) 2025 Michael Opdenacker <michael.opdenacker@rootcommit.com>
 */

/dts-v1/;

#include "k1-orangepi.dtsi"

/ {
	model = "OrangePi R2S";
	compatible = "xunlong,orangepi-r2s", "spacemit,k1";
};

&emmc {
	bus-width = <8>;
	mmc-hs400-1_8v;
	mmc-hs400-enhanced-strobe;
	non-removable;
	no-sd;
	no-sdio;
	status = "okay";
};
