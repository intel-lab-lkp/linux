// SPDX-License-Identifier: (GPL-2.0 OR MIT)

/dts-v1/;

#include "sg2000-milkv-duo-module-01.dtsi"

/ {
	model = "Milk-V Duo Module 01 Evaluation Board";
	compatible = "milkv,duo-module-01-evb", "milkv,duo-module-01", "sophgo,sg2000";

	chosen {
		stdout-path = "serial0:115200n8";
	};
};

&uart0 {
	pinctrl-0 = <&uart0_cfg>;
	pinctrl-names = "default";
	status = "okay";
};

&sdhci0 {
	bus-width = <4>;
	no-1-8-v;
	no-mmc;
	no-sdio;
	disable-wp;
	pinctrl-0 = <&sdhci0_cfg>;
	pinctrl-names = "default";
	status = "okay";
};
