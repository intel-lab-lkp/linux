// SPDX-License-Identifier: (GPL-2.0-or-later OR X11)
/*
 * Device tree overlay for the Orange Pi Zero 2W 24-pin expansion board.
 *
 * The expansion board provides two buttons wired to LRADC channel 0 and an
 * IR receiver.  These are only present when the board is attached, so they
 * are deliberately kept out of the base .dts: on a bare board the LRADC
 * input and the IR receiver pin are not driven and float, which can cause
 * phantom key presses and interrupt storms.
 *
 * Apply on top of:
 *   arch/arm64/boot/dts/allwinner/sun50i-h618-orangepi-zero2w.dts
 */

/dts-v1/;
/plugin/;

#include <dt-bindings/input/input.h>

&lradc {
	vref-supply = <&reg_vcc3v3>;
	status = "okay";
	wakeup-source;

	button-1000 {
		label = "KEY_1";
		linux,code = <KEY_1>;
		channel = <0>;
		voltage = <1000000>;
	};

	button-1600 {
		label = "KEY_ENTER";
		linux,code = <KEY_ENTER>;
		channel = <0>;
		voltage = <1600000>;
	};
};

&ir {
	status = "okay";
};
