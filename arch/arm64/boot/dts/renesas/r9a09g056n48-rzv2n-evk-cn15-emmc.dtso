// SPDX-License-Identifier: GPL-2.0
/*
 * Device Tree overlay for the RZ/V2N EVK with the eMMC sub-board
 * (RTK0EF0186802000BJ) connected to the CN15 connector.
 *
 * Copyright (C) 2025 Renesas Electronics Corp.
 */

/dts-v1/;
/plugin/;

#define RZV2N_PA		10
#define EMMC_GPIO(port, pin)	RZG2L_GPIO(RZV2N_P##port, pin)

#include "rzv2-evk-cn15-emmc-common.dtsi"
