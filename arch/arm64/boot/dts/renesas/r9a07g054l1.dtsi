// SPDX-License-Identifier: (GPL-2.0-only OR BSD-2-Clause)
/*
 * Device Tree Source for the RZ/V2L R9A07G054L1 SoC specific parts
 *
 * Copyright (C) 2021 Renesas Electronics Corp.
 */

/dts-v1/;
#include "r9a07g054.dtsi"

/ {
	compatible = "renesas,r9a07g054l1", "renesas,r9a07g054";

	cpus {
		/delete-node/ cpu-map;
		/delete-node/ cpu@100;
	};
};

&gic {
	reg = <0x0 0x11900000 0 0x20000>,
	      <0x0 0x11940000 0 0x20000>;
};
