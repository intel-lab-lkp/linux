// SPDX-License-Identifier: (GPL-2.0+ OR MIT)
/*
 * Device Tree overlay for the Dell P1911 monitor connected to VGA port of a
 * Salvator-X or Salvator-XS board
 *
 * Copyright 2026 Ideas on Board Oy
 */

/dts-v1/;
/plugin/;

&{/vga} {
	edid = [00 ff ff ff ff ff ff 00 10 ac 74 a0 55 4b 55 30
		2b 14 01 03 80 29 1a 78 ee ee 95 a3 54 4c 99 26
		0f 50 54 bf ef 80 95 00 71 4f 81 80 95 0f 81 00
		01 01 01 01 01 01 9a 29 a0 d0 51 84 22 30 50 98
		36 00 98 ff 10 00 00 1c 00 00 00 ff 00 31 57 4b
		4a 56 30 41 4b 30 55 4b 55 0a 00 00 00 fc 00 44
		45 4c 4c 20 50 31 39 31 31 0a 20 20 00 00 00 fd
		00 38 4b 1e 53 0e 00 0a 20 20 20 20 20 20 00 ba];
};
