// SPDX-License-Identifier: GPL-2.0
/*
 * Device Tree overlay for the RZ/V2N EVK with the SD sub-board
 * (RTK0EF0186B01000BJ) connected to the CN15 connector.
 *
 * Copyright (C) 2025 Renesas Electronics Corp.
 */

/dts-v1/;
/plugin/;

#define RZV2N_PA		10
#define SD_GPIO(port, pin)	RZG2L_GPIO(RZV2N_P##port, pin)
#define SD_PORT_PINMUX(b, p, f)	RZG2L_PORT_PINMUX(RZV2N_P##b, p, f)

#include "rzv2-evk-cn15-sd-common.dtsi"
