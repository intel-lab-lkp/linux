// SPDX-License-Identifier: (GPL-2.0-only OR BSD-2-Clause)
/*
 * Device Tree Source for the RZ/G2L R9A07G044L1 SoC specific parts
 *
 * Copyright (C) 2021 Renesas Electronics Corp.
 */

/dts-v1/;
#include "r9a07g044.dtsi"

/ {
	compatible = "renesas,r9a07g044l1", "renesas,r9a07g044";

	cpus {
		/delete-node/ cpu-map;
		/delete-node/ cpu@100;
	};
};

&gic {
	reg = <0x0 0x11900000 0 0x20000>,
	      <0x0 0x11940000 0 0x20000>;
};
