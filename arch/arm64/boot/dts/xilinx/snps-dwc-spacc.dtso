// SPDX-License-Identifier: GPL-2.0
/*
 * dts file for Synopsys DWC SPAcc
 *
 * (C) Copyright 2024 Synopsys
 *
 * Ruud Derwig <Ruud.Derwig@synopsys.com>
 */

/dts-v1/;
/plugin/;

/ {
	#address-cells = <2>;
	#size-cells = <2>;

	fragment@0 {
		target = <&amba>;

		overlay1: __overlay__ {
			#address-cells = <2>;
			#size-cells = <2>;

			dwc_spacc: spacc@400000000 {
				compatible = "snps-dwc-spacc";
				reg = /bits/ 64 <0x400000000 0x3FFFF>;
				interrupts = <0 89 4>;
				interrupt-parent = <&gic>;
				clock-names = "ref_clk";
				spacc_priority = <0>;
				spacc_index = <0>;
			};
		};
	};
};
