// SPDX-License-Identifier: (GPL-2.0+ OR MIT)
/*
 * FIT-PCIE-SATA V1.0 is an adapter that included with OK3568-C
 * board and allows to connect SATA drives to the device.
 */

/dts-v1/;
/plugin/;

&pcie2x1 {
	status = "disabled";
};

&sata2 {
	status = "okay";
};
