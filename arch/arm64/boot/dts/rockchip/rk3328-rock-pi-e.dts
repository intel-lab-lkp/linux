// SPDX-License-Identifier: (GPL-2.0+ OR MIT)

/dts-v1/;

#include "rk3328-rock-pi-e-base.dtsi"

/ {
	model = "Radxa ROCK Pi E";
	compatible = "radxa,rockpi-e", "rockchip,rk3328";

	aliases {
		mmc0 = &sdmmc;
		mmc1 = &emmc;
	};
};
