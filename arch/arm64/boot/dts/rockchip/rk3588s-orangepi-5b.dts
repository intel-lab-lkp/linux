// SPDX-License-Identifier: (GPL-2.0+ OR MIT)

/dts-v1/;

#include "rk3588s-orangepi-5.dtsi"

/ {
	model = "Xunlong Orange Pi 5B";
	compatible = "rockchip,rk3588s-orangepi-5b", "rockchip,rk3588";
};

&sdhci {
	status = "okay";
};

&sfc {
	status = "disabled";
};