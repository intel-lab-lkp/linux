// SPDX-License-Identifier: (GPL-2.0+ OR MIT)

/dts-v1/;

#include "rk3566-radxa-zero3.dtsi"

/ {
	model = "Radxa ZERO 3W";
	compatible = "radxa,zero-3w", "rockchip,rk3566";

	aliases {
		mmc1 = &sdhci;
	};
};

&sdhci {
	bus-width = <8>;
	max-frequency = <200000000>;
	mmc-hs200-1_8v;
	non-removable;
	pinctrl-names = "default";
	pinctrl-0 = <&emmc_bus8 &emmc_clk &emmc_cmd &emmc_datastrobe>;
	vmmc-supply = <&vcc_3v3>;
	vqmmc-supply = <&vcc_1v8>;
	status = "okay";
};
