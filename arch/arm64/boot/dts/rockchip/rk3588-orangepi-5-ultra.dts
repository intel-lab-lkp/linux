// SPDX-License-Identifier: (GPL-2.0+ OR MIT)

/dts-v1/;

#include <dt-bindings/gpio/gpio.h>
#include <dt-bindings/pinctrl/rockchip.h>
#include "rk3588-orangepi-5-compact.dtsi"

/ {
	model = "Xunlong Orange Pi 5 Ultra";
	compatible = "xunlong,orangepi-5-ultra", "rockchip,rk3588";
};

&pinctrl {

	usb {
		usb_otg_pwren: usb-otg-pwren {
			rockchip,pins = <4 RK_PB1 RK_FUNC_GPIO &pcfg_pull_none>;
		};
	};
};
