// SPDX-License-Identifier: GPL-2.0+
/*
 * (C) Copyright 2018 FriendlyElec Computer Tech. Co., Ltd.
 * (http://www.friendlyarm.com)
 *
 * (C) Copyright 2016 Rockchip Electronics Co., Ltd
 */

/dts-v1/;
#include "rk3328-nanopi-r2s.dts"

/ {
	model = "FriendlyElec NanoPi R2S Plus";
	compatible = "friendlyarm,nanopi-r2s-plus", "rockchip,rk3328";

	aliases {
		mmc1 = &emmc;
	};
};

&emmc {
	bus-width = <8>;
	cap-mmc-highspeed;
	supports-emmc;
	disable-wp;
	non-removable;
	num-slots = <1>;
	pinctrl-names = "default";
	pinctrl-0 = <&emmc_clk &emmc_cmd &emmc_bus8>;
	status = "okay";
};
