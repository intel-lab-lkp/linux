// SPDX-License-Identifier: (GPL-2.0+ OR MIT)

/dts-v1/;

#include "rk3588s-nanopi-r6.dtsi"

/ {
	model = "FriendlyElec NanoPi R6S";
	compatible = "friendlyarm,nanopi-r6s", "rockchip,rk3588s";
};

&lan2_led {
	label = "lan2_led";
};

/* RTL8125BG Ethernet */
&pcie2x1l2 {
	vpcie3v3-supply = <&vcc_3v3_s3>;
};
