// SPDX-License-Identifier: (GPL-2.0+ OR MIT)
/*
 * Copyright (C) 2023 Marvell International Ltd.
 *
 * Device tree for the AC5X RD Type 7 Com Express carrier board,
 * Utilizing the CN913x COM Express CPU module board.
 * This specific board only maintains a PCIe link with the CPU CPU module
 * module, which does not require any special DTS definitions.
 */

#include "cn9131-db-comexpress.dtsi"
#include "ac5x-rd-carrier.dtsi"

/ {
	model = "Marvell Armada AC5X RD COM EXPRESS type 7 carrier board with CN9131 CPU module";
	compatible = "marvell,cn9131-ac5x-carrier", "marvell,rd-ac5x-carrier",
			"marvell,cn9131-cpu-module", "marvell,cn9131",
			"marvell,armada-ap807-quad", "marvell,armada-ap807";

	memory@0 {
		device_type = "memory";
		reg = <0x0 0x0 0x2 0x00000000>;
	};

};
