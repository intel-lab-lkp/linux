// SPDX-License-Identifier: (GPL-2.0+ OR MIT)
/*
 * Copyright (c) 2019 BayLibre SAS. All rights reserved.
 * Copyright (c) 2020 Christian Hewitt <christianshewitt@gmail.com>
 */

/dts-v1/;

#include "meson-sm1-ac2xx.dtsi"

/ {
	compatible = "amediatech,x96-air", "amlogic,sm1";
	model = "Shenzhen Amediatech Technology Co., Ltd X96 Air";
};

&ethmac {
	status = "okay";
	phy-handle = <&internal_ephy>;
	phy-mode = "rmii";
};
&ir {
	linux,rc-map-name = "rc-beelink-gs1";
};

