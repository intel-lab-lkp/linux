// SPDX-License-Identifier: (GPL-2.0 OR MIT)
/*
 * Copyright 2024 Google LLC
 */
/dts-v1/;
/plugin/;

&{/} {
	model = "Google Ciri sku7 board (rev4)";
	compatible = "google,ciri-sku7", "google,ciri", "mediatek,mt8188";
};
