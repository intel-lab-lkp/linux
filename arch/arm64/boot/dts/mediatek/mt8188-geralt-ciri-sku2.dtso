// SPDX-License-Identifier: (GPL-2.0 OR MIT)
/*
 * Copyright 2024 Google LLC
 */
/dts-v1/;
/plugin/;

&{/} {
	model = "Google Ciri sku2 board";
	compatible = "google,ciri-sku2", "google,ciri", "mediatek,mt8188";
};
