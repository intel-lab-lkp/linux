// SPDX-License-Identifier: (GPL-2.0 OR MIT)
/*
 * Copyright (C) 2025 MediaTek Inc.
 * Author: Sirius Wang <sirius.wang@mediatek.com>
 */
/dts-v1/;
#include "mt8189.dtsi"

/ {
	model = "MediaTek MT8189 evaluation board";
	compatible = "mediatek,mt8189-evb", "mediatek,mt8189";

	chosen: chosen {
		stdout-path = "serial0:115200n8";
	};
};

&uart0 {
	status = "okay";
};
