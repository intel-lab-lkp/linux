// SPDX-License-Identifier: GPL-2.0-only OR MIT
/*
 * Device Tree Source for J784S4 SoC Family
 *
 * TRM (SPRUJ43 JULY 2022): https://www.ti.com/lit/zip/spruj52
 *
 * Copyright (C) 2022-2024 Texas Instruments Incorporated - https://www.ti.com/
 *
 */

#include "k3-j784s4-j742s2-common.dtsi"

