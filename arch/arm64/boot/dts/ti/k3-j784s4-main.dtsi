// SPDX-License-Identifier: GPL-2.0-only OR MIT
/*
 * Device Tree Source for J784S4 SoC Family Main Domain peripherals
 *
 * Copyright (C) 2022-2024 Texas Instruments Incorporated - https://www.ti.com/
 */

&cbass_main {
	c71_3: dsp@67800000 {
		compatible = "ti,j721s2-c71-dsp";
		reg = <0x00 0x67800000 0x00 0x00080000>,
		      <0x00 0x67e00000 0x00 0x0000c000>;
		reg-names = "l2sram", "l1dram";
		ti,sci = <&sms>;
		ti,sci-dev-id = <40>;
		ti,sci-proc-ids = <0x33 0xff>;
		resets = <&k3_reset 40 1>;
		firmware-name = "j784s4-c71_3-fw";
		status = "disabled";
	};
};
