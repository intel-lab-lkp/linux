// SPDX-License-Identifier: GPL-2.0-only OR MIT
/**
 * Device Tree Source for enabling IPC using TI SDK firmware on J42S2 SoCs
 *
 * Copyright (C) 2026 Texas Instruments Incorporated - https://www.ti.com/
 * Copyright (C) 2026 Bootlin
 */

&reserved_memory {
	lpm_memory_region: memory@ab000000 {
		reg = <0x00 0xab000000 0x00 0x00300000>;
		no-map;
		bootph-pre-ram;
	};
};

&mcu_r5fss0_core0 {
	memory-region = <&mcu_r5fss0_core0_dma_memory_region>,
			<&mcu_r5fss0_core0_memory_region>,
			<&lpm_memory_region>;
	memory-region-names = "dma", "firmware", "lpm-metadata";
	bootph-pre-ram;
	status = "okay";
};
