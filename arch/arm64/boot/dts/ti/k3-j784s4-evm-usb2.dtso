// SPDX-License-Identifier: GPL-2.0-only OR MIT
/**
 * DT overlay for USB2.0 Type A functionality on J784S4-EVM.
 *
 * J784S4 EVM Product Link: https://www.ti.com/tool/J784S4XEVM
 *
 * Copyright (C) 2024 Texas Instruments Incorporated - https://www.ti.com/
 */

/dts-v1/;
/plugin/;

#include <dt-bindings/gpio/gpio.h>

&exp2 {
	p12-hog {
		/* P12 - USB2.0_MUX_SEL */
		gpio-hog;
		gpios = <12 GPIO_ACTIVE_HIGH>;
		output-high;
	};
};

&usb0 {
	dr_mode = "host";
};
