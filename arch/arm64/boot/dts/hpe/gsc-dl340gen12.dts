// SPDX-License-Identifier: GPL-2.0-only
/dts-v1/;

#include "gsc.dtsi"

/ {
	compatible = "hpe,gsc-dl340gen12", "hpe,gsc";
	model = "HPE ProLiant DL340 Gen12";

	chosen {
		stdout-path = &uartc;
	};

	memory@0 {
		device_type = "memory";
		reg = <0x00000000 0x40000000>;
	};
};
