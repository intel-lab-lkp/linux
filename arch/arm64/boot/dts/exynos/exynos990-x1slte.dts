// SPDX-License-Identifier: GPL-2.0 OR BSD-3-Clause
/*
 * Samsung Galaxy S20 (x1slte/SM-G980F) device tree source
 *
 * Copyright (c) 2024, Umer Uddin <umer.uddin@mentallysanemainliners.org>
 */

/dts-v1/;
#include "exynos990-hubble-common.dtsi"

/ {
	#address-cells = <2>;
	#size-cells = <2>;

	model = "Samsung Galaxy S20";
	compatible = "samsung,x1slte", "samsung,exynos990";
};
