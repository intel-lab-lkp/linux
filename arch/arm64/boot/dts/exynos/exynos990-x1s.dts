// SPDX-License-Identifier: GPL-2.0 OR BSD-3-Clause
/*
 * Samsung Galaxy S20 5G (x1s/SM-G981B) device tree source
 *
 * Copyright (c) 2024, Umer Uddin <umer.uddin@mentallysanemainliners.org>
 */

/dts-v1/;
#include "exynos990-hubble-common.dtsi"

/ {
	#address-cells = <2>;
	#size-cells = <2>;

	model = "Samsung Galaxy S20 5G";
	compatible = "samsung,x1s", "samsung,exynos990";

	memory@9fec00000 {
		device_type = "memory";
		reg = <0x9 0xfec00000 0x0 0x01400000>,
		      <0xa 0x0 0x0 0xfe800000>;
	};
};
