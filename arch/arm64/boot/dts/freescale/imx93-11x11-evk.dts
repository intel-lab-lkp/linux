// SPDX-License-Identifier: (GPL-2.0+ OR MIT)
/*
 * Copyright 2022,2026 NXP
 */

/dts-v1/;

#include "imx93.dtsi"
#include "imx93-11x11-evk-common.dtsi"

/ {
	model = "NXP i.MX93 11X11 EVK board";
	compatible = "fsl,imx93-11x11-evk", "fsl,imx93";
};
