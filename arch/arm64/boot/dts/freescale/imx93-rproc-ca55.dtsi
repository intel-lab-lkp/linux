// SPDX-License-Identifier: (GPL-2.0 OR MIT)
/*
 * Copyright 2024-2026 NXP
 */

/ {
	ca55_1: remoteproc-ca55-1 {
		compatible = "fsl,imx-rproc-psci";
		/* bitmask:0b10, assign A55 Core 1 */
		fsl,cpus-mask = <0x2>;
		memory-region = <&rtos_ca55_reserved>;
	};
};

