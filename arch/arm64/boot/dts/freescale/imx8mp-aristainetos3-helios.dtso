// SPDX-License-Identifier: (GPL-2.0+ OR MIT)
/*
 * Copyright (C) 2024 Heiko Schocher <hs@denx.de>
 */
/dts-v1/;
/plugin/;

#include "imx8mp-aristainetos3-helios.dtsi"

&{/} {
	model = "Aristainetos3 helios carrier";
	compatible = "abb,aristainetos3-helios", "abb,aristianetos3-som", "fsl,imx8mp";
};
