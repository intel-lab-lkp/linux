// SPDX-License-Identifier: GPL-2.0-or-later OR MIT
/*
 * Copyright (C) 2024 PHYTEC Messtechnik GmbH
 * Author: Cem Tenruh <c.tenruh@phytec.de>
 */

/dts-v1/;
/plugin/;

&flexspi {
	status = "disabled";
};

&som_flash {
	status = "disabled";
};
