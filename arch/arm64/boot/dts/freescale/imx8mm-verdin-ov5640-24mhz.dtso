// SPDX-License-Identifier: GPL-2.0-or-later OR MIT
/*
 * Copyright (c) Toradex
 *
 * Toradex CSI Camera Module 5MP OV5640 on Verdin CSI_1.
 *
 * https://developer.toradex.com/hardware/legacy-products/other/csi-camera-module-5mp-ov5640/
 */

/dts-v1/;
/plugin/;

#include "imx8mm-verdin-ov5640.dtsi"

&clock_camera {
	clock-frequency = <24000000>;
};
