// SPDX-License-Identifier: GPL-2.0-only OR MIT
/*
 * Copyright (c) Toradex
 *
 * Toradex SMARC iMX95 SER0 for Cortex-M7
 */

/dts-v1/;
/plugin/;

/* SMARC SER0 */
&lpuart2 {
	status = "reserved";
};
