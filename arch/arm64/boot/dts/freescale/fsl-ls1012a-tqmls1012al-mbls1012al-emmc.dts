// SPDX-License-Identifier: (GPL-2.0-or-later OR MIT)
/*
 * Copyright (c) 2018-2025 TQ-Systems GmbH <linux@ew.tq-group.com>,
 * D-82229 Seefeld, Germany.
 * Author: Matthias Schiffer
 * Author: Max Merchel
 */

#include "fsl-ls1012a-tqmls1012al-mbls1012al.dts"

&esdhc0 {
	vqmmc-supply = <&reg_1p8v>;
	/delete-property/ no-mmc;
	disable-wp;
	mmc-ddr-1_8v;
	mmc-hs200-1_8v;
	no-sdio;
	no-sd;
	voltage-ranges = <1800 1800>;
	non-removable;
};
