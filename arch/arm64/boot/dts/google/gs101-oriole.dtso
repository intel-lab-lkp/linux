// SPDX-License-Identifier: GPL-2.0-only
/*
 * Oriole DVT Device Tree
 *
 * Copyright 2021-2023 Google,LLC
 */

/dts-v1/;
/plugin/;

/ {
	board_id = <0x20304>;
	board_rev = <0x10000>;
	fragment@boardbase {
		target-path="/";
		__overlay__ {
			model = "Oriole DVT";
			compatible = "google,gs101-oriole";
		};
	};
};
