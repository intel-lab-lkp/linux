// SPDX-License-Identifier: GPL-2.0 OR BSD-3-Clause
/*
 * Google Pixel 10 family (mustang + blazer + frankel = muzel) common dtsi.
 *
 * Copyright 2024-2025 Google LLC.
 */

&{/} {
	chosen {
		stdout-path = "serial0";
	};

	aliases {
		serial0 = "/soc@0/serial@db62000";	/* &lsion_cli16_uart */
		ufs0 = "/ufs-placeholder";		/* &ufs - TODO "/soc@0/ufs@3c400000" */
	};
};
