// SPDX-License-Identifier: GPL-2.0-only
/*
 * Copyright Altera Corporation (C) 2026. All rights reserved.
 */

#include "socfpga_stratix10_socdk.dtsi"

/ {
	model = "SoCFPGA Stratix 10 SoCDK eMMC daughter board";
	compatible = "altr,socfpga-stratix10-socdk-emmc",
			"altr,socfpga-stratix10-socdk",
			"altr,socfpga-stratix10";
};

&mmc {
	status = "okay";
	cap-mmc-highspeed;
	broken-cd;
	bus-width = <4>;
	clk-phase-sd-hs = <0>, <135>;
};
