// SPDX-License-Identifier: GPL-2.0
/dts-v1/;

#include "tegra210b01-p2894.dtsi"

/ {
	model = "NVIDIA Shield TV Pro 2019";
	compatible = "nvidia,p2894-0050-a08", "nvidia,darcy", "nvidia,tegra210b01",
		"nvidia,tegra210";
};
