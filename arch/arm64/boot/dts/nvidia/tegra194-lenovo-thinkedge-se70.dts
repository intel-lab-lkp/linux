// SPDX-License-Identifier: GPL-2.0
/dts-v1/;

#include "tegra194-p3668-0001.dtsi"
#include "tegra194-lenovo-thinkedge-se70-baseboard.dtsi"

/ {
	model = "Lenovo ThinkEdge SE70";
	compatible = "lenovo,thinkedge-se70", "nvidia,p3668-0001", "nvidia,tegra194";

	chosen {
		bootargs = "console=ttyTCU0,115200";
	};
};
