// SPDX-License-Identifier: GPL-2.0+ OR MIT
/*
 * Apple iPhone X common device tree
 *
 * Copyright (c) 2022, Konrad Dybcio <konradybcio@kernel.org>
 */

#include "t8015.dtsi"

/ {
};

&serial0 {
	status = "okay";
};
