// SPDX-License-Identifier: BSD-3-Clause
/*
 * Copyright (c) Qualcomm Technologies, Inc. and/or its subsidiaries.
 */

#include "hamoa.dtsi"
#include "iq-x-iot-som.dtsi"

&gpu_zap_shader {
	firmware-name = "qcom/x1e80100/gen70500_zap.mbn";
};

&iris {
	status = "okay";
};
