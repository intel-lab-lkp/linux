// SPDX-License-Identifier: BSD-3-Clause
/*
 * Copyright (c) 2022, Konrad Dybcio <konrad.dybcio@somainline.org>
 */

/dts-v1/;

#include "sm6375-sony-xperia-murray.dtsi"

/ {
	model = "Sony Xperia 10 IV";
	compatible = "sony,pdx225", "qcom,sm6375";
	chassis-type = "handset";
};
