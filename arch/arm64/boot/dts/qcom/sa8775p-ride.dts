// SPDX-License-Identifier: BSD-3-Clause
/*
 * Copyright (c) 2023, Linaro Limited
 * Copyright (c) 2025, Qualcomm Innovation Center, Inc. All rights reserved.
 */

/dts-v1/;

#include "qam8775p-som.dtsi"

#include "sa8775p-ride-common.dtsi"
#include "sa8775p-ride-ethernet-88ea1512.dtsi"

/ {
	model = "Qualcomm SA8775P Ride";
	compatible = "qcom,sa8775p-ride", "qcom,qam8775p-som", "qcom,sa8775p";
};
