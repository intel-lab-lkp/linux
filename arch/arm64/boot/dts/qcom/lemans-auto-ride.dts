// SPDX-License-Identifier: BSD-3-Clause
/*
 * Copyright (c) 2023, Linaro Limited
 */

/dts-v1/;

#include "lemans-auto.dtsi"

#include "lemans-pmics.dtsi"
#include "lemans-ride-common.dtsi"
#include "lemans-ride-ethernet-88ea1512.dtsi"

/ {
	model = "Qualcomm Technologies, Inc. Lemans-auto Ride";
	compatible = "qcom,lemans-auto-ride", "qcom,sa8775p";
};
