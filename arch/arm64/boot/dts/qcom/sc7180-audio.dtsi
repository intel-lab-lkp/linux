// SPDX-License-Identifier: BSD-3-Clause
/*
 * Copyright (c) 2025 Qualcomm Innovation Center, Inc. All rights reserved.
 */
#include "elite-audio.dtsi"
&q6asmdai{
	iommus = <&apps_smmu 0x1001 0x0>;
};
