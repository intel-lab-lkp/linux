// SPDX-License-Identifier: BSD-3-Clause
/*
 * Copyright (c) 2025 Qualcomm Innovation Center, Inc. All rights reserved.
 */
#include "audioreach-audio.dtsi"

&q6apmdai{
	iommus = <&apps_smmu 0x0c01 0x0>;
};
