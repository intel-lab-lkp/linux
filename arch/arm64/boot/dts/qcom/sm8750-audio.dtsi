// SPDX-License-Identifier: BSD-3-Clause
/*
 * Copyright (c) 2025 Qualcomm Innovation Center, Inc. All rights reserved.
 */
#include "audioreach-audio.dtsi"

&q6apmdai{
	iommus = <&apps_smmu 0x1001 0x80>,
		 <&apps_smmu 0x1041 0x20>;
};
