// SPDX-License-Identifier: GPL-2.0-only
/*
 * Xiaomi Mi 8 (dipper).
 *
 * Copyright David Heidelberg. All rights reserved.
 */

/dts-v1/;

#include "sdm845-xiaomi-dipper-common.dtsi"

/ {
	model = "Xiaomi Mi 8";
	compatible = "xiaomi,dipper", "xiaomi,dipper-common", "qcom,sdm845";

	qcom,board-id = <55 0>;

	battery: battery {
		compatible = "simple-battery";

		charge-full-design-microamp-hours = <3400000>;
		voltage-min-design-microvolt = <3400000>;
		voltage-max-design-microvolt = <4400000>;
	};

};

&wifi {
	qcom,calibration-variant = "Xiaomi_dipper";
};
