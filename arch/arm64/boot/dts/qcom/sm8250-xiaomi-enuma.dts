// SPDX-License-Identifier: BSD-3-Clause
/*
 * Copyright (c) 2025 Dawid Wróbel <me@dawidwrobel.com>
 */

/dts-v1/;

#include "sm8250-xiaomi-elish-common.dtsi"

/ {
	model = "Xiaomi Mi Pad 5 Pro 5G";
	compatible = "xiaomi,enuma", "xiaomi,elish", "qcom,sm8250";

	/* Platform type differs from elish; msm-id is inherited unchanged. */
	qcom,board-id = <0x2e 0>;
};

&display_panel {
	compatible = "xiaomi,enuma-csot-nt36523", "xiaomi,elish-csot-nt36523",
		     "novatek,nt36523";
	status = "okay";
};

&wifi_0 {
	qcom,calibration-variant = "Xiaomi_Pad_5Pro_5G";
};
