## drivers/clk/cirrus/Kconfig
```kconfig
# SPDX-License-Identifier: GPL-2.0-only

config COMMON_CLK_CS2600
	tristate "Clock driver for CS2600 Fractional-N Clock Synthesizer & Clock Multiplier"
	depends on I2C
	depends on OF
	select REGMAP_I2C
	help
	  If you say yes here you get support for the CS2600 clock synthesizer
	  and multiplier.

config COMMON_CLK_CS2600_KUNIT_TEST
	tristate "KUnit test for CS2600 clock driver" if !KUNIT_ALL_TESTS
	depends on COMMON_CLK_CS2600
	depends on KUNIT
	depends on DTC
	depends on REGULATOR
	depends on REGULATOR_FIXED_VOLTAGE
	default KUNIT_ALL_TESTS
	help
	  Build the KUnit tests for the Cirrus Logic CS2600
	  clock driver.

	  If unsure say N.
```

## drivers/clk/davinci/Kconfig
```kconfig
# SPDX-License-Identifier: GPL-2.0-only
config COMMON_CLK_DAVINCI
	bool "Clock drivers for TI DaVinci SoCs"
	depends on ARCH_DAVINCI || COMPILE_TEST
	depends on HAS_IOMEM
	select REGMAP_MMIO
	select RESET_CONTROLLER
	default ARCH_DAVINCI
	help
	  Support for the clock controllers found on TI DaVinci SoCs.

if COMMON_CLK_DAVINCI

config COMMON_CLK_DAVINCI_DA8XX_CFGCHIP
	bool "TI DA8xx CFGCHIP clock driver"
	default ARCH_DAVINCI_DA8XX
	help
	  Support for the CFGCHIP clock gates found on TI DA8xx/OMAP-L13x
	  SoCs.

config COMMON_CLK_DAVINCI_DA850
	bool "TI DA850/OMAP-L138/AM18x clock support"
	select COMMON_CLK_DAVINCI_DA8XX_CFGCHIP
	default ARCH_DAVINCI_DA850
	help
	  Support for the PLL and PSC clocks found on TI DA850/OMAP-L138/AM18x
	  SoCs.

endif
```

## drivers/clk/eswin/Kconfig
```kconfig
# SPDX-License-Identifier: GPL-2.0

config COMMON_CLK_EIC7700
	bool "EIC7700 Clock Driver"
	depends on ARCH_ESWIN
	help
	  Build the Eswin EIC7700 SoC clock driver based on the
	  common clock framework. This driver provides support
	  for the clock control on the Eswin EIC7700 SoC,
	  which is essential for managing clock rates and power management.
```

## drivers/clk/mmp/Kconfig
```kconfig
# SPDX-License-Identifier: GPL-2.0-only

config COMMON_CLK_PXA1908
	bool "Clock driver for Marvell PXA1908"
	depends on ARCH_MMP || COMPILE_TEST
	depends on OF
	default y if ARCH_MMP && ARM64
	select PM
	select PM_GENERIC_DOMAINS
	select PM_GENERIC_DOMAINS_OF
	select REGMAP_MMIO
	help
	  This driver supports the Marvell PXA1908 SoC clocks. The SoC's power
	  domains are also supported by the driver.
```

## drivers/clk/rda/Kconfig
```kconfig
# SPDX-License-Identifier: GPL-2.0-only
config CLK_RDA8810
	bool "RDA Micro RDA8810PL Clock and Reset Controller"
	depends on ARCH_RDA || COMPILE_TEST
	select MFD_SYSCON
	select REGMAP_MMIO
	select RESET_CONTROLLER
	help
	  This driver supports clock and reset for RDA Micro RDA8810 platform.
	  If you have a board with the RDA8810PL SoC, say Y to use most of the
	  board peripherals.

	  If unsure, say N.
```

## drivers/clk/realtek/Kconfig
```kconfig
# SPDX-License-Identifier: GPL-2.0-only
config COMMON_CLK_REALTEK
	tristate "Clock driver for Realtek SoCs"
	depends on ARCH_REALTEK || COMPILE_TEST
	default ARCH_REALTEK
	help
	  Enable the common clock framework infrastructure for Realtek
	  system-on-chip platforms.

	  This provides the base support required by individual Realtek
	  clock controller drivers to expose clocks to peripheral devices.

	  If you have a Realtek-based platform, say Y.

if COMMON_CLK_REALTEK

config RTK_CLK_COMMON
	tristate "Realtek Clock Common"
	depends on RESET_CONTROLLER
	select AUXILIARY_BUS
	select MFD_SYSCON
	select RESET_RTK_COMMON
	help
	  Common helper code shared by Realtek clock controller drivers.

	  This provides utility functions and data structures used by
	  multiple Realtek clock implementations, and include integration
	  with reset controllers where required.

endif
```
