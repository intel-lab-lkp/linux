## arch/x86/Kconfig.assembler
```kconfig
# SPDX-License-Identifier: GPL-2.0
# Copyright (C) 2020 Jason A. Donenfeld <Jason@zx2c4.com>. All Rights Reserved.

config AS_APX
	def_bool $(as-instr64,xor %r16$(comma)%r16)
	help
	  Supported by binutils >= 2.42 and LLVM integrated assembler >= V18

config AS_WRUSS
	def_bool $(as-instr64,wrussq %rax$(comma)(%rbx))
	help
	  Supported by binutils >= 2.31 and LLVM integrated assembler
```

## drivers/a2b/Kconfig
```kconfig
# SPDX-License-Identifier: GPL-2.0-only
#
# A2B driver configuration
#

menuconfig A2B
       tristate "A2B support"
       select OF
       help
	 A2B (Automotive Audio Bus) is a digital audio and control bus from
	 Analog Devices Inc. that enables synchronous capture and playback of
	 PCM audio over distance.

	 If unsure, say N.

if A2B

config A2B_AD24XX_I2C
       tristate "Analog Devices Inc. AD24xx I2C interface support"
       depends on I2C
       select REGMAP_I2C
       select A2B_AD24XX_NODE
       help
         Say Y here to enable I2C interface support for AD24xx A2B transceiver
         chips from Analog Devices Inc. Supported models include AD240x, AD241x,
         and AD242x.

	 Selecting this option will also force AD24xx node support, which is
	 required to operate the chip as a main node.

	 If unsure, say N.

config A2B_AD24XX_NODE
       tristate "Analog Devices Inc. AD24xx node support"
       select REGMAP_A2B
       imply GPIO_AD24XX
       imply SND_SOC_AD24XX
       imply COMMON_CLK_AD24XX
       imply I2C_AD24XX
       help
         Say Y here to enable support for AD24xx A2B transceiver nodes. This
         applies to both main nodes and subordinate nodes. Supported models
         include AD240x, AD241x, and AD242x.

	 If unsure, say N.

config A2B_BEO_SHAPE_NODE
       tristate "Bang & Olufsen Beosound Shape node support"
       depends on A2B_AD24XX_NODE
       help
         The Beosound Shape is an A2B-connected amplifier speaker. As a piece of
         hardware it is functionally similar to any board with an AD2425, but
         this driver handles firmware update of the on-board microcontroller in
         a way that is agreeable to the A2B driver model.

	 Beosound Shapes are always subordinate A2B nodes.

	 If unsure, say N.

endif # A2B
```

## drivers/accel/amd-ai-engine/Kconfig
```kconfig
# SPDX-License-Identifier: GPL-2.0-only

config DRM_ACCEL_AMDAIE
	tristate "AMD Versal AI Engine"
	depends on ARM64 || COMPILE_TEST
	depends on ZYNQMP_FIRMWARE
	depends on DRM_ACCEL
	help
	  This option enables support for the AMD AI engine driver.
	  One AMD AI engine device can have multiple partitions (groups of
	  AI engine tiles). AMD AI engine device driver instance manages
	  AI engine partitions. Applications access its partitions through
	  AI engine partition device instance.

	  If unsure, say N
```

## drivers/accel/amd_vpci/Kconfig
```kconfig
# SPDX-License-Identifier: GPL-2.0-only

config DRM_ACCEL_AMD_VPCI
	tristate "AMD Versal PCIe Management Driver"
	depends on DRM_ACCEL
	depends on PCI && HAS_IOMEM
	select FW_LOADER
	select CONFIGFS_FS
	default m
	help
	  AMD Versal PCIe Management Driver provides management services,
	  including download firmware, program bitstream, and communicate with
	  the User function.

	  If "M" is selected, the driver module will be versal-pci
```

## drivers/accel/amdpk/Kconfig
```kconfig
# SPDX-License-Identifier: GPL-2.0-only
#
# Makefile for AMD PKI accelerator for versal-net
#

config DRM_ACCEL_AMDPK
	tristate "AMD PKI accelerator for versal-net"
	depends on DRM_ACCEL
	depends on ARM64 || COMPILE_TEST
	help
	  Enables platform driver for AMD PKI accelerator that are designed
	  for high performance Public Key asymmetric crypto operations on AMD
	  versal-net.

	  If unsure, say N.

	  To compile this driver as a module, choose M here: the
	  module will be called amdpk.
```

## drivers/accel/neutron/Kconfig
```kconfig
# SPDX-License-Identifier: GPL-2.0+

config DRM_ACCEL_NXP_NEUTRON
	tristate "NXP Neutron NPU"
	depends on HAS_IOMEM
	depends on DRM_ACCEL
	depends on ARCH_MXC
	select DRM_GEM_DMA_HELPER
	select DRM_SCHED
	help
	  Enables driver for NXP Neutron NPU.

	  Select this if you have an NXP SoC with Neutron, like i.MX95,
	  and want to run machine learning applications.

	  If built as module, the module is named neutron.
```

## drivers/accel/npac/Kconfig
```kconfig
config DRM_ACCEL_NPAC_CLIENT
	tristate "NPAC Client Driver"
	depends on DRM_ACCEL
	depends on RPMSG
	help
	  This driver is the NPAC (Network Packet ACcelerator) client,
	  communicating with the NPAC host driver running on a remote
	  processor over RPMsg. The driver registers with the DRM accelerator
	  framework and exposes /dev/accel/accel* as the userspace interface
	  for ACL rule offload operations.
	  If you have a device with NPAC and wish to use it with this
	  driver, say M to compile this driver as a module, or Y to
	  compile it into the kernel.
```

## drivers/accel/qda/Kconfig
```kconfig
# SPDX-License-Identifier: GPL-2.0-only
#
# Qualcomm DSP accelerator driver
#


config DRM_ACCEL_QDA_COMPUTE_BUS
	bool

config DRM_ACCEL_QDA
	tristate "Qualcomm DSP accelerator"
	depends on DRM_ACCEL
	depends on ARCH_QCOM || COMPILE_TEST
	depends on RPMSG
	select DRM_ACCEL_QDA_COMPUTE_BUS
	help
	  Enables the DRM-based accelerator driver for Qualcomm's Hexagon DSPs.
	  This driver provides a standardized interface for offloading computational
	  tasks to the DSP, including audio processing, sensor offload, computer
	  vision, and AI inference workloads.

	  The driver supports all DSP domains (ADSP, CDSP, SDSP, GDSP) and
	  implements the FastRPC protocol for communication between the application
	  processor and DSP. It integrates with the Linux kernel's Compute
	  Accelerators subsystem (drivers/accel/) and provides a modern alternative
	  to the legacy FastRPC driver found in drivers/misc/.

	  Key features include DMA-BUF interoperability for seamless buffer sharing
	  with other multimedia subsystems, IOMMU-based memory isolation, and
	  standard DRM IOCTLs for device management and job submission.

	  If unsure, say N.

	  To compile this driver as a module, choose M here: the
	  module will be called qda.
```

## drivers/acpi/numa/Kconfig
```kconfig
# SPDX-License-Identifier: GPL-2.0
config ACPI_NUMA
	def_bool NUMA && !X86

config ACPI_HMAT
	bool "ACPI Heterogeneous Memory Attribute Table Support"
	depends on ACPI_NUMA
	select HMEM_REPORTING
	select MEMREGION
	help
	 If set, this option has the kernel parse and report the
	 platform's ACPI HMAT (Heterogeneous Memory Attributes Table),
	 register memory initiators with their targets, and export
	 performance attributes through the node's sysfs device if
	 provided.

config ACPI_HMAT_KUNIT_TEST
	bool "KUnit tests for ACPI HMAT P2P matrices" if !KUNIT_ALL_TESTS
	depends on ACPI_HMAT && KUNIT=y
	default KUNIT_ALL_TESTS
	help
	  Enable KUnit coverage for parsing and querying the PCIe P2P
	  Latency and Bandwidth Information Structure, including directional
	  matrix indexing, traffic classes, normalization, and unreachable
	  entries.

	  For more information on KUnit and unit tests in general, refer to
	  the KUnit documentation in Documentation/dev-tools/kunit/.
```

## drivers/amba/Kconfig
```kconfig
# SPDX-License-Identifier: GPL-2.0
config ARM_AMBA
	bool "AMBA bus support" || if COMPILE_TEST

if ARM_AMBA

config TEGRA_AHB
	bool
	default y if ARCH_TEGRA
	help
	  Adds AHB configuration functionality for NVIDIA Tegra SoCs,
	  which controls AHB bus master arbitration and some performance
	  parameters (priority, prefetch size).

endif
```

## drivers/block/brmr/Kconfig
```kconfig
# SPDX-License-Identifier: GPL-2.0-or-later

config BLK_DEV_BRMR
	bool

config BLK_DEV_BRMR_CLIENT
	tristate "Block device over RMR (BRMR) client"
	depends on INFINIBAND_RMR_CLIENT
	select BLK_DEV_BRMR
	help
	  BRMR client is a block device driver that sits on top of the
	  RMR ULP and exposes a standard Linux block device (/dev/brmrX)
	  backed by an RMR pool.  Together with RMR it provides a
	  single-hop replication and resynchronization solution for
	  RDMA-connected storage clusters.

	  If unsure, say N.

config BLK_DEV_BRMR_SERVER
	tristate "Block device over RMR (BRMR) server"
	depends on INFINIBAND_RMR_SERVER
	select BLK_DEV_BRMR
	help
	  BRMR server exports a local block device as the backing store
	  for an RMR pool, so that BRMR clients can map it remotely
	  over RDMA.

	  If unsure, say N.
```

## drivers/bus/mhi/ep/Kconfig
```kconfig
config MHI_BUS_EP
	tristate "Modem Host Interface (MHI) bus Endpoint implementation"
	help
	  Bus driver for MHI protocol. Modem Host Interface (MHI) is a
	  communication protocol used by a host processor to control
	  and communicate a modem device over a high speed peripheral
	  bus or shared memory.

	  MHI_BUS_EP implements the MHI protocol for the endpoint devices,
	  such as SDX55 modem connected to the host machine over PCIe.

config MHI_BUS_EP_LOOPBACK
	tristate "MHI Endpoint loopback driver"
	depends on MHI_BUS_EP
	help
	  MHI endpoint loopback driver for data path testing.
	  This driver receives data on the uplink channel and echoes
	  it back on the downlink channel for testing purposes.
```

## drivers/bus/mhi/host/clients/Kconfig
```kconfig
# SPDX-License-Identifier: GPL-2.0

config MHI_BUS_LOOPBACK
	tristate "MHI LOOPBACK client driver"
	depends on MHI_BUS
	help
	  MHI LOOPBACK client driver that binds to the MHI LOOPBACK channel
	  as defined in the MHI specification. The LOOPBACK channel is
	  implemented by MHI-based devices (modems, WLAN) in the field, where
	  the endpoint firmware echoes back whatever the host sends.

	  This driver exposes a sysfs interface for testing MHI data path
	  integrity between host and endpoint. Users can configure the TRE
	  size and count, trigger a loopback test, and read the result.

	  To compile this driver as a module, choose M here. The module
	  will be called mhi_loopback.
```

## drivers/bus/mhi/sahara/Kconfig
```kconfig
config MHI_SAHARA
	tristate
	depends on MHI_BUS
	select FW_LOADER_COMPRESS
	select FW_LOADER_COMPRESS_XZ
	select FW_LOADER_COMPRESS_ZSTD
	help
	  Enable support for the Sahara protocol transported over the MHI bus.

	  The Sahara protocol is used to transfer firmware images, retrieve
	  memory dumps and exchange command mode DDR calibration data between
	  host and device. This driver is not tied to a specific SoC and may be
	  used by multiple MHI based devices.

	  If unsure, say N.

	  To compile this driver as a module, choose M here: the module will be
	  called mhi_sahara.
```

## drivers/cache/Kconfig
```kconfig
# SPDX-License-Identifier: GPL-2.0
menu "Cache Drivers"

config CACHE_COHERENCY_SUBSYSTEM
	bool "Cache coherency control subsystem"
	depends on ARCH_HAS_CPU_CACHE_INVALIDATE_MEMREGION
	depends on GENERIC_CPU_CACHE_INVALIDATE_MEMREGION
	help
	  Framework to which coherency control drivers register allowing core
	  kernel subsystems to issue invalidations and similar coherency
	  operations.

if CACHE_COHERENCY_SUBSYSTEM

config ACPI_CACHE_CONTROL
       tristate "ACPI cache maintenance"
       depends on ARM64 && ACPI
       help
         ACPI0019 device ID in DSDT identifies an interface that may be used
	 to carry out certain forms of cache flush operation.

config HISI_SOC_HHA
	tristate "HiSilicon Hydra Home Agent (HHA) device driver"
	depends on (ARM64 && ACPI) || COMPILE_TEST
	help
	  The Hydra Home Agent (HHA) is responsible of cache coherency
	  on SoC. This drivers provides cache maintenance functions of HHA.

	  This driver can be built as a module. If so, the module will be
	  called hisi_soc_hha.

endif

config AX45MP_L2_CACHE
	bool "Andes Technology AX45MP L2 Cache controller"
	depends on RISCV
	select RISCV_NONSTANDARD_CACHE_OPS
	help
	  Support for the L2 cache controller on Andes Technology AX45MP platforms.

config SIFIVE_CCACHE
	bool "Sifive Composable Cache controller"
	depends on ARCH_SIFIVE || ARCH_STARFIVE
	help
	  Support for the composable cache controller on SiFive platforms.

config STARFIVE_STARLINK_CACHE
	bool "StarFive StarLink Cache controller"
	depends on RISCV
	depends on ARCH_STARFIVE
	depends on 64BIT
	select RISCV_DMA_NONCOHERENT
	select RISCV_NONSTANDARD_CACHE_OPS
	help
	  Support for the StarLink cache controller IP from StarFive.

endmenu
```

## drivers/clk/ambarella/Kconfig
```kconfig
# SPDX-License-Identifier: GPL-2.0-only

config CLK_AMBARELLA_CV75
	bool "Ambarella CV75 RCT clock controller"
	depends on ARCH_AMBARELLA || COMPILE_TEST
	select CLK_AMBARELLA_CCU
	default ARCH_AMBARELLA
	help
	  Say Y to enable the Ambarella CV75 RCT clock controller.

config CLK_AMBARELLA_CCU
	bool
	select REGMAP_MMIO
```

## drivers/clk/amlogic/Kconfig
```kconfig
# SPDX-License-Identifier: (GPL-2.0-only OR MIT)

config COMMON_CLK_AMLOGIC
	tristate "Amlogic Common Clock"
	depends on ARCH_MESON || COMPILE_TEST
	depends on OF
	default ARCH_MESON
	select REGMAP
	help
	  This driver provides the basic clock infrastructure for Amlogic SoCs,
	  offering read and write interfaces for various clock control units.
	  Select Y if your target SoC needs clock driver support.

config COMMON_CLK_AMLOGIC_MISC
	tristate "Amlogic Misc Clock Control Units"
	depends on COMMON_CLK_AMLOGIC
	help
	  Supports non-standard module clock control units in Amlogic SoC clock
	  trees, such as sc-ccu (for smart card controller) and ts-ccu (for
	  temperature sensor). Select Y if the current SoC contains these module
	  clock control units.

config COMMON_CLK_AMLOGIC_MODEL
	tristate "Amlogic Standardized Model Clock Control Units"
	depends on COMMON_CLK_AMLOGIC
	help
	  Supports standardized model clock control units commonly used in Amlogic
	  SoC clock trees, such as composite-ccu, noglitch-ccu, and sysbus-ccu.
	  Most peripheral clock controllers in Amlogic SoCs are composed of
	  these models. Select Y if the current SoC contains these clock control
	  unit models.

config COMMON_CLK_AMLOGIC_PLL
	tristate "Amlogic PLL Controller"
	depends on COMMON_CLK_AMLOGIC
	help
	  Supports PLL controller used in Amlogic SoCs. The PLL supports dynamic
	  configuration of output clock frequency, enabling flexible frequency
	  settings to provide clocks for other modules. Select Y if the current
	  SoC contains PLLs.

config COMMON_CLK_AMLOGIC_A9
	tristate "Amlogic A9 Family Clock Controller"
	depends on COMMON_CLK_AMLOGIC
	default COMMON_CLK_AMLOGIC
	select COMMON_CLK_AMLOGIC_MISC
	select COMMON_CLK_AMLOGIC_MODEL
	select COMMON_CLK_AMLOGIC_PLL
	help
	  Support for the clock controller present on the Amlogic A9 family
	  SoCs. Select Y if A9 family SoC needs to support clock controller.
```

## drivers/clk/anlogic/Kconfig
```kconfig
# SPDX-License-Identifier: GPL-2.0

config ANLOGIC_DR1V90_CRU
	tristate "Anlogic DR1V90 clock support"
	depends on ARCH_ANLOGIC || COMPILE_TEST
	select AUXILIARY_BUS
	default ARCH_ANLOGIC
	help
	  Support for the Clock and Reset Unit in Anlogic DR1V90 SoCs.
```

## drivers/clk/berlin/Kconfig
```kconfig
# SPDX-License-Identifier: GPL-2.0

config SL_COMMON_CLK
	bool

config SL_SYSMGR_CLK
	bool

config SL261X_PLL
	tristate "Synaptics SL261X PLL Driver"
	depends on ARCH_BERLIN || COMPILE_TEST
	default n
	help
	  This driver provides support for PLLs on Synaptics SL261X SoC.

config SL261X_CLK
	tristate "Synaptics SL261X Clock Driver"
	depends on ARCH_BERLIN || COMPILE_TEST
	select SL_COMMON_CLK
	select SL_SYSMGR_CLK
	default n
	help
	  This driver provides support for clock controller on Synaptics SL261X
	  SoC. The clock controller generates and supplies clocks to various
	  peripherals within the SoC.
```
