// SPDX-License-Identifier: GPL-2.0-or-later OR BSD-2-Clause

#include "xrx200.dtsi"

/ {
	compatible = "bt,homehub-v5a", "lantiq,vr9";
	model = "BT Home Hub 5A";

	chosen {
		bootargs = "console=ttyLTQ0,115200";
	};

	memory@0 {
		device_type = "memory";
		reg = <0x0 0x8000000>;
	};
};
