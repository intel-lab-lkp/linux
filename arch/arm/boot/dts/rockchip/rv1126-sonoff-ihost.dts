// SPDX-License-Identifier: (GPL-2.0+ OR MIT)
/*
 * Copyright (c) 2020 Rockchip Electronics Co., Ltd.
 */

/dts-v1/;
#include "rv1126.dtsi"
#include "rv1126-sonoff-ihost.dtsi"

/ {
	model = "Sonoff iHost 4G";
	compatible = "itead,sonoff-ihost", "rockchip,rv1126";
};
