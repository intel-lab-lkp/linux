// SPDX-License-Identifier: (GPL-2.0+ OR MIT)
/*
 * Copyright (c) 2022 Rockchip Electronics Co., Ltd.
 * Copyright (c) 2025 plan44.ch/luz
 * Copyright (c) 2025 Onion Corporation
 */

/dts-v1/;

#include "rv1103b.dtsi"

&uart0 {
	pinctrl-names = "default";
	pinctrl-0 = <&uart0m0_xfer>;
	bootph-all;
	status = "okay";
};

&wdt {
	status = "okay";
};
