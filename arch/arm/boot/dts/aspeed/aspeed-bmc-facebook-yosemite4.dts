// SPDX-License-Identifier: GPL-2.0-or-later
// Copyright 2022 Facebook Inc.

/dts-v1/;
#include "aspeed-g6.dtsi"
#include <dt-bindings/gpio/aspeed-gpio.h>
#include <dt-bindings/leds/leds-pca955x.h>
#include <dt-bindings/i2c/i2c.h>

/ {
	model = "Facebook Yosemite 4 BMC";
	compatible = "facebook,yosemite4-bmc", "aspeed,ast2600";

	aliases {
		serial4 = &uart5;
		serial5 = &uart6;
		serial6 = &uart7;
		serial7 = &uart8;
		serial8 = &uart9;

		i2c16 = &imux16;
		i2c17 = &imux17;
		i2c18 = &imux18;
		i2c19 = &imux19;
		i2c20 = &imux20;
		i2c21 = &imux21;
		i2c22 = &imux22;
		i2c23 = &imux23;
		i2c24 = &imux24;
		i2c25 = &imux25;
		i2c26 = &imux26;
		i2c27 = &imux27;
		i2c28 = &imux28;
		i2c29 = &imux29;
		i2c30 = &imux30;
		i2c31 = &imux31;
		i2c32 = &imux32;
		i2c33 = &imux33;
		i2c34 = &imux34;
		i2c35 = &imux35;
		i2c36 = &imux36;
		i2c37 = &imux37;
	};

	chosen {
		stdout-path = "serial4:57600n8";
	};

	memory@80000000 {
		device_type = "memory";
		reg = <0x80000000 0x80000000>;
	};

	iio-hwmon {
		compatible = "iio-hwmon";
		io-channels = <&adc0 0>, <&adc0 1>, <&adc0 2>, <&adc0 3>,
				<&adc0 4>, <&adc0 5>, <&adc0 6>, <&adc0 7>,
				<&adc1 0>, <&adc1 1>, <&adc1 7>;
	};

	spi_gpio: spi-gpio {
		compatible = "spi-gpio";
		#address-cells = <1>;
		#size-cells = <0>;

		gpio-sck = <&gpio0 ASPEED_GPIO(X, 3) GPIO_ACTIVE_HIGH>;
		gpio-mosi = <&gpio0 ASPEED_GPIO(X, 4) GPIO_ACTIVE_HIGH>;
		gpio-miso = <&gpio0 ASPEED_GPIO(X, 5) GPIO_ACTIVE_HIGH>;
		num-chipselects = <1>;
		cs-gpios = <&gpio0 ASPEED_GPIO(X, 0) GPIO_ACTIVE_LOW>;

		tpmdev@0 {
			compatible = "tcg,tpm_tis-spi";
			spi-max-frequency = <33000000>;
			reg = <0>;
		};
	};

	leds {
		compatible = "gpio-leds";

		fan0_blue {
			retain-state-shutdown;
			default-state = "on";
			gpios = <&led_gpio0 4 GPIO_ACTIVE_HIGH>;
		};

		fan0_amber {
			retain-state-shutdown;
			default-state = "off";
			gpios = <&led_gpio0 5 GPIO_ACTIVE_HIGH>;
		};

		fan1_blue {
			retain-state-shutdown;
			default-state = "on";
			gpios = <&led_gpio0 10 GPIO_ACTIVE_HIGH>;
		};

		fan1_amber {
			retain-state-shutdown;
			default-state = "off";
			gpios = <&led_gpio0 11 GPIO_ACTIVE_HIGH>;
		};

		fan2_blue {
			retain-state-shutdown;
			default-state = "on";
			gpios = <&led_gpio1 4 GPIO_ACTIVE_HIGH>;
		};

		fan2_amber {
			retain-state-shutdown;
			default-state = "off";
			gpios = <&led_gpio1 5 GPIO_ACTIVE_HIGH>;
		};

		fan3_blue {
			retain-state-shutdown;
			default-state = "on";
			gpios = <&led_gpio1 10 GPIO_ACTIVE_HIGH>;
		};

		fan3_amber {
			retain-state-shutdown;
			default-state = "off";
			gpios = <&led_gpio1 11 GPIO_ACTIVE_HIGH>;
		};

		fan4_blue {
			retain-state-shutdown;
			default-state = "on";
			gpios = <&led_gpio0 2 GPIO_ACTIVE_HIGH>;
		};

		fan4_amber {
			retain-state-shutdown;
			default-state = "off";
			gpios = <&led_gpio0 3 GPIO_ACTIVE_HIGH>;
		};

		fan5_blue {
			retain-state-shutdown;
			default-state = "on";
			gpios = <&led_gpio0 8 GPIO_ACTIVE_HIGH>;
		};

		fan5_amber {
			retain-state-shutdown;
			default-state = "off";
			gpios = <&led_gpio0 9 GPIO_ACTIVE_HIGH>;
		};

		fan6_blue {
			retain-state-shutdown;
			default-state = "on";
			gpios = <&led_gpio1 2 GPIO_ACTIVE_HIGH>;
		};

		fan6_amber {
			retain-state-shutdown;
			default-state = "off";
			gpios = <&led_gpio1 3 GPIO_ACTIVE_HIGH>;
		};

		fan7_blue {
			retain-state-shutdown;
			default-state = "on";
			gpios = <&led_gpio1 8 GPIO_ACTIVE_HIGH>;
		};

		fan7_amber {
			retain-state-shutdown;
			default-state = "off";
			gpios = <&led_gpio1 9 GPIO_ACTIVE_HIGH>;
		};

		fan8_blue {
			retain-state-shutdown;
			default-state = "on";
			gpios = <&led_gpio0 0 GPIO_ACTIVE_HIGH>;
		};

		fan8_amber {
			retain-state-shutdown;
			default-state = "off";
			gpios = <&led_gpio0 1 GPIO_ACTIVE_HIGH>;
		};

		fan9_blue {
			retain-state-shutdown;
			default-state = "on";
			gpios = <&led_gpio0 6 GPIO_ACTIVE_HIGH>;
		};

		fan9_amber {
			retain-state-shutdown;
			default-state = "off";
			gpios = <&led_gpio0 7 GPIO_ACTIVE_HIGH>;
		};

		fan10_blue {
			retain-state-shutdown;
			default-state = "on";
			gpios = <&led_gpio1 0 GPIO_ACTIVE_HIGH>;
		};

		fan10_amber {
			retain-state-shutdown;
			default-state = "off";
			gpios = <&led_gpio1 1 GPIO_ACTIVE_HIGH>;
		};

		fan11_blue {
			retain-state-shutdown;
			default-state = "on";
			gpios = <&led_gpio1 6 GPIO_ACTIVE_HIGH>;
		};

		fan11_amber {
			retain-state-shutdown;
			default-state = "off";
			gpios = <&led_gpio1 7 GPIO_ACTIVE_HIGH>;
		};
	};
};

&uart1 {
	status = "okay";
};

&uart2 {
	status = "okay";
};

&uart3 {
	status = "okay";
};

&uart4 {
	status = "okay";
};

&uart5 {
	status = "okay";
};

&uart6 {
	status = "okay";
};

&uart7 {
	status = "okay";
};

&uart8 {
	status = "okay";
};

&uart9 {
	status = "okay";
};

&wdt1 {
	status = "okay";
	pinctrl-names = "default";
	pinctrl-0 = <&pinctrl_wdtrst1_default>;
	aspeed,reset-type = "soc";
	aspeed,external-signal;
	aspeed,ext-push-pull;
	aspeed,ext-active-high;
	aspeed,ext-pulse-duration = <256>;
};

&wdt2 {
	status = "okay";
	pinctrl-names = "default";
	pinctrl-0 = <&pinctrl_wdtrst2_default>;
	aspeed,reset-type = "system";
};

&mac2 {
	status = "okay";
	pinctrl-names = "default";
	pinctrl-0 = <&pinctrl_rmii3_default>;
	use-ncsi;
	mellanox,multi-host;
};

&mac3 {
	status = "okay";
	pinctrl-names = "default";
	pinctrl-0 = <&pinctrl_rmii4_default>;
	use-ncsi;
	mellanox,multi-host;
};

&fmc {
	status = "okay";
	flash@0 {
		status = "okay";
		m25p,fast-read;
		label = "bmc";
		spi-tx-bus-width = <2>;
		spi-rx-bus-width = <2>;
		spi-max-frequency = <50000000>;
#include "openbmc-flash-layout-128.dtsi"
	};
	flash@1 {
		status = "okay";
		m25p,fast-read;
		label = "bmc2";
		spi-tx-bus-width = <2>;
		spi-rx-bus-width = <2>;
		spi-max-frequency = <50000000>;
	};
};

&i2c0 {
	status = "okay";
	mctp-controller;
	bus-frequency = <400000>;
	multi-master;

	mctp@10 {
		compatible = "mctp-i2c-controller";
		reg = <(0x10 | I2C_OWN_SLAVE_ADDRESS)>;
	};

	gpio@21 {
		compatible = "nxp,pca9506";
		reg = <0x21>;
		gpio-controller;
		#gpio-cells = <2>;
	};

	gpio@22 {
		compatible = "nxp,pca9506";
		reg = <0x22>;
		gpio-controller;
		#gpio-cells = <2>;
	};

	gpio@23 {
		compatible = "nxp,pca9506";
		reg = <0x23>;
		gpio-controller;
		#gpio-cells = <2>;
	};

	gpio@24 {
		compatible = "nxp,pca9506";
		reg = <0x24>;
		gpio-controller;
		#gpio-cells = <2>;
	};

	power-sensor@40 {
		compatible = "adi,adm1281";
		reg = <0x40>;
		shunt-resistor-micro-ohms = <500>;
	};
};

&i2c1 {
	status = "okay";
	mctp-controller;
	bus-frequency = <400000>;
	multi-master;

	mctp@10 {
		compatible = "mctp-i2c-controller";
		reg = <(0x10 | I2C_OWN_SLAVE_ADDRESS)>;
	};

	gpio@21 {
		compatible = "nxp,pca9506";
		reg = <0x21>;
		gpio-controller;
		#gpio-cells = <2>;
	};

	gpio@22 {
		compatible = "nxp,pca9506";
		reg = <0x22>;
		gpio-controller;
		#gpio-cells = <2>;
	};

	gpio@23 {
		compatible = "nxp,pca9506";
		reg = <0x23>;
		gpio-controller;
		#gpio-cells = <2>;
	};

	gpio@24 {
		compatible = "nxp,pca9506";
		reg = <0x24>;
		gpio-controller;
		#gpio-cells = <2>;
	};

	power-sensor@40 {
		compatible = "adi,adm1281";
		reg = <0x40>;
		shunt-resistor-micro-ohms = <500>;
	};
};

&i2c2 {
	status = "okay";
	mctp-controller;
	bus-frequency = <400000>;
	multi-master;

	mctp@10 {
		compatible = "mctp-i2c-controller";
		reg = <(0x10 | I2C_OWN_SLAVE_ADDRESS)>;
	};

	gpio@21 {
		compatible = "nxp,pca9506";
		reg = <0x21>;
		gpio-controller;
		#gpio-cells = <2>;
	};

	gpio@22 {
		compatible = "nxp,pca9506";
		reg = <0x22>;
		gpio-controller;
		#gpio-cells = <2>;
	};

	gpio@23 {
		compatible = "nxp,pca9506";
		reg = <0x23>;
		gpio-controller;
		#gpio-cells = <2>;
	};

	gpio@24 {
		compatible = "nxp,pca9506";
		reg = <0x24>;
		gpio-controller;
		#gpio-cells = <2>;
	};

	power-sensor@40 {
		compatible = "adi,adm1281";
		reg = <0x40>;
		shunt-resistor-micro-ohms = <500>;
	};
};

&i2c3 {
	status = "okay";
	mctp-controller;
	bus-frequency = <400000>;
	multi-master;

	mctp@10 {
		compatible = "mctp-i2c-controller";
		reg = <(0x10 | I2C_OWN_SLAVE_ADDRESS)>;
	};

	gpio@21 {
		compatible = "nxp,pca9506";
		reg = <0x21>;
		gpio-controller;
		#gpio-cells = <2>;
	};

	gpio@22 {
		compatible = "nxp,pca9506";
		reg = <0x22>;
		gpio-controller;
		#gpio-cells = <2>;
	};

	gpio@23 {
		compatible = "nxp,pca9506";
		reg = <0x23>;
		gpio-controller;
		#gpio-cells = <2>;
	};

	gpio@24 {
		compatible = "nxp,pca9506";
		reg = <0x24>;
		gpio-controller;
		#gpio-cells = <2>;
	};

	power-sensor@40 {
		compatible = "adi,adm1281";
		reg = <0x40>;
		shunt-resistor-micro-ohms = <500>;
	};
};

&i2c4 {
	status = "okay";
	mctp-controller;
	bus-frequency = <400000>;
	multi-master;

	mctp@10 {
		compatible = "mctp-i2c-controller";
		reg = <(0x10 | I2C_OWN_SLAVE_ADDRESS)>;
	};

	gpio@21 {
		compatible = "nxp,pca9506";
		reg = <0x21>;
		gpio-controller;
		#gpio-cells = <2>;
	};

	gpio@22 {
		compatible = "nxp,pca9506";
		reg = <0x22>;
		gpio-controller;
		#gpio-cells = <2>;
	};

	gpio@23 {
		compatible = "nxp,pca9506";
		reg = <0x23>;
		gpio-controller;
		#gpio-cells = <2>;
	};

	gpio@24 {
		compatible = "nxp,pca9506";
		reg = <0x24>;
		gpio-controller;
		#gpio-cells = <2>;
	};

	power-sensor@40 {
		compatible = "adi,adm1281";
		reg = <0x40>;
		shunt-resistor-micro-ohms = <500>;
	};
};

&i2c5 {
	status = "okay";
	mctp-controller;
	bus-frequency = <400000>;
	multi-master;

	mctp@10 {
		compatible = "mctp-i2c-controller";
		reg = <(0x10 | I2C_OWN_SLAVE_ADDRESS)>;
	};

	gpio@21 {
		compatible = "nxp,pca9506";
		reg = <0x21>;
		gpio-controller;
		#gpio-cells = <2>;
	};

	gpio@22 {
		compatible = "nxp,pca9506";
		reg = <0x22>;
		gpio-controller;
		#gpio-cells = <2>;
	};

	gpio@23 {
		compatible = "nxp,pca9506";
		reg = <0x23>;
		gpio-controller;
		#gpio-cells = <2>;
	};

	gpio@24 {
		compatible = "nxp,pca9506";
		reg = <0x24>;
		gpio-controller;
		#gpio-cells = <2>;
	};

	power-sensor@40 {
		compatible = "adi,adm1281";
		reg = <0x40>;
		shunt-resistor-micro-ohms = <500>;
	};
};

&i2c6 {
	status = "okay";
	mctp-controller;
	bus-frequency = <400000>;
	multi-master;

	mctp@10 {
		compatible = "mctp-i2c-controller";
		reg = <(0x10 | I2C_OWN_SLAVE_ADDRESS)>;
	};

	gpio@21 {
		compatible = "nxp,pca9506";
		reg = <0x21>;
		gpio-controller;
		#gpio-cells = <2>;
	};

	gpio@22 {
		compatible = "nxp,pca9506";
		reg = <0x22>;
		gpio-controller;
		#gpio-cells = <2>;
	};

	gpio@23 {
		compatible = "nxp,pca9506";
		reg = <0x23>;
		gpio-controller;
		#gpio-cells = <2>;
	};

	gpio@24 {
		compatible = "nxp,pca9506";
		reg = <0x24>;
		gpio-controller;
		#gpio-cells = <2>;
	};

	power-sensor@40 {
		compatible = "adi,adm1281";
		reg = <0x40>;
		shunt-resistor-micro-ohms = <500>;
	};
};

&i2c7 {
	status = "okay";
	mctp-controller;
	bus-frequency = <400000>;
	multi-master;

	mctp@10 {
		compatible = "mctp-i2c-controller";
		reg = <(0x10 | I2C_OWN_SLAVE_ADDRESS)>;
	};

	gpio@21 {
		compatible = "nxp,pca9506";
		reg = <0x21>;
		gpio-controller;
		#gpio-cells = <2>;
	};

	gpio@22 {
		compatible = "nxp,pca9506";
		reg = <0x22>;
		gpio-controller;
		#gpio-cells = <2>;
	};

	gpio@23 {
		compatible = "nxp,pca9506";
		reg = <0x23>;
		gpio-controller;
		#gpio-cells = <2>;
	};

	gpio@24 {
		compatible = "nxp,pca9506";
		reg = <0x24>;
		gpio-controller;
		#gpio-cells = <2>;
	};

	power-sensor@40 {
		compatible = "adi,adm1281";
		reg = <0x40>;
		shunt-resistor-micro-ohms = <500>;
	};
};

&i2c8 {
	status = "okay";
	bus-frequency = <400000>;
	i2c-mux@70 {
		compatible = "nxp,pca9544";
		i2c-mux-idle-disconnect;
		reg = <0x70>;

		imux16: i2c@0 {
			#address-cells = <1>;
			#size-cells = <0>;
			reg = <0>;

			gpio@49 {
				compatible = "nxp,pca9537";
				reg = <0x49>;
			};

			eeprom@50 {
				compatible = "atmel,24c128";
				reg = <0x50>;
			};

			eeprom@51 {
				compatible = "atmel,24c128";
				reg = <0x51>;
			};

			eeprom@54 {
				compatible = "atmel,24c128";
				reg = <0x54>;
			};
		};

		imux17: i2c@1 {
			#address-cells = <1>;
			#size-cells = <0>;
			reg = <1>;
			gpio@49 {
				compatible = "nxp,pca9537";
				reg = <0x49>;
			};

			eeprom@50 {
				compatible = "atmel,24c128";
				reg = <0x50>;
			};

			eeprom@51 {
				compatible = "atmel,24c128";
				reg = <0x51>;
			};

			eeprom@54 {
				compatible = "atmel,24c128";
				reg = <0x54>;
			};
		};

		imux18: i2c@2 {
			#address-cells = <1>;
			#size-cells = <0>;
			reg = <2>;
			gpio@49 {
				compatible = "nxp,pca9537";
				reg = <0x49>;
			};

			eeprom@50 {
				compatible = "atmel,24c128";
				reg = <0x50>;
			};

			eeprom@51 {
				compatible = "atmel,24c128";
				reg = <0x51>;
			};

			eeprom@54 {
				compatible = "atmel,24c128";
				reg = <0x54>;
			};
		};

		imux19: i2c@3 {
			#address-cells = <1>;
			#size-cells = <0>;
			reg = <3>;
			gpio@49 {
				compatible = "nxp,pca9537";
				reg = <0x49>;
			};

			eeprom@50 {
				compatible = "atmel,24c128";
				reg = <0x50>;
			};

			eeprom@51 {
				compatible = "atmel,24c128";
				reg = <0x51>;
			};

			eeprom@54 {
				compatible = "atmel,24c128";
				reg = <0x54>;
			};
		};
	};
};

&i2c9 {
	status = "okay";
	bus-frequency = <400000>;
	i2c-mux@71 {
		compatible = "nxp,pca9544";
		i2c-mux-idle-disconnect;
		reg = <0x71>;

		imux20: i2c@0 {
			#address-cells = <1>;
			#size-cells = <0>;
			reg = <0>;
			gpio@49 {
				compatible = "nxp,pca9537";
				reg = <0x49>;
			};

			eeprom@50 {
				compatible = "atmel,24c128";
				reg = <0x50>;
			};

			eeprom@51 {
				compatible = "atmel,24c128";
				reg = <0x51>;
			};

			eeprom@54 {
				compatible = "atmel,24c128";
				reg = <0x54>;
			};
		};

		imux21: i2c@1 {
			#address-cells = <1>;
			#size-cells = <0>;
			reg = <1>;
			gpio@49 {
				compatible = "nxp,pca9537";
				reg = <0x49>;
			};

			eeprom@50 {
				compatible = "atmel,24c128";
				reg = <0x50>;
			};

			eeprom@51 {
				compatible = "atmel,24c128";
				reg = <0x51>;
			};

			eeprom@54 {
				compatible = "atmel,24c128";
				reg = <0x54>;
			};
		};

		imux22: i2c@2 {
			#address-cells = <1>;
			#size-cells = <0>;
			reg = <2>;
			gpio@49 {
				compatible = "nxp,pca9537";
				reg = <0x49>;
			};

			eeprom@50 {
				compatible = "atmel,24c128";
				reg = <0x50>;
			};

			eeprom@51 {
				compatible = "atmel,24c128";
				reg = <0x51>;
			};

			eeprom@54 {
				compatible = "atmel,24c128";
				reg = <0x54>;
			};
		};

		imux23: i2c@3 {
			#address-cells = <1>;
			#size-cells = <0>;
			reg = <3>;

			gpio@49 {
				compatible = "nxp,pca9537";
				reg = <0x49>;
			};

			eeprom@50 {
				compatible = "atmel,24c128";
				reg = <0x50>;
			};

			eeprom@51 {
				compatible = "atmel,24c128";
				reg = <0x51>;
			};

			eeprom@54 {
				compatible = "atmel,24c128";
				reg = <0x54>;
			};
		};
	};
};

&i2c10 {
	status = "okay";
	bus-frequency = <400000>;
	i2c-clk-high-min-percent = <40>;
	i2c-mux@74 {
		compatible = "nxp,pca9544";
		i2c-mux-idle-disconnect;
		reg = <0x74>;

		imux28: i2c@0 {
			#address-cells = <1>;
			#size-cells = <0>;
			reg = <0>;

			gpio@20 {
				compatible = "nxp,pca9506";
				reg = <0x20>;
				gpio-controller;
				#gpio-cells = <2>;
			};

			gpio@21 {
				compatible = "nxp,pca9506";
				reg = <0x21>;
				gpio-controller;
				#gpio-cells = <2>;
			};

			gpio@22 {
				compatible = "nxp,pca9506";
				reg = <0x22>;
				gpio-controller;
				#gpio-cells = <2>;
			};

			gpio@23 {
				compatible = "nxp,pca9506";
				reg = <0x23>;
				gpio-controller;
				#gpio-cells = <2>;
			};

			gpio@24 {
				compatible = "nxp,pca9506";
				reg = <0x24>;
				gpio-controller;
				#gpio-cells = <2>;
				gpio-line-names =
				"","","","",
				"NIC0_MAIN_PWR_EN","NIC1_MAIN_PWR_EN",
				"NIC2_MAIN_PWR_EN","NIC3_MAIN_PWR_EN",
				"","","","","","","","",
				"","","","","","","","",
				"","","","","","","","";
			};
		};

		imux29: i2c@1 {
			#address-cells = <1>;
			#size-cells = <0>;
			reg = <1>;
		};
	};
};

&i2c11 {
	status = "okay";
	power-sensor@10 {
		compatible = "adi,adm1272";
		reg = <0x10>;
	};

	power-sensor@12 {
		compatible = "adi,adm1272";
		reg = <0x12>;
	};

	gpio@20 {
		compatible = "nxp,pca9555";
		pinctrl-names = "default";
		gpio-controller;
		#gpio-cells = <2>;
		reg = <0x20>;
		interrupt-parent = <&gpio0>;
		interrupts = <98 IRQ_TYPE_LEVEL_LOW>;
		gpio-line-names =
		"P48V_OCP_GPIO1","P48V_OCP_GPIO2",
		"P48V_OCP_GPIO3","FAN_BOARD_0_REVISION_0_R",
		"FAN_BOARD_0_REVISION_1_R","FAN_BOARD_1_REVISION_0_R",
		"FAN_BOARD_1_REVISION_1_R","RST_MUX_R_N",
		"RST_LED_CONTROL_FAN_BOARD_0_N","RST_LED_CONTROL_FAN_BOARD_1_N",
		"RST_IOEXP_FAN_BOARD_0_N","RST_IOEXP_FAN_BOARD_1_N",
		"PWRGD_LOAD_SWITCH_FAN_BOARD_0_R","PWRGD_LOAD_SWITCH_FAN_BOARD_1_R",
		"","";
	};

	gpio@21 {
		compatible = "nxp,pca9555";
		pinctrl-names = "default";
		gpio-controller;
		#gpio-cells = <2>;
		reg = <0x21>;
		interrupt-parent = <&gpio0>;
		interrupts = <98 IRQ_TYPE_LEVEL_LOW>;
		gpio-line-names =
		"HSC_OCP_SLOT_ODD_GPIO1","HSC_OCP_SLOT_ODD_GPIO2",
		"HSC_OCP_SLOT_ODD_GPIO3","HSC_OCP_SLOT_EVEN_GPIO1",
		"HSC_OCP_SLOT_EVEN_GPIO2","HSC_OCP_SLOT_EVEN_GPIO3",
		"ADC_TYPE_0_R","ADC_TYPE_1_R",
		"MEDUSA_BOARD_REV_0","MEDUSA_BOARD_REV_1",
		"MEDUSA_BOARD_REV_2","MEDUSA_BOARD_TYPE",
		"DELTA_MODULE_TYPE","P12V_HSC_TYPE",
		"","";
	};

	gpio@22 {
		compatible = "nxp,pca9555";
		pinctrl-names = "default";
		gpio-controller;
		#gpio-cells = <2>;
		reg = <0x22>;
		interrupt-parent = <&gpio0>;
		interrupts = <98 IRQ_TYPE_LEVEL_LOW>;
		gpio-line-names =
		"CARD_TYPE_SLOT1","CARD_TYPE_SLOT2",
		"CARD_TYPE_SLOT3","CARD_TYPE_SLOT4",
		"CARD_TYPE_SLOT5","CARD_TYPE_SLOT6",
		"CARD_TYPE_SLOT7","CARD_TYPE_SLOT8",
		"OC_P48V_HSC_0_N","FLT_P48V_HSC_0_N",
		"OC_P48V_HSC_1_N","FLT_P48V_HSC_1_N",
		"EN_P48V_AUX_0","EN_P48V_AUX_1",
		"PWRGD_P12V_AUX_0","PWRGD_P12V_AUX_1";
	};

	gpio@23 {
		compatible = "nxp,pca9555";
		pinctrl-names = "default";
		gpio-controller;
		#gpio-cells = <2>;
		reg = <0x23>;
		interrupt-parent = <&gpio0>;
		interrupts = <98 IRQ_TYPE_LEVEL_LOW>;
		gpio-line-names =
		"HSC1_ALERT1_R_N","HSC2_ALERT1_R_N",
		"HSC3_ALERT1_R_N","HSC4_ALERT1_R_N",
		"HSC5_ALERT1_R_N","HSC6_ALERT1_R_N",
		"HSC7_ALERT1_R_N","HSC8_ALERT1_R_N",
		"HSC1_ALERT2_R_N","HSC2_ALERT2_R_N",
		"HSC3_ALERT2_R_N","HSC4_ALERT2_R_N",
		"HSC5_ALERT2_R_N","HSC6_ALERT2_R_N",
		"HSC7_ALERT2_R_N","HSC8_ALERT2_R_N";
	};

	power-sensor@40 {
		compatible = "mps,mp5023";
		reg = <0x40>;
	};

	power-sensor@41 {
			compatible = "ti,ina233";
			resistor-calibration = /bits/ 16 <0x0a00>;
			current-lsb= /bits/ 16 <0x0001>;
			reg = <0x41>;
	};

	power-sensor@44 {
			compatible = "ti,ina238";
			shunt-resistor = <1000>;
			reg = <0x44>;
	};

	temperature-sensor@48 {
		compatible = "ti,tmp75";
		reg = <0x48>;
	};

	temperature-sensor@49 {
		compatible = "ti,tmp75";
		reg = <0x49>;
	};

	eeprom@54 {
		compatible = "atmel,24c128";
		reg = <0x54>;
	};

	power-sensor@62 {
		compatible = "pmbus";
		reg = <0x62>;
	};

	power-sensor@64 {
		compatible = "pmbus";
		reg = <0x64>;
	};

	power-sensor@65 {
		compatible = "pmbus";
		reg = <0x65>;
	};

	power-sensor@68 {
		compatible = "pmbus";
		reg = <0x68>;
	};
};

&i2c12 {
	status = "okay";
	bus-frequency = <400000>;

	i2c-mux@70 {
		compatible = "nxp,pca9544";
		i2c-mux-idle-disconnect;
		reg = <0x70>;

		imux34: i2c@0 {
			#address-cells = <1>;
			#size-cells = <0>;
			reg = <0>;

			temperature-sensor@48 {
				compatible = "ti,tmp75";
				reg = <0x48>;
			};

			eeprom@50 {
				compatible = "atmel,24c128";
				reg = <0x50>;
			};

			eeprom@54 {
				compatible = "atmel,24c64";
				reg = <0x54>;
			};

			rtc@6f {
				compatible = "nuvoton,nct3018y";
				reg = <0x6f>;
			};
		};

		imux35: i2c@1 {
			#address-cells = <1>;
			#size-cells = <0>;
			reg = <1>;
		};

		imux36: i2c@2 {
			#address-cells = <1>;
			#size-cells = <0>;
			reg = <2>;
		};

		imux37: i2c@3 {
			#address-cells = <1>;
			#size-cells = <0>;
			reg = <3>;
		};
	};
};

&i2c13 {
	status = "okay";
	bus-frequency = <100000>;
	multi-master;

	ipmb@10 {
		compatible = "ipmb-dev";
		reg = <(0x10 | I2C_OWN_SLAVE_ADDRESS)>;
		i2c-protocol;
	};

	gpio@20 {
		compatible = "nxp,pca9506";
		reg = <0x20>;
		gpio-controller;
		#gpio-cells = <2>;
	};

	gpio@21 {
		compatible = "nxp,pca9506";
		reg = <0x21>;
		gpio-controller;
		#gpio-cells = <2>;
	};

	gpio@22 {
		compatible = "nxp,pca9506";
		reg = <0x22>;
		gpio-controller;
		#gpio-cells = <2>;
	};

	gpio@23 {
		compatible = "nxp,pca9506";
		reg = <0x23>;
		gpio-controller;
		#gpio-cells = <2>;
	};
};

&i2c14 {
	status = "okay";
	bus-frequency = <400000>;
	adc@1d {
		compatible = "ti,adc128d818";
		reg = <0x1d>;
		ti,mode = /bits/ 8 <1>;
	};

	adc@36 {
		compatible = "ti,adc128d818";
		reg = <0x36>;
		ti,mode = /bits/ 8 <1>;
	};

	adc@37 {
		compatible = "ti,adc128d818";
		reg = <0x37>;
		ti,mode = /bits/ 8 <1>;
	};

	power-sensor@40 {
		compatible = "ti,ina233";
		reg = <0x40>;
		resistor-calibration = /bits/ 16 <0x0a00>;
		current-lsb= /bits/ 16 <0x0001>;
	};

	power-sensor@41 {
		compatible = "ti,ina233";
		reg = <0x41>;
		resistor-calibration = /bits/ 16 <0x0a00>;
		current-lsb= /bits/ 16 <0x0001>;
	};

	power-sensor@42 {
		compatible = "ti,ina233";
		reg = <0x42>;
		resistor-calibration = /bits/ 16 <0x0a00>;
		current-lsb= /bits/ 16 <0x0001>;
	};

	power-sensor@43 {
		compatible = "ti,ina233";
		reg = <0x43>;
		resistor-calibration = /bits/ 16 <0x0a00>;
		current-lsb= /bits/ 16 <0x0001>;
	};

	power-sensor@44 {
		compatible = "ti,ina233";
		reg = <0x44>;
		resistor-calibration = /bits/ 16 <0x0a00>;
		current-lsb= /bits/ 16 <0x0001>;
	};

	temperature-sensor@4e {
		compatible = "ti,tmp75";
		reg = <0x4e>;
	};

	temperature-sensor@4f {
		compatible = "ti,tmp75";
		reg = <0x4f>;
	};

	eeprom@51 {
		compatible = "atmel,24c128";
		reg = <0x51>;
	};

	i2c-mux@74 {
		compatible = "nxp,pca9546";
		#address-cells = <1>;
		#size-cells = <0>;
		i2c-mux-idle-disconnect;
		reg = <0x74>;

		imux30: i2c@0 {
			#address-cells = <1>;
			#size-cells = <0>;
			reg = <0>;

			adc@1f {
				compatible = "ti,adc128d818";
				reg = <0x1f>;
				ti,mode = /bits/ 8 <1>;
			};

			pwm@20{
				compatible = "maxim,max31790";
				#address-cells = <1>;
				#size-cells = <0>;
				reg = <0x20>;
				channel@4 {
					reg = <4>;
					sensor-type = "TACH";
				};

				channel@5 {
					reg = <5>;
					sensor-type = "TACH";
				};
			};

			gpio@22{
				compatible = "ti,tca6424";
				reg = <0x22>;
				gpio-controller;
				#gpio-cells = <2>;
			};

			pwm@2f{
				compatible = "maxim,max31790";
				#address-cells = <1>;
				#size-cells = <0>;
				reg = <0x2f>;
				channel@4 {
					reg = <4>;
					sensor-type = "TACH";
				};

				channel@5 {
					reg = <5>;
					sensor-type = "TACH";
				};
			};

			adc@33 {
				compatible = "maxim,max11615";
				reg = <0x33>;
			};

			eeprom@52 {
				compatible = "atmel,24c128";
				reg = <0x52>;
			};

			led_gpio0: gpio@61 {
				compatible = "nxp,pca9552";
				reg = <0x61>;
				#address-cells = <1>;
				#size-cells = <0>;
				gpio-controller;
				#gpio-cells = <2>;
			};
		};

		imux31: i2c@1 {
			#address-cells = <1>;
			#size-cells = <0>;
			reg = <1>;

			adc@1f {
				compatible = "ti,adc128d818";
				reg = <0x1f>;
				ti,mode = /bits/ 8 <1>;
			};

			pwm@20{
				compatible = "maxim,max31790";
				#address-cells = <1>;
				#size-cells = <0>;
				reg = <0x20>;
				channel@4 {
					reg = <4>;
					sensor-type = "TACH";
				};

				channel@5 {
					reg = <5>;
					sensor-type = "TACH";
				};
			};

			gpio@22{
				compatible = "ti,tca6424";
				reg = <0x22>;
				gpio-controller;
				#gpio-cells = <2>;
			};

			pwm@2f{
				compatible = "maxim,max31790";
				#address-cells = <1>;
				#size-cells = <0>;
				reg = <0x2f>;
				channel@4 {
					reg = <4>;
					sensor-type = "TACH";
				};

				channel@5 {
					reg = <5>;
					sensor-type = "TACH";
				};
			};

			adc@33 {
				compatible = "maxim,max11615";
				reg = <0x33>;
			};

			eeprom@52 {
				compatible = "atmel,24c128";
				reg = <0x52>;
			};

			led_gpio1: gpio@61 {
				compatible = "nxp,pca9552";
				reg = <0x61>;
				#address-cells = <1>;
				#size-cells = <0>;
				gpio-controller;
				#gpio-cells = <2>;
			};
		};
	};

	i2c-mux@73 {
		compatible = "nxp,pca9544";
		#address-cells = <1>;
		#size-cells = <0>;
		i2c-mux-idle-disconnect;
		reg = <0x73>;

		imux32: i2c@0 {
			#address-cells = <1>;
			#size-cells = <0>;
			reg = <0>;

			adc@35 {
				compatible = "maxim,max11617";
				reg = <0x35>;
			};
		};

		imux33: i2c@1 {
			#address-cells = <1>;
			#size-cells = <0>;
			reg = <1>;

			adc@35 {
				compatible = "maxim,max11617";
				reg = <0x35>;
			};
		};
	};
};

&i2c15 {
	status = "okay";
	mctp-controller;
	multi-master;
	bus-frequency = <400000>;
	i2c-clk-high-min-percent = <40>;

	mctp@10 {
		compatible = "mctp-i2c-controller";
		reg = <(0x10 | I2C_OWN_SLAVE_ADDRESS)>;
	};

	i2c-mux@72 {
		compatible = "nxp,pca9544";
		reg = <0x72>;

		imux24: i2c@0 {
			#address-cells = <1>;
			#size-cells = <0>;
			reg = <0>;
			mctp-controller;
			temperature-sensor@1f {
				compatible = "ti,tmp421";
				reg = <0x1f>;
			};

			temperature-sensor@3c {
				compatible = "smsc,emc1403";
				reg = <0x3c>;
			};

			eeprom@50 {
				compatible = "atmel,24c64";
				reg = <0x50>;
			};
		};

		imux25: i2c@1 {
			#address-cells = <1>;
			#size-cells = <0>;
			reg = <1>;
			mctp-controller;
			temperature-sensor@1f {
				compatible = "ti,tmp421";
				reg = <0x1f>;
			};

			temperature-sensor@3c {
				compatible = "smsc,emc1403";
				reg = <0x3c>;
			};

			eeprom@50 {
				compatible = "atmel,24c64";
				reg = <0x50>;
			};
		};

		imux26: i2c@2 {
			#address-cells = <1>;
			#size-cells = <0>;
			reg = <2>;
			mctp-controller;
			temperature-sensor@1f {
				compatible = "ti,tmp421";
				reg = <0x1f>;
			};

			temperature-sensor@3c {
				compatible = "smsc,emc1403";
				reg = <0x3c>;
			};

			eeprom@50 {
				compatible = "atmel,24c64";
				reg = <0x50>;
			};
		};

		imux27: i2c@3 {
			#address-cells = <1>;
			#size-cells = <0>;
			reg = <3>;
			mctp-controller;
			temperature-sensor@1f {
				compatible = "ti,tmp421";
				reg = <0x1f>;
			};

			temperature-sensor@3c {
				compatible = "smsc,emc1403";
				reg = <0x3c>;
			};

			eeprom@50 {
				compatible = "atmel,24c64";
				reg = <0x50>;
			};
		};
	};
};

&adc0 {
	status = "okay";
	pinctrl-0 = <&pinctrl_adc0_default &pinctrl_adc1_default
			&pinctrl_adc2_default &pinctrl_adc3_default
			&pinctrl_adc4_default &pinctrl_adc5_default
			&pinctrl_adc6_default &pinctrl_adc7_default>;
};

&adc1 {
	status = "okay";
	pinctrl-0 = <&pinctrl_adc8_default &pinctrl_adc9_default>
			&pinctrl_adc15_default>;
};

&ehci0 {
	status = "okay";
};

&ehci1 {
	status = "okay";
};

&uhci {
	status = "okay";
};

&sgpiom0 {
	status = "okay";
	ngpios = <128>;
	bus-frequency = <48000>;
};

&pinctrl {
	pinctrl_gpio0_unbiased: gpio0_unbiased {
		/* GPIOB0, GPIOB1 */
		pins = "J26", "K23";
		bias-disable;
	};
	pinctrl_gpio2_unbiased: gpio2_unbiased {
		/* GPIOI5, GPIOI6, GPIOI7,
		   GPIOL6 */
		pins = "E16", "B16", "A15", "B14";
		bias-disable;
	};
	pinctrl_gpio3_unbiased: gpio3_unbiased {
		/* GPIOM2, GPIOM3, GPIOM4, GPIOM5,
		   GPION0, GPION1, GPION2, GPION3, GPION5,
		   GPIOO0, GPIOO1, GPIOO2, GPIOO3,
		   GPIOP0, GPIOP1, GPIOP2, GPIOP3, GPIOP4, GPIOP5, GPIOP6 */
		pins = "A12", "E14", "B12", "C12", "P25", "N23", "N25", "N24", "M23", "AD26", "AD22", "AD23", "AD24", "AB22", "W24", "AA23", "AA24", "W23", "AB23", "AB24";
		bias-disable;
	};
	pinctrl_gpio4_unbiased: gpio4_unbiased {
		/* GPIOR0, GPIOR1, GPIOR2, GPIOR3, GPIOR4, GPIOR5, GPIOR6, GPIOR7
		   GPIOS0, GPIOS1, GPIOS2, GPIOS3, GPIOS5, GPIOS6, GPIOS7 */
		pins = "V25", "U24", "V24", "V26", "U25", "T23", "W26", "U26", "R23", "T25", "T26", "R24", "P24", "P23", "T24";
		bias-disable;
	};
	pinctrl_gpio5_unbiased: gpio5_unbiased {
		/* GPIOV0, GPIOV1, GPIOV2, GPIOV3, GPIOV4, GPIOV5, GPIOV6, GPIOV7
		   GPIOX1, GPIOX2 */
		pins = "AB15", "AF14", "AD14", "AC15", "AE15", "AE14", "AD15", "AF15", "AA9", "AC9";
		bias-disable;
	};
	pinctrl_gpio6_unbiased: gpio6_unbiased {
		/* GPIOY2, GPIOY5, GPIOY6
		   GPIOZ0, GPIOZ1, GPIOZ3, GPIOZ4 */
		pins = "AE11", "AF12", "AC12", "AC10", "AD10", "AB11", "AC11";
		bias-disable;
	};
};

&gpio0 {
	pinctrl-names = "default";
	pinctrl-0 = <&pinctrl_gpiu2_default &pinctrl_gpiu3_default
		     &pinctrl_gpiu4_default &pinctrl_gpiu6_default
		     &pinctrl_gpio0_unbiased &pinctrl_gpio2_unbiased
		     &pinctrl_gpio3_unbiased &pinctrl_gpio4_unbiased
		     &pinctrl_gpio5_unbiased &pinctrl_gpio6_unbiased>;
	gpio-line-names =
	/*A0-A7*/       "","","","","","","","",
	/*B0-B7*/       "FLT_HSC_SERVER_SLOT8_N","AC_ON_OFF_BTN_CPLD_SLOT5_N",
			"PWRGD_SLOT1_STBY","PWRGD_SLOT2_STBY",
			"PWRGD_SLOT3_STBY","PWRGD_SLOT4_STBY","","",
	/*C0-C7*/       "","","","","FM_NIC0_WAKE_N",
			"FM_NIC1_WAKE_N","","RST_PCIE_SLOT2_N",
	/*D0-D7*/       "","","","","","","","",
	/*E0-E7*/       "PRSNT_NIC1_N","PRSNT_NIC2_N","","RST_PCIE_SLOT1_N",
			"","","","",
	/*F0-F7*/       "FM_RESBTN_SLOT1_BMC_N","FM_RESBTN_SLOT2_BMC_N",
			"FM_RESBTN_SLOT3_BMC_N","FM_RESBTN_SLOT4_BMC_N",
			"PRSNT_SB_SLOT1_N","PRSNT_SB_SLOT2_N",
			"PRSNT_SB_SLOT3_N","PRSNT_SB_SLOT4_N",
	/*G0-G7*/       "","","","","","","","",
	/*H0-H7*/       "","","","","","","","",
	/*I0-I7*/       "","","","","","ALT_MEDUSA_ADC_N",
			"ALT_SMB_BMC_CPLD2_N",
			"INT_SPIDER_ADC_R_N",
	/*J0-J7*/       "","","","","","","","",
	/*K0-K7*/       "","","","","","","","",
	/*L0-L7*/       "","","","","","","ALT_MEDUSA_P12V_EFUSE_N","",
	/*M0-M7*/       "EN_NIC0_POWER_BMC_R","EN_NIC1_POWER_BMC_R",
			"INT_MEDUSA_IOEXP_TEMP_N","PRSNT_NIC3_N",
			"INT_SMB_BMC_SLOT1_4_BMC_N",
			"AC_ON_OFF_BTN_CPLD_SLOT6_N","","",
	/*N0-N7*/       "FLT_HSC_SERVER_SLOT1_N","FLT_HSC_SERVER_SLOT2_N",
			"FLT_HSC_SERVER_SLOT3_N","FLT_HSC_SERVER_SLOT4_N",
			"FM_BMC_READY_R2","RST_SMB_NIC0_R_N","","",
	/*O0-O7*/       "AC_ON_OFF_BTN_CPLD_SLOT8_N","RST_SMB_NIC1_R_N",
			"RST_SMB_NIC2_R_N","RST_SMB_NIC3_R_N",
			"","","","",
	/*P0-P7*/       "ALT_SMB_BMC_CPLD1_N","BTN_BMC_R2_N",
			"EN_P3V_BAT_SCALED_R","PWRGD_P5V_USB_BMC",
			"FM_BMC_RTCRST_R","RST_USB_HUB_R_N",
			"FLAG_P5V_USB_BMC_N","",
	/*Q0-Q7*/       "AC_ON_OFF_BTN_CPLD_SLOT1_N","AC_ON_OFF_BTN_CPLD_SLOT2_N",
			"AC_ON_OFF_BTN_CPLD_SLOT3_N","AC_ON_OFF_BTN_CPLD_SLOT4_N",
			"PRSNT_SB_SLOT5_N","PRSNT_SB_SLOT6_N",
			"PRSNT_SB_SLOT7_N","PRSNT_SB_SLOT8_N",
	/*R0-R7*/       "AC_ON_OFF_BTN_CPLD_SLOT7_N","INT_SMB_BMC_SLOT5_8_BMC_N",
			"FM_PWRBRK_NIC_BMC_R2","RST_PCIE_SLOT4_N",
			"RST_PCIE_SLOT5_N","RST_PCIE_SLOT6_N",
			"RST_PCIE_SLOT7_N","RST_PCIE_SLOT8_N",
	/*S0-S7*/       "FM_NIC2_WAKE_N","FM_NIC3_WAKE_N",
			"EN_NIC3_POWER_BMC_R","SEL_BMC_JTAG_MUX_R",
			"","ALT_P12V_AUX_N","FAST_PROCHOT_N",
			"SPI_WP_DISABLE_STATUS_R_N",
	/*T0-T7*/       "","","","","","","","",
	/*U0-U7*/       "","","RST_PCIE_SLOT3_N","",
			"","PRSNT_NIC0_N","","",
	/*V0-V7*/       "FM_RESBTN_SLOT5_BMC_N","FM_RESBTN_SLOT6_BMC_N",
			"FM_RESBTN_SLOT7_BMC_N","FM_RESBTN_SLOT8_BMC_N",
			"","","","",
	/*W0-W7*/       "PRSNT_TPM_BMC_N","PRSNT_OCP_DEBUG_BMC_N","ALT_TEMP_BMC_N","ALT_RTC_BMC_N",
			"","","","",
	/*X0-X7*/       "","LT_HSC_SERVER_SLOT6_N","FLT_HSC_SERVER_SLOT7_N","","","",
			"PWRGD_SLOT5_STBY","PWRGD_SLOT6_STBY",
	/*Y0-Y7*/       "","","SPI_LOCK_REQ_BMC_N","PWRGD_SLOT7_STBY",
			"","","EN_NIC2_POWER_BMC_R","",
	/*Z0-Z7*/       "EN_P5V_USB_CPLD_R","FLT_HSC_SERVER_SLOT5_N",
			"PWRGD_SLOT8_STBY","","","","","";

	pin_gpio_b4 {
		gpios = <ASPEED_GPIO(B, 4) GPIO_ACTIVE_HIGH>;
		input;
	};
	pin_gpio_b5 {
		gpios = <ASPEED_GPIO(B, 5) GPIO_ACTIVE_HIGH>;
		input;
	};
	pin_gpio_f0 {
		gpios = <ASPEED_GPIO(F, 0) GPIO_ACTIVE_LOW>;
		input;
	};
	pin_gpio_f1 {
		gpios = <ASPEED_GPIO(F, 1) GPIO_ACTIVE_LOW>;
		input;
	};
	pin_gpio_f2 {
		gpios = <ASPEED_GPIO(F, 2) GPIO_ACTIVE_LOW>;
		input;
		};
	pin_gpio_f3 {
		gpios = <ASPEED_GPIO(F, 3) GPIO_ACTIVE_LOW>;
		input;
	};
	pin_gpio_f4 {
		gpios = <ASPEED_GPIO(F, 4) GPIO_ACTIVE_LOW>;
		input;
	};
	pin_gpio_f5 {
		gpios = <ASPEED_GPIO(F, 5) GPIO_ACTIVE_LOW>;
		input;
	};
	pin_gpio_f6 {
		gpios = <ASPEED_GPIO(F, 6) GPIO_ACTIVE_LOW>;
		input;
	};
	pin_gpio_f7 {
		gpios = <ASPEED_GPIO(F, 7) GPIO_ACTIVE_LOW>;
		input;
	};
	pin_gpio_l6 {
		gpios = <ASPEED_GPIO(L, 6) GPIO_ACTIVE_LOW>;
		input;
	};
	pin_gpio_l7 {
		gpios = <ASPEED_GPIO(L, 7) GPIO_ACTIVE_LOW>;
		input;
	};
	pin_gpio_s0 {
		gpios = <ASPEED_GPIO(S, 0) GPIO_ACTIVE_LOW>;
		input;
	};
	pin_gpio_s1 {
		gpios = <ASPEED_GPIO(S, 1) GPIO_ACTIVE_LOW>;
		input;
	};
	pin_gpio_v0 {
		gpios = <ASPEED_GPIO(V, 0) GPIO_ACTIVE_LOW>;
		input;
	};
	pin_gpio_v1 {
		gpios = <ASPEED_GPIO(V, 1) GPIO_ACTIVE_LOW>;
		input;
	};
	pin_gpio_v2 {
		gpios = <ASPEED_GPIO(V, 2) GPIO_ACTIVE_LOW>;
		input;
	};
	pin_gpio_v3 {
		gpios = <ASPEED_GPIO(V, 3) GPIO_ACTIVE_LOW>;
		input;
	};
	pin_gpio_w0 {
		gpios = <ASPEED_GPIO(W, 0) GPIO_ACTIVE_LOW>;
		input;
	};
	pin_gpio_w1 {
		gpios = <ASPEED_GPIO(W, 1) GPIO_ACTIVE_LOW>;
		input;
	};
	pin_gpio_w2 {
		gpios = <ASPEED_GPIO(W, 2) GPIO_ACTIVE_LOW>;
		input;
	};
	pin_gpio_w3 {
		gpios = <ASPEED_GPIO(W, 3) GPIO_ACTIVE_LOW>;
		input;
	};
	pin_gpio_w4 {
		gpios = <ASPEED_GPIO(W, 4) GPIO_ACTIVE_LOW>;
		input;
	};
	pin_gpio_w5 {
		gpios = <ASPEED_GPIO(W, 5) GPIO_ACTIVE_LOW>;
		input;
	};
	pin_gpio_w6 {
		gpios = <ASPEED_GPIO(W, 6) GPIO_ACTIVE_LOW>;
		input;
	};
	pin_gpio_w7 {
		gpios = <ASPEED_GPIO(W, 7) GPIO_ACTIVE_LOW>;
		input;
	};
	pin_gpio_z3 {
		gpios = <ASPEED_GPIO(Z, 3) GPIO_ACTIVE_LOW>;
		input;
	};
	pin_gpio_z4 {
		gpios = <ASPEED_GPIO(Z, 4) GPIO_ACTIVE_LOW>;
		input;
	};
	pin_gpio_z5 {
		gpios = <ASPEED_GPIO(Z, 5) GPIO_ACTIVE_LOW>;
		input;
	};
};
