// SPDX-License-Identifier: GPL-2.0
/*
 * Copyright (c) 2023 Dario Binacchi <dario.binacchi@amarulasolutions.com>
 */

#include "stm32f769-disco.dts"

&panel_backlight {
	status = "disabled";
};

&panel0 {
	compatible = "frida,frd400b25025", "novatek,nt35510";
	vddi-supply = <&vcc_3v3>;
	vdd-supply = <&vcc_3v3>;
	/delete-property/backlight;
	/delete-property/power-supply;
};
