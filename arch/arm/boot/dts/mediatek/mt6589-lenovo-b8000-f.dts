// SPDX-License-Identifier: (GPL-2.0-only OR BSD-2-Clause)
/*
 * Copyright (c) 2026 Akari Tsuyukusa <akkun11.open@gmail.com>
 */

#include "mt6589-lenovo-blade.dtsi"

/ {
	model = "Lenovo YOGA Tablet 10 (Wi-Fi)";
	compatible = "lenovo,b8000-f", "mediatek,mt6589";
};

&uart0 {
	status = "okay";
};
