// SPDX-License-Identifier: (GPL-2.0-only OR MIT)
/*
 * Copyright (C) 2015 Rabeeh Khoury <rabeeh@solid-run.com>
 * Based on dt work by Russell King
 */
/dts-v1/;

#include "imx6dl.dtsi"
#include "imx6qdl-sr-som.dtsi"
#include "imx6qdl-sr-som-emmc.dtsi"
#include "imx6qdl-sr-som-ti.dtsi"
#include "imx6qdl-hummingboard2.dtsi"
#include "imx6qdl-solidsense.dtsi"

/ {
	model = "SolidRun SolidSense Solo/DualLite (1.5som+emmc)";
	compatible = "solidrun,solidsense/dl", "fsl,imx6dl";
};
