// SPDX-License-Identifier: GPL-2.0+
/*
 * Copyright (C) 2026 Variscite Ltd. - https://www.variscite.com
 */

/dts-v1/;

#include "imx6ul.dtsi"
#include "imx6ul-var-dart.dtsi"
#include "imx6ul-imx6ull-var-dart-nand.dtsi"
#include "imx6ul-imx6ull-var-dart-wifi-brcm.dtsi"
#include "imx6ul-imx6ull-var-dart-wm8904.dtsi"
#include "imx6ul-var-dart-6ulcustomboard.dtsi"

/ {
	model = "Variscite DART-6UL with i.MX6UL, NAND flash, WiFi BRCM & WM8904 support on VAR-6ULCustomBoard";
	compatible = "variscite,dart-6ul-imx6ul-nand-wifi-brcm-6ulcustomboard",
		     "variscite,dart-6ul-imx6ul",
		     "fsl,imx6ul";
};
