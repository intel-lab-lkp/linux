// SPDX-License-Identifier: GPL-2.0+
/*
 * Variscite VAR-6ULCustomBoard for DART-6UL
 *
 * Link: https://variscite.com/carrier-boards/var-6ulcustomboard/
 *
 * Copyright (C) 2026 Variscite Ltd. - https://www.variscite.com
 */

#include "imx6ul-imx6ull-var-dart-6ulcustomboard.dtsi"

&iomuxc {
	pinctrl_rtc: rtc-grp {
		fsl,pins = <
			MX6UL_PAD_SNVS_TAMPER7__GPIO5_IO07	0x1b0b0
		>;
	};
};
