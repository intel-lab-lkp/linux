// SPDX-License-Identifier: GPL-2.0+
/*
 * Copyright (C) 2026 Variscite Ltd. - https://www.variscite.com
 */

#include "imx6ul-imx6ull-var-wm8904.dtsi"

&sound_wm8904 {
	simple-audio-card,routing =
		"Headphone Jack", "HPOUTL",
		"Headphone Jack", "HPOUTR",
		"IN1L", "Line In Jack",
		"IN1R", "Line In Jack",
		"IN2L", "Microphone Jack",
		"IN2R", "Microphone Jack",
		"Microphone Jack", "MICBIAS";
};
