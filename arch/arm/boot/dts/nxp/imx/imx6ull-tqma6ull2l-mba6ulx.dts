// SPDX-License-Identifier: (GPL-2.0-or-later OR MIT)
/*
 * Copyright (c) 2018-2022 TQ-Systems GmbH <linux@ew.tq-group.com>,
 * D-82229 Seefeld, Germany.
 * Author: Markus Niebel
 */

/dts-v1/;

#include "imx6ull-tqma6ull2l.dtsi"
#include "mba6ulx.dtsi"

/ {
	model = "TQ-Systems TQMa6ULL2L SoM on MBa6ULx board";
	compatible = "tq,imx6ull-tqma6ull2l-mba6ulx", "tq,imx6ull-tqma6ull2l", "fsl,imx6ull";
};
