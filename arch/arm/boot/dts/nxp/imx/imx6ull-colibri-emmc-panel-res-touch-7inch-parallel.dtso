// SPDX-License-Identifier: GPL-2.0-only OR MIT
/*
 * Copyright (c) Toradex
 *
 * Toradex Resistive Touch Display 7" Parallel connected through the 40-way
 * Unified Interface Display connector.
 *
 * https://docs.toradex.com/104498-7-inch-parallel-resistive-touch-display-800x480.pdf
 * https://developer.toradex.com/hardware/accessories/displays/resistive-touch-display-7inch-parallel/
 * https://www.toradex.com/accessories/resistive-touch-display
 */

/dts-v1/;
/plugin/;

#include "imx6ull-imx7-colibri-panel-res-touch-7inch-parallel.dtsi"
