// SPDX-License-Identifier: GPL-2.0+
/*
 * Copyright (C) 2026 Variscite Ltd. - https://www.variscite.com
 */

/dts-v1/;

#include "imx6ul.dtsi"
#include "imx6ul-var-dart.dtsi"
#include "imx6ul-imx6ull-var-dart-nand.dtsi"
#include "imx6ul-imx6ull-var-wm8731.dtsi"
#include "imx6ul-var-dart-6ulcustomboard.dtsi"
#include "imx6ul-imx6ull-var-dart-6ulcustomboard-sd-card.dtsi"

/ {
	model = "Variscite DART-6UL with i.MX6UL, NAND flash, SD card & WM8731 support on VAR-6ULCustomBoard";
	compatible = "variscite,dart-6ul-imx6ul-nand-sd-card-wm8731-6ulcustomboard",
		     "variscite,dart-6ul-imx6ul",
		     "fsl,imx6ul";
};
