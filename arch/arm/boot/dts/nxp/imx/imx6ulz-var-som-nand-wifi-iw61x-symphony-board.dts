// SPDX-License-Identifier: GPL-2.0+
/*
 * Copyright (C) 2026 Variscite Ltd. - https://www.variscite.com
 */

/dts-v1/;

#include "imx6ulz.dtsi"
#include "imx6ulz-var-som.dtsi"
#include "imx6ul-imx6ull-var-som-nand.dtsi"
#include "imx6ul-imx6ull-var-som-wifi-iw61x.dtsi"
#include "imx6ul-imx6ull-var-wm8904.dtsi"
#include "imx6ulz-var-som-symphony-board.dtsi"

/ {
	model = "Variscite VAR-SOM-6UL with i.MX6ULZ, NAND flash, WiFi IW61x & WM8904 support on Symphony-Board";
	compatible = "variscite,var-som-imx6ulz-nand-wifi-iw61x-symphony-board",
		     "variscite,var-som-imx6ulz",
		     "fsl,imx6ull",
		     "fsl,imx6ulz";
};
