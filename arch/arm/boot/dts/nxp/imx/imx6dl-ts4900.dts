// SPDX-License-Identifier: (GPL-2.0-only OR MIT)
/*
 * Copyright 2015 Technologic Systems
 */

/dts-v1/;
#include "imx6dl.dtsi"
#include "imx6qdl-ts4900.dtsi"

/ {
	model = "Technologic Systems i.MX6 Solo/DualLite TS-4900 (Default Device Tree)";
	compatible = "technologic,imx6dl-ts4900", "fsl,imx6dl";

	/* Will be filled by the bootloader */
	memory@10000000 {
		device_type = "memory";
		reg = <0x10000000 0>;
	};
};
