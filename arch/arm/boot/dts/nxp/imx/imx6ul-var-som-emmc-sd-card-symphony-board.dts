// SPDX-License-Identifier: GPL-2.0+
/*
 * Copyright (C) 2026 Variscite Ltd. - https://www.variscite.com
 */

/dts-v1/;

#include "imx6ul.dtsi"
#include "imx6ul-var-som.dtsi"
#include "imx6ul-imx6ull-var-som-emmc.dtsi"
#include "imx6ul-imx6ull-var-wm8904.dtsi"
#include "imx6ul-var-som-symphony-board.dtsi"
#include "imx6ul-imx6ull-var-som-concerto-board-sd-card.dtsi"

/ {
	model = "Variscite VAR-SOM-6UL with i.MX6UL, eMMC, SD card & WM8904 support on Symphony-Board";
	compatible = "variscite,var-som-imx6ul-emmc-sd-card-symphony-board",
		     "variscite,var-som-imx6ul",
		     "fsl,imx6ul";
};
