// SPDX-License-Identifier: GPL-2.0+
/*
 * Copyright (C) 2026 Variscite Ltd. - https://www.variscite.com
 */

/dts-v1/;

#include "imx6ul.dtsi"
#include "imx6ul-var-som.dtsi"
#include "imx6ul-imx6ull-var-som-nand.dtsi"
#include "imx6ul-imx6ull-var-som-wifi-brcm.dtsi"
#include "imx6ul-imx6ull-var-wm8731.dtsi"
#include "imx6ul-var-som-concerto-board.dtsi"

/ {
	model = "Variscite VAR-SOM-6UL with i.MX6UL, NAND flash, WiFi BRCM & WM8731 support on Concerto-Board";
	compatible = "variscite,var-som-imx6ul-nand-wifi-brcm-wm8731-concerto-board",
		     "variscite,var-som-imx6ul",
		     "fsl,imx6ul";
};
