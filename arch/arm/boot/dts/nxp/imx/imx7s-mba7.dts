// SPDX-License-Identifier: GPL-2.0-or-later OR MIT
/*
 * Device Tree Source for TQ-Systems TQMa7S board on MBa7 carrier board.
 *
 * Copyright (c) 2016 TQ-Systems GmbH <linux@ew.tq-group.com>,
 * D-82229 Seefeld, Germany.
 * Author: Markus Niebel
 *
 * Copyright (C) 2019 Bruno Thomsen <bruno.thomsen@gmail.com>
 */

/dts-v1/;

#include "imx7s-tqma7.dtsi"
#include "imx7-mba7.dtsi"

/ {
	model = "TQ-Systems TQMa7S board on MBa7 carrier board";
	compatible = "tq,imx7s-mba7", "tq,imx7s-tqma7", "fsl,imx7s";
};
