// SPDX-License-Identifier: GPL-2.0+
/*
 * Copyright (C) 2026 Variscite Ltd. - https://www.variscite.com
 */

/dts-v1/;

#include "imx6ulz.dtsi"
#include "imx6ulz-var-dart.dtsi"
#include "imx6ul-imx6ull-var-dart-emmc.dtsi"
#include "imx6ul-imx6ull-var-dart-wifi-brcm.dtsi"
#include "imx6ul-imx6ull-var-wm8731.dtsi"
#include "imx6ulz-var-dart-6ulcustomboard.dtsi"

/ {
	model = "Variscite DART-6UL with i.MX6ULZ, eMMC, WiFi BRCM & WM8731 support on VAR-6ULCustomBoard";
	compatible = "variscite,dart-6ul-imx6ulz-emmc-wifi-brcm-wm8731-6ulcustomboard",
		     "variscite,dart-6ul-imx6ulz",
		     "fsl,imx6ull",
		     "fsl,imx6ulz";
};
