// SPDX-License-Identifier: GPL-2.0+
/*
 * Support for Variscite MX6 Concerto Carrier board with the VAR-SOM-6UL
 * Variscite SoM mounted on it (6ULL CPU variant).
 *
 * Copyright 2026 Dimonoff
 */

/dts-v1/;

#include "imx6ull.dtsi"
#include "imx6ull-var-som.dtsi"
#include "imx6ul-imx6ull-var-som-emmc.dtsi"
#include "imx6ul-imx6ull-var-som-wifi-brcm.dtsi"
#include "imx6ul-imx6ull-var-wm8904.dtsi"
#include "imx6ull-var-som-concerto-board.dtsi"

/ {
	model = "Variscite VAR-SOM-6UL Concerto Board (6ULL CPU)";
	compatible = "variscite,mx6ullconcerto",
		     "variscite,var-som-imx6ull",
		     "fsl,imx6ull";
};
