// SPDX-License-Identifier: (GPL-2.0-only OR MIT)
/*
 * Copyright (C) 2015 Rabeeh Khoury <rabeeh@solid-run.com>
 * Based on dt work by Russell King
 */
/dts-v1/;

#include "imx6q.dtsi"
#include "imx6qdl-sr-som.dtsi"
#include "imx6qdl-sr-som-emmc.dtsi"
#include "imx6qdl-sr-som-ti.dtsi"
#include "imx6qdl-hummingboard2.dtsi"
#include "imx6qdl-solidsense.dtsi"

/ {
	model = "SolidRun SolidSense Dual/Quad (1.5som+emmc)";
	compatible = "solidrun,solidsense/q", "fsl,imx6q";
};
