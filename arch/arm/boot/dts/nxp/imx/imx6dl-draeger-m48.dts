// SPDX-License-Identifier: GPL-2.0+

/*
 *  (C) Copyright 2020 Draeger and Licensors, info@draeger.com
 *  Based on work by Russell King
 *
 *  Device Tree file for Drager M48 Board
 */

/dts-v1/;

#include "imx6dl.dtsi"
/* PAD config disabled in imx6qdl-draeger-m48.dtsi by setting value to 0x80000000
 * PAD configuration register must not be 0, so it is set to 0xfff
 */
#define MX6QDL_PAD_CTL_GRP_DDR_TYPE_RGMII        0x768 0xfff 0x000 0x000C0000 0x0
#define MX6QDL_PAD_CTL_GRP_RGMII_TERM            0x788 0xfff 0x000 0x00000200 0x0
#include "imx6qdl-draeger-m48.dtsi"

/ {
	model = "Draeger M48 i.MX6 DualLite";
	compatible = "draeger,imx6dl-m48", "fsl,imx6dl";
};
