// SPDX-License-Identifier: GPL-2.0+
/*
 * Copyright (C) 2026 Variscite Ltd. - https://www.variscite.com
 */

/dts-v1/;

#include "imx6ull.dtsi"
#include "imx6ull-var-som.dtsi"
#include "imx6ul-imx6ull-var-som-nand.dtsi"
#include "imx6ul-imx6ull-var-wm8731.dtsi"
#include "imx6ull-var-som-concerto-board.dtsi"
#include "imx6ul-imx6ull-var-som-concerto-board-sd-card.dtsi"

/ {
	model = "Variscite VAR-SOM-6UL with i.MX6ULL, NAND flash, SD card & WM8731 support on Concerto-Board";
	compatible = "variscite,var-som-imx6ull-nand-sd-card-wm8731-concerto-board",
		     "variscite,var-som-imx6ull",
		     "fsl,imx6ull";
};
