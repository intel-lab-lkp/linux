// SPDX-License-Identifier: GPL-2.0+
/*
 * Copyright (C) 2026 Variscite Ltd. - https://www.variscite.com
 */

/dts-v1/;

#include "imx6ull.dtsi"
#include "imx6ull-var-som.dtsi"
#include "imx6ul-imx6ull-var-som-emmc.dtsi"
#include "imx6ul-imx6ull-var-som-wifi-brcm.dtsi"
#include "imx6ul-imx6ull-var-wm8904.dtsi"
#include "imx6ull-var-som-concerto-board.dtsi"

/ {
	model = "Variscite VAR-SOM-6UL with i.MX6ULL, eMMC, WiFi BRCM & WM8904 support on Concerto-Board";
	compatible = "variscite,var-som-imx6ull-emmc-wifi-brcm-concerto-board",
		     "variscite,var-som-imx6ull",
		     "fsl,imx6ull";
};
