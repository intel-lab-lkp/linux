// SPDX-License-Identifier: GPL-2.0-only OR MIT
/*
 * Copyright (c) Toradex
 *
 * Toradex Capacitive Touch Display 10.1" LVDS
 *
 * Toradex Capacitive Touch Display 10.1" on Iris v2 carrier board X7 / X5
 * connectors through on-carrier LVDS transmitter
 *
 * https://developer.toradex.com/hardware/accessories/displays/capacitive-touch-display-101inch-lvds
 * https://www.toradex.com/accessories/capacitive-touch-display-10.1-inch-lvds
 * https://developer.toradex.com/hardware/colibri-som-family/carrier-boards/iris-carrier-board/
 * https://www.toradex.com/products/carrier-board/iris-carrier-board
 * https://docs.toradex.com/108421-colibri_arm_iris_carrier_board_datasheet.pdf
 */

/dts-v1/;
/plugin/;

#include <dt-bindings/gpio/gpio.h>
#include <dt-bindings/interrupt-controller/irq.h>

#include "imx6ull-imx7-colibri-iris-panel-cap-touch-10inch-lvds.dtsi"

&atmel_mxt_ts {
	pinctrl-0 = <&pinctrl_atmel_conn &pinctrl_atmel_snvs_conn>;
	/* SODIMM 107 / TOUCH_INT# */
	interrupt-parent = <&gpio5>;
	interrupts = <4 IRQ_TYPE_EDGE_FALLING>;
	/* SODIMM 106 / TOUCH_RST# */
	reset-gpios = <&gpio1 10 GPIO_ACTIVE_LOW>;

	status = "okay";
};

/*
 * The LVDS transmitter control pins are muxed as GPIO by the pinctrl_gpio1,
 * pinctrl_gpio7 and pinctrl_snvs_gpio1 groups of the module device tree.
 */
&lvds_encoder {
	/* SODIMM 63 / LVDS_RGB_MODE */
	b6b8-gpios = <&gpio2 1 GPIO_ACTIVE_HIGH>;
	/* SODIMM 95 / LVDS_COLOR_MAP */
	map-gpios = <&gpio5 3 GPIO_ACTIVE_HIGH>;
	/* SODIMM 55 / LVDS_CH_MODE */
	mode-gpios = <&gpio2 0 GPIO_ACTIVE_HIGH>;
	/* SODIMM 99 / LVDS_PWRON */
	powerdown-gpios = <&gpio1 14 GPIO_ACTIVE_LOW>;
};
