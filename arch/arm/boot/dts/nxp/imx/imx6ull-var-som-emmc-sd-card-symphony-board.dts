// SPDX-License-Identifier: GPL-2.0+
/*
 * Copyright (C) 2026 Variscite Ltd. - https://www.variscite.com
 */

/dts-v1/;

#include "imx6ull-var-som.dtsi"
#include "imx6ul-imx6ull-var-emmc.dtsi"
#include "imx6ul-imx6ull-var-wm8904.dtsi"
#include "imx6ull-var-som-symphony-board.dtsi"
#include "imx6ul-var-som-lvds-panel.dtsi"
#include "imx6ul-var-som-sd.dtsi"

/ {
	model = "Variscite VAR-SOM-6UL with i.MX6ULL, eMMC, SD card & WM8904 support on Symphony-Board";
	compatible = "variscite,var-som-imx6ull-emmc-sd-card-symphony",
		     "variscite,var-som-imx6ull",
		     "fsl,imx6ull";
};
