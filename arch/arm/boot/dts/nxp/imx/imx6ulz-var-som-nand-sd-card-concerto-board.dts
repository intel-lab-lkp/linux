// SPDX-License-Identifier: GPL-2.0+
/*
 * Copyright (C) 2026 Variscite Ltd. - https://www.variscite.com
 */

/dts-v1/;

#include "imx6ulz.dtsi"
#include "imx6ulz-var-som.dtsi"
#include "imx6ul-imx6ull-var-som-nand.dtsi"
#include "imx6ul-imx6ull-var-wm8904.dtsi"
#include "imx6ulz-var-som-concerto-board.dtsi"
#include "imx6ul-imx6ull-var-som-concerto-board-sd-card.dtsi"

/ {
	model = "Variscite VAR-SOM-6UL with i.MX6ULZ, NAND flash, SD card & WM8904 support on Concerto-Board";
	compatible = "variscite,var-som-imx6ulz-nand-sd-card-concerto-board",
		     "variscite,var-som-imx6ulz",
		     "fsl,imx6ull",
		     "fsl,imx6ulz";
};
