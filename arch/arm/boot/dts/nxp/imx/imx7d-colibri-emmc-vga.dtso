// SPDX-License-Identifier: GPL-2.0-only OR MIT
/*
 * Copyright (c) Toradex
 *
 * VGA output connected to the Colibri parallel RGB LCD interface through a
 * non-programmable video DAC with a DVI connector.
 *
 * The VGA output is available on multiple carrier boards (including Iris,
 * Eval, Aster) without VESA DDC I2C signals.
 */

/dts-v1/;
/plugin/;

#include <dt-bindings/gpio/gpio.h>

#include "imx6ull-imx7-colibri-vga.dtsi"

&vga_encoder {
	pinctrl-names = "default";
	pinctrl-0 = <&pinctrl_gpio_bl_on>;
	/* SODIMM 71 / BL_ON */
	enable-gpios = <&gpio5 1 GPIO_ACTIVE_HIGH>;
};
