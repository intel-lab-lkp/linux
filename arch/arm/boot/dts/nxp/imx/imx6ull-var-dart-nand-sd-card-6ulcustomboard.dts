// SPDX-License-Identifier: GPL-2.0+
/*
 * Copyright (C) 2026 Variscite Ltd. - https://www.variscite.com
 */

/dts-v1/;

#include "imx6ull.dtsi"
#include "imx6ull-var-dart.dtsi"
#include "imx6ul-imx6ull-var-dart-nand.dtsi"
#include "imx6ul-imx6ull-var-dart-wm8904.dtsi"
#include "imx6ull-var-dart-6ulcustomboard.dtsi"
#include "imx6ul-imx6ull-var-dart-6ulcustomboard-sd-card.dtsi"

/ {
	model = "Variscite DART-6UL with i.MX6ULL, NAND flash, SD card & WM8904 support on VAR-6ULCustomBoard";
	compatible = "variscite,dart-6ul-imx6ull-nand-sd-card-6ulcustomboard",
		     "variscite,dart-6ul-imx6ull",
		     "fsl,imx6ull";
};
