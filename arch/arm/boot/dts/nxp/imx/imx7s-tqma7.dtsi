// SPDX-License-Identifier: GPL-2.0-or-later OR MIT
/*
 * Device Tree Include file for TQ-Systems TQMa7S board with NXP i.MX7Solo SoC.
 *
 * Copyright (c) 2016 TQ-Systems GmbH <linux@ew.tq-group.com>,
 * D-82229 Seefeld, Germany.
 * Author: Markus Niebel
 *
 * Copyright (C) 2019 Bruno Thomsen <bruno.thomsen@gmail.com>
 */

#include "imx7s.dtsi"
#include "imx7-tqma7.dtsi"
