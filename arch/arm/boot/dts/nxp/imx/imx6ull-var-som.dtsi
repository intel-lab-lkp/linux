// SPDX-License-Identifier: GPL-2.0+
/*
 * Support for Variscite VAR-SOM-6UL module with imx6ull CPU
 *
 * https://variscite.com/system-on-module-som/i-mx-6/i-mx-6ul/var-som-6ul/
 *
 * Copyright 2026 Dimonoff
 * Copyright (C) 2026 Variscite Ltd. - https://www.variscite.com
 */

#include "imx6ul-imx6ull-var-som.dtsi"

&adc1 {
	vref-supply = <&touch_3v3_regulator>;
	status = "okay";
};

&iomuxc_snvs {
	pinctrl_enet1_gpio: enet1-gpio-grp {
		fsl,pins = <
			MX6ULL_PAD_SNVS_TAMPER0__GPIO5_IO00	0x1b0b0
		>;
	};

	pinctrl_wifi: wifi-grp {
		fsl,pins = <
			MX6ULL_PAD_SNVS_TAMPER4__GPIO5_IO04	0x1b0b0
			MX6ULL_PAD_SNVS_TAMPER6__GPIO5_IO06	0x03029
		>;
	};
};
