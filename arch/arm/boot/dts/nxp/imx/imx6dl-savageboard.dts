// SPDX-License-Identifier: (GPL-2.0-or-later OR MIT)
/*
 * Copyright (C) 2017 Milo Kim <woogyom.kim@gmail.com>
 */

/dts-v1/;

#include "imx6dl.dtsi"
#include "imx6qdl-savageboard.dtsi"

/ {
	model = "Poslab SavageBoard Dual";
	compatible = "poslab,imx6dl-savageboard", "fsl,imx6dl";
};
