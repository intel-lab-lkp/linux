// SPDX-License-Identifier: (GPL-2.0-or-later OR MIT)
/*
 * Copyright (C) 2017 Milo Kim <woogyom.kim@gmail.com>
 */

/dts-v1/;

#include "imx6q.dtsi"
#include "imx6qdl-savageboard.dtsi"

/ {
	model = "Poslab SavageBoard Quad";
	compatible = "poslab,imx6q-savageboard", "fsl,imx6q";
};

&sata {
	status = "okay";
};
