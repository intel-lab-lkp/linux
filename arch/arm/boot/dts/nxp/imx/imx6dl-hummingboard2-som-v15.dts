// SPDX-License-Identifier: (GPL-2.0-only OR MIT)
/*
 * Device Tree file for SolidRun HummingBoard2
 * Copyright (C) 2015 Rabeeh Khoury <rabeeh@solid-run.com>
 * Based on work by Russell King
 */
/dts-v1/;

#include "imx6dl.dtsi"
#include "imx6qdl-sr-som.dtsi"
#include "imx6qdl-sr-som-ti.dtsi"
#include "imx6qdl-hummingboard2.dtsi"

/ {
	model = "SolidRun HummingBoard2 Solo/DualLite (1.5som)";
	compatible = "solidrun,hummingboard2/dl", "fsl,imx6dl";
};
