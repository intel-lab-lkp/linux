// SPDX-License-Identifier: GPL-2.0+
/*
 * Copyright (C) 2026 Variscite Ltd. - https://www.variscite.com
 */

/dts-v1/;

#include "imx6ul.dtsi"
#include "imx6ul-var-som.dtsi"
#include "imx6ul-imx6ull-var-som-nand.dtsi"
#include "imx6ul-imx6ull-var-wm8731.dtsi"
#include "imx6ul-var-som-symphony-board.dtsi"
#include "imx6ul-imx6ull-var-som-concerto-board-sd-card.dtsi"

/ {
	model = "Variscite VAR-SOM-6UL with i.MX6UL, NAND flash, SD card & WM8731 support on Symphony-Board";
	compatible = "variscite,var-som-imx6ul-nand-sd-card-wm8731-symphony-board",
		     "variscite,var-som-imx6ul",
		     "fsl,imx6ul";
};
