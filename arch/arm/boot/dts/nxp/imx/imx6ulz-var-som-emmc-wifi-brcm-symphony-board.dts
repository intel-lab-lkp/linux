// SPDX-License-Identifier: GPL-2.0+
/*
 * Copyright (C) 2026 Variscite Ltd. - https://www.variscite.com
 */

/dts-v1/;

#include "imx6ulz.dtsi"
#include "imx6ulz-var-som.dtsi"
#include "imx6ul-imx6ull-var-som-emmc.dtsi"
#include "imx6ul-imx6ull-var-som-wifi-brcm.dtsi"
#include "imx6ul-imx6ull-var-wm8904.dtsi"
#include "imx6ulz-var-som-symphony-board.dtsi"

/ {
	model = "Variscite VAR-SOM-6UL with i.MX6ULZ, eMMC, WiFi BRCM & WM8904 support on Symphony-Board";
	compatible = "variscite,var-som-imx6ulz-emmc-wifi-brcm-symphony-board",
		     "variscite,var-som-imx6ulz",
		     "fsl,imx6ull",
		     "fsl,imx6ulz";
};
