## Documentation/devicetree/bindings/clock/gpio-locked-fixed-clock.yaml
```yaml
# SPDX-License-Identifier: (GPL-2.0-only OR BSD-2-Clause)
%YAML 1.2
---
$id: http://devicetree.org/schemas/clock/gpio-locked-fixed-clock.yaml#
$schema: http://devicetree.org/meta-schemas/core.yaml#

title: GPIO Locked Fixed Clock

maintainers:
  - Vyacheslav Yurkov <V.Yurkov.EXT@bruker.com>

description: |
  Provides a clock output whose availability depends on a set of
  prerequisite conditions. These conditions include the presence of
  one or more parent clocks and the asserted state of one or more
  GPIO lock indicators. An example of such clocks is FPGA clock that
  are outside CPU control, with the lock status exposed through GPIO
  signal.

  The output clock is considered available only when all configured
  prerequisites are satisfied.

properties:
  compatible:
    const: gpio-locked-fixed-clock

  "#clock-cells":
    const: 0

  clocks:
    description: Input clocks whose validity is monitored by this provider.

  clock-output-names:
    description: Names of the clock provided by this controller.
    maxItems: 1

  locked-gpios:
    description: |
      GPIOs to check the lock state.
    minItems: 1
    maxItems: 32

required:
  - compatible
  - "#clock-cells"

anyOf:
  - required:
      - clocks
  - required:
      - locked-gpios

additionalProperties: false

examples:
  - |
    #include <dt-bindings/gpio/gpio.h>

    clk_gpio_locked: gpio-locked-fixed-clock {
        compatible = "gpio-locked-fixed-clock";
        #clock-cells = <0>;

        clocks = <&clk0 0>, <&pll 0>;

        locked-gpios = <&gpio0 4 GPIO_ACTIVE_HIGH>,
                <&gpio0 5 GPIO_ACTIVE_HIGH>,
                <&gpio1 2 GPIO_ACTIVE_LOW>;

        clock-output-names = "clkout0";
    };
```

## Documentation/devicetree/bindings/clock/hisilicon,clock-reset-generator.yaml
```yaml
# SPDX-License-Identifier: (GPL-2.0-only OR BSD-2-Clause)
%YAML 1.2
---
$id: http://devicetree.org/schemas/clock/hisilicon,clock-reset-generator.yaml#
$schema: http://devicetree.org/meta-schemas/core.yaml#

title: Hisilicon SOC Clock and Reset Generator (CRG) module

maintainers:
  - Yang Xiwen <forbidden405@foxmail.com>

description: |
  Hisilicon SOC clock control module which supports the clocks, resets and
  power domains on various SoCs.

properties:
  compatible:
    minItems: 1
    items:
      - enum:
          - hisilicon,hi3559av100-clock
          - hisilicon,hi3559av100-shub-clock
          - hisilicon,hi3660-crgctrl
          - hisilicon,hi3660-pctrl
          - hisilicon,hi3660-pmuctrl
          - hisilicon,hi3660-sctrl
          - hisilicon,hi3660-iomcu
          - hisilicon,hi3660-stub-clk
          - hisilicon,hi3670-crgctrl
          - hisilicon,hi3670-pctrl
          - hisilicon,hi3670-pmuctrl
          - hisilicon,hi3670-sctrl
          - hisilicon,hi3670-iomcu
          - hisilicon,hi3670-media1-crg
          - hisilicon,hi3670-media2-crg
          - hisilicon,hi6220-acpu-sctrl
          - hisilicon,hi6220-aoctrl
          - hisilicon,hi6220-sysctrl
          - hisilicon,hi6220-mediactrl
          - hisilicon,hi6220-pmctrl
          - hisilicon,hi6220-stub-clk
          - hisilicon,hi3516cv300-crg
          - hisilicon,hi3516cv300-sysctrl
          - hisilicon,hi3519-crg
          - hisilicon,hi3798cv200-crg
          - hisilicon,hi3798cv200-sysctrl
          - hisilicon,hi3798mv200-crg
          - hisilicon,hi3798mv200-sysctrl
      - const: syscon
      - const: simple-mfd

  reg:
    maxItems: 1

  ranges:
    maxItems: 1

  '#clock-cells':
    const: 1

  '#reset-cells':
    enum: [1, 2]
    description: |
      First cell is reset request register offset.
      Second cell is bit offset in reset request register.

  '#address-cells':
    const: 1

  '#size-cells':
    const: 1

  mboxes:
    $ref: /schemas/types.yaml#/definitions/phandle-array
    description: |
      Phandle to the mailbox for sending msg to MCU
      (See ../mailbox/hisilicon,hi3660-mailbox.txt for more info)

  mbox-names:
    $ref: /schemas/types.yaml#/definitions/string-array
    description: |
      Names of the mailboxes.

  hisilicon,hi6220-clk-sram:
    $ref: /schemas/types.yaml#/definitions/phandle
    description: |
      Phandle to the syscon managing the SoC internal sram
      the driver needs using the sram to pass parameters for frequency change.

  reset-controller:
    type: object
    description: |
      Reset controller for Hi3798CV200 GMAC module

patternProperties:
  '.*-dll@[0-9a-f]+':
    type: object
    description: |
      eMMC/SD delay-locked-loop (DLL) register subnode

required:
  - compatible
  - '#clock-cells'

allOf:
  - if:
      properties:
        compatible:
          not:
            contains:
              enum:
                - hisilicon,hi3798cv200-crg
    then:
      properties:
        reset-controller: false
  - oneOf:
      - required:
          - hisilicon,hi6220-clk-sram
      - required:
          - reg

additionalProperties: false

examples:
  - |
    #include <dt-bindings/clock/hi3559av100-clock.h>
    soc {
        #address-cells = <2>;
        #size-cells = <2>;

        clock-controller@12010000 {
            compatible = "hisilicon,hi3559av100-clock";
            #clock-cells = <1>;
            #reset-cells = <2>;
            reg = <0x0 0x12010000 0x0 0x10000>;
        };
    };
  - |
    #include <dt-bindings/interrupt-controller/arm-gic.h>
    #include <dt-bindings/clock/hi3660-clock.h>
    soc {
        #address-cells = <2>;
        #size-cells = <2>;

        clock-controller@fff35000 {
            compatible = "hisilicon,hi3660-crgctrl", "syscon";
            reg = <0x0 0xfff35000 0x0 0x1000>;
            #clock-cells = <1>;
        };
    };
  - |
    crg: clock-reset-controller@8a22000 {
        compatible = "hisilicon,hi3798mv200-crg", "syscon", "simple-mfd";
        reg = <0x8a22000 0x1000>;
        ranges = <0x0 0x8a22000 0x1000>;
        #address-cells = <1>;
        #size-cells = <1>;
        #clock-cells = <1>;
        #reset-cells = <2>;

        emmc_sap_dll: sap-dll@39c {
            compatible = "hisilicon,sdmmc-sap-dll", "syscon", "simple-mfd";
            reg = <0x39c 0x8>;
        };

        sdio0_sap_dll: sap-dll@3a4 {
            compatible = "hisilicon,sdmmc-sap-dll", "syscon", "simple-mfd";
            reg = <0x3a4 0x8>;
        };

        sdio1_sap_dll: sap-dll@3ac {
            compatible = "hisilicon,sdmmc-sap-dll", "syscon", "simple-mfd";
            reg = <0x3ac 0x8>;
        };
    };
```

## Documentation/devicetree/bindings/clock/imx8m-clock.yaml
```yaml
# SPDX-License-Identifier: GPL-2.0
%YAML 1.2
---
$id: http://devicetree.org/schemas/clock/imx8m-clock.yaml#
$schema: http://devicetree.org/meta-schemas/core.yaml#

title: NXP i.MX8M Family Clock Control Module

maintainers:
  - Abel Vesa <abelvesa@kernel.org>
  - Peng Fan <peng.fan@nxp.com>

description: |
  NXP i.MX8M Mini/Nano/Plus/Quad clock control module is an integrated clock
  controller, which generates and supplies to all modules.

properties:
  compatible:
    enum:
      - fsl,imx8mm-ccm
      - fsl,imx8mn-ccm
      - fsl,imx8mp-ccm
      - fsl,imx8mq-ccm

  reg:
    maxItems: 1

  interrupts:
    maxItems: 2

  clocks:
    minItems: 7
    maxItems: 10

  clock-names:
    minItems: 7
    maxItems: 10

  '#clock-cells':
    const: 1
    description:
      The clock consumer should specify the desired clock by having the clock
      ID in its "clocks" phandle cell. See include/dt-bindings/clock/imx8m-clock.h
      for the full list of i.MX8M clock IDs.

  fsl,ssc-modfreq-hz:
    description:
      The values of modulation frequency (Hz unit) for each clock
      supporting spread spectrum.
    minItems: 7
    maxItems: 10

  fsl,ssc-modrate-percent:
    description:
      The percentage values of modulation rate for each clock
      supporting spread spectrum.
    minItems: 7
    maxItems: 10

  fsl,ssc-modmethod:
    $ref: /schemas/types.yaml#/definitions/non-unique-string-array
    description:
      The modulation techniques for each clock supporting spread
      spectrum.
    minItems: 7
    maxItems: 10
    items:
      enum:
        - ""
        - down-spread
        - up-spread
        - center-spread

required:
  - compatible
  - reg
  - clocks
  - clock-names
  - '#clock-cells'

allOf:
  - if:
      properties:
        compatible:
          contains:
            const: fsl,imx8mq-ccm
    then:
      properties:
        clocks:
          items:
            - description: 32k osc
            - description: 25m osc
            - description: 27m osc
            - description: ext1 clock input
            - description: ext2 clock input
            - description: ext3 clock input
            - description: ext4 clock input
        clock-names:
          items:
            - const: ckil
            - const: osc_25m
            - const: osc_27m
            - const: clk_ext1
            - const: clk_ext2
            - const: clk_ext3
            - const: clk_ext4
        fsl,ssc-modfreq-hz: false
        fsl,ssc-modrate-percent: false
        fsl,ssc-modmethod: false

    else:
      properties:
        clocks:
          items:
            - description: 32k osc
            - description: 24m osc
            - description: ext1 clock input
            - description: ext2 clock input
            - description: ext3 clock input
            - description: ext4 clock input
            - description: audio1 PLL input
            - description: audio2 PLL input
            - description: dram PLL input
            - description: video PLL input

        clock-names:
          items:
            - const: osc_32k
            - const: osc_24m
            - const: clk_ext1
            - const: clk_ext2
            - const: clk_ext3
            - const: clk_ext4
            - const: audio_pll1
            - const: audio_pll2
            - const: dram_pll
            - const: video_pll

additionalProperties: false

examples:
  # Clock Control Module node:
  - |
    #include <dt-bindings/clock/imx8mm-clock.h>

    clock-controller@30380000 {
        compatible = "fsl,imx8mm-ccm";
        reg = <0x30380000 0x10000>;
        #clock-cells = <1>;
        clocks = <&osc_32k>, <&osc_24m>, <&clk_ext1>, <&clk_ext2>,
                 <&clk_ext3>, <&clk_ext4>,
                 <&anatop IMX8MM_ANATOP_AUDIO_PLL1>,
                 <&anatop IMX8MM_ANATOP_AUDIO_PLL1>,
                 <&anatop IMX8MM_ANATOP_DRAM_PLL>,
                 <&anatop IMX8MM_ANATOP_VIDEO_PLL>;
        clock-names = "osc_32k", "osc_24m", "clk_ext1", "clk_ext2",
                      "clk_ext3", "clk_ext4", "audio_pll1", "audio_pll2",
                      "dram_pll", "video_pll";
        fsl,ssc-modfreq-hz = <0>, <0>, <0>, <0>,
                             <0>, <0>,
                             <6818>,
                             <0>,
                             <0>,
                             <2419>;
        fsl,ssc-modrate-percent = <0>, <0>, <0>, <0>,
                             <0>, <0>,
                             <3>,
                             <0>,
                             <0>,
                             <7>;
        fsl,ssc-modmethod = "", "", "", "",
                            "", "",
                            "down-spread",
                            "",
                            "",
                            "center-spread";
    };

  - |
    clock-controller@30380000 {
        compatible = "fsl,imx8mq-ccm";
        reg = <0x30380000 0x10000>;
        #clock-cells = <1>;
        clocks = <&ckil>, <&osc_25m>, <&osc_27m>, <&clk_ext1>,
                 <&clk_ext2>, <&clk_ext3>, <&clk_ext4>;
        clock-names = "ckil", "osc_25m", "osc_27m", "clk_ext1",
                      "clk_ext2", "clk_ext3", "clk_ext4";
    };

...
```

## Documentation/devicetree/bindings/clock/imx95-blk-ctl.yaml
```yaml
# SPDX-License-Identifier: (GPL-2.0-only OR BSD-2-Clause)
%YAML 1.2
---
$id: http://devicetree.org/schemas/clock/imx95-blk-ctl.yaml#
$schema: http://devicetree.org/meta-schemas/core.yaml#

title: NXP i.MX95 Block Control

maintainers:
  - Peng Fan <peng.fan@nxp.com>

properties:
  compatible:
    items:
      - enum:
          - nxp,imx95-cameramix-csr
          - nxp,imx95-display-master-csr
          - nxp,imx95-dispmix-lvds-csr
          - nxp,imx95-dispmix-csr
          - nxp,imx95-netcmix-blk-ctrl
          - nxp,imx95-vpumix-csr
      - const: syscon

  reg:
    maxItems: 1

  power-domains:
    maxItems: 1

  clocks:
    maxItems: 1

  '#clock-cells':
    const: 1
    description:
      The clock consumer should specify the desired clock by having the clock
      ID in its "clocks" phandle cell. See
      include/dt-bindings/clock/nxp,imx95-clock.h

  mux-controller:
    type: object
    $ref: /schemas/mux/reg-mux.yaml

required:
  - compatible
  - reg
  - '#clock-cells'

additionalProperties: false

examples:
  # Clock Control Module node:
  - |
    #include <dt-bindings/clock/nxp,imx95-clock.h>

    syscon@4c410000 {
      compatible = "fsl,imx95-vpumix-blk-ctrl", "syscon";
      reg = <0x4c410000 0x10000>;
      #clock-cells = <1>;
    };
...
```

## Documentation/devicetree/bindings/clock/marvell,pxa1908.yaml
```yaml
# SPDX-License-Identifier: GPL-2.0-only OR BSD-2-Clause
%YAML 1.2
---
$id: http://devicetree.org/schemas/clock/marvell,pxa1908.yaml#
$schema: http://devicetree.org/meta-schemas/core.yaml#

title: Marvell PXA1908 Clock Controllers

maintainers:
  - Duje Mihanović <duje.mihanovic@skole.hr>

description: |
  The PXA1908 clock subsystem generates and supplies clock to various
  controllers within the PXA1908 SoC. The PXA1908 contains numerous clock
  controller blocks, with the ones currently supported being APBC, APBCP, MPMU
  and APMU roughly corresponding to internal buses.

  All these clock identifiers could be found in <include/dt-bindings/marvell,pxa1908.h>.

properties:
  compatible:
    oneOf:
      - enum:
          - marvell,pxa1908-apbc
          - marvell,pxa1908-apbcp
          - marvell,pxa1908-mpmu
      - items:
          - const: marvell,pxa1908-apmu
          - const: simple-mfd
          - const: syscon

  reg:
    maxItems: 1

  '#clock-cells':
    const: 1

  power-controller:
    description: |
      Optional power domain controller node.
    type: object
    additionalProperties: true
    properties:
      compatible:
        const: marvell,pxa1908-power-controller

required:
  - compatible
  - reg
  - '#clock-cells'

allOf:
  - if:
      not:
        properties:
          compatible:
            contains:
              const: marvell,pxa1908-apmu
    then:
      properties:
        power-controller: false

additionalProperties: false

examples:
  # APMU block:
  - |
    clock-controller@d4282800 {
      compatible = "marvell,pxa1908-apmu", "simple-mfd", "syscon";
      reg = <0xd4282800 0x400>;
      #clock-cells = <1>;
    };
```
