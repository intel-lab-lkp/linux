## Documentation/devicetree/bindings/clock/amlogic,axg-audio-clkc.yaml
```yaml
# SPDX-License-Identifier: GPL-2.0-only OR BSD-2-Clause
%YAML 1.2
---
$id: http://devicetree.org/schemas/clock/amlogic,axg-audio-clkc.yaml#
$schema: http://devicetree.org/meta-schemas/core.yaml#

title: Amlogic AXG Audio Clock Controller

maintainers:
  - Neil Armstrong <neil.armstrong@linaro.org>
  - Jerome Brunet <jbrunet@baylibre.com>

description:
  The Amlogic AXG audio clock controller generates and supplies clock to the
  other elements of the audio subsystem, such as fifos, i2s, spdif and pdm
  devices.

properties:
  compatible:
    enum:
      - amlogic,axg-audio-clkc
      - amlogic,g12a-audio-clkc
      - amlogic,sm1-audio-clkc

  '#clock-cells':
    const: 1

  '#reset-cells':
    const: 1

  reg:
    maxItems: 1

  clocks:
    maxItems: 28
    items:
      - description: main peripheral bus clock
    additionalItems:
      oneOf:
        - description: mst_in[0-7] - input plls to generate clock signals
        - description: slv_sclk[0-9] - slave bit clocks provided by external components
        - description: slv_lrclk[0-9]- slave sample clocks provided by external components

  clock-names:
    maxItems: 28
    items:
      - const: pclk
    additionalItems:
      oneOf:
        - pattern: "^mst_in[0-7]$"
        - pattern: "^slv_sclk[0-9]$"
        - pattern: "^slv_lrclk[0-9]$"

  resets:
    description: internal reset line

required:
  - compatible
  - '#clock-cells'
  - reg
  - clocks
  - clock-names
  - resets

allOf:
  - if:
      properties:
        compatible:
          contains:
            enum:
              - amlogic,g12a-audio-clkc
              - amlogic,sm1-audio-clkc
    then:
      required:
        - '#reset-cells'
    else:
      properties:
        '#reset-cells': false

additionalProperties: false

examples:
  - |
    #include <dt-bindings/clock/axg-clkc.h>
    #include <dt-bindings/reset/amlogic,meson-axg-reset.h>
    apb {
        #address-cells = <2>;
        #size-cells = <2>;

        clkc_audio: clock-controller@0 {
            compatible = "amlogic,axg-audio-clkc";
            reg = <0x0 0x0 0x0 0xb4>;
            #clock-cells = <1>;

            clocks = <&clkc CLKID_AUDIO>,
                     <&clkc CLKID_MPLL0>,
                     <&clkc CLKID_MPLL1>,
                     <&clkc CLKID_MPLL2>,
                     <&clkc CLKID_MPLL3>,
                     <&clkc CLKID_HIFI_PLL>,
                     <&clkc CLKID_FCLK_DIV3>,
                     <&clkc CLKID_FCLK_DIV4>,
                     <&clkc CLKID_GP0_PLL>;
            clock-names = "pclk",
                          "mst_in0",
                          "mst_in1",
                          "mst_in2",
                          "mst_in3",
                          "mst_in4",
                          "mst_in5",
                          "mst_in6",
                          "mst_in7";
            resets = <&reset RESET_AUDIO>;
        };
    };
```

## Documentation/devicetree/bindings/clock/amlogic,c3-peripherals-clkc.yaml
```yaml
# SPDX-License-Identifier: (GPL-2.0-only OR BSD-2-Clause)
# Copyright (C) 2022-2023 Amlogic, Inc. All rights reserved
%YAML 1.2
---
$id: http://devicetree.org/schemas/clock/amlogic,c3-peripherals-clkc.yaml#
$schema: http://devicetree.org/meta-schemas/core.yaml#

title: Amlogic C3 Serials Peripheral Clock Controller

maintainers:
  - Neil Armstrong <neil.armstrong@linaro.org>
  - Jerome Brunet <jbrunet@baylibre.com>
  - Xianwei Zhao <xianwei.zhao@amlogic.com>
  - Chuan Liu <chuan.liu@amlogic.com>

properties:
  compatible:
    const: amlogic,c3-peripherals-clkc

  reg:
    maxItems: 1

  clocks:
    minItems: 12
    items:
      - description: input oscillator (usually at 24MHz)
      - description: input oscillator (usually at 32KHz)
      - description: input Fix PLL
      - description: input Fclk div 2
      - description: input Fclk div 2p5
      - description: input Fclk div 3
      - description: input Fclk div 4
      - description: input Fclk div 5
      - description: input Fclk div 7
      - description: input gp0 pll
      - description: input gp1 pll
      - description: input hifi pll
      - description: input pad clock for rtc_clk (optional)

  clock-names:
    minItems: 12
    items:
      - const: xtal_24m
      - const: xtal_32k
      - const: fix
      - const: fdiv2
      - const: fdiv2p5
      - const: fdiv3
      - const: fdiv4
      - const: fdiv5
      - const: fdiv7
      - const: gp0
      - const: gp1
      - const: hifi
      - const: pad

  "#clock-cells":
    const: 1

required:
  - compatible
  - reg
  - clocks
  - clock-names
  - "#clock-cells"

additionalProperties: false

examples:
  - |
    apb {
        #address-cells = <2>;
        #size-cells = <2>;

        clock-controller@0 {
            compatible = "amlogic,c3-peripherals-clkc";
            reg = <0x0 0x0 0x0 0x49c>;
            #clock-cells = <1>;
            clocks = <&xtal_24m>,
                     <&xtal_32k>,
                     <&clkc_pll 1>,
                     <&clkc_pll 5>,
                     <&clkc_pll 7>,
                     <&clkc_pll 9>,
                     <&clkc_pll 11>,
                     <&clkc_pll 13>,
                     <&clkc_pll 15>,
                     <&clkc_pll 17>,
                     <&clkc_pll 19>,
                     <&clkc_pll 21>;
            clock-names = "xtal_24m",
                          "xtal_32k",
                          "fix",
                          "fdiv2",
                          "fdiv2p5",
                          "fdiv3",
                          "fdiv4",
                          "fdiv5",
                          "fdiv7",
                          "gp0",
                          "gp1",
                          "hifi";
        };
    };
```

## Documentation/devicetree/bindings/clock/amlogic,c3-pll-clkc.yaml
```yaml
# SPDX-License-Identifier: (GPL-2.0-only OR BSD-2-Clause)
# Copyright (C) 2022-2023 Amlogic, Inc. All rights reserved
%YAML 1.2
---
$id: http://devicetree.org/schemas/clock/amlogic,c3-pll-clkc.yaml#
$schema: http://devicetree.org/meta-schemas/core.yaml#

title: Amlogic C3 serials PLL Clock Controller

maintainers:
  - Chuan Liu <chuan.liu@amlogic.com>

properties:
  compatible:
    const: amlogic,c3-pll-clkc

  reg:
    maxItems: 1

  clocks:
    minItems: 1
    items:
      - description: input pll_in
      - description: input mclk_pll_in

  clock-names:
    minItems: 1
    items:
      - const: pll_in
      - const: mclk_pll_in

  "#clock-cells":
    const: 1

required:
  - compatible
  - reg
  - clocks
  - clock-names
  - "#clock-cells"

additionalProperties: false

examples:
  - |
    #include <dt-bindings/clock/amlogic,c3-peripherals-clkc.h>
    apb {
        #address-cells = <2>;
        #size-cells = <2>;

        clkc_pll: clock-controller@8000 {
          compatible = "amlogic,c3-pll-clkc";
          reg = <0x0 0x8000 0x0 0x1a4>;
          clocks = <&clkc_periphs CLKID_PLL_IN>,
                   <&clkc_periphs CLKID_MCLK_PLL_IN>;
          clock-names = "pll_in", "mclk_pll_in";
          #clock-cells = <1>;
        };
    };
```

## Documentation/devicetree/bindings/clock/amlogic,t7-pll-clkc.yaml
```yaml
# SPDX-License-Identifier: GPL-2.0-only OR BSD-2-Clause
# Copyright (C) 2024 Amlogic, Inc. All rights reserved
%YAML 1.2
---
$id: http://devicetree.org/schemas/clock/amlogic,t7-pll-clkc.yaml#
$schema: http://devicetree.org/meta-schemas/core.yaml#

title: Amlogic T7 PLL Clock Control Controller

maintainers:
  - Neil Armstrong <neil.armstrong@linaro.org>
  - Jerome Brunet <jbrunet@baylibre.com>
  - Jian Hu <jian.hu@amlogic.com>
  - Xianwei Zhao <xianwei.zhao@amlogic.com>

if:
  properties:
    compatible:
      contains:
        const: amlogic,t7-pll-mclk

then:
  properties:
    clocks:
      items:
        - description: mclk pll input oscillator gate
        - description: 24M oscillator input clock source for mclk_sel_0
        - description: fix 50Mhz input clock source for mclk_sel_0

    clock-names:
      items:
        - const: input
        - const: mclk_in0
        - const: mclk_in1

else:
  properties:
    clocks:
      items:
        - description: pll input oscillator gate

    clock-names:
      items:
        - const: input

properties:
  compatible:
    enum:
      - amlogic,t7-pll-gp0
      - amlogic,t7-pll-gp1
      - amlogic,t7-pll-hifi
      - amlogic,t7-pll-pcie
      - amlogic,t7-mpll
      - amlogic,t7-pll-hdmi
      - amlogic,t7-pll-mclk

  reg:
    maxItems: 1

  '#clock-cells':
    const: 1

  clocks:
    minItems: 1
    maxItems: 3

  clock-names:
    minItems: 1
    maxItems: 3

required:
  - compatible
  - '#clock-cells'
  - reg
  - clocks
  - clock-names

additionalProperties: false

examples:
  - |
    apb {
        #address-cells = <2>;
        #size-cells = <2>;

        clock-controller@8080 {
            compatible = "amlogic,t7-pll-gp0";
            reg = <0 0x8080 0 0x20>;
            clocks = <&scmi_clk 2>;
            clock-names = "input";
            #clock-cells = <1>;
        };

        clock-controller@8300 {
            compatible = "amlogic,t7-pll-mclk";
            reg = <0 0x8300 0 0x18>;
            clocks = <&scmi_clk 2>,
                     <&xtal>,
                     <&scmi_clk 31>;
            clock-names = "input", "mclk_in0", "mclk_in1";
            #clock-cells = <1>;
        };
    };
```

## Documentation/devicetree/bindings/clock/axis,artpec8-clock.yaml
```yaml
# SPDX-License-Identifier: (GPL-2.0-only OR BSD-2-Clause)
%YAML 1.2
---
$id: http://devicetree.org/schemas/clock/axis,artpec8-clock.yaml#
$schema: http://devicetree.org/meta-schemas/core.yaml#

title: Axis ARTPEC-8 SoC clock controller

maintainers:
  - Jesper Nilsson <jesper.nilsson@axis.com>

description: |
  ARTPEC-8 clock controller is comprised of several CMU units, generating
  clocks for different domains. Those CMU units are modeled as separate device
  tree nodes, and might depend on each other. The root clock in that root tree
  is an external clock: OSCCLK (25 MHz). This external clock must be defined
  as a fixed-rate clock in dts.

  CMU_CMU is a top-level CMU, where all base clocks are prepared using PLLs and
  dividers; all other clocks of function blocks (other CMUs) are usually
  derived from CMU_CMU.

  Each clock is assigned an identifier and client nodes can use this identifier
  to specify the clock which they consume. All clocks available for usage
  in clock consumer nodes are defined as preprocessor macros in
  'include/dt-bindings/clock/axis,artpec8-clk.h' header.

properties:
  compatible:
    enum:
      - axis,artpec8-cmu-cmu
      - axis,artpec8-cmu-bus
      - axis,artpec8-cmu-core
      - axis,artpec8-cmu-cpucl
      - axis,artpec8-cmu-fsys
      - axis,artpec8-cmu-imem
      - axis,artpec8-cmu-peri

  clocks:
    minItems: 1
    maxItems: 5

  clock-names:
    minItems: 1
    maxItems: 5

  "#clock-cells":
    const: 1

  reg:
    maxItems: 1

required:
  - compatible
  - reg
  - "#clock-cells"
  - clocks
  - clock-names

allOf:
  - if:
      properties:
        compatible:
          contains:
            const: axis,artpec8-cmu-cmu

    then:
      properties:
        clocks:
          items:
            - description: External reference clock (25 MHz)

        clock-names:
          items:
            - const: fin_pll

  - if:
      properties:
        compatible:
          contains:
            const: axis,artpec8-cmu-bus

    then:
      properties:
        clocks:
          items:
            - description: External reference clock (25 MHz)
            - description: CMU_BUS BUS clock (from CMU_CMU)
            - description: CMU_BUS DLP clock (from CMU_CMU)

        clock-names:
          items:
            - const: fin_pll
            - const: dout_clkcmu_bus_bus
            - const: dout_clkcmu_bus_dlp

  - if:
      properties:
        compatible:
          contains:
            const: axis,artpec8-cmu-core

    then:
      properties:
        clocks:
          items:
            - description: External reference clock (25 MHz)
            - description: CMU_CORE main clock (from CMU_CMU)
            - description: CMU_CORE DLP clock (from CMU_CMU)

        clock-names:
          items:
            - const: fin_pll
            - const: dout_clkcmu_core_main
            - const: dout_clkcmu_core_dlp

  - if:
      properties:
        compatible:
          contains:
            const: axis,artpec8-cmu-cpucl

    then:
      properties:
        clocks:
          items:
            - description: External reference clock (25 MHz)
            - description: CMU_CPUCL switch clock (from CMU_CMU)

        clock-names:
          items:
            - const: fin_pll
            - const: dout_clkcmu_cpucl_switch

  - if:
      properties:
        compatible:
          contains:
            const: axis,artpec8-cmu-fsys

    then:
      properties:
        clocks:
          items:
            - description: External reference clock (25 MHz)
            - description: CMU_FSYS SCAN0 clock (from CMU_CMU)
            - description: CMU_FSYS SCAN1 clock (from CMU_CMU)
            - description: CMU_FSYS BUS clock (from CMU_CMU)
            - description: CMU_FSYS IP clock (from CMU_CMU)

        clock-names:
          items:
            - const: fin_pll
            - const: dout_clkcmu_fsys_scan0
            - const: dout_clkcmu_fsys_scan1
            - const: dout_clkcmu_fsys_bus
            - const: dout_clkcmu_fsys_ip

  - if:
      properties:
        compatible:
          contains:
            const: axis,artpec8-cmu-imem

    then:
      properties:
        clocks:
          items:
            - description: External reference clock (25 MHz)
            - description: CMU_IMEM ACLK clock (from CMU_CMU)
            - description: CMU_IMEM JPEG clock (from CMU_CMU)

        clock-names:
          items:
            - const: fin_pll
            - const: dout_clkcmu_imem_aclk
            - const: dout_clkcmu_imem_jpeg

  - if:
      properties:
        compatible:
          contains:
            const: axis,artpec8-cmu-peri

    then:
      properties:
        clocks:
          items:
            - description: External reference clock (25 MHz)
            - description: CMU_PERI IP clock (from CMU_CMU)
            - description: CMU_PERI AUDIO clock (from CMU_CMU)
            - description: CMU_PERI DISP clock (from CMU_CMU)

        clock-names:
          items:
            - const: fin_pll
            - const: dout_clkcmu_peri_ip
            - const: dout_clkcmu_peri_audio
            - const: dout_clkcmu_peri_disp

additionalProperties: false

examples:
  # Clock controller node for CMU_FSYS
  - |
    #include <dt-bindings/clock/axis,artpec8-clk.h>

    cmu_fsys: clock-controller@16c10000 {
        compatible = "axis,artpec8-cmu-fsys";
        reg = <0x16c10000 0x4000>;
        #clock-cells = <1>;
        clocks = <&fin_pll>,
                 <&cmu_cmu DOUT_CLKCMU_FSYS_SCAN0>,
                 <&cmu_cmu DOUT_CLKCMU_FSYS_SCAN1>,
                 <&cmu_cmu DOUT_CLKCMU_FSYS_BUS>,
                 <&cmu_cmu DOUT_CLKCMU_FSYS_IP>;
        clock-names = "fin_pll",
                      "dout_clkcmu_fsys_scan0",
                      "dout_clkcmu_fsys_scan1",
                      "dout_clkcmu_fsys_bus",
                      "dout_clkcmu_fsys_ip";
    };

...
```
