## Documentation/devicetree/bindings/clock/eswin,eic7700-clock.yaml
```yaml
# SPDX-License-Identifier: (GPL-2.0-only OR BSD-2-Clause)
%YAML 1.2
---
$id: http://devicetree.org/schemas/clock/eswin,eic7700-clock.yaml#
$schema: http://devicetree.org/meta-schemas/core.yaml#

title: Eswin EIC7700 SoC clock controller

maintainers:
  - Yifeng Huang <huangyifeng@eswincomputing.com>
  - Xuyang Dong <dongxuyang@eswincomputing.com>

description:
  The clock controller generates and supplies clock to all the modules
  for eic7700 SoC.

properties:
  compatible:
    const: eswin,eic7700-clock

  reg:
    maxItems: 1

  '#clock-cells':
    const: 0

  '#address-cells':
    const: 1

  '#size-cells':
    const: 0

required:
  - compatible
  - reg
  - '#clock-cells'
  - '#address-cells'
  - '#size-cells'

patternProperties:
  "^fixed-rate.*":
    type: object
    $ref: /schemas/clock/fixed-clock.yaml#

  ".*pll@[a-f0-9]+$":
    type: object

    properties:
      compatible:
        const: eswin,pll-clock

      reg:
        items:
          - description: PLL's config 0 register
          - description: PLL's config 1 register
          - description: PLL's config 2 register
          - description: PLL's status register

      '#clock-cells':
        const: 0

      clock-output-names:
        maxItems: 1

      enable-shift:
        description: Bit shift of the enable register.
        $ref: /schemas/types.yaml#/definitions/uint32
        minimum: 0
        maximum: 31

      enable-width:
        description: Width of the enable register.
        $ref: /schemas/types.yaml#/definitions/uint32
        minimum: 0
        maximum: 31

      refdiv-shift:
        description: Bit shift of the reference divider register.
        $ref: /schemas/types.yaml#/definitions/uint32
        minimum: 0
        maximum: 31

      refdiv-width:
        description: Width of the reference divider register.
        $ref: /schemas/types.yaml#/definitions/uint32
        minimum: 0
        maximum: 31

      fbdiv-shift:
        description: Bit shift of the feedback divider register.
        $ref: /schemas/types.yaml#/definitions/uint32
        minimum: 0
        maximum: 31

      fbdiv-width:
        description: Width of the feedback divider register.
        $ref: /schemas/types.yaml#/definitions/uint32
        minimum: 0
        maximum: 31

      frac-shift:
        description: Bit shift of the fractional divider register.
        $ref: /schemas/types.yaml#/definitions/uint32
        minimum: 0
        maximum: 31

      frac-width:
        description: Width of the fractional divider register.
        $ref: /schemas/types.yaml#/definitions/uint32
        minimum: 0
        maximum: 31

      postdiv1-shift:
        description: Bit shift of the post divider 1 register.
        $ref: /schemas/types.yaml#/definitions/uint32
        minimum: 0
        maximum: 31

      postdiv1-width:
        description: Width of the post divider 1 register.
        $ref: /schemas/types.yaml#/definitions/uint32
        minimum: 0
        maximum: 31

      postdiv2-shift:
        description: Bit shift of the post divider 2 register.
        $ref: /schemas/types.yaml#/definitions/uint32
        minimum: 0
        maximum: 31

      postdiv2-width:
        description: Width of the post divider 2 register.
        $ref: /schemas/types.yaml#/definitions/uint32
        maximum: 31

      lock-shift:
        description: Bit shift of the lock register.
        $ref: /schemas/types.yaml#/definitions/uint32
        minimum: 0
        maximum: 31

      lock-width:
        description: Width of the lock register.
        $ref: /schemas/types.yaml#/definitions/uint32
        minimum: 0
        maximum: 31

    required:
      - compatible
      - reg
      - '#clock-cells'
      - clock-output-names
      - enable-shift
      - enable-width
      - refdiv-shift
      - refdiv-width
      - fbdiv-shift
      - fbdiv-width
      - frac-shift
      - frac-width
      - postdiv1-shift
      - postdiv1-width
      - postdiv2-shift
      - postdiv2-width
      - lock-shift
      - lock-width

    additionalProperties: false

  ".*mux@[a-f0-9]+$":
    type: object

    properties:
      compatible:
        const: eswin,mux-clock

      reg:
        maxItems: 1

      clocks:
        minItems: 2
        maxItems: 3

      '#clock-cells':
        const: 0

      clock-output-names:
        maxItems: 1

      shift:
        description: Bit shift of the select register.
        $ref: /schemas/types.yaml#/definitions/uint32
        minimum: 0
        maximum: 31

      width:
        description: Width of the select register.
        $ref: /schemas/types.yaml#/definitions/uint32
        minimum: 0
        maximum: 31


    required:
      - compatible
      - reg
      - clocks
      - '#clock-cells'
      - clock-output-names
      - shift
      - width

    additionalProperties: false

  "^fixed-factor.*":
    type: object
    $ref: /schemas/clock/fixed-factor-clock.yaml#

  ".*div@[a-f0-9]+$":
    type: object

    properties:
      compatible:
        const: eswin,divider-clock

      reg:
        maxItems: 1

      clocks:
        maxItems: 1

      '#clock-cells':
        const: 0

      clock-output-names:
        maxItems: 1

      shift:
        description: Bit shift of the divider register.
        $ref: /schemas/types.yaml#/definitions/uint32
        minimum: 0
        maximum: 31

      width:
        description: Width of the divider register.
        $ref: /schemas/types.yaml#/definitions/uint32
        minimum: 0
        maximum: 31

      div-flags:
        description: Flags of the divider register.
        $ref: /schemas/types.yaml#/definitions/uint32
        minimum: 0
        maximum: 31

    required:
      - compatible
      - reg
      - clocks
      - '#clock-cells'
      - clock-output-names
      - shift
      - width
      - div-flags

    additionalProperties: false

  ".*gate@[a-f0-9]+$":
    type: object

    properties:
      compatible:
        const: eswin,gate-clock

      reg:
        maxItems: 1

      clocks:
        maxItems: 1

      '#clock-cells':
        const: 0

      clock-output-names:
        maxItems: 1

      bit-index:
        description: Bit shift of the gate enable register.
        $ref: /schemas/types.yaml#/definitions/uint32
        minimum: 0
        maximum: 31

    required:
      - compatible
      - reg
      - clocks
      - '#clock-cells'
      - clock-output-names
      - bit-index

    additionalProperties: false

additionalProperties: false

examples:
  - |
    clock-controller@51828000 {
        compatible = "eswin,eic7700-clock";
        reg = <0x51828000 0x80000>;
        #clock-cells = <0>;
        #address-cells = <1>;
        #size-cells = <0>;

        fixed_rate_clk_xtal_24m: fixed-rate-clk-xtal-24m {
          compatible = "fixed-clock";
          #clock-cells = <0>;
          clock-frequency = <24000000>;
          clock-output-names = "fixed_rate_clk_xtal_24m";
        };

        clk_pll_cpu: clk-cpu-pll@64 {
          compatible = "eswin,pll-clock";
          reg = <0x64>, <0x68>, <0x6c>, <0xa4>;
          #clock-cells = <0>;
          enable-shift = <0>;
          enable-width = <1>;
          refdiv-shift = <12>;
          refdiv-width = <6>;
          fbdiv-shift = <20>;
          fbdiv-width = <12>;
          frac-shift = <4>;
          frac-width = <24>;
          postdiv1-shift = <1>;
          postdiv1-width = <3>;
          postdiv2-shift = <16>;
          postdiv2-width = <3>;
          lock-shift = <5>;
          lock-width = <1>;
          clock-output-names = "clk_pll_cpu";
        };

        mux_cpu_root_3mux1: cpu-root-3mux1-mux@208 {
          compatible = "eswin,mux-clock";
          reg = <0x208>;
          #clock-cells = <0>;
          clocks = <&clk_pll_cpu>,
                   <&fixed_factor_u84_core_lp_div2>,
                   <&fixed_rate_clk_xtal_24m>;
          shift = <0>;
          width = <2>;
          clock-output-names = "mux_cpu_root_3mux1";
        };

        fixed_factor_cpu_div2: fixed-factor-cpu-div2 {
          compatible = "fixed-factor-clock";
          #clock-cells = <0>;
          clocks = <&mux_cpu_root_3mux1>;
          clock-div = <2>;
          clock-mult = <1>;
          clock-output-names = "fixed_factor_cpu_div2";
        };

        divider_u84_rtc_toggle: u84-rtc-toggle-div@1ec {
          compatible = "eswin,divider-clock";
          reg = <0x1ec>;
          #clock-cells = <0>;
          clocks = <&fixed_rate_clk_xtal_24m>;
          shift = <16>;
          width = <5>;
          div-flags = <0x5>;
          clock-output-names = "divider_u84_rtc_toggle";
        };

        gate_vi_phy_cfg: vi-phy-cfg-gate@1ac {
          compatible = "eswin,gate-clock";
          reg = <0x1ac>;
          #clock-cells = <0>;
          clocks = <&fixed_rate_clk_xtal_24m>;
          bit-index = <1>;
          clock-output-names = "gate_vi_phy_cfg";
        };
    };
```

## Documentation/devicetree/bindings/clock/fixed-mmio-clock.yaml
```yaml
# SPDX-License-Identifier: GPL-2.0
%YAML 1.2
---
$id: http://devicetree.org/schemas/clock/fixed-mmio-clock.yaml#
$schema: http://devicetree.org/meta-schemas/core.yaml#

title: Simple memory mapped IO fixed-rate clock sources

description:
  This binding describes a fixed-rate clock for which the frequency can
  be read from a single 32-bit memory mapped I/O register.

  An optional ready register can be specified in a second reg entry.
  The ready register will be polled until it signals ready prior to reading
  the fixed rate. This is useful for example to optionally wait for a PLL
  to lock.

  It was designed for test systems, like FPGA, not for complete,
  finished SoCs.

maintainers:
  - Jan Kotas <jank@cadence.com>

properties:
  compatible:
    const: fixed-mmio-clock

  reg:
    minItems: 1
    items:
      - description: Fixed rate register
      - description: Optional clock ready register

  "#clock-cells":
    const: 0

  clock-output-names:
    maxItems: 1

  ready-timeout-us:
    description:
      Optional timeout in micro-seconds when polling for clock readiness.
      0 means no timeout.
    default: 0

  ready-mask:
    description:
      Optional mask to apply when reading the ready register.
    $ref: /schemas/types.yaml#/definitions/uint32
    default: 0xffffffff

  ready-value:
    description:
      When a ready register is specified in reg, poll the ready reg until
      ready-reg & ready-mask == ready-value.
    $ref: /schemas/types.yaml#/definitions/uint32

required:
  - compatible
  - reg
  - "#clock-cells"

additionalProperties: false

examples:
  - |
    sysclock: sysclock@fd020004 {
      compatible = "fixed-mmio-clock";
      #clock-cells = <0>;
      reg = <0xfd020004 0x4>;
      clock-output-names = "sysclk";
    };
  - |
    clock@fd040000 {
      compatible = "fixed-mmio-clock";
      #clock-cells = <0>;
      reg = <0xfd040000 0x4 0xfd040004 0x4>;
      ready-mask = <1>;
      ready-value = <1>;
      clock-output-names = "pclk";
    };
...
```

## Documentation/devicetree/bindings/clock/fsl,imx8m-anatop.yaml
```yaml
# SPDX-License-Identifier: (GPL-2.0-only OR BSD-2-Clause)
%YAML 1.2
---
$id: http://devicetree.org/schemas/clock/fsl,imx8m-anatop.yaml#
$schema: http://devicetree.org/meta-schemas/core.yaml#

title: NXP i.MX8M Family Anatop Module

maintainers:
  - Peng Fan <peng.fan@nxp.com>

description: |
  NXP i.MX8M Family anatop PLL module which generates PLL to CCM root.

properties:
  compatible:
    oneOf:
      - enum:
          - fsl,imx8mm-anatop
          - fsl,imx8mq-anatop
      - items:
          - enum:
              - fsl,imx8mn-anatop
              - fsl,imx8mp-anatop
          - const: fsl,imx8mm-anatop

  reg:
    maxItems: 1

  interrupts:
    maxItems: 1

  '#clock-cells':
    const: 1

  fsl,ssc-clocks:
    $ref: /schemas/types.yaml#/definitions/phandle-array
    description:
      List of phandle and clock specifier pairs of PLLs with spread
      spectrum generation hardware capability.
    maxItems: 4

  fsl,ssc-modfreq-hz:
    description:
      The values of modulation frequency (Hz unit) of spread spectrum
      clocking for each PLL.
    maxItems: 4

  fsl,ssc-modrate-percent:
    description:
      The percentage values of modulation rate of spread spectrum
      clocking for each PLL.
    maxItems: 4

  fsl,ssc-modmethod:
    $ref: /schemas/types.yaml#/definitions/string-array
    description:
      The modulation techniques of spread spectrum clocking for
      each PLL.
    oneOf:
      - enum:
          - down-spread
          - up-spread
          - center-spread
    maxItems: 4

required:
  - compatible
  - reg
  - '#clock-cells'

allOf:
  - if:
      not:
        properties:
          compatible:
            contains:
              const: fsl,imx8mm-anatop
    then:
      properties:
        fsl,ssc-clocks: false
        fsl,ssc-modfreq-hz: false
        fsl,ssc-modrate-percent: false
        fsl,ssc-modmethod: false

additionalProperties: false

examples:
  - |
    anatop: clock-controller@30360000 {
        compatible = "fsl,imx8mn-anatop", "fsl,imx8mm-anatop";
        reg = <0x30360000 0x10000>;
        #clock-cells = <1>;
    };

...
```

## Documentation/devicetree/bindings/clock/fsl,imx93-anatop.yaml
```yaml
# SPDX-License-Identifier: (GPL-2.0-only OR BSD-2-Clause)
%YAML 1.2
---
$id: http://devicetree.org/schemas/clock/fsl,imx93-anatop.yaml#
$schema: http://devicetree.org/meta-schemas/core.yaml#

title: NXP i.MX93 Anatop Module

maintainers:
  - Peng Fan <peng.fan@nxp.com>

description: |
  NXP i.MX93 anatop PLL module which generates PLL to CCM root.

properties:
  compatible:
    items:
      - const: fsl,imx93-anatop

  reg:
    maxItems: 1

  '#clock-cells':
    const: 1

required:
  - compatible
  - reg
  - '#clock-cells'

additionalProperties: false

examples:
  - |
    anatop: clock-controller@44480000 {
        compatible = "fsl,imx93-anatop";
        reg = <0x44480000 0x2000>;
        #clock-cells = <1>;
    };

...
```

## Documentation/devicetree/bindings/clock/gpio-gate-clock.yaml
```yaml
# SPDX-License-Identifier: (GPL-2.0-only OR BSD-2-Clause)
%YAML 1.2
---
$id: http://devicetree.org/schemas/clock/gpio-gate-clock.yaml#
$schema: http://devicetree.org/meta-schemas/core.yaml#

title: Simple GPIO clock gate

maintainers:
  - Jyri Sarha <jsarha@ti.com>

properties:
  compatible:
    enum:
      - gpio-gate-clock
      - gpio-locked-fixed-clock

  clocks:
    maxItems: 1

  '#clock-cells':
    const: 0

  enable-gpios:
    description: GPIO reference for enabling and disabling the clock.
    maxItems: 1

  locked-gpios:
    description: GPIO that indicates whether the clock is enabled or disabled.
    maxItems: 1

required:
  - compatible
  - '#clock-cells'

allOf:
  - if:
      properties:
        compatible:
          const: gpio-gate-clock
    then:
      required:
        - enable-gpios
  - if:
      properties:
        compatible:
          const: gpio-locked-fixed-clock
    then:
      required:
        - locked-gpios

additionalProperties: false

examples:
  - |
    #include <dt-bindings/gpio/gpio.h>

    clock {
        compatible = "gpio-gate-clock";
        clocks = <&parentclk>;
        #clock-cells = <0>;
        enable-gpios = <&gpio 1 GPIO_ACTIVE_HIGH>;
    };

    clk_gpio_locked {
        compatible = "gpio-locked-fixed-clock";
        #clock-cells = <0>;
        clocks = <&pll>;
        locked-gpios = <&gpio0 4 GPIO_ACTIVE_HIGH>;
    };
```
