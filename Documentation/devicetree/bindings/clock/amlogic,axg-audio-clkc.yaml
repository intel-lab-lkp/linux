## Documentation/devicetree/bindings/clock/brcm,kona-ccu.yaml
```yaml
# SPDX-License-Identifier: GPL-2.0-only OR BSD-2-Clause
%YAML 1.2
---
$id: http://devicetree.org/schemas/clock/brcm,kona-ccu.yaml#
$schema: http://devicetree.org/meta-schemas/core.yaml#

title: Broadcom Kona family clock control units (CCU)

maintainers:
  - Florian Fainelli <florian.fainelli@broadcom.com>
  - Ray Jui <rjui@broadcom.com>
  - Scott Branden <sbranden@broadcom.com>

description:
  Broadcom "Kona" style clock control unit (CCU) is a clock provider that
  manages a set of clock signals.

properties:
  compatible:
    enum:
      - brcm,bcm11351-aon-ccu
      - brcm,bcm11351-hub-ccu
      - brcm,bcm11351-master-ccu
      - brcm,bcm11351-root-ccu
      - brcm,bcm11351-slave-ccu
      - brcm,bcm21664-aon-ccu
      - brcm,bcm21664-master-ccu
      - brcm,bcm21664-root-ccu
      - brcm,bcm21664-slave-ccu

  reg:
    maxItems: 1

  '#clock-cells':
    const: 1

  clock-output-names:
    minItems: 1
    maxItems: 10

allOf:
  - if:
      properties:
        compatible:
          contains:
            enum:
              - brcm,bcm11351-aon-ccu
              - brcm,bcm11351-hub-ccu
              - brcm,bcm11351-master-ccu
              - brcm,bcm11351-root-ccu
              - brcm,bcm11351-slave-ccu
    then:
      properties:
        clock-output-names:
          description: |
            The following table defines the set of CCUs and clock specifiers
            for BCM281XX family clocks.
            These clock specifiers are defined in:
                "include/dt-bindings/clock/bcm281xx.h"

            CCU     Clock        Type  Index  Specifier
            ---     -----        ----  -----  ---------
            root    frac_1m      peri    0    BCM281XX_ROOT_CCU_FRAC_1M

            aon     hub_timer    peri    0    BCM281XX_AON_CCU_HUB_TIMER
            aon     pmu_bsc      peri    1    BCM281XX_AON_CCU_PMU_BSC
            aon     pmu_bsc_var  peri    2    BCM281XX_AON_CCU_PMU_BSC_VAR

            hub     tmon_1m      peri    0    BCM281XX_HUB_CCU_TMON_1M

            master  sdio1        peri    0    BCM281XX_MASTER_CCU_SDIO1
            master  sdio2        peri    1    BCM281XX_MASTER_CCU_SDIO2
            master  sdio3        peri    2    BCM281XX_MASTER_CCU_SDIO3
            master  sdio4        peri    3    BCM281XX_MASTER_CCU_SDIO4
            master  dmac         peri    4    BCM281XX_MASTER_CCU_DMAC
            master  usb_ic       peri    5    BCM281XX_MASTER_CCU_USB_IC
            master  hsic2_48m    peri    6    BCM281XX_MASTER_CCU_HSIC_48M
            master  hsic2_12m    peri    7    BCM281XX_MASTER_CCU_HSIC_12M

            slave   uartb        peri    0    BCM281XX_SLAVE_CCU_UARTB
            slave   uartb2       peri    1    BCM281XX_SLAVE_CCU_UARTB2
            slave   uartb3       peri    2    BCM281XX_SLAVE_CCU_UARTB3
            slave   uartb4       peri    3    BCM281XX_SLAVE_CCU_UARTB4
            slave   ssp0         peri    4    BCM281XX_SLAVE_CCU_SSP0
            slave   ssp2         peri    5    BCM281XX_SLAVE_CCU_SSP2
            slave   bsc1         peri    6    BCM281XX_SLAVE_CCU_BSC1
            slave   bsc2         peri    7    BCM281XX_SLAVE_CCU_BSC2
            slave   bsc3         peri    8    BCM281XX_SLAVE_CCU_BSC3
            slave   pwm          peri    9    BCM281XX_SLAVE_CCU_PWM
  - if:
      properties:
        compatible:
          contains:
            enum:
              - brcm,bcm21664-aon-ccu
              - brcm,bcm21664-master-ccu
              - brcm,bcm21664-root-ccu
              - brcm,bcm21664-slave-ccu
    then:
      properties:
        clock-output-names:
          maxItems: 8
          description: |
            The following table defines the set of CCUs and clock specifiers
            for BCM21664 family clocks.
            These clock specifiers are defined in:
                "include/dt-bindings/clock/bcm21664.h"

            CCU     Clock         Type  Index  Specifier
            ---     -----         ----  -----  ---------
            root    frac_1m       peri    0    BCM21664_ROOT_CCU_FRAC_1M

            aon     hub_timer     peri    0    BCM21664_AON_CCU_HUB_TIMER

            master  sdio1         peri    0    BCM21664_MASTER_CCU_SDIO1
            master  sdio2         peri    1    BCM21664_MASTER_CCU_SDIO2
            master  sdio3         peri    2    BCM21664_MASTER_CCU_SDIO3
            master  sdio4         peri    3    BCM21664_MASTER_CCU_SDIO4
            master  sdio1_sleep   peri    4    BCM21664_MASTER_CCU_SDIO1_SLEEP
            master  sdio2_sleep   peri    5    BCM21664_MASTER_CCU_SDIO2_SLEEP
            master  sdio3_sleep   peri    6    BCM21664_MASTER_CCU_SDIO3_SLEEP
            master  sdio4_sleep   peri    7    BCM21664_MASTER_CCU_SDIO4_SLEEP

            slave   uartb         peri    0    BCM21664_SLAVE_CCU_UARTB
            slave   uartb2        peri    1    BCM21664_SLAVE_CCU_UARTB2
            slave   uartb3        peri    2    BCM21664_SLAVE_CCU_UARTB3
            slave   uartb4        peri    3    BCM21664_SLAVE_CCU_UARTB4
            slave   bsc1          peri    4    BCM21664_SLAVE_CCU_BSC1
            slave   bsc2          peri    5    BCM21664_SLAVE_CCU_BSC2
            slave   bsc3          peri    6    BCM21664_SLAVE_CCU_BSC3
            slave   bsc4          peri    7    BCM21664_SLAVE_CCU_BSC4

required:
  - compatible
  - reg
  - '#clock-cells'
  - clock-output-names

additionalProperties: false

examples:
  - |
    clock-controller@3e011000 {
      compatible = "brcm,bcm11351-slave-ccu";
      reg = <0x3e011000 0x0f00>;
      #clock-cells = <1>;
      clock-output-names = "uartb",
                           "uartb2",
                           "uartb3",
                           "uartb4",
                           "ssp0",
                           "ssp2",
                           "bsc1",
                           "bsc2",
                           "bsc3",
                           "pwm";
    };
...
```

## Documentation/devicetree/bindings/clock/cirrus,cs2600.yaml
```yaml
# SPDX-License-Identifier: (GPL-2.0-only OR BSD-2-Clause)
%YAML 1.2
---
$id: http://devicetree.org/schemas/clock/cirrus,cs2600.yaml#
$schema: http://devicetree.org/meta-schemas/core.yaml#

title: Cirrus Logic Fractional-N Clock Synthesizer & Clock Multiplier

maintainers:
  - patches@opensource.cirrus.com

description: |
  The CS2600 is a system-clocking device that enables frequency synthesis
  and clock generation from a stable timing reference clock. The device can
  generate low-jitter clocks from a noisy clock reference at frequencies as
  low as 50 Hz. The CS2600 has two clock inputs: REF_CLK_IN and CLK_IN.
  REF_CLK_IN can be either a crystal or an external clock source.
  REF_CLK_IN is always required to clock the PLL. Either REF_CLK_IN or
  CLK_IN can be used as the reference frequency from which the output
  frequency is derived.

  The clock tree of the CS2600 is:

                 +------------+
  REF_CLK_IN ----| Hybrid PLL | PLL_OUT    +--------+
                 |   + FLL    |-----+------|  GATE  |--------- CLK_OUT
      CLK_IN ----|            |     |      +--------+
                 +------------+     |
                                    |      +---------+
                                    +------| DIVIDER |-------- BCLK_OUT
                                    |      +---------+
                                    |
                                    |      +---------+
                                    +------| DIVIDER |-------- FSYNC_OUT
                                           +---------+

  Clock output names are defined in <dt-bindings/clock/cirrus,cs2600-clock.h>

properties:
  compatible:
    enum:
      - cirrus,cs2600

  reg:
    maxItems: 1

  '#clock-cells':
    const: 1

  clocks:
    minItems: 1
    maxItems: 2

  clock-names:
    minItems: 1
    items:
      - const: ref_clk_in
      - const: clk_in

  vdd-supply:
    description: Power Supply

  clock-output-names:
    maxItems: 4
    description:
      Names for the output clocks corresponding to PLL_OUT, CLK_OUT,
      BCLK_OUT and FSYNC_OUT.

  cirrus,aux1-output-source:
    description: |
      Selects the signal  routed to the AUX1_OUT pin:
        - "ref_clk_in"    the clock on REF_CLK_IN
        - "clk_in"        the clock on CLK_IN
        - "phase_unlock"  indicate the input and output clocks are not in phase,
        - "freq_unlock"   indicate the PLL is unlocked,
        - "clkin_missing" indicate no clock present at clk_in pin.
    $ref: /schemas/types.yaml#/definitions/string
    enum:
      - ref_clk_in
      - clk_in
      - phase_unlock
      - freq_unlock
      - clkin_missing
    default: ref_clk_in

  cirrus,internal-oscillator:
    description:
      Use the internal oscillator as the source of REF_CLK_IN. The clocks
      and clock-names properties must provide a fixed-rate clock of exactly
      12000000 Hz as the ref_clk_in clock.
    type: boolean

  cirrus,smart-mode:
    description:
      Use REF_CLK_IN as the frequency reference until CLK_IN is present,
      with a glitchless switch to CLK_IN as the frequency reference when
      CLK_IN is present.
    type: boolean

  cirrus,smart-mode-clkin-only:
    description:
      In Smart Mode keep PLL_OUT disabled until there is clock on CLK_IN.
    type: boolean

  cirrus,bclk-invert:
    description:
      Invert the BCLK output.
    type: boolean

  cirrus,fsync-invert:
    description:
      Invert the FSYNC output.
    type: boolean

  cirrus,fsync-duty-cycles:
    description:
      FSYNC output duty. The number of BCLK cycles that FSYNC is asserted.
      If not present the duty is 50%.
      This is determined by the type of audio port that is being clocked.
      For example TDM formats typically define FSYNC is a pulse of 1 BCLK
      at the start of a frame.
    $ref: /schemas/types.yaml#/definitions/uint32
    enum: [ 1, 2, 4, 8, 16, 32 ]

required:
  - compatible
  - reg
  - '#clock-cells'
  - clocks
  - clock-names
  - vdd-supply

allOf:
  - if:
      required:
        - cirrus,smart-mode-clkin-only
    then:
      required:
        - cirrus,smart-mode

  # Require clk_in for smart mode
  - if:
      required:
        - cirrus,smart-mode
    then:
      properties:
        clocks:
          minItems: 2
        clock-names:
          minItems: 2

additionalProperties: false

examples:
  - |
    i2c {
      #address-cells = <1>;
      #size-cells = <0>;

      clock-controller@2c {
        compatible = "cirrus,cs2600";
        reg = <0x2c>;
        #clock-cells = <1>;
        clocks = <&xtl_clk>, <&sync_clock>;
        clock-names = "ref_clk_in", "clk_in";
        vdd-supply = <&vreg>;
        cirrus,smart-mode;
        cirrus,smart-mode-clkin-only;
      };
    };
```

## Documentation/devicetree/bindings/clock/cix,sky1-audss-clock.yaml
```yaml
# SPDX-License-Identifier: (GPL-2.0-only OR BSD-2-Clause)
%YAML 1.2
---
$id: http://devicetree.org/schemas/clock/cix,sky1-audss-clock.yaml#
$schema: http://devicetree.org/meta-schemas/core.yaml#

title: Cix Sky1 audio subsystem clock controller

maintainers:
  - Joakim Zhang <joakim.zhang@cixtech.com>

description: |
  Clock provider for the Cix Sky1 audio subsystem (AUDSS).

  This node is a child of a cix,sky1-audss-system-control syscon node
  (see cix,sky1-system-control.yaml). It does not have a reg property; clock
  mux, divider and gate fields are accessed through the parent register block.

  Software reset lines for AUDSS blocks are exposed on the parent syscon via
  #reset-cells (provider). Reset indices are defined in
  include/dt-bindings/reset/cix,sky1-audss-system-control.h.

  Four SoC-level reference clocks listed in clocks/clock-names feed the AUDSS
  clock tree. The provider exposes the internal AUDSS clocks to other devices
  via #clock-cells; indices are defined in cix,sky1-audss-clock.h.

  The parent cix,sky1-audss-system-control node describes the SoC syscon
  NoC (or bus) reset via resets and the audio subsystem power domain via
  power-domains.

properties:
  compatible:
    const: cix,sky1-audss-clock

  '#clock-cells':
    const: 1
    description:
      Clock indices are defined in include/dt-bindings/clock/cix,sky1-audss-clock.h.

  clocks:
    items:
      - description: I2S parent clock for sampling rates multiple of 8kHz.
      - description: I2S parent clock for sampling rates multiple of 11.025kHz.
      - description: clock feeding most devices in audss (NOC, DSP, SRAM, HDA, DMAC, I2S, and Mailbox).
      - description: clock feeding for HDA, Timer and Watchdog, which is a dedicated 48MHz clock.

  clock-names:
    items:
      - const: x8k
      - const: x11k
      - const: sys
      - const: 48m

required:
  - compatible
  - '#clock-cells'
  - clocks
  - clock-names

additionalProperties: false

examples:
  - |
    #include <dt-bindings/clock/cix,sky1.h>

    clock-controller {
        compatible = "cix,sky1-audss-clock";
        #clock-cells = <1>;
        clocks = <&scmi_clk CLK_TREE_AUDIO_CLK0>, <&scmi_clk CLK_TREE_AUDIO_CLK2>,
                 <&scmi_clk CLK_TREE_AUDIO_CLK4>, <&scmi_clk CLK_TREE_AUDIO_CLK5>;
        clock-names = "x8k", "x11k", "sys", "48m";
    };
```

## Documentation/devicetree/bindings/clock/clock-controller-guard.yaml
```yaml
# SPDX-License-Identifier: (GPL-2.0-only OR BSD-2-Clause)
%YAML 1.2
---
$id: "http://devicetree.org/schemas/clock/clock-controller-guard.yaml#"
$schema: "http://devicetree.org/meta-schemas/core.yaml#"

title: Clock Controller Guard

maintainers:
  - Vyacheslav Yurkov <V.Yurkov.EXT@bruker.com>

description: |
  Clock controller that guards upstream clocks and/or GPIO
  signals and exposes them as a single clock output.

properties:
  compatible:
    const: clock-controller-guard

  "#clock-cells":
    const: 1

  clocks:
    description: Input clocks that will be guarded.
    minItems: 0

  clock-names: Input clock names.
    minItems: 0

  clock-output-names:
    description: Names of the clock provided by this controller.
    minItems: 1
    items:
      type: string

  gpios:
    description: |
      GPIOs used to control or guard the clocks.
    minItems: 0
    maxItems: 32

  gpio-names:
    description: Names corresponding to each GPIO.
    minItems: 0
    maxItems: 32

    items:
      type: string

required:
  - compatible
  - "#clock-cells"
anyOf:
  - required:
      - clocks
  - required:
      - gpios
dependencies:
  gpio-names: [gpios]
  clock-names: [clocks]

additionalProperties: false

examples:
  - |
    clkctrl: clock-controller {
        compatible = "clock-controller-guard";
        #clock-cells = <1>;

        clocks = <&clk0 0>, <&pll 0>;

        gpios = <&gpio0 4 GPIO_ACTIVE_HIGH>,
                <&gpio0 5 GPIO_ACTIVE_HIGH>,
                <&gpio1 2 GPIO_ACTIVE_LOW>;

        gpio-names = "gpio0", "gpio1", "gpio2";

        clock-output-names = "clkout0";
    };
```
