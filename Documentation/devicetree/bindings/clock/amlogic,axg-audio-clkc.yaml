## Documentation/devicetree/bindings/clock/maxim,max77686.yaml
```yaml
# SPDX-License-Identifier: (GPL-2.0-only OR BSD-2-Clause)
%YAML 1.2
---
$id: http://devicetree.org/schemas/clock/maxim,max77686.yaml#
$schema: http://devicetree.org/meta-schemas/core.yaml#

title: Maxim MAX77686 family clock generator block

maintainers:
  - Anand Moon <linux.amoon@gmail.com>

description: |
  Binding for Maxim MAX77686 32k clock generator block

  This is a part of device tree bindings of MAX77686 multi-function
  device. More information can be found in MFD DT binding
  doc as follows:
    bindings/mfd/maxim,max77686.yaml for MAX77686

  The MAX77686 contains three 32.768khz crystal clock outputs that can
  be controlled (gated/ungated) over I2C. Clocks are defined as
  preprocessor macros in dt-bindings/clock/maxim,max77686.h.

properties:
  compatible:
    enum:
      - max77686-rtc

  "#clock-cells":
    const: 1

  clock-output-names:
    maxItems: 3
    description: Names for AP, CP and BT clocks.

required:
  - compatible
  - "#clock-cells"

additionalProperties: false

examples:
  - |
    max77686_osc: clocks {
        compatible = "max77686-rtc";
        #clock-cells = <1>;
        clock-output-names = "32khz_ap", "32khz_cp", "32khz_pmic";
    };
```

## Documentation/devicetree/bindings/clock/mediatek,mt6685-clock.yaml
```yaml
# SPDX-License-Identifier: (GPL-2.0 OR BSD-2-Clause)
%YAML 1.2
---
$id: http://devicetree.org/schemas/clock/mediatek,mt6685-clock.yaml#
$schema: http://devicetree.org/meta-schemas/core.yaml#

title: MediaTek Clock Controller for MT6685 SPMI PM/Clock IC

maintainers:
  - AngeloGioacchino Del Regno <angelogioacchino.delregno@collabora.com>

description: |
  The clock architecture in MediaTek PMICs+Clock ICs is structured like below:
  Crystal(XO) or Internal ClockGen -->
          dividers -->
                  muxes -->
                          clock gate

  This device provides clock gate control in different IP blocks.

properties:
  compatible:
    const: mediatek,mt6685-sck-top

  reg:
    maxItems: 1

  '#clock-cells':
    const: 1

required:
  - compatible
  - reg
  - '#clock-cells'

additionalProperties: false
```

## Documentation/devicetree/bindings/clock/mediatek,mt6789-clock.yaml
```yaml
# SPDX-License-Identifier: (GPL-2.0 OR BSD-2-Clause)
%YAML 1.2
---
$id: http://devicetree.org/schemas/clock/mediatek,mt6789-clock.yaml#
$schema: http://devicetree.org/meta-schemas/core.yaml#

title: MediaTek Functional Clock Controller for MT6789

maintainers:
  - Arseniy Velikanov <me@adomerle.pw>

description:
  The Mediatek functional clock controller provides various clocks on MT6789.

properties:
  compatible:
    items:
      - enum:
          - mediatek,mt6789-afe
          - mediatek,mt6789-camsys
          - mediatek,mt6789-camsys-rawa
          - mediatek,mt6789-camsys-rawb
          - mediatek,mt6789-imgsys
          - mediatek,mt6789-imp-iic-wrap-c
          - mediatek,mt6789-imp-iic-wrap-en
          - mediatek,mt6789-imp-iic-wrap-n
          - mediatek,mt6789-imp-iic-wrap-w
          - mediatek,mt6789-ipesys
          - mediatek,mt6789-mdpsys
          - mediatek,mt6789-mfgcfg
          - mediatek,mt6789-vdecsys
          - mediatek,mt6789-vencsys

  reg:
    maxItems: 1

  '#clock-cells':
    const: 1

required:
  - compatible
  - reg

additionalProperties: false

examples:
  - |
    clock-controller@11210000 {
        compatible = "mediatek,mt6789-afe";
        reg = <0x11210000 0x1000>;
        #clock-cells = <1>;
    };
```

## Documentation/devicetree/bindings/clock/mediatek,mt6789-sys-clock.yaml
```yaml
# SPDX-License-Identifier: (GPL-2.0 OR BSD-2-Clause)
%YAML 1.2
---
$id: http://devicetree.org/schemas/clock/mediatek,mt6789-sys-clock.yaml#
$schema: http://devicetree.org/meta-schemas/core.yaml#

title: MediaTek System Clock Controller for MT6789

maintainers:
  - Arseniy Velikanov <me@adomerle.pw>

description:
  The Mediatek system clock controller provides various clocks and system configuration
  like reset and bus protection on MT6789.

properties:
  compatible:
    items:
      - enum:
          - mediatek,mt6789-apmixedsys
          - mediatek,mt6789-topckgen
          - mediatek,mt6789-infracfg-ao
          - mediatek,mt6789-mcusys
      - const: syscon

  reg:
    maxItems: 1

  '#clock-cells':
    const: 1

  '#reset-cells':
    const: 1

required:
  - compatible
  - reg

additionalProperties: false

examples:
  - |
    mcusys: syscon@c530000 {
      compatible = "mediatek,mt6789-mcusys", "syscon";
      reg = <0xc530000 0x1000>;
      #clock-cells = <1>;
    };

  - |
    topckgen: syscon@10000000 {
        compatible = "mediatek,mt6789-topckgen", "syscon";
        reg = <0x10000000 0x1000>;
        #clock-cells = <1>;
    };

  - |
    infracfg_ao: syscon@10001000 {
        compatible = "mt6789-infracfg-ao", "syscon";
        reg = <0x10001000 0x1000>;
        #clock-cells = <1>;
    };

  - |
    apmixedsys: syscon@1000c000 {
        compatible = "mediatek,mt6789-apmixedsys", "syscon";
        reg = <0x1000c000 0x1000>;
        #clock-cells = <1>;
    };
```

## Documentation/devicetree/bindings/clock/mediatek,mt6893-clock.yaml
```yaml
# SPDX-License-Identifier: (GPL-2.0 OR BSD-2-Clause)
%YAML 1.2
---
$id: http://devicetree.org/schemas/clock/mediatek,mt6893-clock.yaml#
$schema: http://devicetree.org/meta-schemas/core.yaml#

title: MediaTek Functional Clock Controller for MT6893

maintainers:
  - AngeloGioacchino Del Regno <angelogioacchino.delregno@collabora.com>

description: |
  The clock architecture in MediaTek SoCs is structured like below:
  PLLs -->
          dividers -->
                      muxes
                           -->
                              clock gate

  The devices provide clock gate control in different IP blocks.

properties:
  compatible:
    enum:
      - mediatek,mt6893-scp-adsp
      - mediatek,mt6893-imp-iic-wrap-c
      - mediatek,mt6893-imp-iic-wrap-e
      - mediatek,mt6893-imp-iic-wrap-n
      - mediatek,mt6893-imp-iic-wrap-s
      - mediatek,mt6893-mdpsys
      - mediatek,mt6893-mfgcfg
      - mediatek,mt6893-vdecsys
      - mediatek,mt6893-vdecsys-soc
      - mediatek,mt6893-vencsys-c0
      - mediatek,mt6893-vencsys-c1

  reg:
    maxItems: 1

  '#clock-cells':
    const: 1

required:
  - compatible
  - reg
  - '#clock-cells'

additionalProperties: false

examples:
  - |
    clock-controller@11008000 {
        compatible = "mediatek,mt6893-imp-iic-wrap-c";
        reg = <0x11008000 0x1000>;
        #clock-cells = <1>;
    };
```

## Documentation/devicetree/bindings/clock/mediatek,mt6893-sys-clock.yaml
```yaml
# SPDX-License-Identifier: (GPL-2.0 OR BSD-2-Clause)
%YAML 1.2
---
$id: http://devicetree.org/schemas/clock/mediatek,mt6893-sys-clock.yaml#
$schema: http://devicetree.org/meta-schemas/core.yaml#

title: MediaTek System Clock Controller for MT6893

maintainers:
  - AngeloGioacchino Del Regno <angelogioacchino.delregno@collabora.com>

description: |
  The clock architecture in MediaTek SoCs is structured like below:
  PLLs -->
          dividers -->
                      muxes
                           -->
                              clock gate

  The apmixedsys provides most of PLLs which are generated from SoC 26m.
  The topckgen provides dividers and muxes which provide the clock source to other IP blocks.
  The infracfg_ao provides clock gate in peripheral and infrastructure IP blocks.
  The device nodes also provide the system control capacity for configuration.

properties:
  compatible:
    items:
      - enum:
          - mediatek,mt6893-apmixedsys
          - mediatek,mt6893-infracfg-ao
          - mediatek,mt6893-topckgen
      - const: syscon

  reg:
    maxItems: 1

  '#clock-cells':
    const: 1

  '#reset-cells':
    const: 1

required:
  - compatible
  - reg
  - '#clock-cells'

additionalProperties: false

examples:
  - |
    clock-controller@10000000 {
        compatible = "mediatek,mt6893-topckgen", "syscon";
        reg = <0x10000000 0x1000>;
        #clock-cells = <1>;
    };

    clock-controller@10001000 {
        compatible = "mediatek,mt6893-infracfg-ao", "syscon";
        reg = <0x10001000 0x1000>;
        #clock-cells = <1>;
    };

    clock-controller@1000c000 {
        compatible = "mediatek,mt6893-apmixedsys", "syscon";
        reg = <0x1000c000 0x1000>;
        #clock-cells = <1>;
    };
```
