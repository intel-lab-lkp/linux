## Documentation/devicetree/bindings/clock/nvidia,tegra124-dfll.yaml
```yaml
# SPDX-License-Identifier: (GPL-2.0-only OR BSD-2-Clause)
%YAML 1.2
---
$id: http://devicetree.org/schemas/clock/nvidia,tegra124-dfll.yaml#
$schema: http://devicetree.org/meta-schemas/core.yaml#

title: NVIDIA Tegra124 DFLL FCPU clocksource

maintainers:
  - Joseph Lo <josephl@nvidia.com>
  - Thierry Reding <treding@nvidia.com>
  - Tuomas Tynkkynen <ttynkkynen@nvidia.com>

description:
  The DFLL IP block on Tegra is a root clocksource designed for clocking the
  fast CPU cluster. It consists of a free-running voltage controlled oscillator
  connected to the CPU voltage rail (VDD_CPU), and a closed loop control module
  that will automatically adjust the VDD_CPU voltage by communicating with an
  off-chip PMIC either via an I2C bus or via PWM signals.

properties:
  compatible:
    enum:
      - nvidia,tegra124-dfll
      - nvidia,tegra210-dfll

  reg:
    items:
      - description: DFLL control logic registers
      - description: I2C output logic registers
      - description: Integrated I2C master controller registers
      - description: Look-up table RAM for voltage register values

  interrupts:
    maxItems: 1

  "#clock-cells":
    const: 0

  clocks:
    items:
      - description: Clock source for the DFLL control logic
      - description: Closed loop reference clock
      - description: Clock source for the integrated I2C master

  clock-names:
    items:
      - const: soc
      - const: ref
      - const: i2c

  clock-output-names:
    description: Name of the DFLL CPU clock output
    items:
      - const: dfllCPU_out

  resets:
    minItems: 1
    maxItems: 2

  reset-names:
    minItems: 1
    items:
      - const: dvco
      - const: dfll

  vdd-cpu-supply: true

  nvidia,sample-rate:
    description: Sample rate of the DFLL control loop
    $ref: /schemas/types.yaml#/definitions/uint32

  nvidia,droop-ctrl:
    description: Droop control parameter (CL_DVFS_DROOP_CTRL) in TRM
    $ref: /schemas/types.yaml#/definitions/uint32

  nvidia,force-mode:
    description: Force mode parameter (DFLL_PARAMS_FORCE_MODE) in TRM
    $ref: /schemas/types.yaml#/definitions/uint32

  nvidia,cf:
    description: CF parameter (DFLL_PARAMS_CF_PARAM) in TRM
    $ref: /schemas/types.yaml#/definitions/uint32

  nvidia,ci:
    description: CI parameter (DFLL_PARAMS_CI_PARAM) in TRM
    $ref: /schemas/types.yaml#/definitions/uint32

  nvidia,cg:
    description: CG parameter (DFLL_PARAMS_CG_PARAM) in TRM
    $ref: /schemas/types.yaml#/definitions/uint32

  nvidia,cg-scale:
    description: CG scale flag (DFLL_PARAMS_CG_SCALE) in TRM
    type: boolean

  nvidia,pwm-to-pmic:
    description: Use PWM to control regulator rather than I2C
    type: boolean

  nvidia,i2c-fs-rate:
    description: I2C full speed transfer rate when using I2C mode
    $ref: /schemas/types.yaml#/definitions/uint32

  nvidia,pwm-period-nanoseconds:
    description: Period of PWM square wave in nanoseconds
    $ref: /schemas/types.yaml#/definitions/uint32

  nvidia,pwm-tristate-microvolts:
    description: Regulator voltage in microvolts when PWM control is disabled
    $ref: /schemas/types.yaml#/definitions/uint32

  nvidia,pwm-min-microvolts:
    description: Regulator voltage in microvolts when PWM control is enabled
    $ref: /schemas/types.yaml#/definitions/uint32

  nvidia,pwm-voltage-step-microvolts:
    description: Voltage increase in microvolts per duty cycle increment
    $ref: /schemas/types.yaml#/definitions/uint32

  pinctrl-0:
    description: I/O pad configuration when PWM control is enabled

  pinctrl-1:
    description: I/O pad configuration when PWM control is disabled

  pinctrl-names:
    items:
      - const: dvfs_pwm_enable
      - const: dvfs_pwm_disable

required:
  - compatible
  - reg
  - interrupts
  - "#clock-cells"
  - clocks
  - clock-names
  - clock-output-names
  - resets
  - reset-names
  - vdd-cpu-supply
  - nvidia,sample-rate
  - nvidia,droop-ctrl
  - nvidia,force-mode
  - nvidia,cf
  - nvidia,ci
  - nvidia,cg

dependencies:
  nvidia,pwm-to-pmic:
    - nvidia,pwm-min-microvolts
    - nvidia,pwm-period-nanoseconds
    - nvidia,pwm-tristate-microvolts
    - nvidia,pwm-voltage-step-microvolts

additionalProperties: false

allOf:
  - if:
      properties:
        compatible:
          contains:
            const: nvidia,tegra124-dfll
    then:
      properties:
        resets:
          maxItems: 1

        reset-names:
          maxItems: 1
    else:
      properties:
        resets:
          minItems: 2

        reset-names:
          minItems: 2

examples:
  - |
    #include <dt-bindings/interrupt-controller/arm-gic.h>
    #include <dt-bindings/reset/tegra124-car.h>
    #include <dt-bindings/clock/tegra124-car-common.h>

    clock@70110000 {
        compatible = "nvidia,tegra124-dfll";
        reg = <0x70110000 0x100>, /* DFLL control */
              <0x70110000 0x100>, /* I2C output control */
              <0x70110100 0x100>, /* Integrated I2C controller */
              <0x70110200 0x100>; /* Look-up table RAM */
        interrupts = <GIC_SPI 62 IRQ_TYPE_LEVEL_HIGH>;
        clocks = <&tegra_car TEGRA124_CLK_DFLL_SOC>,
                 <&tegra_car TEGRA124_CLK_DFLL_REF>,
                 <&tegra_car TEGRA124_CLK_I2C5>;
        clock-names = "soc", "ref", "i2c";
        resets = <&tegra_car TEGRA124_RST_DFLL_DVCO>;
        reset-names = "dvco";
        #clock-cells = <0>;
        clock-output-names = "dfllCPU_out";
        vdd-cpu-supply = <&reg_vdd_cpu>;

        nvidia,sample-rate = <25000>;
        nvidia,droop-ctrl = <0x00000f00>;
        nvidia,force-mode = <1>;
        nvidia,cf = <6>;
        nvidia,ci = <0>;
        nvidia,cg = <2>;

        nvidia,pwm-min-microvolts = <708000>; /* 708mV */
        nvidia,pwm-period-nanoseconds = <2500>; /* 2.5us */
        nvidia,pwm-to-pmic;
        nvidia,pwm-tristate-microvolts = <1000000>;
        nvidia,pwm-voltage-step-microvolts = <19200>; /* 19.2mV */

        pinctrl-names = "dvfs_pwm_enable", "dvfs_pwm_disable";
        pinctrl-0 = <&dvfs_pwm_active_state>;
        pinctrl-1 = <&dvfs_pwm_inactive_state>;
    };
```

## Documentation/devicetree/bindings/clock/qcom,camcc-common.yaml
```yaml
# SPDX-License-Identifier: (GPL-2.0-only OR BSD-2-Clause)
%YAML 1.2
---
$id: http://devicetree.org/schemas/clock/qcom,camcc-common.yaml#
$schema: http://devicetree.org/meta-schemas/core.yaml#

title: Qualcomm Camera Clock & Reset Controller common properties

maintainers:
  - Bryan O'Donoghue <bryan.odonoghue@linaro.org>

description: |
  Qualcomm camera clock control module provides the clocks, resets and power
  domains on Qualcomm SoCs.

allOf:
  - $ref: qcom,gcc.yaml#

properties:
  compatible: true

  clocks:
    minItems: 1
    maxItems: 4

  clock-names:
    minItems: 1
    maxItems: 4

  power-domains:
    maxItems: 1
    description:
      A phandle and PM domain specifier for the MMCX power domain.

  required-opps:
    maxItems: 1
    description:
      OPP node describing required MMCX performance point.

required:
  - compatible
  - clocks

additionalProperties: true
```

## Documentation/devicetree/bindings/clock/qcom,camcc.yaml
```yaml
# SPDX-License-Identifier: (GPL-2.0-only OR BSD-2-Clause)
%YAML 1.2
---
$id: http://devicetree.org/schemas/clock/qcom,camcc.yaml#
$schema: http://devicetree.org/meta-schemas/core.yaml#

title: Qualcomm Camera Clock & Reset Controller

maintainers:
  - Bjorn Andersson <andersson@kernel.org>
  - Jonathan Marek <jonathan@marek.ca>
  - Konrad Dybcio <konrad.dybcio@linaro.org>
  - Taniya Das <quic_tdas@quicinc.com>
  - Vladimir Zapolskiy <vladimir.zapolskiy@linaro.org>

description: |
  Qualcomm camera clock control module provides the clocks, resets and power
  domains on Qualcomm SoCs.

  See also:: include/dt-bindings/clock/qcom,camcc-sc7180.h
  See also:: include/dt-bindings/clock/qcom,camcc-sc7280.h
  See also:: include/dt-bindings/clock/qcom,camcc-sdm845.h
  See also:: include/dt-bindings/clock/qcom,camcc-sm8250.h
  See also:: include/dt-bindings/clock/qcom,sm6350-camcc.h
  See also:: include/dt-bindings/clock/qcom,sm8450-camcc.h
  See also:: include/dt-bindings/clock/qcom,sm8550-camcc.h

properties:
  compatible:
    enum:
      - qcom,sc7180-camcc
      - qcom,sc7280-camcc
      - qcom,sc8280xp-camcc
      - qcom,sdm845-camcc
      - qcom,sm6350-camcc
      - qcom,sm8250-camcc
      - qcom,sm8450-camcc
      - qcom,sm8550-camcc

  clocks:
    minItems: 1
    maxItems: 4

  clock-names:
    minItems: 1
    maxItems: 4

  '#clock-cells':
    const: 1

  '#reset-cells':
    const: 1

  '#power-domain-cells':
    const: 1

  power-domains:
    maxItems: 1
    description:
      A phandle and PM domain specifier for the MMCX power domain.

  reg:
    maxItems: 1

  required-opps:
    maxItems: 1
    description:
      OPP node describing required MMCX performance point.

required:
  - compatible
  - reg
  - clocks
  - '#clock-cells'
  - '#reset-cells'
  - '#power-domain-cells'

allOf:
  - if:
      properties:
        compatible:
          enum:
            - qcom,sc7180-camcc
    then:
      properties:
        clocks:
          items:
            - description: Board XO source
            - description: Camera_ahb clock from GCC
            - description: Camera XO clock from GCC
        clock-names:
          items:
            - const: bi_tcxo
            - const: iface
            - const: xo
  - if:
      properties:
        compatible:
          enum:
            - qcom,sdm845-camcc
            - qcom,sm6350-camcc
    then:
      properties:
        clocks:
          items:
            - description: Board XO source
        clock-names:
          items:
            - const: bi_tcxo
  - if:
      properties:
        compatible:
          enum:
            - qcom,sc7280-camcc
    then:
      properties:
        clocks:
          items:
            - description: Board XO source
            - description: Board XO active source
            - description: Sleep clock source
        clock-names:
          items:
            - const: bi_tcxo
            - const: bi_tcxo_ao
            - const: sleep_clk
  - if:
      properties:
        compatible:
          enum:
            - qcom,sc8280xp-camcc
            - qcom,sm8250-camcc
            - qcom,sm8450-camcc
    then:
      properties:
        clocks:
          items:
            - description: AHB
            - description: Board XO source
            - description: Board active XO source
            - description: Sleep clock source
        clock-names:
          items:
            - const: iface
            - const: bi_tcxo
            - const: bi_tcxo_ao
            - const: sleep_clk
      required:
        - power-domains
        - required-opps

additionalProperties: false

examples:
  - |
    #include <dt-bindings/clock/qcom,gcc-sm8250.h>
    #include <dt-bindings/clock/qcom,rpmh.h>
    #include <dt-bindings/power/qcom,rpmhpd.h>
    clock-controller@ad00000 {
      compatible = "qcom,sm8250-camcc";
      reg = <0x0ad00000 0x10000>;
      clocks = <&gcc GCC_CAMERA_AHB_CLK>,
               <&rpmhcc RPMH_CXO_CLK>,
               <&rpmhcc RPMH_CXO_CLK_A>,
               <&sleep_clk>;
      clock-names = "iface", "bi_tcxo", "bi_tcxo_ao", "sleep_clk";
      #clock-cells = <1>;
      #reset-cells = <1>;
      #power-domain-cells = <1>;
      power-domains = <&rpmhpd RPMHPD_MMCX>;
      required-opps = <&rpmhpd_opp_low_svs>;
    };
...
```

## Documentation/devicetree/bindings/clock/qcom,eliza-camcc.yaml
```yaml
# SPDX-License-Identifier: (GPL-2.0-only OR BSD-2-Clause)
%YAML 1.2
---
$id: http://devicetree.org/schemas/clock/qcom,eliza-camcc.yaml#
$schema: http://devicetree.org/meta-schemas/core.yaml#

title: Qualcomm Camera Clock & Reset Controller on Eliza

maintainers:
  - Taniya Das <taniya.das@oss.qualcomm.com>

description: |
  Qualcomm camera clock control module provides the clocks, resets and power
  domains on Eliza.

  See also:
    include/dt-bindings/clock/qcom,eliza-camcc.h
    include/dt-bindings/clock/qcom,eliza-cambistmclkcc.h

properties:
  compatible:
    enum:
      - qcom,eliza-cambistmclkcc
      - qcom,eliza-camcc

  clocks:
    items:
      - description: Camera AHB clock from GCC
      - description: Board XO source
      - description: Sleep clock source

required:
  - compatible
  - clocks

allOf:
  - $ref: qcom,gcc.yaml#

unevaluatedProperties: false

examples:
  - |
    #include <dt-bindings/clock/qcom,eliza-gcc.h>
    clock-controller@adb0000 {
        compatible = "qcom,eliza-camcc";
        reg = <0x0adb0000 0x40000>;
        clocks = <&bi_tcxo_div2>,
                 <&sleep_clk>,
                 <&gcc GCC_CAMERA_AHB_CLK>;
        #clock-cells = <1>;
        #reset-cells = <1>;
        #power-domain-cells = <1>;
    };

...
```

## Documentation/devicetree/bindings/clock/qcom,eliza-videocc.yaml
```yaml
# SPDX-License-Identifier: (GPL-2.0-only OR BSD-2-Clause)
%YAML 1.2
---
$id: http://devicetree.org/schemas/clock/qcom,eliza-videocc.yaml#
$schema: http://devicetree.org/meta-schemas/core.yaml#

title: Qualcomm Video Clock & Reset Controller on Eliza

maintainers:
  - Taniya Das <taniya.das@oss.qualcomm.com>

description: |
  Qualcomm video clock control module provides the clocks, resets and power
  domains on Eliza.

  See also: include/dt-bindings/clock/qcom,eliza-videocc.h

properties:
  compatible:
    const: qcom,eliza-videocc

  clocks:
    items:
      - description: Board XO source
      - description: Sleep clock source
      - description: Video AHB clock from GCC

required:
  - compatible
  - clocks

allOf:
  - $ref: qcom,gcc.yaml#

unevaluatedProperties: false

examples:
  - |
    #include <dt-bindings/clock/qcom,eliza-gcc.h>
    clock-controller@aaf0000 {
        compatible = "qcom,eliza-videocc";
        reg = <0x0aaf0000 0x10000>;
        clocks = <&bi_tcxo_div2>,
                 <&sleep_clk>,
                 <&gcc GCC_VIDEO_AHB_CLK>;
        #clock-cells = <1>;
        #reset-cells = <1>;
        #power-domain-cells = <1>;
    };

...
```

## Documentation/devicetree/bindings/clock/qcom,gcc-msm8937.yaml
```yaml
# SPDX-License-Identifier: (GPL-2.0-only OR BSD-2-Clause)
%YAML 1.2
---
$id: http://devicetree.org/schemas/clock/qcom,gcc-msm8937.yaml#
$schema: http://devicetree.org/meta-schemas/core.yaml#

title: Qualcomm Global Clock & Reset Controller on MSM8937

maintainers:
  - Barnabas Czeman <barnabas.czeman@mainlining.org>

description: |
  Qualcomm global clock control module provides the clocks, resets and power
  domains on MSM8937.

  See also::
    include/dt-bindings/clock/qcom,gcc-msm8917.h

properties:
  compatible:
    const: qcom,gcc-msm8937

  clocks:
    items:
      - description: XO source
      - description: Sleep clock source
      - description: DSI phy instance 0 dsi clock
      - description: DSI phy instance 0 byte clock
      - description: DSI phy instance 1 dsi clock
      - description: DSI phy instance 1 byte clock

  clock-names:
    items:
      - const: xo
      - const: sleep_clk
      - const: dsi0pll
      - const: dsi0pllbyte
      - const: dsi1pll
      - const: dsi1pllbyte

required:
  - compatible
  - clocks
  - clock-names
  - '#power-domain-cells'

allOf:
  - $ref: qcom,gcc.yaml#

unevaluatedProperties: false

examples:
  - |
    gcc: clock-controller@1800000 {
      compatible = "qcom,gcc-msm8937";
      reg = <0x01800000 0x80000>;
      #clock-cells = <1>;
      #reset-cells = <1>;
      #power-domain-cells = <1>;
      clocks = <&rpmcc RPM_SMD_XO_CLK_SRC>,
               <&sleep_clk>,
               <&dsi0_phy 1>,
               <&dsi0_phy 0>,
               <&dsi1_phy 1>,
               <&dsi1_phy 0>;
      clock-names = "xo",
                    "sleep_clk",
                    "dsi0pll",
                    "dsi0pllbyte",
                    "dsi1pll",
                    "dsi1pllbyte";
    };
...
```
