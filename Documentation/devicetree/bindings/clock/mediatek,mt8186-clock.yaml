## Documentation/devicetree/bindings/clock/mediatek,mt8186-clock.yaml
```yaml
# SPDX-License-Identifier: (GPL-2.0 OR BSD-2-Clause)
%YAML 1.2
---
$id: http://devicetree.org/schemas/clock/mediatek,mt8186-clock.yaml#
$schema: http://devicetree.org/meta-schemas/core.yaml#

title: MediaTek Functional Clock Controller for Mediatek SoCs

maintainers:
  - Chun-Jie Chen <chun-jie.chen@mediatek.com>

description: |
  The clock architecture in MediaTek like below
  PLLs -->
          dividers -->
                      muxes
                           -->
                              clock gate

  The devices provide clock gate control in different IP blocks.

properties:
  compatible:
    items:
      - enum:
          - mediatek,mt8186-camsys
          - mediatek,mt8186-camsys_rawa
          - mediatek,mt8186-camsys_rawb
          - mediatek,mt8186-imgsys1
          - mediatek,mt8186-imgsys2
          - mediatek,mt8186-imp_iic_wrap
          - mediatek,mt8186-ipesys
          - mediatek,mt8186-mdpsys
          - mediatek,mt8186-mfgsys
          - mediatek,mt8186-vdecsys
          - mediatek,mt8186-vencsys
          - mediatek,mt8186-wpesys
          - mediatek,mt8188-adsp-audio26m
          - mediatek,mt8188-camsys
          - mediatek,mt8188-camsys-rawa
          - mediatek,mt8188-camsys-rawb
          - mediatek,mt8188-camsys-yuva
          - mediatek,mt8188-camsys-yuvb
          - mediatek,mt8188-ccusys
          - mediatek,mt8188-imgsys
          - mediatek,mt8188-imgsys-wpe1
          - mediatek,mt8188-imgsys-wpe2
          - mediatek,mt8188-imgsys-wpe3
          - mediatek,mt8188-imgsys1-dip-nr
          - mediatek,mt8188-imgsys1-dip-top
          - mediatek,mt8188-imp-iic-wrap-c
          - mediatek,mt8188-imp-iic-wrap-en
          - mediatek,mt8188-imp-iic-wrap-w
          - mediatek,mt8188-ipesys
          - mediatek,mt8188-mfgcfg
          - mediatek,mt8188-vdecsys
          - mediatek,mt8188-vdecsys-soc
          - mediatek,mt8188-vencsys
          - mediatek,mt8188-wpesys
          - mediatek,mt8188-wpesys-vpp0
          - mediatek,mt8192-camsys
          - mediatek,mt8192-camsys_rawa
          - mediatek,mt8192-camsys_rawb
          - mediatek,mt8192-camsys_rawc
          - mediatek,mt8192-imgsys
          - mediatek,mt8192-imgsys2
          - mediatek,mt8192-imp_iic_wrap_c
          - mediatek,mt8192-imp_iic_wrap_e
          - mediatek,mt8192-imp_iic_wrap_s
          - mediatek,mt8192-imp_iic_wrap_ws
          - mediatek,mt8192-imp_iic_wrap_w
          - mediatek,mt8192-imp_iic_wrap_n
          - mediatek,mt8192-ipesys
          - mediatek,mt8192-mdpsys
          - mediatek,mt8192-mfgcfg
          - mediatek,mt8192-msdc_top
          - mediatek,mt8192-scp_adsp
          - mediatek,mt8192-vdecsys_soc
          - mediatek,mt8192-vdecsys
          - mediatek,mt8192-vencsys
          - mediatek,mt8195-apusys_pll
          - mediatek,mt8195-camsys
          - mediatek,mt8195-camsys_rawa
          - mediatek,mt8195-camsys_yuva
          - mediatek,mt8195-camsys_rawb
          - mediatek,mt8195-camsys_yuvb
          - mediatek,mt8195-camsys_mraw
          - mediatek,mt8195-ccusys
          - mediatek,mt8195-imgsys
          - mediatek,mt8195-imgsys1_dip_top
          - mediatek,mt8195-imgsys1_dip_nr
          - mediatek,mt8195-imgsys1_wpe
          - mediatek,mt8195-imp_iic_wrap_s
          - mediatek,mt8195-imp_iic_wrap_w
          - mediatek,mt8195-ipesys
          - mediatek,mt8195-mfgcfg
          - mediatek,mt8195-scp_adsp
          - mediatek,mt8195-vdecsys_soc
          - mediatek,mt8195-vdecsys
          - mediatek,mt8195-vdecsys_core1
          - mediatek,mt8195-vencsys
          - mediatek,mt8195-vencsys_core1
          - mediatek,mt8195-wpesys
          - mediatek,mt8195-wpesys_vpp0
          - mediatek,mt8195-wpesys_vpp1

  reg:
    maxItems: 1

  '#clock-cells':
    const: 1

  '#reset-cells':
    const: 1

required:
  - compatible
  - reg
  - '#clock-cells'

allOf:
  - if:
      properties:
        compatible:
          enum:
            - mediatek,mt8188-camsys-rawa
            - mediatek,mt8188-camsys-rawb
            - mediatek,mt8188-camsys-yuva
            - mediatek,mt8188-camsys-yuvb
            - mediatek,mt8188-imgsys-wpe1
            - mediatek,mt8188-imgsys-wpe2
            - mediatek,mt8188-imgsys-wpe3
            - mediatek,mt8188-imgsys1-dip-nr
            - mediatek,mt8188-imgsys1-dip-top
            - mediatek,mt8188-ipesys
    then:
      required:
        - '#reset-cells'
    else:
      properties:
        '#reset-cells': false

additionalProperties: false

examples:
  - |
    imp_iic_wrap: clock-controller@11017000 {
        compatible = "mediatek,mt8186-imp_iic_wrap";
        reg = <0x11017000 0x1000>;
        #clock-cells = <1>;
    };
```

## Documentation/devicetree/bindings/clock/mediatek,mt8189-clock.yaml
```yaml
# SPDX-License-Identifier: (GPL-2.0 OR BSD-2-Clause)
%YAML 1.2
---
$id: http://devicetree.org/schemas/clock/mediatek,mt8189-clock.yaml#
$schema: http://devicetree.org/meta-schemas/core.yaml#

title: MediaTek Functional Clock Controller for MT8189

maintainers:
  - Qiqi Wang <qiqi.wang@mediatek.com>

description: |
  The clock architecture in MediaTek like below
  PLLs -->
          dividers -->
                      muxes -->
                               clock gate

  The devices provide clock gate control in different IP blocks.

properties:
  compatible:
    items:
      - enum:
        - mediatek,mt8189-camsys-main
        - mediatek,mt8189-camsys-rawa
        - mediatek,mt8189-camsys-rawb
        - mediatek,mt8189-dbg-ao
        - mediatek,mt8189-dem
        - mediatek,mt8189-dispsys
        - mediatek,mt8189-dvfsrc-top
        - mediatek,mt8189-gce-d
        - mediatek,mt8189-gce-m
        - mediatek,mt8189-iic-wrap-e
        - mediatek,mt8189-iic-wrap-en
        - mediatek,mt8189-iic-wrap-s
        - mediatek,mt8189-iic-wrap-ws
        - mediatek,mt8189-imgsys1
        - mediatek,mt8189-imgsys2
        - mediatek,mt8189-infra-ao
        - mediatek,mt8189-ipesys
        - mediatek,mt8189-mdpsys
        - mediatek,mt8189-mfgcfg
        - mediatek,mt8189-mm-infra
        - mediatek,mt8189-peri-ao
        - mediatek,mt8189-scp-clk
        - mediatek,mt8189-scp-i2c-clk
        - mediatek,mt8189-ufscfg-ao
        - mediatek,mt8189-ufscfg-pdn
        - mediatek,mt8189-vdec-core
        - mediatek,mt8189-venc
      - const: syscon

  reg:
    maxItems: 1

  '#clock-cells':
    const: 1

  '#reset-cells':
    const: 1

required:
  - compatible
  - reg
  - '#clock-cells'

allOf:
  - if:
      properties:
        compatible:
          contains:
            enum:
              - mediatek,mt8189-peri-ao
              - mediatek,mt8189-ufscfg-ao
              - mediatek,mt8189-ufscfg-pdn

    then:
      required:
        - '#reset-cells'

additionalProperties: false

examples:
  - |
    clock-controller@11b21000 {
        compatible = "mediatek,mt8189-iic-wrap-ws", "syscon";
        reg = <0x11b21000 0x1000>;
        #clock-cells = <1>;
    };
```

## Documentation/devicetree/bindings/clock/mediatek,mt8189-sys-clock.yaml
```yaml
# SPDX-License-Identifier: (GPL-2.0 OR BSD-2-Clause)
%YAML 1.2
---
$id: http://devicetree.org/schemas/clock/mediatek,mt8189-sys-clock.yaml#
$schema: http://devicetree.org/meta-schemas/core.yaml#

title: MediaTek System Clock Controller for MT8189

maintainers:
  - Qiqi Wang <qiqi.wang@mediatek.com>

description: |
  The clock architecture in MediaTek like below
  PLLs -->
          dividers -->
                      muxes -->
                               clock gate

  The apmixedsys provides most of PLLs which generated from SoC 26m.
  The topckgen provides dividers and muxes which provide the clock source to other IP blocks.
  The infracfg_ao provides clock gate in peripheral and infrastructure IP blocks.
  The mcusys provides mux control to select the clock source in AP MCU.
  The device nodes also provide the system control capacity for configuration.

properties:
  compatible:
    items:
      - enum:
          - mediatek,mt8189-apmixedsys
          - mediatek,mt8189-topckgen
          - mediatek,mt8189-vlpckgen
          - mediatek,mt8189-vlp-ao-ckgen
          - mediatek,mt8189-vlpcfg-ao
      - const: syscon

  reg:
    maxItems: 1

  '#clock-cells':
    const: 1

  '#reset-cells':
    const: 1

required:
  - compatible
  - reg
  - '#clock-cells'

additionalProperties: false

examples:
  - |
    clock-controller@10000000 {
        compatible = "mediatek,mt8189-topckgen", "syscon";
        reg = <0x10000000 0x1000>;
        #clock-cells = <1>;
    };
```

## Documentation/devicetree/bindings/clock/mediatek,mt8196-clock.yaml
```yaml
# SPDX-License-Identifier: (GPL-2.0 OR BSD-2-Clause)
%YAML 1.2
---
$id: http://devicetree.org/schemas/clock/mediatek,mt8196-clock.yaml#
$schema: http://devicetree.org/meta-schemas/core.yaml#

title: MediaTek Functional Clock Controller for MT8196

maintainers:
  - Guangjie Song <guangjie.song@mediatek.com>
  - Laura Nao <laura.nao@collabora.com>

description: |
  The clock architecture in MediaTek SoCs is structured like below:
  PLLs -->
          dividers -->
                      muxes
                           -->
                              clock gate

  The device nodes provide clock gate control in different IP blocks.

properties:
  compatible:
    items:
      - enum:
          - mediatek,mt8196-imp-iic-wrap-c
          - mediatek,mt8196-imp-iic-wrap-e
          - mediatek,mt8196-imp-iic-wrap-n
          - mediatek,mt8196-imp-iic-wrap-w
          - mediatek,mt8196-mdpsys0
          - mediatek,mt8196-mdpsys1
          - mediatek,mt8196-pericfg-ao
          - mediatek,mt8196-pextp0cfg-ao
          - mediatek,mt8196-pextp1cfg-ao
          - mediatek,mt8196-ufscfg-ao
          - mediatek,mt8196-vencsys
          - mediatek,mt8196-vencsys-c1
          - mediatek,mt8196-vencsys-c2
          - mediatek,mt8196-vdecsys
          - mediatek,mt8196-vdecsys-soc
          - mediatek,mt8196-vdisp-ao
      - const: syscon

  reg:
    maxItems: 1

  '#clock-cells':
    const: 1

  '#reset-cells':
    const: 1
    description:
      Reset lines for PEXTP0/1 and UFS blocks.

  mediatek,hardware-voter:
    $ref: /schemas/types.yaml#/definitions/phandle
    description:
      On the MT8196 SoC, a Hardware Voter (HWV) backed by a fixed-function
      MCU manages clock and power domain control across the AP and other
      remote processors. By aggregating their votes, it ensures clocks are
      safely enabled/disabled and power domains are active before register
      access.

required:
  - compatible
  - reg
  - '#clock-cells'

additionalProperties: false

examples:
  - |
    pericfg_ao: clock-controller@16640000 {
        compatible = "mediatek,mt8196-pericfg-ao", "syscon";
        reg = <0x16640000 0x1000>;
        mediatek,hardware-voter = <&scp_hwv>;
        #clock-cells = <1>;
    };
  - |
    pextp0cfg_ao: clock-controller@169b0000 {
        compatible = "mediatek,mt8196-pextp0cfg-ao", "syscon";
        reg = <0x169b0000 0x1000>;
        #clock-cells = <1>;
        #reset-cells = <1>;
    };
```

## Documentation/devicetree/bindings/clock/mediatek,mt8196-sys-clock.yaml
```yaml
# SPDX-License-Identifier: (GPL-2.0 OR BSD-2-Clause)
%YAML 1.2
---
$id: http://devicetree.org/schemas/clock/mediatek,mt8196-sys-clock.yaml#
$schema: http://devicetree.org/meta-schemas/core.yaml#

title: MediaTek System Clock Controller for MT8196

maintainers:
  - Guangjie Song <guangjie.song@mediatek.com>
  - Laura Nao <laura.nao@collabora.com>

description: |
  The clock architecture in MediaTek SoCs is structured like below:
  PLLs -->
          dividers -->
                      muxes
                           -->
                              clock gate

  The apmixedsys, apmixedsys_gp2, vlpckgen, armpll, ccipll, mfgpll and ptppll
  provide most of the PLLs which are generated from the SoC's 26MHZ crystal oscillator.
  The topckgen, topckgen_gp2 and vlpckgen provide dividers and muxes which
  provide the clock source to other IP blocks.

properties:
  compatible:
    items:
      - enum:
          - mediatek,mt8196-apmixedsys
          - mediatek,mt8196-armpll-b-pll-ctrl
          - mediatek,mt8196-armpll-bl-pll-ctrl
          - mediatek,mt8196-armpll-ll-pll-ctrl
          - mediatek,mt8196-apmixedsys-gp2
          - mediatek,mt8196-ccipll-pll-ctrl
          - mediatek,mt8196-mfgpll-pll-ctrl
          - mediatek,mt8196-mfgpll-sc0-pll-ctrl
          - mediatek,mt8196-mfgpll-sc1-pll-ctrl
          - mediatek,mt8196-ptppll-pll-ctrl
          - mediatek,mt8196-topckgen
          - mediatek,mt8196-topckgen-gp2
          - mediatek,mt8196-vlpckgen
      - const: syscon

  reg:
    maxItems: 1

  '#clock-cells':
    const: 1

  mediatek,hardware-voter:
    $ref: /schemas/types.yaml#/definitions/phandle
    description:
      On the MT8196 SoC, a Hardware Voter (HWV) backed by a fixed-function
      MCU manages clock and power domain control across the AP and other
      remote processors. By aggregating their votes, it ensures clocks are
      safely enabled/disabled and power domains are active before register
      access.

required:
  - compatible
  - reg
  - '#clock-cells'

additionalProperties: false

examples:
  - |
    apmixedsys_clk: syscon@10000800 {
        compatible = "mediatek,mt8196-apmixedsys", "syscon";
        reg = <0x10000800 0x1000>;
        #clock-cells = <1>;
    };
  - |
    topckgen: syscon@10000000 {
        compatible = "mediatek,mt8196-topckgen", "syscon";
        reg = <0x10000000 0x800>;
        mediatek,hardware-voter = <&scp_hwv>;
        #clock-cells = <1>;
    };
```

## Documentation/devicetree/bindings/clock/nuvoton,npcm845-clk.yaml
```yaml
# SPDX-License-Identifier: GPL-2.0-only OR BSD-2-Clause
%YAML 1.2
---
$id: http://devicetree.org/schemas/clock/nuvoton,npcm845-clk.yaml#
$schema: http://devicetree.org/meta-schemas/core.yaml#

title: Nuvoton NPCM8XX Clock Controller

maintainers:
  - Tomer Maimon <tmaimon77@gmail.com>

description: |
  Nuvoton Arbel BMC NPCM8XX contains an integrated clock controller, which
  generates and supplies clocks to all modules within the BMC.

properties:
  compatible:
    enum:
      - nuvoton,npcm845-clk

  nuvoton,sysclk:
    $ref: /schemas/types.yaml#/definitions/phandle
    description: phandle to access clock registers.

  clocks:
    items:
      - description: 25Mhz referance clock

  clock-names:
    items:
      - const: refclk

  '#clock-cells':
    const: 1
    description:
      See include/dt-bindings/clock/nuvoton,npcm8xx-clock.h for the full
      list of NPCM8XX clock IDs.

required:
  - compatible
  - nuvoton,sysclk
  - clocks
  - clock-names
  - '#clock-cells'

additionalProperties: false

examples:
  - |
    refclk: refclk-25mhz {
        compatible = "fixed-clock";
        #clock-cells = <0>;
        clock-frequency = <25000000>;
    }; 
  
    clk: clock-controller {
        compatible = "nuvoton,npcm845-clk";
        nuvoton,sysclk = <&clk_rst>;
        #clock-cells = <1>;
        clocks = <&refclk>;
        clock-names = "refclk";
    };
...
```
