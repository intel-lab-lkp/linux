## Documentation/devicetree/bindings/clock/qcom,sm8550-tcsr.yaml
```yaml
# SPDX-License-Identifier: (GPL-2.0-only OR BSD-2-Clause)
%YAML 1.2
---
$id: http://devicetree.org/schemas/clock/qcom,sm8550-tcsr.yaml#
$schema: http://devicetree.org/meta-schemas/core.yaml#

title: Qualcomm TCSR Clock Controller on SM8550

maintainers:
  - Bjorn Andersson <andersson@kernel.org>
  - Taniya Das <taniya.das@oss.qualcomm.com>

description: |
  Qualcomm TCSR clock control module provides the clocks, resets and
  power domains on SM8550

  See also:
  - include/dt-bindings/clock/qcom,eliza-tcsr.h
  - include/dt-bindings/clock/qcom,glymur-tcsr.h
  - include/dt-bindings/clock/qcom,nord-tcsrcc.h
  - include/dt-bindings/clock/qcom,sm8550-tcsr.h
  - include/dt-bindings/clock/qcom,sm8650-tcsr.h
  - include/dt-bindings/clock/qcom,sm8750-tcsr.h

properties:
  compatible:
    items:
      - enum:
          - qcom,eliza-tcsr
          - qcom,glymur-tcsr
          - qcom,kaanapali-tcsr
          - qcom,milos-tcsr
          - qcom,nord-tcsrcc
          - qcom,sar2130p-tcsr
          - qcom,sm8550-tcsr
          - qcom,sm8650-tcsr
          - qcom,sm8750-tcsr
          - qcom,x1e80100-tcsr
      - const: syscon

  clocks:
    items:
      - description: TCXO pad clock

  reg:
    maxItems: 1

  '#clock-cells':
    const: 1

  '#reset-cells':
    const: 1

  vdda-refgen-0p9-supply: true
  vdda-refgen-1p2-supply: true
  vdda-qrefrx0-0p9-supply: true
  vdda-qrefrx1-0p9-supply: true
  vdda-qrefrx2-0p9-supply: true
  vdda-qrefrx4-0p9-supply: true
  vdda-qrefrx5-0p9-supply: true
  vdda-qreftx0-0p9-supply: true
  vdda-qreftx0-1p2-supply: true
  vdda-qreftx1-0p9-supply: true
  vdda-qrefrpt0-0p9-supply: true
  vdda-qrefrpt1-0p9-supply: true
  vdda-qrefrpt2-0p9-supply: true
  vdda-qrefrpt3-0p9-supply: true
  vdda-qrefrpt4-0p9-supply: true

allOf:
  - if:
      properties:
        compatible:
          contains:
            const: qcom,glymur-tcsr
    else:
      properties:
        vdda-refgen-0p9-supply: false
        vdda-refgen-1p2-supply: false
        vdda-qrefrx0-0p9-supply: false
        vdda-qrefrx1-0p9-supply: false
        vdda-qrefrx2-0p9-supply: false
        vdda-qrefrx4-0p9-supply: false
        vdda-qrefrx5-0p9-supply: false
        vdda-qreftx0-0p9-supply: false
        vdda-qreftx0-1p2-supply: false
        vdda-qreftx1-0p9-supply: false
        vdda-qrefrpt0-0p9-supply: false
        vdda-qrefrpt1-0p9-supply: false
        vdda-qrefrpt2-0p9-supply: false
        vdda-qrefrpt3-0p9-supply: false
        vdda-qrefrpt4-0p9-supply: false

required:
  - compatible
  - clocks

additionalProperties: false

examples:
  - |
    #include <dt-bindings/clock/qcom,rpmh.h>

    clock-controller@1fc0000 {
      compatible = "qcom,sm8550-tcsr", "syscon";
      reg = <0x1fc0000 0x30000>;
      clocks = <&rpmhcc RPMH_CXO_CLK>;
      #clock-cells = <1>;
      #reset-cells = <1>;
    };

...
```

## Documentation/devicetree/bindings/clock/qcom,sm8750-gxcc.yaml
```yaml
# SPDX-License-Identifier: (GPL-2.0-only OR BSD-2-Clause)
%YAML 1.2
---
$id: http://devicetree.org/schemas/clock/qcom,sm8750-gxcc.yaml#
$schema: http://devicetree.org/meta-schemas/core.yaml#

title: Qualcomm Graphics Clock & Reset Controller on SM8750

maintainers:
  - Konrad Dybcio <konradybcio@kernel.org>

description: |
  Qualcomm graphics clock control module provides the clocks, resets and power
  domains on Qualcomm SoCs.

  See also:
    include/dt-bindings/reset/qcom,sm8750-gpucc.h

properties:
  compatible:
    enum:
      - qcom,sm8750-gxcc

  reg:
    maxItems: 1

  power-domains:
    items:
      - description: GFX voltage rail
      - description: MX_COLLAPSIBLE voltage rail
      - description: GPU_CC_CX GDSC

  '#power-domain-cells':
    const: 1

required:
  - compatible
  - power-domains
  - '#power-domain-cells'

unevaluatedProperties: false

examples:
  - |
    #include <dt-bindings/clock/qcom,sm8750-gpucc.h>
    #include <dt-bindings/power/qcom,rpmhpd.h>

    soc {
        #address-cells = <2>;
        #size-cells = <2>;

        clock-controller@3d64000 {
            compatible = "qcom,sm8750-gxcc";
            reg = <0x0 0x03d64000 0x0 0x6000>;
            power-domains = <&rpmhpd RPMHPD_GFX>,
                            <&rpmhpd RPMHPD_MXC>,
                            <&gpucc GPU_CC_CX_GDSC>;
            #power-domain-cells = <1>;
        };
    };
...
```

## Documentation/devicetree/bindings/clock/raspberrypi,rp1-clocks.yaml
```yaml
# SPDX-License-Identifier: (GPL-2.0-only OR BSD-2-Clause)
%YAML 1.2
---
$id: http://devicetree.org/schemas/clock/raspberrypi,rp1-clocks.yaml#
$schema: http://devicetree.org/meta-schemas/core.yaml#

title: RaspberryPi RP1 clock generator

maintainers:
  - Andrea della Porta <andrea.porta@suse.com>

description: |
  The RP1 contains a clock generator designed as three PLLs (CORE, AUDIO,
  VIDEO), and each PLL output can be programmed though dividers to generate
  the clocks to drive the sub-peripherals embedded inside the chipset.

  Link to datasheet:
  https://datasheets.raspberrypi.com/rp1/rp1-peripherals.pdf

properties:
  compatible:
    const: raspberrypi,rp1-clocks

  reg:
    maxItems: 1

  '#clock-cells':
    description:
      The index in the assigned-clocks is mapped to the output clock as per
      definitions in dt-bindings/clock/rp1.h.
    const: 1

  clocks:
    maxItems: 1

required:
  - compatible
  - reg
  - '#clock-cells'
  - clocks

additionalProperties: false

examples:
  - |
    #include <dt-bindings/clock/rp1.h>

    rp1 {
        #address-cells = <2>;
        #size-cells = <2>;

        rp1_clocks: clocks@18000 {
            compatible = "raspberrypi,rp1-clocks";
            reg = <0xc0 0x40018000 0x0 0x10038>;
            #clock-cells = <1>;
            clocks = <&clk_xosc>;

            assigned-clocks = <&rp1_clocks RP1_PLL_SYS_CORE>,
                              <&rp1_clocks RP1_PLL_AUDIO_CORE>,
                              /* RP1_PLL_VIDEO_CORE and dividers are now managed by VEC,DPI drivers */
                              <&rp1_clocks RP1_PLL_SYS>,
                              <&rp1_clocks RP1_PLL_SYS_SEC>,
                              <&rp1_clocks RP1_PLL_AUDIO>,
                              <&rp1_clocks RP1_PLL_AUDIO_SEC>,
                              <&rp1_clocks RP1_CLK_SYS>,
                              <&rp1_clocks RP1_PLL_SYS_PRI_PH>,
                              /* RP1_CLK_SLOW_SYS is used for the frequency counter (FC0) */
                              <&rp1_clocks RP1_CLK_SLOW_SYS>,
                              <&rp1_clocks RP1_CLK_SDIO_TIMER>,
                              <&rp1_clocks RP1_CLK_SDIO_ALT_SRC>,
                              <&rp1_clocks RP1_CLK_ETH_TSU>;

            assigned-clock-rates = <1000000000>, // RP1_PLL_SYS_CORE
                                   <1536000000>, // RP1_PLL_AUDIO_CORE
                                   <200000000>,  // RP1_PLL_SYS
                                   <125000000>,  // RP1_PLL_SYS_SEC
                                   <61440000>,   // RP1_PLL_AUDIO
                                   <192000000>,  // RP1_PLL_AUDIO_SEC
                                   <200000000>,  // RP1_CLK_SYS
                                   <100000000>,  // RP1_PLL_SYS_PRI_PH
                                   /* Must match the XOSC frequency */
                                   <50000000>, // RP1_CLK_SLOW_SYS
                                   <1000000>, // RP1_CLK_SDIO_TIMER
                                   <200000000>, // RP1_CLK_SDIO_ALT_SRC
                                   <50000000>; // RP1_CLK_ETH_TSU
        };
    };
```

## Documentation/devicetree/bindings/clock/rda,8810pl-apsyscon.yaml
```yaml
# SPDX-License-Identifier: (GPL-2.0-only OR BSD-2-Clause)
%YAML 1.2
---
$id: http://devicetree.org/schemas/clock/rda,8810pl-apsyscon.yaml#
$schema: http://devicetree.org/meta-schemas/core.yaml#

title: RDA Micro RDA8810PL AP Clock Controller

maintainers:
  - Dang Huynh <dang.huynh@mainlining.org>

properties:
  compatible:
    items:
      - const: rda,8810pl-apsyscon
      - const: syscon

  reg:
    maxItems: 1

  '#clock-cells':
    const: 1

  '#reset-cells':
    const: 1

required:
  - compatible
  - reg
  - '#clock-cells'
  - '#reset-cells'

additionalProperties: false

examples:
  - |
    #include <dt-bindings/clock/rda,8810pl-apclk.h>
    syscon@0 {
      compatible = "rda,8810pl-apsyscon", "syscon";
      reg = <0x0 0x1000>;
      #clock-cells = <1>;
      #reset-cells = <1>;
    };
```

## Documentation/devicetree/bindings/clock/realtek,rtd1625-clk.yaml
```yaml
# SPDX-License-Identifier: (GPL-2.0-only OR BSD-2-Clause)
%YAML 1.2
---
$id: http://devicetree.org/schemas/clock/realtek,rtd1625-clk.yaml#
$schema: http://devicetree.org/meta-schemas/core.yaml#

title: Realtek RTD1625 Clock & Reset Controller

maintainers:
  - Yu-Chun Lin <eleanor.lin@realtek.com>

description: |
  The Realtek RTD1625 Clock Controller manages and distributes clock
  signals to various controllers and implements a Reset Controller for the
  SoC peripherals.

  Clocks are referenced by unique identifiers, which are defined as
  preprocessor macros in dt-bindings/clock/realtek,rtd1625-clk.h. Client
  device nodes within the Device Tree use these identifiers to specify the
  specific clock and reset signals they require.

properties:
  compatible:
    enum:
      - realtek,rtd1625-crt-clk
      - realtek,rtd1625-iso-clk
      - realtek,rtd1625-iso-s-clk

  reg:
    maxItems: 1

  "#clock-cells":
    const: 1

  "#reset-cells":
    const: 1

required:
  - compatible
  - reg
  - "#clock-cells"
  - "#reset-cells"

additionalProperties: false

examples:
  - |
    clock-controller@98000000 {
      compatible = "realtek,rtd1625-crt-clk";
      reg = <98000000 0x1000>;
      #clock-cells = <1>;
      #reset-cells = <1>;
    };
```
