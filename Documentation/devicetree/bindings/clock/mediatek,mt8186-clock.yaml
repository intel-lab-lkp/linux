## Documentation/devicetree/bindings/clock/qcom,hawi-lpass-va-csr.yaml
```yaml
# SPDX-License-Identifier: (GPL-2.0-only OR BSD-2-Clause)
%YAML 1.2
---
$id: http://devicetree.org/schemas/clock/qcom,hawi-lpass-va-csr.yaml#
$schema: http://devicetree.org/meta-schemas/core.yaml#

title: Qualcomm LPASS VA CSR heartbeat pulse clock provider

maintainers:
  - Srinivas Kandagatla <srinivas.kandagatla@oss.qualcomm.com>
  - Sarath Ganapathiraju <sarath.ganapathiraju@oss.qualcomm.com>

description:
  The Hawi LPASS (Low Power Audio Subsystem) VA CSR block contains a
  rate generator that produces a periodic HeartBeat Pulse, also known
  as the RateGen Pulse. This pulse synchronizes the start of DMAs and
  Codec Interfaces for audio usecases and can serve as a periodic wakeup
  source for the DSP.

properties:
  compatible:
    enum:
      - qcom,hawi-lpass-va-csr

  reg:
    maxItems: 1
    description: Address and size of the VA CSR register block.

  "#clock-cells":
    const: 0

required:
  - compatible
  - reg
  - "#clock-cells"

additionalProperties: false

examples:
  - |
    clock-controller@7ee0000 {
      compatible = "qcom,hawi-lpass-va-csr";
      reg = <0x07ee0000 0xe000>;
      #clock-cells = <0>;
    };
```

## Documentation/devicetree/bindings/clock/qcom,ipq-cmn-pll.yaml
```yaml
# SPDX-License-Identifier: GPL-2.0-only OR BSD-2-Clause
%YAML 1.2
---
$id: http://devicetree.org/schemas/clock/qcom,ipq-cmn-pll.yaml#
$schema: http://devicetree.org/meta-schemas/core.yaml#

title: Qualcomm Common PLL Clock Controller on IPQ SoC

maintainers:
  - Bjorn Andersson <andersson@kernel.org>
  - Luo Jie <quic_luoj@quicinc.com>

description:
  The common PLL clock controller expects a reference input clock.
  This reference clock is from the on-board Wi-Fi. The CMN PLL
  supplies a number of fixed rate output clocks to the Ethernet
  devices including PPE (packet process engine) and the connected
  switch or PHY device.

properties:
  compatible:
    enum:
      - qcom,ipq9574-cmn-pll

  reg:
    maxItems: 1

  clocks:
    items:
      - description: The reference clock, the supported clock rates include
          25000000, 31250000, 40000000, 48000000, 50000000 and 96000000 HZ.
      - description: The AHB clock
      - description: The SYS clock
    description:
      The reference clock is the source clock of CMN PLL, which is from the
      Wi-Fi. The AHB and SYS clocks must be enabled to access common PLL
      clock registers.

  clock-names:
    items:
      - const: ref
      - const: ahb
      - const: sys

  clock-output-names:
    items:
      - const: ppe-353mhz
      - const: eth0-50mhz
      - const: eth1-50mhz
      - const: eth2-50mhz
      - const: eth-25mhz
    description:
      The output clocks are given to Ethernet blocks that includes PPE and
      the connected switch or PHY device.

  "#clock-cells":
    const: 1

required:
  - compatible
  - reg
  - clocks
  - clock-names
  - clock-output-names
  - "#clock-cells"

additionalProperties: false

examples:
  - |
    #include <dt-bindings/clock/qcom,ipq9574-gcc.h>

    clock-controller@9b000 {
        compatible = "qcom,ipq9574-cmn-pll";
        reg = <0x0009b000 0x800>;
        clocks = <&cmn_pll_ref_clk>,
                 <&gcc GCC_CMN_12GPLL_AHB_CLK>,
                 <&gcc GCC_CMN_12GPLL_SYS_CLK>;
        clock-names = "ref", "ahb", "sys";
        clock-output-names = "ppe-353mhz",
                             "eth0-50mhz",
                             "eth1-50mhz",
                             "eth2-50mhz",
                             "eth-25mhz";
        #clock-cells = <1>;
    };
...
```

## Documentation/devicetree/bindings/clock/qcom,ipq5332-nsscc.yaml
```yaml
# SPDX-License-Identifier: (GPL-2.0-only OR BSD-2-Clause)
%YAML 1.2
---
$id: http://devicetree.org/schemas/clock/qcom,ipq5332-nsscc.yaml#
$schema: http://devicetree.org/meta-schemas/core.yaml#

title: Qualcomm Networking Sub System Clock & Reset Controller on IPQ5332

maintainers:
  - Bjorn Andersson <andersson@kernel.org>

description: |
  Qualcomm networking sub system clock control module provides the clocks,
  resets and power domains on IPQ5332

  See also::
    include/dt-bindings/clock/qcom,ipq5332-nsscc.h

allOf:
  - $ref: qcom,gcc.yaml#

properties:
  compatible:
    const: qcom,ipq5332-nsscc

  clocks:
    items:
      - description: Common PLL nss clock 200M source
      - description: Common PLL nss clock 300M source
      - description: GCC GPLL0 out aux clock source
      - description: Uniphy0 NSS Rx clock source
      - description: Uniphy0 NSS Tx clock source
      - description: Uniphy1 NSS Rx clock source
      - description: Uniphy1 NSS Tx clock source
      - description: Board XO source

required:
  - compatible
  - clocks

unevaluatedProperties: false

examples:
  - |
    clock-controller@39b00000 {
      compatible = "qcom,ipq5332-nsscc";
      reg = <0x39b00000 0x80000>;
      clocks = <&bias_pll_cc_clk>,
               <&bias_pll_nss_noc_clk>,
               <&gcc_gpll0_out_aux>,
               <&uniphy 0>,
               <&uniphy 1>,
               <&uniphy 2>,
               <&uniphy 3>,
               <&xo_board_clk>;
      #clock-cells = <1>;
      #reset-cells = <1>;
      #power-domain-cells = <1>;
    };
...
```

## Documentation/devicetree/bindings/clock/qcom,ipq5424-apss-clk.yaml
```yaml
# SPDX-License-Identifier: (GPL-2.0-only OR BSD-2-Clause)
%YAML 1.2
---
$id: http://devicetree.org/schemas/clock/qcom,ipq5424-apss-clk.yaml#
$schema: http://devicetree.org/meta-schemas/core.yaml#

title: Qualcomm APSS IPQ5424 Clock Controller

maintainers:
  - Sricharan Ramabadhran <quic_srichara@quicinc.com>
  - Md Sadre Alam <quic_mdalam@quicinc.com>

description: |
  The CPU core in ipq5424 is clocked by a huayra PLL with RCG support.
  The RCG and PLL have a separate register space from the GCC.

properties:
  compatible:
    enum:
      - qcom,ipq5424-apss-clk
  reg:
    maxItems: 1

  clocks:
    items:
      - description: Reference to the XO clock.
      - description: Reference to the GPLL0 clock.

  clock-names:
    items:
      - const: xo
      - const: gpll0

  '#clock-cells':
    const: 1

  '#interconnect-cells':
    const: 1

required:
  - compatible
  - reg
  - clocks
  - clock-names
  - '#clock-cells'
  - '#interconnect-cells'

additionalProperties: false

examples:
  - |
    #include <dt-bindings/clock/qcom,ipq5424-gcc.h>

    apss_clk: apss-clock@fa80000 {
      compatible = "qcom,ipq5424-apss-clk";
      reg = <0x0fa80000 0x20000>;
      clocks = <&xo_board>, <&gcc GPLL0>;
      clock-names = "xo", "gpll0";
      #clock-cells = <1>;
      #interconnect-cells = <1>;
    };
```

## Documentation/devicetree/bindings/clock/qcom,ipq9574-nsscc.yaml
```yaml
# SPDX-License-Identifier: (GPL-2.0-only OR BSD-2-Clause)
%YAML 1.2
---
$id: http://devicetree.org/schemas/clock/qcom,ipq9574-nsscc.yaml#
$schema: http://devicetree.org/meta-schemas/core.yaml#

title: Qualcomm Networking Sub System Clock & Reset Controller on IPQ9574

maintainers:
  - Bjorn Andersson <andersson@kernel.org>
  - Anusha Rao <quic_anusha@quicinc.com>

description: |
  Qualcomm networking sub system clock control module provides the clocks,
  resets and power domains on IPQ9574

  See also::
    include/dt-bindings/clock/qcom,ipq9574-nsscc.h
    include/dt-bindings/reset/qcom,ipq9574-nsscc.h

properties:
  compatible:
    const: qcom,ipq9574-nsscc

  clocks:
    items:
      - description: Board XO source
      - description: Bias PLL cc clock source
      - description: Bias PLL nss noc clock source
      - description: Bias PLL ubi nc clock source
      - description: GCC GPLL0 OUT AUX clock source
      - description: Uniphy0 NSS Rx clock source
      - description: Uniphy0 NSS Tx clock source
      - description: Uniphy1 NSS Rx clock source
      - description: Uniphy1 NSS Tx clock source
      - description: Uniphy2 NSS Rx clock source
      - description: Uniphy2 NSS Tx clock source
      - description: GCC NSSCC clock source

  '#interconnect-cells':
    const: 1

required:
  - compatible
  - clocks

allOf:
  - $ref: qcom,gcc.yaml#

unevaluatedProperties: false

examples:
  - |
    #include <dt-bindings/clock/qcom,ipq9574-gcc.h>
    clock-controller@39b00000 {
      compatible = "qcom,ipq9574-nsscc";
      reg = <0x39b00000 0x80000>;
      clocks = <&xo_board_clk>,
               <&bias_pll_cc_clk>,
               <&bias_pll_nss_noc_clk>,
               <&bias_pll_ubi_nc_clk>,
               <&gcc GPLL0_OUT_AUX>,
               <&uniphy 0>,
               <&uniphy 1>,
               <&uniphy 2>,
               <&uniphy 3>,
               <&uniphy 4>,
               <&uniphy 5>,
               <&gcc GCC_NSSCC_CLK>;
      #clock-cells = <1>;
      #reset-cells = <1>;
      #power-domain-cells = <1>;
    };
...
```

## Documentation/devicetree/bindings/clock/qcom,ipq9650-apss-clk.yaml
```yaml
# SPDX-License-Identifier: (GPL-2.0-only OR BSD-2-Clause)
%YAML 1.2
---
$id: http://devicetree.org/schemas/clock/qcom,ipq9650-apss-clk.yaml#
$schema: http://devicetree.org/meta-schemas/core.yaml#

title: Qualcomm APSS IPQ9650 Clock Controller

maintainers:
  - Kathiravan Thirumoorthy <kathiravan.thirumoorthy@oss.qualcomm.com>

description:
  The APSS clock controller provides the CPU and L3 clocks on IPQ9650 and
  has a register space separate from the GCC. The four Cortex-A55 cores,
  the Cortex-A78 core and the L3 are each clocked by their own Zonda PLL.
  Each clock is selected through a glitch-free mux (GFM) whose parents are
  XO, GPLL0 and the corresponding PLL.

properties:
  compatible:
    enum:
      - qcom,ipq9650-apss-clk

  reg:
    maxItems: 1

  clocks:
    items:
      - description: Reference to the XO clock.
      - description: Reference to the GPLL0 clock.

  '#clock-cells':
    const: 1

  '#interconnect-cells':
    const: 1

required:
  - compatible
  - reg
  - clocks
  - '#clock-cells'
  - '#interconnect-cells'

additionalProperties: false

examples:
  - |
    #include <dt-bindings/clock/qcom,ipq9650-gcc.h>

    apss_clk: clock-controller@fa80000 {
      compatible = "qcom,ipq9650-apss-clk";
      reg = <0x0fa80000 0x30000>;
      clocks = <&xo_board>,
               <&gcc GPLL0>;
      #clock-cells = <1>;
      #interconnect-cells = <1>;
    };
```

## Documentation/devicetree/bindings/clock/qcom,milos-camcc.yaml
```yaml
# SPDX-License-Identifier: (GPL-2.0-only OR BSD-2-Clause)
%YAML 1.2
---
$id: http://devicetree.org/schemas/clock/qcom,milos-camcc.yaml#
$schema: http://devicetree.org/meta-schemas/core.yaml#

title: Qualcomm Camera Clock & Reset Controller on Milos

maintainers:
  - Luca Weiss <luca.weiss@fairphone.com>

description: |
  Qualcomm camera clock control module provides the clocks, resets and power
  domains on Milos.

  See also: include/dt-bindings/clock/qcom,milos-camcc.h

properties:
  compatible:
    const: qcom,milos-camcc

  clocks:
    items:
      - description: Board XO source
      - description: Sleep clock source
      - description: Camera AHB clock from GCC

  power-domains:
    items:
      - description: CX power domain
      - description: MX power domain

  required-opps:
    items:
      - description: CX performance point
      - description: MX performance point

required:
  - compatible
  - clocks
  - power-domains
  - required-opps

allOf:
  - $ref: qcom,gcc.yaml#

unevaluatedProperties: false

examples:
  - |
    #include <dt-bindings/clock/qcom,milos-gcc.h>
    #include <dt-bindings/power/qcom,rpmhpd.h>
    clock-controller@adb0000 {
        compatible = "qcom,milos-camcc";
        reg = <0x0adb0000 0x40000>;
        clocks = <&bi_tcxo_div2>,
                 <&sleep_clk>,
                 <&gcc GCC_CAMERA_AHB_CLK>;

        power-domains = <&rpmhpd RPMHPD_CX>,
                        <&rpmhpd RPMHPD_MX>;
        required-opps = <&rpmhpd_opp_low_svs>,
                        <&rpmhpd_opp_low_svs>;

        #clock-cells = <1>;
        #reset-cells = <1>;
        #power-domain-cells = <1>;
    };

...
```

## Documentation/devicetree/bindings/clock/qcom,sm8550-camcc.yaml
```yaml
# SPDX-License-Identifier: (GPL-2.0-only OR BSD-2-Clause)
%YAML 1.2
---
$id: http://devicetree.org/schemas/clock/qcom,sm8550-camcc.yaml#
$schema: http://devicetree.org/meta-schemas/core.yaml#

title: Qualcomm Camera Clock & Reset Controller on SM8550

maintainers:
  - Bryan O'Donoghue <bryan.odonoghue@linaro.org>

description: |
  Qualcomm camera clock control module provides the clocks, resets and power
  domains on SM8550.

  See also:: include/dt-bindings/clock/qcom,sm8550-camcc.h

allOf:
  - $ref: qcom,camcc-common.yaml#

properties:
  compatible:
    const: qcom,sm8550-camcc

  clocks:
    items:
      - description: Camera AHB clock from GCC
      - description: Board XO source
      - description: Board active XO source
      - description: Sleep clock source

required:
  - power-domains
  - required-opps

unevaluatedProperties: false

examples:
  - |
    #include <dt-bindings/clock/qcom,sm8550-gcc.h>
    #include <dt-bindings/clock/qcom,rpmh.h>
    #include <dt-bindings/power/qcom,rpmhpd.h>
    clock-controller@ade0000 {
      compatible = "qcom,sm8550-camcc";
      reg = <0xade0000 0x20000>;
      clocks = <&gcc GCC_CAMERA_AHB_CLK>,
               <&rpmhcc RPMH_CXO_CLK>,
               <&rpmhcc RPMH_CXO_CLK_A>,
               <&sleep_clk>;
      power-domains = <&rpmhpd RPMHPD_MMCX>;
      required-opps = <&rpmhpd_opp_low_svs>;
      #clock-cells = <1>;
      #reset-cells = <1>;
      #power-domain-cells = <1>;
    };
...
```
