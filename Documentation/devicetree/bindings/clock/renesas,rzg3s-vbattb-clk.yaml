## Documentation/devicetree/bindings/clock/samsung,exynos9610-cmu.yaml
```yaml
# SPDX-License-Identifier: (GPL-2.0-only OR BSD-2-Clause)
%YAML 1.2
---
$id: http://devicetree.org/schemas/clock/samsung,exynos9610-cmu.yaml#
$schema: http://devicetree.org/meta-schemas/core.yaml#

title: Samsung Exynos9610 SoC clock controller

maintainers:
  - Alexandru Chimac <alex@chimac.ro>
  - Chanwoo Choi <cw00.choi@samsung.com>
  - Krzysztof Kozlowski <krzk@kernel.org>

description: |
  Exynos9610 clock controller is comprised of several CMU units, generating
  clocks for different domains. Those CMU units are modeled as separate device
  tree nodes, and might depend on each other. The root clock in that root tree
  is an external clock: OSCCLK (26MHz). This external clock must be defined
  as a fixed-rate clock in the device tree.

  CMU_TOP is a top-level CMU, where all base clocks are prepared using PLLs and
  dividers; all other clocks of function blocks (other CMUs) are usually
  derived from CMU_TOP.

  Each clock is assigned an identifier and client nodes can use this identifier
  to specify the clock which they consume. All clocks available for usage
  in clock consumer nodes are defined as preprocessor macros in
  'include/dt-bindings/clock/samsung,exynos9610-cmu.h'.

properties:
  compatible:
    enum:
      - samsung,exynos9610-cmu-top
      - samsung,exynos9610-cmu-apm
      - samsung,exynos9610-cmu-cam
      - samsung,exynos9610-cmu-cmgp
      - samsung,exynos9610-cmu-core
      - samsung,exynos9610-cmu-cpucl0
      - samsung,exynos9610-cmu-dispaud
      - samsung,exynos9610-cmu-fsys
      - samsung,exynos9610-cmu-g2d
      - samsung,exynos9610-cmu-g3d
      - samsung,exynos9610-cmu-peri
      - samsung,exynos9610-cmu-usb

  clocks:
    minItems: 1
    maxItems: 5

  clock-names:
    minItems: 1
    maxItems: 5

  "#clock-cells":
    const: 1

  reg:
    maxItems: 1

required:
  - compatible
  - "#clock-cells"
  - clocks
  - clock-names
  - reg

allOf:
  - if:
      properties:
        compatible:
          contains:
            const: samsung,exynos9610-cmu-top

    then:
      properties:
        clocks:
          items:
            - description: External reference clock (26MHz)

        clock-names:
          items:
            - const: oscclk

  - if:
      properties:
        compatible:
          contains:
            const: samsung,exynos9610-cmu-apm

    then:
      properties:
        clocks:
          items:
            - description: External reference clock (26MHz)
            - description: CMU_APM bus clock (from CMU_TOP)

        clock-names:
          items:
            - const: oscclk
            - const: dout_cmu_apm_bus

  - if:
      properties:
        compatible:
          contains:
            const: samsung,exynos9610-cmu-cam

    then:
      properties:
        clocks:
          items:
            - description: External reference clock (26MHz)
            - description: CMU_CAM bus clock (from CMU_TOP)

        clock-names:
          items:
            - const: oscclk
            - const: dout_cmu_cam_bus

  - if:
      properties:
        compatible:
          contains:
            const: samsung,exynos9610-cmu-cmgp

    then:
      properties:
        clocks:
          items:
            - description: External reference clock (26MHz)
            - description: CMU_CMGP bus clock (from CMU_APM)

        clock-names:
          items:
            - const: oscclk
            - const: gout_cmu_cmgp_bus

  - if:
      properties:
        compatible:
          contains:
            const: samsung,exynos9610-cmu-core

    then:
      properties:
        clocks:
          items:
            - description: External reference clock (26MHz)
            - description: CMU_CORE bus clock (from CMU_TOP)
            - description: CMU_CORE CCI clock (from CMU_TOP)
            - description: CMU_CORE G3D clock (from CMU_TOP)

        clock-names:
          items:
            - const: oscclk
            - const: gout_cmu_core_bus
            - const: gout_cmu_core_cci
            - const: gout_cmu_core_g3d

  - if:
      properties:
        compatible:
          contains:
            const: samsung,exynos9610-cmu-cpucl0

    then:
      properties:
        clocks:
          items:
            - description: External reference clock (26MHz)
            - description: CMU_CPUCL0 debug clock (from CMU_TOP)
            - description: CMU_CPUCL0 switch clock (from CMU_TOP)
            - description: HPM clock (from CMU_TOP)

        clock-names:
          items:
            - const: oscclk
            - const: dout_cmu_cpucl0_dbg
            - const: dout_cmu_cpucl0_switch
            - const: dout_cmu_hpm

  - if:
      properties:
        compatible:
          contains:
            const: samsung,exynos9610-cmu-dispaud

    then:
      properties:
        clocks:
          items:
            - description: External reference clock (26MHz)
            - description: CMU_DISPAUD audio clock (from CMU_TOP)
            - description: CMU_DISPAUD CPU clock (from CMU_TOP)
            - description: CMU_DISPAUD display clock (from CMU_TOP)

        clock-names:
          items:
            - const: oscclk
            - const: dout_cmu_dispaud_aud
            - const: dout_cmu_dispaud_cpu
            - const: dout_cmu_dispaud_disp

  - if:
      properties:
        compatible:
          contains:
            const: samsung,exynos9610-cmu-fsys

    then:
      properties:
        clocks:
          items:
            - description: External reference clock (26MHz)
            - description: CMU_FSYS bus clock (from CMU_TOP)
            - description: CMU_FSYS external MMC clock (from CMU_TOP)
            - description: CMU_FSYS embedded MMC clock (from CMU_TOP)
            - description: CMU_FSYS embedded UFS clock (from CMU_TOP)

        clock-names:
          items:
            - const: oscclk
            - const: dout_cmu_fsys_bus
            - const: dout_cmu_fsys_mmc_card
            - const: dout_cmu_fsys_mmc_embd
            - const: dout_cmu_fsys_ufs_embd

  - if:
      properties:
        compatible:
          contains:
            const: samsung,exynos9610-cmu-g2d

    then:
      properties:
        clocks:
          items:
            - description: External reference clock (26MHz)
            - description: CMU_G2D G2D clock (from CMU_TOP)
            - description: CMU_G2D MSCL clock (from CMU_TOP)

        clock-names:
          items:
            - const: oscclk
            - const: dout_cmu_g2d_g2d
            - const: dout_cmu_g2d_mscl

  - if:
      properties:
        compatible:
          contains:
            const: samsung,exynos9610-cmu-g3d

    then:
      properties:
        clocks:
          items:
            - description: External reference clock (26MHz)
            - description: CMU_G3D switch clock (from CMU_TOP)
            - description: HPM clock (from CMU_TOP)

        clock-names:
          items:
            - const: oscclk
            - const: dout_cmu_g3d_switch
            - const: dout_cmu_hpm

  - if:
      properties:
        compatible:
          contains:
            const: samsung,exynos9610-cmu-peri

    then:
      properties:
        clocks:
          items:
            - description: External reference clock (26MHz)
            - description: CMU_PERI bus clock (from CMU_TOP)
            - description: CMU_PERI IP clock (from CMU_TOP)
            - description: CMU_PERI UART clock (from CMU_TOP)

        clock-names:
          items:
            - const: oscclk
            - const: dout_cmu_peri_bus
            - const: dout_cmu_peri_ip
            - const: dout_cmu_peri_uart

  - if:
      properties:
        compatible:
          contains:
            const: samsung,exynos9610-cmu-usb

    then:
      properties:
        clocks:
          items:
            - description: External reference clock (26MHz)
            - description: CMU_USB bus clock (from CMU_TOP)
            - description: CMU_USB DPGTC clock (from CMU_TOP)
            - description: CMU_USB DRD clock (from CMU_TOP)

        clock-names:
          items:
            - const: oscclk
            - const: dout_cmu_usb_bus
            - const: dout_cmu_usb_dpgtc
            - const: dout_cmu_usb_usb30drd

additionalProperties: false

examples:
  # Clock controller node for CMU_FSYS
  - |
    #include <dt-bindings/clock/samsung,exynos9610-cmu.h>

    cmu_fsys: clock-controller@13400000 {
        compatible = "samsung,exynos9610-cmu-fsys";
        reg = <0x13400000 0x8000>;
        #clock-cells = <1>;

        clocks = <&oscclk>,
                 <&cmu_top CLK_DOUT_CMU_FSYS_BUS>,
                 <&cmu_top CLK_DOUT_CMU_FSYS_MMC_CARD>,
                 <&cmu_top CLK_DOUT_CMU_FSYS_MMC_EMBD>,
                 <&cmu_top CLK_DOUT_CMU_FSYS_UFS_EMBD>;
        clock-names = "oscclk",
                      "dout_cmu_fsys_bus",
                      "dout_cmu_fsys_mmc_card",
                      "dout_cmu_fsys_mmc_embd",
                      "dout_cmu_fsys_ufs_embd";
    };
...
```

## Documentation/devicetree/bindings/clock/siflower,sf21-topcrm.yaml
```yaml
# SPDX-License-Identifier: (GPL-2.0-only OR BSD-2-Clause)
%YAML 1.2
---
$id: http://devicetree.org/schemas/clock/siflower,sf21-topcrm.yaml#
$schema: http://devicetree.org/meta-schemas/core.yaml#

title: Siflower SF21 toplevel clock and reset module

maintainers:
  - Chuanhong Guo <gch981213@gmail.com>

description: |
  The toplevel clock and reset module on Siflower SF21 SoCs manages
  the main PLLs, high-level clock muxes/dividers/gates, and some
  reset lines.
  Available clocks are defined in:
  include/dt-bindings/clock/siflower,sf21-topcrm.h
  Available resets are defined in:
  include/dt-bindings/reset/siflower,sf21-topcrm.h

properties:
  compatible:
    const: siflower,sf21-topcrm

  reg:
    maxItems: 1

  clocks:
    maxItems: 1

  "#clock-cells":
    const: 1

  "#reset-cells":
    const: 1

required:
  - compatible
  - reg
  - clocks
  - "#clock-cells"
  - "#reset-cells"

additionalProperties: false

examples:
  - |
    #include <dt-bindings/clock/siflower,sf21-topcrm.h>
    soc {
        #address-cells = <1>;
        #size-cells = <1>;

        clock-controller@ce00400 {
            compatible = "siflower,sf21-topcrm";
            reg = <0x0ce00400 0x400>;
            clocks = <&refclk>;
            #clock-cells = <1>;
            #reset-cells = <1>;
        };
    };
```

## Documentation/devicetree/bindings/clock/skyworks,si522xx.yaml
```yaml
# SPDX-License-Identifier: (GPL-2.0-only OR BSD-2-Clause)
%YAML 1.2
---
$id: http://devicetree.org/schemas/clock/skyworks,si522xx.yaml#
$schema: http://devicetree.org/meta-schemas/core.yaml#

title: Skyworks Si522xx I2C PCIe clock generators

description: |
  The Skyworks Si522xx are I2C PCIe clock generators providing
  from 2 to 12 output clocks.

maintainers:
  - Marek Vasut <marek.vasut@mailbox.org>

properties:
  compatible:
    enum:
      - skyworks,si52202
      - skyworks,si52204
      - skyworks,si52208
      - skyworks,si52212

  reg:
    const: 0x6a

  '#clock-cells':
    const: 1

  clocks:
    items:
      - description: XTal input clock

  skyworks,out-amplitude-microvolt:
    enum: [ 600000, 650000, 700000, 750000, 800000, 850000 ]
    description: Output clock signal amplitude

  skyworks,out-spread-spectrum:
    $ref: /schemas/types.yaml#/definitions/uint32
    enum: [ 100000, 99750, 99500 ]
    description: Output clock down spread in pcm (1/1000 of percent)

patternProperties:
  "^DIFF[0-11]$":
    type: object
    description:
      Description of one of the outputs (DIFF0..DIF11).

    properties:
      skyworks,slew-rate:
        $ref: /schemas/types.yaml#/definitions/uint32
        enum: [ 1900000, 2400000 ]
        description: Output clock slew rate select in V/ns

    additionalProperties: false

required:
  - compatible
  - reg
  - clocks
  - '#clock-cells'

additionalProperties: false

examples:
  - |
    i2c {
        #address-cells = <1>;
        #size-cells = <0>;

        clock-generator@6a {
            compatible = "skyworks,si52202";
            reg = <0x6a>;
            #clock-cells = <1>;
            clocks = <&ref25m>;
        };
    };

...
```

## Documentation/devicetree/bindings/clock/sophgo,sg2044-clk.yaml
```yaml
# SPDX-License-Identifier: (GPL-2.0 OR BSD-2-Clause)
%YAML 1.2
---
$id: http://devicetree.org/schemas/clock/sophgo,sg2044-clk.yaml#
$schema: http://devicetree.org/meta-schemas/core.yaml#

title: Sophgo SG2044 Clock Controller

maintainers:
  - Inochi Amaoto <inochiama@gmail.com>

properties:
  compatible:
    const: sophgo,sg2044-clk

  reg:
    maxItems: 1

  clocks:
    maxItems: 1

  '#clock-cells':
    const: 1

required:
  - compatible
  - reg
  - clocks
  - '#clock-cells'

additionalProperties: false

examples:
  - |
    clock-controller@50002000 {
      compatible = "sophgo,sg2044-clk";
      reg = <0x50002000 0x1000>;
      #clock-cells = <1>;
      clocks = <&osc>;
    };
```

## Documentation/devicetree/bindings/clock/sprd,sc9832e-clk.yaml
```yaml
# SPDX-License-Identifier: (GPL-2.0-only OR BSD-2-Clause)
# Copyright 2026 Unisoc Inc.
%YAML 1.2
---
$id: http://devicetree.org/schemas/clock/sprd,sc9832e-clk.yaml#
$schema: http://devicetree.org/meta-schemas/core.yaml#

title: Unisoc SC9832E Clock Controllers

maintainers:
  - Nadi Ke <kenadicanady@gmail.com>
  - Orson Zhai <orsonzhai@gmail.com>
  - Baolin Wang <baolin.wang7@gmail.com>
  - Chunyan Zhang <zhang.lyra@gmail.com>

properties:
  compatible:
    enum:
      - sprd,sc9832e-glbregs
      - sprd,sc9832e-pll
      - sprd,sc9832e-mpll
      - sprd,sc9832e-dpll
      - sprd,sc9832e-rpll
      - sprd,sc9832e-apahb-gate
      - sprd,sc9832e-aonapb-gate
      - sprd,sc9832e-ap-clk
      - sprd,sc9832e-aon-clk
      - sprd,sc9832e-apapb-gate

  "#clock-cells":
    const: 1

  reg:
    maxItems: 1

  clocks:
    minItems: 1
    maxItems: 6

  clock-names:
    minItems: 1
    maxItems: 6

required:
  - compatible
  - reg
  - clocks
  - clock-names
  - "#clock-cells"

allOf:
  - if:
      properties:
        compatible:
          contains:
            enum:
              - sprd,sc9832e-glbregs
              - sprd,sc9832e-pll
              - sprd,sc9832e-mpll
              - sprd,sc9832e-dpll
              - sprd,sc9832e-rpll
              - sprd,sc9832e-apahb-gate
              - sprd,sc9832e-aonapb-gate
              - sprd,sc9832e-apapb-gate
    then:
      properties:
        clocks:
          maxItems: 1
        clock-names:
          items:
            - const: ext-26m

  - if:
      properties:
        compatible:
          contains:
            const: sprd,sc9832e-ap-clk
    then:
      properties:
        clocks:
          minItems: 2
          maxItems: 2
        clock-names:
          items:
            - const: ext-26m
            - const: ext-1m

  - if:
      properties:
        compatible:
          contains:
            const: sprd,sc9832e-aon-clk
    then:
      properties:
        clocks:
          minItems: 6
          maxItems: 6
        clock-names:
          items:
            - const: ext-4m3
            - const: ext-26m
            - const: ext-32k
            - const: ext-6m5
            - const: ext-13m
            - const: ext-250k

additionalProperties: false

examples:
  - |
    #include <dt-bindings/clock/sprd,sc9832e-clk.h>

    clock-controller@21500000 {
        compatible = "sprd,sc9832e-ap-clk";
        reg = <0x21500000 0x1000>;
        clocks = <&ext_26m>, <&ext_1m>;
        clock-names = "ext-26m", "ext-1m";
        #clock-cells = <1>;
    };
...
```
