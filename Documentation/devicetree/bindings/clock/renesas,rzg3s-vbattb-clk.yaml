## Documentation/devicetree/bindings/clock/renesas,rzg3s-vbattb-clk.yaml
```yaml
# SPDX-License-Identifier: (GPL-2.0-only OR BSD-2-Clause)
%YAML 1.2
---
$id: http://devicetree.org/schemas/clock/renesas,rzg3s-vbattb-clk.yaml#
$schema: http://devicetree.org/meta-schemas/core.yaml#

title: Renesas VBATTB clock

maintainers:
  - Claudiu Beznea <claudiu.beznea.uj@bp.renesas.com>

description:
  Renesas VBATTB module is an always on powered module (backed by battery) which
  generates a clock (VBATTCLK). This clocks feeds the RTC and the tamper detector
  modules.

properties:
  compatible:
    const: renesas,rzg3s-vbattb-clk

  reg:
    maxItems: 1

  clocks:
    items:
      - description: VBATTB module clock
      - description: VBATTB input xtal

  clock-names:
    items:
      - const: bclk
      - const: vbattb_xtal

  '#clock-cells':
    const: 0

  power-domains:
    maxItems: 1

  renesas,vbattb-load-nanofarads:
    description: load capacitance of the on board xtal
    $ref: /schemas/types.yaml#/definitions/uint32
    enum: [ 4000, 7000, 9000, 12500 ]

  renesas,vbattb-osc-bypass:
    description: set when external clock is connected to RTXOUT pin
    type: boolean

required:
  - compatible
  - reg
  - clocks
  - clock-names
  - power-domains
  - '#clock-cells'
  - renesas,vbattb-load-nanofarads

additionalProperties: false

examples:
  - |
    #include <dt-bindings/clock/r9a08g045-cpg.h>
    #include <dt-bindings/interrupt-controller/arm-gic.h>

    vbattb: vbattb@1005c000 {
        compatible = "renesas,rzg3s-vbattb", "syscon", "simple-mfd";
        reg = <0x1005c000 0x1000>;
        ranges = <0 0 0x1005c000 0 0x1000>;
        interrupts = <GIC_SPI 43 IRQ_TYPE_LEVEL_HIGH>;
        interrupt-names = "tampdi";
        clocks = <&cpg CPG_MOD R9A08G045_VBAT_BCLK>;
        clock-names = "bclk";
        power-domains = <&cpg>;
        resets = <&cpg R9A08G045_VBAT_BRESETN>;
        #address-cells = <2>;
        #size-cells = <2>;
        status = "disabled";

        vbattclk: clock-controller@1c {
            compatible = "renesas,rzg3s-vbattb-clk";
            reg = <0 0x1c 0 0x10>;
            clocks = <&cpg CPG_MOD R9A08G045_VBAT_BCLK>, <&vbattb_xtal>;
            clock-names = "bclk", "vbattb_xtal";
            #clock-cells = <0>;
            power-domains = <&cpg>;
            status = "disabled";
        };
    };

...
```

## Documentation/devicetree/bindings/clock/renesas,rzv2h-cpg.yaml
```yaml
# SPDX-License-Identifier: (GPL-2.0-only OR BSD-2-Clause)
%YAML 1.2
---
$id: http://devicetree.org/schemas/clock/renesas,rzv2h-cpg.yaml#
$schema: http://devicetree.org/meta-schemas/core.yaml#

title: Renesas RZ/V2H(P) Clock Pulse Generator (CPG)

maintainers:
  - Lad Prabhakar <prabhakar.mahadev-lad.rj@bp.renesas.com>

description: |
  On Renesas RZ/V2H(P) SoC's, the CPG (Clock Pulse Generator) handles the generation
  and control of clock signals for the IP modules, the generation and control of resets,
  and control over booting, low power consumption and the power supply domains.

properties:
  compatible:
    const: renesas,r9a09g057-cpg

  reg:
    maxItems: 1

  clocks:
    maxItems: 1

  clock-names:
    description:
      Clock source to CPG can be either from external clock input (EXCLK) or
      crystal oscillator (XIN/XOUT).
    const: extal

  '#clock-cells':
    description: |
      - For CPG core clocks, the two clock specifier cells must be "CPG_CORE"
        and a core clock reference, as defined in
        <dt-bindings/clock/r9a09g057-cpg.h>,
      - For module clocks, the two clock specifier cells must be "CPG_MOD" and
        a module number, as defined in <dt-bindings/clock/r9a09g057-cpg.h>.
    const: 2

  '#power-domain-cells':
    description:
      SoC devices that are part of the CPG/Module Standby Mode Clock Domain and
      can be power-managed through Module Standby should refer to the CPG device
      node in their "power-domains" property, as documented by the generic PM
      Domain bindings in Documentation/devicetree/bindings/power/power-domain.yaml.
      The power domain specifiers defined in <dt-bindings/clock/r9a09g057-cpg.h> could
      be used to reference individual CPG power domains.

  '#reset-cells':
    description:
      The single reset specifier cell must be the module number, as defined in
      <dt-bindings/clock/r9a09g057-cpg.h>.
    const: 1

required:
  - compatible
  - reg
  - clocks
  - clock-names
  - '#clock-cells'
  - '#power-domain-cells'
  - '#reset-cells'

additionalProperties: false

examples:
  - |
    cpg: clock-controller@10420000 {
            compatible = "renesas,r9a09g057-cpg";
            reg = <0x10420000 0x10000>;
            clocks = <&extal_clk>;
            clock-names = "extal";
            #clock-cells = <2>;
            #power-domain-cells = <0>;
            #reset-cells = <1>;
    };
```

## Documentation/devicetree/bindings/clock/renesas,sh7750-cpg.yaml
```yaml
# SPDX-License-Identifier: (GPL-2.0-only OR BSD-2-Clause)
%YAML 1.2
---
$id: http://devicetree.org/schemas/clock/renesas,sh7750-cpg.yaml#
$schema: http://devicetree.org/meta-schemas/core.yaml#

title: Renesas SH7750/7751 Clock Pulse Generator (CPG)

maintainers:
  - Yoshinori Sato <ysato@users.sourceforge.jp>

description:
  The Clock Pulse Generator (CPG) generates core clocks for the SoC.  It
  includes PLLs, and variable ratio dividers.

  The CPG may also provide a Clock Domain for SoC devices, in combination with
  the CPG Module Stop (MSTP) Clocks.

properties:
  compatible:
    items:
      - enum:
          - renesas,sh7750-cpg             # SH7750
          - renesas,sh7750s-cpg            # SH775S
          - renesas,sh7750r-cpg            # SH7750R
          - renesas,sh7751-cpg             # SH7751
          - renesas,sh7751r-cpg            # SH7751R
      - const: renesas,sh7750-cpg

  reg:
    maxItems: 2

  reg-names:
    items:
      - const: FRQCR
      - const: CLKSTP00

  clocks: true

  clock-names: true

  '#clock-cells':
    const: 1

  renesas,mode:
    description: Board-specific settings of the MD[0-2] pins on SoC
    $ref: /schemas/types.yaml#/definitions/uint32
    minimum: 0
    maximum: 6

  '#power-domain-cells':
    const: 0

required:
  - compatible
  - reg
  - reg-names
  - clocks
  - clock-names
  - '#clock-cells'

additionalProperties: false

examples:
  - |
    #include <dt-bindings/clock/sh7750.h>
    cpg: clock-controller@ffc00000 {
        #clock-cells = <1>;
        #power-domain-cells = <0>;
        compatible = "renesas,sh7751r-cpg";
        clocks = <&xtal>;
        clock-names = "xtal";
        reg = <0xffc00000 20>, <0xfe0a0000 16>;
    };
```

## Documentation/devicetree/bindings/clock/rockchip,clk-pvtpll.yaml
```yaml
# SPDX-License-Identifier: GPL-2.0-only OR BSD-2-Clause
%YAML 1.2
---
$id: http://devicetree.org/schemas/clock/rockchip,clk-pvtpll.yaml#
$schema: http://devicetree.org/meta-schemas/core.yaml#

title: Rockchip Pvtpll

maintainers:
  - Elaine Zhang <zhangqing@rock-chips.com>
  - Heiko Stuebner <heiko@sntech.de>

properties:
  compatible:
    enum:
      - rockchip,rv1103b-core-pvtpll
      - rockchip,rv1103b-enc-pvtpll
      - rockchip,rv1103b-isp-pvtpll
      - rockchip,rv1103b-npu-pvtpll
      - rockchip,rv1126b-core-pvtpll
      - rockchip,rv1126b-isp-pvtpll
      - rockchip,rv1126b-enc-pvtpll
      - rockchip,rv1126b-aisp-pvtpll
      - rockchip,rv1126b-npu-pvtpll
      - rockchip,rk3506-core-pvtpll

  reg:
    maxItems: 1

  "#clock-cells":
    const: 0

  clocks:
    maxItems: 1

  clock-output-names:
    maxItems: 1

  rockchip,cru:
    $ref: /schemas/types.yaml#/definitions/phandle
    description: |
      Phandle to the main Clock and Reset Unit (CRU) controller.
      Required for PVTPLLs that need to interact with the main CRU
      for clock management operations.

required:
  - "#clock-cells"
  - compatible
  - reg
  - clock-output-names

additionalProperties: false

examples:
  - |
    pvtpll_core: pvtpll-core@20480000 {
      compatible = "rockchip,rv1126b-core-pvtpll", "syscon";
      reg = <0x20480000 0x100>;
      #clock-cells = <0>;
      clock-output-names = "clk_core_pvtpll";
    };

  - |
    pvtpll_isp: pvtpll-isp@21c60000 {
      compatible = "rockchip,rv1126b-isp-pvtpll";
      reg = <0x21c60000 0x100>;
      rockchip,cru = <&cru>;
      #clock-cells = <0>;
      clock-output-names = "clk_isp_pvtpll";
    };

  - |
    pvtpll_enc: pvtpll-enc@21f00000 {
      compatible = "rockchip,rv1126b-enc-pvtpll";
      reg = <0x21f00000 0x100>;
      #clock-cells = <0>;
      clock-output-names = "clk_vepu_pvtpll";
    };

  - |
    pvtpll_aisp: pvtpll-aisp@21fc0000 {
      compatible = "rockchip,rv1126b-aisp-pvtpll";
      reg = <0x21fc0000 0x100>;
      rockchip,cru = <&cru>;
      #clock-cells = <0>;
      clock-output-names = "clk_vcp_pvtpll";
    };

  - |
    pvtpll_npu: pvtpll-npu@22080000 {
      compatible = "rockchip,rv1126b-npu-pvtpll", "syscon";
      reg = <0x22080000 0x100>;
      rockchip,cru = <&cru>;
      #clock-cells = <0>;
      clock-output-names = "clk_npu_pvtpll";
    };

...
```

## Documentation/devicetree/bindings/clock/rockchip,pvtpll.yaml
```yaml
# SPDX-License-Identifier: GPL-2.0-only OR BSD-2-Clause
%YAML 1.2
---
$id: http://devicetree.org/schemas/clock/rockchip,pvtpll.yaml#
$schema: http://devicetree.org/meta-schemas/core.yaml#

title: Rockchip Pvtpll

maintainers:
  - Elaine Zhang <zhangqing@rock-chips.com>
  - Heiko Stuebner <heiko@sntech.de>

properties:
  compatible:
    enum:
      - rockchip,rv1103b-core-pvtpll
      - rockchip,rv1103b-enc-pvtpll
      - rockchip,rv1103b-isp-pvtpll
      - rockchip,rv1103b-npu-pvtpll
      - rockchip,rv1126b-core-pvtpll
      - rockchip,rv1126b-isp-pvtpll
      - rockchip,rv1126b-enc-pvtpll
      - rockchip,rv1126b-aisp-pvtpll
      - rockchip,rv1126b-npu-pvtpll
      - rockchip,rk3506-core-pvtpll

  reg:
    maxItems: 1

  "#clock-cells":
    const: 0

  clocks:
    maxItems: 1

  clock-output-names:
    maxItems: 1

  rockchip,cru:
    $ref: /schemas/types.yaml#/definitions/phandle
    description: |
      Phandle to the main Clock and Reset Unit (CRU) controller.
      Required for PVTPLLs that need to interact with the main CRU
      for clock management operations.

required:
  - compatible
  - reg
  - "#clock-cells"
  - clock-output-names

additionalProperties: false

examples:
  - |
    pvtpll@20480000 {
      compatible = "rockchip,rv1126b-core-pvtpll";
      reg = <0x20480000 0x100>;
      #clock-cells = <0>;
      clock-output-names = "clk_core_pvtpll";
    };

  - |
    pvtpll@21c60000 {
      compatible = "rockchip,rv1126b-isp-pvtpll";
      reg = <0x21c60000 0x100>;
      #clock-cells = <0>;
      clock-output-names = "clk_isp_pvtpll";
      rockchip,cru = <&cru>;
    };

  - |
    pvtpll@21f00000 {
      compatible = "rockchip,rv1126b-enc-pvtpll";
      reg = <0x21f00000 0x100>;
      #clock-cells = <0>;
      clock-output-names = "clk_vepu_pvtpll";
    };

  - |
    pvtpll@21fc0000 {
      compatible = "rockchip,rv1126b-aisp-pvtpll";
      reg = <0x21fc0000 0x100>;
      #clock-cells = <0>;
      clock-output-names = "clk_vcp_pvtpll";
      rockchip,cru = <&cru>;
    };

  - |
    pvtpll@22080000 {
      compatible = "rockchip,rv1126b-npu-pvtpll";
      reg = <0x22080000 0x100>;
      #clock-cells = <0>;
      clock-output-names = "clk_npu_pvtpll";
      rockchip,cru = <&cru>;
    };

...
```

## Documentation/devicetree/bindings/clock/rockchip,rk3576-cru.yaml
```yaml
# SPDX-License-Identifier: GPL-2.0-only OR BSD-2-Clause
%YAML 1.2
---
$id: http://devicetree.org/schemas/clock/rockchip,rk3576-cru.yaml#
$schema: http://devicetree.org/meta-schemas/core.yaml#

title: Rockchip rk3576 Family Clock and Reset Control Module

maintainers:
  - Elaine Zhang <zhangqing@rock-chips.com>
  - Heiko Stuebner <heiko@sntech.de>

description: |
  The RK3576 clock controller generates the clock and also implements a reset
  controller for SoC peripherals. For example it provides SCLK_UART2 and
  PCLK_UART2, as well as SRST_P_UART2 and SRST_S_UART2 for the second UART
  module.

properties:
  compatible:
    enum:
      - rockchip,rk3576-cru

  reg:
    maxItems: 1

  "#clock-cells":
    const: 1

  "#reset-cells":
    const: 1

  clocks:
    maxItems: 2

  clock-names:
    items:
      - const: xin24m
      - const: xin32k

  rockchip,grf:
    $ref: /schemas/types.yaml#/definitions/phandle
    description: >
      phandle to the syscon managing the "general register files". It is used
      for GRF muxes, if missing any muxes present in the GRF will not be
      available.

required:
  - compatible
  - reg
  - "#clock-cells"
  - "#reset-cells"

additionalProperties: false

examples:
  - |
    #include <dt-bindings/clock/rockchip,rk3576-cru.h>
    clock-controller@27200000 {
      compatible = "rockchip,rk3576-cru";
      reg = <0xfd7c0000 0x5c000>;
      #clock-cells = <1>;
      #reset-cells = <1>;
      assigned-clocks =
        <&cru CLK_AUDIO_FRAC_1_SRC>,
        <&cru PLL_GPLL>, <&cru PLL_CPLL>,
        <&cru PLL_AUPLL>, <&cru CLK_UART_FRAC_0>,
        <&cru CLK_UART_FRAC_1>, <&cru CLK_UART_FRAC_2>,
        <&cru CLK_AUDIO_FRAC_0>, <&cru CLK_AUDIO_FRAC_1>,
        <&cru CLK_CPLL_DIV2>, <&cru CLK_CPLL_DIV4>,
        <&cru CLK_CPLL_DIV10>, <&cru FCLK_DDR_CM0_CORE>,
        <&cru ACLK_PHP_ROOT>;
      assigned-clock-parents = <&cru PLL_AUPLL>;
      assigned-clock-rates =
        <0>,
        <1188000000>, <1000000000>,
        <786432000>, <18432000>,
        <96000000>, <128000000>,
        <45158400>, <49152000>,
        <500000000>, <250000000>,
        <100000000>, <500000000>,
        <250000000>;
      rockchip,grf = <&pmu0_grf>;
    };
```

## Documentation/devicetree/bindings/clock/rockchip,rv1103b-cru.yaml
```yaml
# SPDX-License-Identifier: GPL-2.0-only OR BSD-2-Clause
%YAML 1.2
---
$id: http://devicetree.org/schemas/clock/rockchip,rv1103b-cru.yaml#
$schema: http://devicetree.org/meta-schemas/core.yaml#

title: Rockchip RV1103B Clock and Reset Unit

maintainers:
  - Fabio Estevam <festevam@nabladev.com>
  - Heiko Stuebner <heiko@sntech.de>

description: |
  The RV1103B clock controller generates and supplies clocks to various
  controllers within the SoC and also implements a reset controller for SoC
  peripherals.
  Each clock is assigned an identifier and client nodes can use this identifier
  to specify the clock which they consume. All available clocks are defined as
  preprocessor macros in the dt-bindings/clock/rockchip,rv1103b-cru.h header
  and can be used in device tree sources. Similar macros exist for the reset
  sources in these files.
  There are several clocks that are generated outside the SoC. It is expected
  that they are defined using standard clock bindings with following
  clock-output-names:
    - "xin24m"   - crystal input                              - required
    - "xin32k"   - rtc clock                                  - optional

properties:
  compatible:
    enum:
      - rockchip,rv1103b-cru

  reg:
    maxItems: 1

  "#clock-cells":
    const: 1

  "#reset-cells":
    const: 1

  clocks:
    maxItems: 1

  clock-names:
    const: xin24m

required:
  - compatible
  - reg
  - "#clock-cells"
  - "#reset-cells"

additionalProperties: false

examples:
  - |
    clock-controller@20000000 {
      compatible = "rockchip,rv1103b-cru";
      reg = <0x20000000 0x81000>;
      #clock-cells = <1>;
      #reset-cells = <1>;
    };
```
