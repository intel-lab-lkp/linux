## Documentation/devicetree/bindings/clock/sprd,ums512-clk.yaml
```yaml
# SPDX-License-Identifier: (GPL-2.0-only OR BSD-2-Clause)
# Copyright 2022 Unisoc Inc.
%YAML 1.2
---
$id: http://devicetree.org/schemas/clock/sprd,ums512-clk.yaml#
$schema: http://devicetree.org/meta-schemas/core.yaml#

title: UMS512 Soc clock controller

maintainers:
  - Orson Zhai <orsonzhai@gmail.com>
  - Baolin Wang <baolin.wang7@gmail.com>
  - Chunyan Zhang <zhang.lyra@gmail.com>

properties:
  compatible:
    enum:
      - sprd,ums512-apahb-gate
      - sprd,ums512-ap-clk
      - sprd,ums512-aonapb-clk
      - sprd,ums512-pmu-gate
      - sprd,ums512-g0-pll
      - sprd,ums512-g2-pll
      - sprd,ums512-g3-pll
      - sprd,ums512-gc-pll
      - sprd,ums512-aon-gate
      - sprd,ums512-audcpapb-gate
      - sprd,ums512-audcpahb-gate
      - sprd,ums512-gpu-clk
      - sprd,ums512-mm-clk
      - sprd,ums512-mm-gate-clk
      - sprd,ums512-apapb-gate
      - sprd,ums9620-pmu-gate
      - sprd,ums9620-g1-pll
      - sprd,ums9620-g5l-pll
      - sprd,ums9620-g5r-pll
      - sprd,ums9620-g8-pll
      - sprd,ums9620-g9-pll
      - sprd,ums9620-g10-pll
      - sprd,ums9620-apapb-gate
      - sprd,ums9620-ap-clk
      - sprd,ums9620-apahb-gate
      - sprd,ums9620-aon-gate
      - sprd,ums9620-aonapb-clk
      - sprd,ums9620-topdvfs-clk
      - sprd,ums9620-ipaapb-gate
      - sprd,ums9620-ipa-clk
      - sprd,ums9620-ipaglb-gate
      - sprd,ums9620-ipadispc-gate
      - sprd,ums9620-pcieapb-gate
      - sprd,ums9620-pcie-clk
      - sprd,ums9620-mm-gate
      - sprd,ums9620-mm-clk
      - sprd,ums9620-dpu-vsp-gate
      - sprd,ums9620-dpu-vsp-clk

  "#clock-cells":
    const: 1

  clocks:
    description: |
      The input parent clock(s) phandle for the clock, only list
      fixed clocks which are declared in devicetree.

  reg:
    maxItems: 1

required:
  - compatible
  - '#clock-cells'
  - reg

allOf:
  - if:
      properties:
        compatible:
          contains:
            pattern: "^sprd,ums512-.*"

    then:
      properties:
        clocks:
          minItems: 1
          maxItems: 4

        clock-names:
          minItems: 1
          items:
            - const: ext-26m
            - const: ext-32k
            - const: ext-4m
            - const: rco-100m

  - if:
      properties:
        compatible:
          contains:
            pattern: "^sprd,ums9620-.*"
    then:
      properties:
        clocks:
          minItems: 1
          maxItems: 6

        clock-names:
          minItems: 1
          maxItems: 6

unevaluatedProperties: false

examples:
  - |
    ap_clk: clock-controller@20200000 {
      compatible = "sprd,ums512-ap-clk";
      reg = <0x20200000 0x1000>;
      clocks = <&ext_26m>;
      clock-names = "ext-26m";
      #clock-cells = <1>;
    };

    aonapb_gate: clock-controller@0 {
      compatible = "sprd,ums9620-aon-gate";
      reg = <0x0 0x3000>;
      clocks = <&ext_26m>, <&ext_32k>, <&rco_60m>;
      clock-names = "ext-26m", "ext-32k", "rco-60m";
      #clock-cells = <1>;
    };
...
```

## Documentation/devicetree/bindings/clock/st,stm32-rcc.yaml
```yaml
# SPDX-License-Identifier: (GPL-2.0-only OR BSD-2-Clause)
%YAML 1.2
---
$id: http://devicetree.org/schemas/clock/st,stm32-rcc.yaml#
$schema: http://devicetree.org/meta-schemas/core.yaml#

title: STMicroelectronics STM32 Reset Clock Controller

maintainers:
  - Dario Binacchi <dario.binacchi@amarulasolutions.com>

description: |
  The RCC IP is both a reset and a clock controller.

  This binding uses common clock and reset bindings
  Documentation/devicetree/bindings/clock/clock-bindings.txt
  Documentation/devicetree/bindings/reset/reset.txt

  Specifying softreset control of devices
  =======================================

  Device nodes should specify the reset channel required in their "resets"
  property, containing a phandle to the reset device node and an index specifying
  which channel to use.
  The index is the bit number within the RCC registers bank, starting from RCC
  base address.
  It is calculated as: index = register_offset / 4 * 32 + bit_offset.
  Where bit_offset is the bit offset within the register.

  For example, for CRC reset:
  crc = AHB1RSTR_offset / 4 * 32 + CRCRST_bit_offset = 0x10 / 4 * 32 + 12 = 140

  The list of valid indices is available in:
  - include/dt-bindings/mfd/stm32f4-rcc.h for STM32F4 series
  - include/dt-bindings/mfd/stm32f7-rcc.h for STM32F7 series
  - include/dt-bindings/mfd/stm32h7-rcc.h for STM32H7 series

properties:
  compatible:
    oneOf:
      - items:
          - const: st,stm32f42xx-rcc
          - const: st,stm32-rcc
      - items:
          - enum:
              - st,stm32f469-rcc
          - const: st,stm32f42xx-rcc
          - const: st,stm32-rcc
      - items:
          - const: st,stm32f746-rcc
          - const: st,stm32-rcc
      - items:
          - enum:
              - st,stm32f769-rcc
          - const: st,stm32f746-rcc
          - const: st,stm32-rcc
      - items:
          - const: st,stm32h743-rcc
          - const: st,stm32-rcc

  reg:
    maxItems: 1

  '#reset-cells':
    const: 1

  '#clock-cells':
    enum: [1, 2]

  clocks:
    minItems: 2
    maxItems: 3

  st,syscfg:
    $ref: /schemas/types.yaml#/definitions/phandle
    description:
      Phandle to system configuration controller. It can be used to control the
      power domain circuitry.

  st,ssc-modfreq-hz:
    description:
      The modulation frequency for main PLL (in Hz)

  st,ssc-moddepth-permyriad:
    $ref: /schemas/types.yaml#/definitions/uint32
    description:
      The modulation rate for main PLL (in permyriad, i.e. 0.01%)
    minimum: 25
    maximum: 200

  st,ssc-modmethod:
    $ref: /schemas/types.yaml#/definitions/non-unique-string-array
    description:
      The modulation techniques for main PLL.
    items:
      enum:
        - center-spread
        - down-spread

required:
  - compatible
  - reg
  - '#reset-cells'
  - '#clock-cells'
  - clocks
  - st,syscfg

allOf:
  - if:
      properties:
        compatible:
          contains:
            const: st,stm32h743-rcc
    then:
      properties:
        '#clock-cells':
          const: 1
          description: |
            The clock index for the specified type.
        st,ssc-modfreq-hz: false
        st,ssc-moddepth-permyriad: false
        st,ssc-modmethod: false

    else:
      properties:
        '#clock-cells':
          const: 2
          description: |
            - The first cell is the clock type, possible values are 0 for
              gated clocks and 1 otherwise.
            - The second cell is the clock index for the specified type.

additionalProperties: false

examples:
  # Reset and Clock Control Module node:
  - |
    rcc@40023800 {
        #reset-cells = <1>;
        #clock-cells = <2>;
        compatible = "st,stm32f42xx-rcc", "st,stm32-rcc";
        reg = <0x40023800 0x400>;
        clocks = <&clk_hse>, <&clk_i2s_ckin>;
        st,syscfg = <&pwrcfg>;
        st,ssc-modfreq-hz = <10000>;
        st,ssc-moddepth-permyriad = <200>;
        st,ssc-modmethod = "center-spread";
    };

  - |
    rcc@40023800 {
        #reset-cells = <1>;
        #clock-cells = <2>;
        compatible = "st,stm32f746-rcc", "st,stm32-rcc";
        reg = <0x40023800 0x400>;
        clocks = <&clk_hse>, <&clk_i2s_ckin>;
        st,syscfg = <&pwrcfg>;
    };

  - |
    rcc@58024400 {
        compatible = "st,stm32h743-rcc", "st,stm32-rcc";
        reg = <0x58024400 0x400>;
        #clock-cells = <1>;
        #reset-cells = <1>;
        clocks = <&clk_hse>, <&clk_lse>, <&clk_i2s>;
        st,syscfg = <&pwrcfg>;
    };

...
```

## Documentation/devicetree/bindings/clock/st,stm32mp25-rcc.yaml
```yaml
# SPDX-License-Identifier: (GPL-2.0-only OR BSD-2-Clause)
%YAML 1.2
---
$id: http://devicetree.org/schemas/clock/st,stm32mp25-rcc.yaml#
$schema: http://devicetree.org/meta-schemas/core.yaml#

title: STM32MP25 Reset Clock Controller

maintainers:
  - Gabriel Fernandez <gabriel.fernandez@foss.st.com>

description: |
  The RCC hardware block is both a reset and a clock controller.
  RCC makes also power management (resume/supend).

  See also::
    include/dt-bindings/clock/st,stm32mp25-rcc.h
    include/dt-bindings/reset/st,stm32mp25-rcc.h

properties:
  compatible:
    enum:
      - st,stm32mp25-rcc

  reg:
    maxItems: 1

  '#clock-cells':
    const: 1

  '#reset-cells':
    const: 1

  clocks:
    description: Specifies oscillators.
    maxItems: 5

  clock-names:
    items:
      - const: hse
      - const: hsi
      - const: msi
      - const: lse
      - const: lsi

required:
  - compatible
  - reg
  - "#clock-cells"
  - "#reset-cells"
  - clocks
  - clock-names

additionalProperties: false

examples:
  - |
    #include <dt-bindings/clock/st,stm32mp25-rcc.h>

    rcc: clock-controller@44200000 {
        compatible = "st,stm32mp25-rcc";
        reg = <0x44200000 0x10000>;
        #clock-cells = <1>;
        #reset-cells = <1>;
        clock-names = "hse", "hsi", "msi", "lse", "lsi";
        clocks = <&scmi_clk CK_SCMI_HSE>,
                 <&scmi_clk CK_SCMI_HSI>,
                 <&scmi_clk CK_SCMI_MSI>,
                 <&scmi_clk CK_SCMI_LSE>,
                 <&scmi_clk CK_SCMI_LSI>;
    };
...
```

## Documentation/devicetree/bindings/clock/syna,sl261x-clk.yaml
```yaml
# SPDX-License-Identifier: (GPL-2.0-only OR BSD-2-Clause)
%YAML 1.2
---
$id: http://devicetree.org/schemas/clock/syna,sl261x-clk.yaml#
$schema: http://devicetree.org/meta-schemas/core.yaml#

title: Synaptics SL261x clock controllers

maintainers:
  - Jisheng Zhang <jszhang@kernel.org>

description: |
  The SL261x clock hardware is divided into SoC, CPU, AIO, and system
  manager register blocks. Each clock controller is a child of the node
  containing its register range. The CPU clock node has a phandle to the
  global chip control syscon.

properties:
  compatible:
    oneOf:
      - enum:
          - syna,sl261x-soc-clk
          - syna,sl261x-cpu-clk
          - syna,sl261x-aio-clk
          - syna,sl261x-system-clk
      - items:
          - const: simple-mfd
          - const: syscon

  reg:
    maxItems: 1

  syna,gbl-syscon:
    $ref: /schemas/types.yaml#/definitions/phandle
    description: Phandle to the SL261x global chip control syscon.

  '#clock-cells':
    const: 1

  clocks:
    maxItems: 1
    description: Reference clock used as the input to the PLLs.

required:
  - compatible

allOf:
  - if:
      properties:
        compatible:
          contains:
            const: syna,sl261x-cpu-clk
    then:
      required:
        - syna,gbl-syscon
    else:
      properties:
        syna,gbl-syscon: false

additionalProperties: false

examples:
  - |
    osc: clock-osc {
        compatible = "fixed-clock";
        #clock-cells = <0>;
        clock-frequency = <25000000>;
    };

    chip: syscon@f7e10000 {
        compatible = "syscon", "simple-mfd";
        reg = <0xf7e10000 0x10000>;

        clk: clock {
            compatible = "syna,sl261x-soc-clk";
            #clock-cells = <1>;
            clocks = <&osc>;
        };
    };

    cpu_wrap: cpu-wrap@f7e30000 {
        compatible = "syscon", "simple-mfd";
        reg = <0xf7e30000 0x4000>;

        cpuclk: clock {
            compatible = "syna,sl261x-cpu-clk";
            #clock-cells = <1>;
            clocks = <&osc>;
            syna,gbl-syscon = <&chip>;
        };
    };
...
```

## Documentation/devicetree/bindings/clock/tenstorrent,atlantis-prcm.yaml
```yaml
# SPDX-License-Identifier: (GPL-2.0-only OR BSD-2-Clause)
%YAML 1.2
---
$id: http://devicetree.org/schemas/clock/tenstorrent,atlantis-prcm.yaml#
$schema: http://devicetree.org/meta-schemas/core.yaml#

title: Tenstorrent Atlantis PRCM (Power, Reset, Clock Management) Module

maintainers:
  - Anirudh Srinivasan <asrinivasan@oss.tenstorrent.com>

description:
  Multifunctional register block found in Tenstorrent Atlantis SoC whose main
  function is to control clocks and resets. This block is instantiated multiple
  times in the SoC, each block controls clock and resets for a different
  subsystem. RCPU prcm serves low speed IO interfaces. PCIe prcm serves all
  PCIe related functions, HSIO prcm serves high speed IO interfaces (Ethernet,
  USB), MM prcm serves GPU, display and video processing functions.

properties:
  compatible:
    enum:
      - tenstorrent,atlantis-prcm-rcpu
      - tenstorrent,atlantis-prcm-pcie
      - tenstorrent,atlantis-prcm-mm
      - tenstorrent,atlantis-prcm-hsio

  reg:
    maxItems: 1

  clocks:
    maxItems: 1

  "#clock-cells":
    const: 1
    description:
      See <dt-bindings/clock/tenstorrent,atlantis-prcm.h> for valid indices.

  "#reset-cells":
    const: 1

  tenstorrent,prcm-rcpu:
    $ref: /schemas/types.yaml#/definitions/phandle
    description:
      Phandle reference to RCPU prcm, needed by other 3 prcms (PCIe, MM, HSIO)
      as the control registers for the PLLs that drive these subsystems are in
      RCPU prcm's range

required:
  - compatible
  - reg
  - clocks
  - "#clock-cells"
  - "#reset-cells"

allOf:
  - if:
      properties:
        compatible:
          contains:
            enum:
              - tenstorrent,atlantis-prcm-pcie
              - tenstorrent,atlantis-prcm-mm
              - tenstorrent,atlantis-prcm-hsio
    then:
      required:
        - tenstorrent,prcm-rcpu
    else:
      properties:
        tenstorrent,prcm-rcpu: false

additionalProperties: false

examples:
  - |
    clock-controller@a8000000 {
      compatible = "tenstorrent,atlantis-prcm-rcpu";
      reg = <0xa8000000 0x10000>;
      clocks = <&osc_24m>;
      #clock-cells = <1>;
      #reset-cells = <1>;
    };
```
