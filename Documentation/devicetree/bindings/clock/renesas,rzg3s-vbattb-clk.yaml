## Documentation/devicetree/bindings/clock/ti,cdce6214.yaml
```yaml
# SPDX-License-Identifier: (GPL-2.0-only OR BSD-2-Clause)
%YAML 1.2
---
$id: http://devicetree.org/schemas/clock/ti,cdce6214.yaml#
$schema: http://devicetree.org/meta-schemas/core.yaml#

title: TI CDCE6214 programmable clock generator with PLL

maintainers:
  - Sascha Hauer <s.hauer@pengutronix.de>

description: >
  Ultra-Low Power Clock Generator With One PLL, Four Differential Outputs,
  Two Inputs, and Internal EEPROM

  - CDCE6214: https://www.ti.com/product/CDCE6214

properties:
  compatible:
    enum:
      - ti,cdce6214

  reg:
    maxItems: 1

  clocks:
    minItems: 1
    maxItems: 2

  clock-names:
    minItems: 1
    items:
      - enum: [ priref, secref ]
      - const: secref

  '#address-cells':
    const: 1

  '#size-cells':
    const: 0

  '#clock-cells':
    const: 1

patternProperties:
  '-pins$':
    type: object
    additionalProperties: false
    patternProperties:
      '^conf':
        type: object
        additionalProperties: false
        $ref: /schemas/pinctrl/pincfg-node.yaml#

        properties:
          pins:
            items:
              enum: [priref, secref, out0, out1, out2, out3, out4 ]
          io-standard:
            description: |
              1: CMOS
              2: LVDS
              3: Low-Power HCSL
              4: XTAL mode
              5: differential
            enum: [1, 2, 3, 4, 5]
            $ref: /schemas/types.yaml#/definitions/uint32
          xo-cload-femtofarad:
            description: >
              Load capacity for XO in Femtofarad
            $ref: /schemas/types.yaml#/definitions/uint32
          xo-bias-microampere:
            description: |
              Bias current setting of the XO
            $ref: /schemas/types.yaml#/definitions/uint32
          cmosp-mode:
            description: |
              Driving mode for CMOSN output:
              1: Low Polarity
              2: High Polrity
              3: Disable
            $ref: /schemas/types.yaml#/definitions/uint32
            maximum: 3
          cmosn-mode:
            description: |
              Driving mode for CMOSN output:
              1: Low Polarity
              2: High Polrity
              3: Disable
            $ref: /schemas/types.yaml#/definitions/uint32
            maximum: 3

        allOf:
          - if:
              properties:
                pins:
                  contains:
                    const: priref
            then:
              properties:
                io-standard:
                  enum: [ 1, 5 ]

          - if:
              properties:
                pins:
                  contains:
                    const: secref
            then:
              properties:
                io-standard:
                  enum: [ 1, 4, 5 ]

          - if:
              properties:
                pins:
                  contains:
                    const: out0
            then:
              properties:
                io-standard:
                  enum: [ 1 ]

          - if:
              properties:
                pins:
                  contains:
                    enum:
                      - out1
                      - out4
            then:
              properties:
                io-standard:
                  enum: [ 1, 2, 3 ]

          - if:
              properties:
                pins:
                  contains:
                    enum:
                      - out2
                      - out3
            then:
              properties:
                io-standard:
                  enum: [ 2, 3 ]

        required:
          - pins

required:
  - compatible
  - reg
  - clocks
  - '#clock-cells'

additionalProperties: false

examples:
  - |
    #include <dt-bindings/clock/ti,cdce6214.h>
    i2c {
        #address-cells = <1>;
        #size-cells = <0>;

        clock-generator@67 {
            compatible = "ti,cdce6214";
            reg = <0x67>;
            #address-cells = <1>;
            #size-cells = <0>;
            #clock-cells = <1>;
            clocks = <&clock_ref25m>;
            clock-names = "priref";

            cdce6214_pins: cdce6214-pins {
                conf1 {
                    pins = "secref";
                    io-standard = <CDCE6214_IOSTD_XTAL>;
                    xo-cload-femtofarad = <8100>;
                    xo-bias-microampere = <100>;
                };

                conf2 {
                    pins = "out1";
                    io-standard = <CDCE6214_IOSTD_CMOS>;
                    cmosp-mode = <CDCE6214_CMOS_MODE_HIGH>;
                    cmosn-mode = <CDCE6214_CMOS_MODE_LOW>;
                };

                conf3 {
                    pins = "out4";
                    io-standard = <CDCE6214_IOSTD_CMOS>;
                    cmosp-mode = <CDCE6214_CMOS_MODE_HIGH>;
                    cmosn-mode = <CDCE6214_CMOS_MODE_LOW>;
                };
            };
        };
    };
```

## Documentation/devicetree/bindings/clock/ti,twl6032-clk.yaml
```yaml
# SPDX-License-Identifier: (GPL-2.0 OR BSD-2-Clause)
%YAML 1.2
---
$id: http://devicetree.org/schemas/clock/ti,twl6032-clk.yaml#
$schema: http://devicetree.org/meta-schemas/core.yaml#

title: Clocks of the TWL6032 PMIC

maintainers:
  - Andreas Kemnade <andreas@kemnade.info>

description:
  The TWL6032 has some 32Khz clock outputs which can be controlled.

properties:
  compatible:
    enum:
      - ti,twl6032-clk32kaudio
      - ti,twl6032-clk32kg

  '#clock-cells':
    const: 0

required:
  - compatible
  - '#clock-cells'

additionalProperties: false

examples:
  - |
    twl {
        clk32kaudio {
            compatible = "ti,twl6032-clk32kaudio";
            #clock-cells = <0>;
        };
    };
...
```

## Documentation/devicetree/bindings/clock/ti/ti,dm814-adpll-clock.yaml
```yaml
# SPDX-License-Identifier: (GPL-2.0-only OR BSD-2-Clause)
%YAML 1.2
---
$id: http://devicetree.org/schemas/clock/ti/ti,dm814-adpll-clock.yaml#
$schema: http://devicetree.org/meta-schemas/core.yaml#

title: Texas Instruments DM814x ADPLL Clock

maintainers:
  - Tony Lindgren <tony@atomide.com>

description:
  The ADPLL is a register-mapped clock generator found on TI DM814x SoCs. It
  provides multiple output clocks from two or three selectable input clocks and
  three to four children.

properties:
  compatible:
    enum:
      - ti,dm814-adpll-s-clock
      - ti,dm814-adpll-lj-clock

  reg:
    maxItems: 1

  '#clock-cells':
    const: 1

  clocks:
    minItems: 2
    maxItems: 3

  clock-names:
    minItems: 2
    maxItems: 3

  clock-output-names:
    minItems: 3
    maxItems: 4

required:
  - compatible
  - reg
  - '#clock-cells'
  - clocks
  - clock-output-names

if:
  properties:
    compatible:
      contains:
        const: ti,dm814-adpll-s-clock
then:
  properties:
    clocks:
      minItems: 3
    clock-names:
      items:
        - const: clkinp
        - const: clkinpulow
        - const: clkinphif
    clock-output-names:
      items:
        - description: dcoclkldo
        - description: clkout
        - description: clkoutx2
        - description: clkouthif
else:
  properties:
    clocks:
      maxItems: 2
    clock-names:
      items:
        - const: clkinp
        - const: clkinpulow
    clock-output-names:
      items:
        - description: dcoclkldo
        - description: clkout
        - description: clkoutldo

additionalProperties: false

examples:
  - |
    adpll@40 {
        compatible = "ti,dm814-adpll-s-clock";
        reg = <0x40 0x40>;
        #clock-cells = <1>;
        clocks = <&devosc_ck &devosc_ck &devosc_ck>;
        clock-names = "clkinp", "clkinpulow", "clkinphif";
        clock-output-names = "481c5040.adpll.dcoclkldo",
                             "481c5040.adpll.clkout",
                             "481c5040.adpll.clkoutx2",
                             "481c5040.adpll.clkouthif";
    };

  - |
    adpll@80 {
        compatible = "ti,dm814-adpll-lj-clock";
        reg = <0x80 0x30>;
        #clock-cells = <1>;
        clocks = <&devosc_ck &devosc_ck>;
        clock-names = "clkinp", "clkinpulow";
        clock-output-names = "481c5080.adpll.dcoclkldo",
                             "481c5080.adpll.clkout",
                             "481c5080.adpll.clkoutldo";
    };
```

## Documentation/devicetree/bindings/clock/via,vt8500-clock.yaml
```yaml
# SPDX-License-Identifier: (GPL-2.0-only OR BSD-2-Clause)
%YAML 1.2
---
$id: http://devicetree.org/schemas/clock/via,vt8500-clock.yaml#
$schema: http://devicetree.org/meta-schemas/core.yaml#

title: VIA/Wondermedia VT8500 Clock Controller

maintainers:
  - Alexey Charkov <alchark@gmail.com>
  - Krzysztof Kozlowski <krzk@kernel.org>

description:
  Clock controller bindings for VIA/Wondermedia VT8500 and Wondermedia WM8xxx
  series SoCs.

properties:
  compatible:
    enum:
      - via,vt8500-pll-clock
      - wm,wm8650-pll-clock
      - wm,wm8750-pll-clock
      - wm,wm8850-pll-clock
      - via,vt8500-device-clock

  reg:
    description: Offset of the PLL register within the PMC register space.
    maxItems: 1

  clocks:
    maxItems: 1

  "#clock-cells":
    const: 0

  clock-output-names:
    maxItems: 1

  enable-reg:
    description: Offset of the clock enable register within the PMC register space.
    $ref: /schemas/types.yaml#/definitions/uint32

  enable-bit:
    description: Bit index controlling clock enable.
    $ref: /schemas/types.yaml#/definitions/uint32
    maximum: 31

  divisor-reg:
    description: Offset of the clock divisor register within the PMC register space.
    $ref: /schemas/types.yaml#/definitions/uint32

  divisor-mask:
    description: Bitmask describing the divisor field inside divisor-reg.
    $ref: /schemas/types.yaml#/definitions/uint32
    default: 0x1f

required:
  - compatible
  - clocks
  - "#clock-cells"

allOf:
  - if:
      properties:
        compatible:
          const: via,vt8500-device-clock
    then:
      properties:
        reg: false
      anyOf:
        - required:
            - enable-reg
            - enable-bit
        - required:
            - divisor-reg
  - if:
      properties:
        compatible:
          enum:
            - via,vt8500-pll-clock
            - wm,wm8650-pll-clock
            - wm,wm8750-pll-clock
            - wm,wm8850-pll-clock
    then:
      required:
        - reg

dependentRequired:
  enable-reg:
    - enable-bit
  enable-bit:
    - enable-reg
  divisor-mask:
    - divisor-reg

additionalProperties: false

examples:
  - |
    clocks {
        #address-cells = <1>;
        #size-cells = <0>;

        ref25: clock-25000000 {
            compatible = "fixed-clock";
            clock-frequency = <25000000>;
            #clock-cells = <0>;
        };

        plla: clock@200 {
            compatible = "wm,wm8650-pll-clock";
            reg = <0x200>;
            clocks = <&ref25>;
            #clock-cells = <0>;
        };

        pllb: clock@204 {
            compatible = "wm,wm8650-pll-clock";
            reg = <0x204>;
            clocks = <&ref25>;
            #clock-cells = <0>;
        };

        clksdhc: sdhc {
            compatible = "via,vt8500-device-clock";
            clocks = <&pllb>;
            #clock-cells = <0>;
            divisor-reg = <0x328>;
            divisor-mask = <0x3f>;
            enable-reg = <0x254>;
            enable-bit = <18>;
        };
    };
```
