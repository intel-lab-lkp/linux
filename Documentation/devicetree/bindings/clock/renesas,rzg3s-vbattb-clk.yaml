## Documentation/devicetree/bindings/clock/samsung,exynos8890-cmu.yaml
```yaml
# SPDX-License-Identifier: (GPL-2.0-only OR BSD-2-Clause)
%YAML 1.2
---
$id: http://devicetree.org/schemas/clock/samsung,exynos8890-cmu.yaml#
$schema: http://devicetree.org/meta-schemas/core.yaml#

title: Samsung Exynos8890 SoC clock controller

maintainers:
  - Ivaylo Ivanov <ivo.ivanov.ivanov1@gmail.com>
  - Chanwoo Choi <cw00.choi@samsung.com>
  - Krzysztof Kozlowski <krzk@kernel.org>

description: |
  Exynos8890 clock controller is comprised of several CMU units, generating
  clocks for different domains. Those CMU units are modeled as separate device
  tree nodes, and might depend on each other. The root clocks in that root tree
  are two external clocks: XTCXO (76.8 MHz) and RTCCLK (32768 Hz). XTCXO must be
  defined as a fixed-rate clock in dts, whereas RTCCLK originates from PMIC.

  CMU_TOP is a top-level CMU, where all base clocks are prepared using PLLs and
  dividers; all other clocks of function blocks (other CMUs) are usually
  derived from CMU_TOP.

  Each clock is assigned an identifier and client nodes can use this identifier
  to specify the clock which they consume. All clocks available for usage
  in clock consumer nodes are defined as preprocessor macros in
  'include/dt-bindings/clock/samsung,exynos8890-cmu.h' header.

properties:
  compatible:
    enum:
      - samsung,exynos8890-cmu-apollo
      - samsung,exynos8890-cmu-aud
      - samsung,exynos8890-cmu-bus0
      - samsung,exynos8890-cmu-bus1
      - samsung,exynos8890-cmu-ccore
      - samsung,exynos8890-cmu-disp0
      - samsung,exynos8890-cmu-disp1
      - samsung,exynos8890-cmu-fsys0
      - samsung,exynos8890-cmu-fsys1
      - samsung,exynos8890-cmu-g3d
      - samsung,exynos8890-cmu-mif0
      - samsung,exynos8890-cmu-mif1
      - samsung,exynos8890-cmu-mif2
      - samsung,exynos8890-cmu-mif3
      - samsung,exynos8890-cmu-mngs
      - samsung,exynos8890-cmu-peric0
      - samsung,exynos8890-cmu-peric1
      - samsung,exynos8890-cmu-peris
      - samsung,exynos8890-cmu-top

  clocks:
    minItems: 1
    maxItems: 15

  clock-names:
    minItems: 1
    maxItems: 15

  "#clock-cells":
    const: 1

  reg:
    maxItems: 1

required:
  - compatible
  - clocks
  - clock-names
  - reg
  - "#clock-cells"

allOf:
  - if:
      properties:
        compatible:
          contains:
            const: samsung,exynos8890-cmu-apollo

    then:
      properties:
        clocks:
          items:
            - description: External reference clock (76.8 MHz)
            - description: CMU_APOLLO BUS_PLL clock (from CMU_TOP)

        clock-names:
          items:
            - const: oscclk
            - const: bus

  - if:
      properties:
        compatible:
          contains:
            const: samsung,exynos8890-cmu-aud

    then:
      properties:
        clocks:
          items:
            - description: External reference clock (76.8 MHz)
            - description: CMU_AUD PLL clock (from CMU_TOP)

        clock-names:
          items:
            - const: oscclk
            - const: pll

  - if:
      properties:
        compatible:
          contains:
            const: samsung,exynos8890-cmu-bus0

    then:
      properties:
        clocks:
          items:
            - description: External reference clock (76.8 MHz)
            - description: CMU_BUS0 ACLK 528MHz clock (from CMU_TOP)
            - description: CMU_BUS0 ACLK 200MHz clock (from CMU_TOP)
            - description: CMU_BUS0 PCLK 132MHz clock (from CMU_TOP)

        clock-names:
          items:
            - const: oscclk
            - const: "528"
            - const: "200"
            - const: "132"

  - if:
      properties:
        compatible:
          contains:
            const: samsung,exynos8890-cmu-bus1

    then:
      properties:
        clocks:
          items:
            - description: External reference clock (76.8 MHz)
            - description: CMU_BUS1 ACLK 528MHz clock (from CMU_BUS0)
            - description: CMU_BUS1 PCLK 132MHz clock (from CMU_TOP)

        clock-names:
          items:
            - const: oscclk
            - const: "528"
            - const: "132"

  - if:
      properties:
        compatible:
          contains:
            const: samsung,exynos8890-cmu-ccore

    then:
      properties:
        clocks:
          items:
            - description: External reference clock (76.8 MHz)
            - description: CMU_CCORE ACLK 800MHz clock (from CMU_TOP)
            - description: CMU_CCORE ACLK 264MHz clock (from CMU_TOP)
            - description: CMU_CCORE ACLK G3D 800MHz clock (from CMU_TOP)
            - description: CMU_CCORE ACLK 528MHz clock (from CMU_TOP)
            - description: CMU_CCORE ACLK 132MHz clock (from CMU_TOP)
            - description: CMU_CCORE PCLK 66MHz clock (from CMU_TOP)

        clock-names:
          items:
            - const: oscclk
            - const: "800"
            - const: "264"
            - const: g3d
            - const: "528"
            - const: "132"
            - const: "66"

  - if:
      properties:
        compatible:
          contains:
            const: samsung,exynos8890-cmu-disp0

    then:
      properties:
        clocks:
          items:
            - description: External reference clock (76.8 MHz)
            - description: CMU_DISP0 ACLK 0 400MHz clock (from CMU_TOP)
            - description: CMU_DISP0 ACLK 1 400MHz clock (from CMU_TOP)
            - description: CMU_DISP0 DECON0 ECLK0 clock (from CMU_TOP)
            - description: CMU_DISP0 DECON0 VCLK0 clock (from CMU_TOP)
            - description: CMU_DISP0 DECON0 VCLK1 clock (from CMU_TOP)
            - description: CMU_DISP0 HDMI audio clock (from CMU_TOP)

        clock-names:
          items:
            - const: oscclk
            - const: "0_400"
            - const: "1_400"
            - const: eclk0
            - const: vclk0
            - const: vclk1
            - const: audio

  - if:
      properties:
        compatible:
          contains:
            const: samsung,exynos8890-cmu-disp1

    then:
      properties:
        clocks:
          items:
            - description: External reference clock (76.8 MHz)
            - description: CMU_DISP1 ACLK 0 400MHz clock (from CMU_TOP)
            - description: CMU_DISP1 ACLK 1 400MHz clock (from CMU_TOP)
            - description: CMU_DISP1 DECON1 ECLK0 clock (from CMU_TOP)
            - description: CMU_DISP1 DECON1 ECLK1 clock (from CMU_TOP)

        clock-names:
          items:
            - const: oscclk
            - const: "0_400"
            - const: "1_400"
            - const: eclk0
            - const: eclk01

  - if:
      properties:
        compatible:
          contains:
            const: samsung,exynos8890-cmu-fsys0

    then:
      properties:
        clocks:
          items:
            - description: External reference clock (76.8 MHz)
            - description: CMU_FSYS0 ACLK 200MHz clock (from CMU_TOP)
            - description: CMU_FSYS0 USB30DRD clock (from CMU_TOP)
            - description: CMU_FSYS0 MMC0 clock (from CMU_TOP)
            - description: CMU_FSYS0 UFS UNIPRO20 clock (from CMU_TOP)
            - description: CMU_FSYS0 PHY 24MHz clock (from CMU_TOP)
            - description: CMU_FSYS0 UFS UNIPRO config clock (from CMU_TOP)

        clock-names:
          items:
            - const: oscclk
            - const: "200"
            - const: usb
            - const: mmc
            - const: unipro20
            - const: 24m
            - const: unipro_cfg

  - if:
      properties:
        compatible:
          contains:
            const: samsung,exynos8890-cmu-fsys1

    then:
      properties:
        clocks:
          items:
            - description: External reference clock (76.8 MHz)
            - description: CMU_FSYS1 ACLK 200MHz clock (from CMU_TOP)
            - description: CMU_FSYS1 MMC2 clock (from CMU_TOP)
            - description: CMU_FSYS1 UFS UNIPRO20 clock (from CMU_TOP)
            - description: CMU_FSYS1 UFS UNIPRO config clock (from CMU_TOP)
            - description: CMU_FSYS1 PCIe PHY clock (from CMU_TOP)
            - description: CMU_FSYS1 PCIe PLL clock (from CMU_TOP)

        clock-names:
          items:
            - const: oscclk
            - const: "200"
            - const: mmc2
            - const: unipro20
            - const: unipro_cfg
            - const: pcie_phy
            - const: pcie_pll

  - if:
      properties:
        compatible:
          contains:
            const: samsung,exynos8890-cmu-g3d

    then:
      properties:
        clocks:
          items:
            - description: External reference clock (76.8 MHz)
            - description: CMU_G3D PLL clock (from CMU_TOP)
            - description: CMU_G3D BUS_PLL clock (from CMU_TOP)

        clock-names:
          items:
            - const: oscclk
            - const: pll
            - const: bus

  - if:
      properties:
        compatible:
          contains:
            enum:
              - samsung,exynos8890-cmu-mif0
              - samsung,exynos8890-cmu-mif1
              - samsung,exynos8890-cmu-mif2
              - samsung,exynos8890-cmu-mif3

    then:
      properties:
        clocks:
          items:
            - description: External reference clock (76.8 MHz)
            - description: CMU_MIFx BUS_PLL clock (from CMU_TOP)

        clock-names:
          items:
            - const: oscclk
            - const: bus

  - if:
      properties:
        compatible:
          contains:
            const: samsung,exynos8890-cmu-mngs

    then:
      properties:
        clocks:
          items:
            - description: External reference clock (76.8 MHz)
            - description: CMU_MNGS BUS_PLL clock (from CMU_TOP)

        clock-names:
          items:
            - const: oscclk
            - const: bus

  - if:
      properties:
        compatible:
          contains:
            const: samsung,exynos8890-cmu-peric0

    then:
      properties:
        clocks:
          items:
            - description: External reference clock (76.8 MHz)
            - description: CMU_PERIC0 ACLK 66MHz clock (from CMU_TOP)
            - description: CMU_PERIC0 UART0 clock (from CMU_TOP)

        clock-names:
          items:
            - const: oscclk
            - const: "66"
            - const: uart0

  - if:
      properties:
        compatible:
          contains:
            const: samsung,exynos8890-cmu-peric1

    then:
      properties:
        clocks:
          items:
            - description: External reference clock (76.8 MHz)
            - description: CMU_PERIC1 ACLK 66MHz clock (from CMU_TOP)
            - description: CMU_PERIC1 SPI0 clock (from CMU_TOP)
            - description: CMU_PERIC1 SPI1 clock (from CMU_TOP)
            - description: CMU_PERIC1 SPI2 clock (from CMU_TOP)
            - description: CMU_PERIC1 SPI3 clock (from CMU_TOP)
            - description: CMU_PERIC1 SPI4 clock (from CMU_TOP)
            - description: CMU_PERIC1 SPI5 clock (from CMU_TOP)
            - description: CMU_PERIC1 SPI6 clock (from CMU_TOP)
            - description: CMU_PERIC1 SPI7 clock (from CMU_TOP)
            - description: CMU_PERIC1 UART1 clock (from CMU_TOP)
            - description: CMU_PERIC1 UART2 clock (from CMU_TOP)
            - description: CMU_PERIC1 UART3 clock (from CMU_TOP)
            - description: CMU_PERIC1 UART4 clock (from CMU_TOP)
            - description: CMU_PERIC1 UART5 clock (from CMU_TOP)

        clock-names:
          items:
            - const: oscclk
            - const: "66"
            - const: spi0
            - const: spi1
            - const: spi2
            - const: spi3
            - const: spi4
            - const: spi5
            - const: spi6
            - const: spi7
            - const: uart1
            - const: uart2
            - const: uart3
            - const: uart4
            - const: uart5

  - if:
      properties:
        compatible:
          contains:
            const: samsung,exynos8890-cmu-peris

    then:
      properties:
        clocks:
          items:
            - description: External reference clock (76.8 MHz)
            - description: CMU_PERIS ACLK 66MHz clock (from CMU_TOP)

        clock-names:
          items:
            - const: oscclk
            - const: peris

  - if:
      properties:
        compatible:
          contains:
            const: samsung,exynos8890-cmu-top

    then:
      properties:
        clocks:
          items:
            - description: External reference clock (76.8 MHz)

        clock-names:
          items:
            - const: oscclk

additionalProperties: false

examples:
  - |
    #include <dt-bindings/clock/samsung,exynos8890-cmu.h>

    cmu_peric1: clock-controller@14c80000 {
        compatible = "samsung,exynos8890-cmu-peric1";
        reg = <0x14c80000 0x8000>;
        #clock-cells = <1>;
        clocks = <&oscclk>,
                 <&cmu_top CLK_GOUT_TOP_ACLK_PERIC1_66>,
                 <&cmu_top CLK_GOUT_TOP_SCLK_PERIC1_SPI0>,
                 <&cmu_top CLK_GOUT_TOP_SCLK_PERIC1_SPI1>,
                 <&cmu_top CLK_GOUT_TOP_SCLK_PERIC1_SPI2>,
                 <&cmu_top CLK_GOUT_TOP_SCLK_PERIC1_SPI3>,
                 <&cmu_top CLK_GOUT_TOP_SCLK_PERIC1_SPI4>,
                 <&cmu_top CLK_GOUT_TOP_SCLK_PERIC1_SPI5>,
                 <&cmu_top CLK_GOUT_TOP_SCLK_PERIC1_SPI6>,
                 <&cmu_top CLK_GOUT_TOP_SCLK_PERIC1_SPI7>,
                 <&cmu_top CLK_GOUT_TOP_SCLK_PERIC1_UART1>,
                 <&cmu_top CLK_GOUT_TOP_SCLK_PERIC1_UART2>,
                 <&cmu_top CLK_GOUT_TOP_SCLK_PERIC1_UART3>,
                 <&cmu_top CLK_GOUT_TOP_SCLK_PERIC1_UART4>,
                 <&cmu_top CLK_GOUT_TOP_SCLK_PERIC1_UART5>;
        clock-names = "oscclk", "66", "spi0", "spi1", "spi2", "spi3",
                      "spi4", "spi5", "spi6", "spi7", "uart1", "uart2",
                      "uart3", "uart4", "uart5";
    };

...
```
