## Documentation/devicetree/bindings/clock/zte,zx297520v3-lspclk.yaml
```yaml
# SPDX-License-Identifier: (GPL-2.0-only OR BSD-2-Clause)
%YAML 1.2
---
$id: http://devicetree.org/schemas/clock/zte,zx297520v3-lspclk.yaml#
$schema: http://devicetree.org/meta-schemas/core.yaml#

title: ZTE zx297520v3 SoC LSP clock and reset controller

maintainers:
  - Stefan Dösinger <stefandoesinger@gmail.com>

description: |
  This clock and reset controller controls low speed peripherals on the board.
  This is a relatively isolated subsystem containing UART, I2C, I2S and SPI
  devices. The clock controller is responsible for bringing the devices out of
  reset and enabling their clocks as needed.

  The controller receives its clock signal from the matrix controller and need
  to be declared as clock inputs.

  All available clocks are defined as preprocessor macros in the
  'dt-bindings/clock/zte,zx297520v3-clk.h' header.

properties:
  compatible:
    const: zte,zx297520v3-lspclk

  reg:
    maxItems: 1

  clocks:
    items:
      - description: Main PLL divided by 5 output from matrixclk (124.8 MHz)
      - description: Main PLL divided by 4 output from matrixclk (156 MHz)
      - description: Main PLL divided by 6 output from matrixclk (104 MHz)
      - description: Main PLL divided by 8 output from matrixclk (78 MHz)
      - description: Main PLL divided by 12 output from matrixclk (52 MHz)
      - description: Main oscillator output from matrixclk (26 MHz)
      - description: Timer oscillator output from matrixclk (32 KHz)
      - description: LSP pclk output from matrixclk (26 MHz)
      - description: TDM wclk mux output from matrixclk
      - description: DPLL divided by 4 output from matrixclk (122.88 MHz)

  clock-names:
    items:
      - const: mpll_d5
      - const: mpll_d4
      - const: mpll_d6
      - const: mpll_d8
      - const: mpll_d12
      - const: osc26m
      - const: osc32k
      - const: pclk
      - const: tdm_wclk
      - const: dpll_d4

  "#clock-cells":
    const: 1

  "#reset-cells":
    const: 1

required:
  - compatible
  - reg
  - clocks
  - clock-names
  - '#clock-cells'
  - '#reset-cells'

additionalProperties: false

examples:
  - |
    #include <dt-bindings/clock/zte,zx297520v3-clk.h>

    matrixclk: clock-controller@1306000 {
        compatible = "zte,zx297520v3-matrixclk", "syscon";
        reg = <0x01306000 0x400>;
        clocks = <&osc26m>, <&osc32k>,
                 <&topclk ZX297520V3_MPLL>, <&topclk ZX297520V3_MPLL_D2>,
                 <&topclk ZX297520V3_MPLL_D3>, <&topclk ZX297520V3_MPLL_D4>,
                 <&topclk ZX297520V3_MPLL_D5>, <&topclk ZX297520V3_MPLL_D6>,
                 <&topclk ZX297520V3_MPLL_D8>, <&topclk ZX297520V3_MPLL_D12>,
                 <&topclk ZX297520V3_MPLL_D16>, <&topclk ZX297520V3_MPLL_D26>,
                 <&topclk ZX297520V3_UPLL>, <&topclk ZX297520V3_UPLL_D2>,
                 <&topclk ZX297520V3_UPLL_D3>, <&topclk ZX297520V3_UPLL_D4>,
                 <&topclk ZX297520V3_UPLL_D5>, <&topclk ZX297520V3_UPLL_D6>,
                 <&topclk ZX297520V3_UPLL_D8>, <&topclk ZX297520V3_UPLL_D12>,
                 <&topclk ZX297520V3_UPLL_D16>,
                 <&topclk ZX297520V3_DPLL>, <&topclk ZX297520V3_DPLL_D2>,
                 <&topclk ZX297520V3_DPLL_D3>, <&topclk ZX297520V3_DPLL_D4>,
                 <&topclk ZX297520V3_DPLL_D5>, <&topclk ZX297520V3_DPLL_D6>,
                 <&topclk ZX297520V3_DPLL_D8>, <&topclk ZX297520V3_DPLL_D12>,
                 <&topclk ZX297520V3_DPLL_D16>,
                 <&topclk ZX297520V3_GPLL>, <&topclk ZX297520V3_GPLL_D2>,
                 <&topclk ZX297520V3_GPLL_D3>, <&topclk ZX297520V3_GPLL_D4>,
                 <&topclk ZX297520V3_GPLL_D5>, <&topclk ZX297520V3_GPLL_D6>,
                 <&topclk ZX297520V3_GPLL_D8>, <&topclk ZX297520V3_GPLL_D12>,
                 <&topclk ZX297520V3_GPLL_D16>;
        clock-names = "osc26m", "osc32k", "mpll", "mpll_d2", "mpll_d3",
                      "mpll_d4", "mpll_d5", "mpll_d6", "mpll_d8", "mpll_d12",
                      "mpll_d16", "mpll_d26", "upll", "upll_d2", "upll_d3",
                      "upll_d4", "upll_d5", "upll_d6", "upll_d8", "upll_d12",
                      "upll_d16", "dpll", "dpll_d2", "dpll_d3", "dpll_d4",
                      "dpll_d5", "dpll_d6", "dpll_d8", "dpll_d12", "dpll_d16",
                      "gpll", "gpll_d2", "gpll_d3", "gpll_d4", "gpll_d5",
                      "gpll_d6", "gpll_d8", "gpll_d12", "gpll_d16";
        #clock-cells = <1>;
        #reset-cells = <1>;
    };

    clock-controller@1400000 {
        compatible = "zte,zx297520v3-lspclk";
        reg = <0x01400000 0x100>;
        clocks = <&matrixclk ZX297520V3_LSP_MPLL_D5_WCLK>,
                 <&matrixclk ZX297520V3_LSP_MPLL_D4_WCLK>,
                 <&matrixclk ZX297520V3_LSP_MPLL_D6_WCLK>,
                 <&matrixclk ZX297520V3_LSP_MPLL_D8_WCLK>,
                 <&matrixclk ZX297520V3_LSP_MPLL_D12_WCLK>,
                 <&matrixclk ZX297520V3_LSP_OSC26M_WCLK>,
                 <&matrixclk ZX297520V3_LSP_OSC32K_WCLK>,
                 <&matrixclk ZX297520V3_LSP_PCLK>,
                 <&matrixclk ZX297520V3_LSP_TDM_WCLK>,
                 <&matrixclk ZX297520V3_LSP_DPLL_D4_WCLK>;
        clock-names = "mpll_d5", "mpll_d4", "mpll_d6", "mpll_d8", "mpll_d12",
                      "osc26m", "osc32k", "pclk", "tdm_wclk", "dpll_d4";
        #clock-cells = <1>;
        #reset-cells = <1>;
    };
```
