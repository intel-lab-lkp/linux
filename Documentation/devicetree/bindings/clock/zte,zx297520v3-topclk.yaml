## Documentation/devicetree/bindings/display/apple,h7-display-pipe.yaml
```yaml
# SPDX-License-Identifier: (GPL-2.0 OR BSD-2-Clause)
%YAML 1.2
---
$id: http://devicetree.org/schemas/display/apple,h7-display-pipe.yaml#
$schema: http://devicetree.org/meta-schemas/core.yaml#

title: Apple pre-DCP display controller.

maintainers:
  - asahi@lists.linux.dev
  - Sasha Finkelstein <fnkl.kernel@gmail.com>

description:
  A secondary display controller used to drive the "touchbar" on certain Apple laptops.

properties:
  compatible:
    items:
      - enum:
          - apple,t8112-display-pipe
          - apple,t8103-display-pipe
      - const: apple,h7-display-pipe

  reg:
    maxItems: 2

  reg-names:
    items:
      - const: be
      - const: fe

  power-domains:
    maxItems: 2

  interrupts:
    maxItems: 2

  interrupt-names:
    items:
      - const: be
      - const: fe

  iommus:
    maxItems: 1

  port:
    $ref: /schemas/graph.yaml#/properties/port

required:
  - compatible
  - reg
  - interrupts
  - port

additionalProperties: false

examples:
  - |
    #include <dt-bindings/interrupt-controller/apple-aic.h>
    display_dfr: display-pipe@228200000 {
    	compatible = "apple,t8103-display-pipe", "apple,h7-display-pipe";
    	reg-names = "be", "fe";
    	reg = <0x28200000 0xc000>,
    		<0x28400000 0x4000>;
    	power-domains = <&ps_dispdfr_fe>, <&ps_dispdfr_be>;
    	interrupt-parent = <&aic>;
    	interrupts = <AIC_IRQ 502 IRQ_TYPE_LEVEL_HIGH>,
    		<AIC_IRQ 506 IRQ_TYPE_LEVEL_HIGH>;
    	interrupt-names = "be", "fe";
    	iommus = <&displaydfr_dart 0>;
    	port {
    		dfr_adp_out_mipi: endpoint {
    			remote-endpoint = <&dfr_mipi_in_adp>;
    		};
    	};
    };
...
```

## Documentation/devicetree/bindings/display/atmel/atmel,hlcdc-dc.yaml
```yaml
# SPDX-License-Identifier: (GPL-2.0 OR BSD-2-Clause)
# Copyright (C) 2024 Microchip Technology, Inc. and its subsidiaries
%YAML 1.2
---
$id: http://devicetree.org/schemas/display/atmel/atmel,hlcdc-dc.yaml#
$schema: http://devicetree.org/meta-schemas/core.yaml#

title: Atmel's HLCDC (High LCD Controller) DRM driver

maintainers:
  - Nicolas Ferre <nicolas.ferre@microchip.com>
  - Alexandre Belloni <alexandre.belloni@bootlin.com>
  - Claudiu Beznea <claudiu.beznea@tuxon.dev>

description: |
  Device-Tree bindings for Atmel's HLCDC DRM driver. The Atmel HLCDC Display
  Controller is a subdevice of the HLCDC MFD device.
  # See ../../mfd/atmel,hlcdc.yaml for more details.

properties:
  compatible:
    const: atmel,hlcdc-display-controller

  pinctrl-names:
    const: default

  pinctrl-0: true

  '#address-cells':
    const: 1

  '#size-cells':
    const: 0

  port@0:
    $ref: /schemas/graph.yaml#/$defs/port-base
    unevaluatedProperties: false
    description:
      Output endpoint of the controller, connecting the LCD panel signals.

    properties:
      '#address-cells':
        const: 1

      '#size-cells':
        const: 0

      reg:
        maxItems: 1

      endpoint:
        $ref: /schemas/graph.yaml#/$defs/endpoint-base
        unevaluatedProperties: false
        description:
          Endpoint connecting the LCD panel signals.

        properties:
          bus-width:
            description: |
              Any endpoint grandchild node may specify a desired video interface according to
              ../../media/video-interfaces.yaml, specifically "bus-width" whose recognized
              values are <12>, <16>, <18> and <24>, and override any output mode selection
              heuristic, forcing "rgb444","rgb565", "rgb666" and "rgb888" respectively.
            enum: [ 12, 16, 18, 24 ]

additionalProperties: false

required:
  - '#address-cells'
  - '#size-cells'
  - compatible
  - pinctrl-names
  - pinctrl-0
  - port@0

examples:
  - |
    #include <dt-bindings/clock/at91.h>
    #include <dt-bindings/dma/at91.h>
    #include <dt-bindings/interrupt-controller/arm-gic.h>
    //Example 1
    hlcdc: hlcdc@f0030000 {
      compatible = "atmel,sama5d3-hlcdc";
      reg = <0xf0030000 0x2000>;
      interrupts = <36 IRQ_TYPE_LEVEL_HIGH 0>;
      clocks = <&lcdc_clk>, <&lcdck>, <&clk32k>;
      clock-names = "periph_clk","sys_clk", "slow_clk";

      hlcdc-display-controller {
        compatible = "atmel,hlcdc-display-controller";
        pinctrl-names = "default";
        pinctrl-0 = <&pinctrl_lcd_base &pinctrl_lcd_rgb888>;
        #address-cells = <1>;
        #size-cells = <0>;

        port@0 {
          #address-cells = <1>;
          #size-cells = <0>;
          reg = <0>;

          hlcdc_panel_output: endpoint@0 {
            reg = <0>;
            remote-endpoint = <&panel_input>;
          };
        };
      };

      hlcdc_pwm: hlcdc-pwm {
        compatible = "atmel,hlcdc-pwm";
        pinctrl-names = "default";
        pinctrl-0 = <&pinctrl_lcd_pwm>;
        #pwm-cells = <3>;
      };
    };
  - |
    //Example 2 With a video interface override to force rgb565
    hlcdc-display-controller {
      pinctrl-names = "default";
      pinctrl-0 = <&pinctrl_lcd_base &pinctrl_lcd_rgb565>;
      #address-cells = <1>;
      #size-cells = <0>;

      port@0 {
        #address-cells = <1>;
        #size-cells = <0>;
        reg = <0>;
        hlcdc_panel_output2: endpoint@0 {
          reg = <0>;
          remote-endpoint = <&panel_input>;
          bus-width = <16>;
        };
      };
    };
```

## Documentation/devicetree/bindings/display/boot-logo-clut224.yaml
```yaml
# SPDX-License-Identifier: (GPL-2.0-only OR BSD-2-Clause)
%YAML 1.2
---
$id: http://devicetree.org/schemas/display/boot-logo-clut224.yaml#
$schema: http://devicetree.org/meta-schemas/core.yaml#

title: Boot logo supplied by the device tree

maintainers:
  - Max Pedraza <maximpedraza@gmail.com>

description: |
  Embedded systems commonly need a product specific boot logo. Today that
  means pointing CONFIG_LOGO_LINUX_CLUT224_FILE at a different image, which
  bakes it into the kernel image: changing the logo means building and
  deploying a new kernel.

  This node lets the boot logo be described by the device tree instead, so that
  a single kernel image can serve several products, or several revisions of the
  same product, that only differ in branding.

  Since a logo is configuration rather than a description of the hardware, the
  node lives under /chosen, next to the other things firmware hands to the
  operating system. Open Firmware, which the device tree descends from, carried
  a boot logo in the same spirit as the oem-logo variable under /options.

  The image is stored in the same paletted format the in-kernel CLUT224 logos
  use: a palette of at most 224 RGB entries plus one palette index per pixel.

properties:
  $nodename:
    const: logo

  compatible:
    const: boot-logo-clut224

  width:
    $ref: /schemas/types.yaml#/definitions/uint32
    description: Logo width in pixels.
    minimum: 1
    maximum: 65535

  height:
    $ref: /schemas/types.yaml#/definitions/uint32
    description: Logo height in pixels.
    minimum: 1
    maximum: 65535

  clut:
    $ref: /schemas/types.yaml#/definitions/uint8-array
    description:
      Colour lookup table, as consecutive red, green and blue bytes per entry.
      The number of entries is derived from the property length and must not
      exceed 224.
    minItems: 3
    maxItems: 672

  data:
    $ref: /schemas/types.yaml#/definitions/uint8-array
    description:
      One byte per pixel, left to right and top to bottom, each byte being an
      index into the colour lookup table. The property length must be equal to
      width multiplied by height.

  memory-region:
    maxItems: 1
    description: |
      Reserved memory region holding the logo, as an alternative to carrying
      it in the width, height, clut and data properties. The bootloader is
      expected to have placed the image there before starting the kernel.

      This lets one image be shared by several device trees that differ only
      in where the logo goes, which is what a family of products built on the
      same board but with different panels needs.

      The region starts with a header of four little endian 32 bit words:
      the magic number 0x4f474f4c ("LOGO"), the width, the height and the
      number of palette entries. The palette follows, as consecutive red,
      green and blue bytes per entry, and then one byte per pixel, each an
      index into that palette.

  logo-position:
    $ref: /schemas/types.yaml#/definitions/int32-array
    description:
      X and Y coordinates, in screen pixels, of the top left corner of the
      logo once it has been rotated. A value of -1 on an axis centres the
      logo on that axis instead, which is the only way to say it when the
      logo size is not known to the device tree, as is the case for the
      memory-region form. Defaults to the top left corner of the screen.
    items:
      - description: X coordinate, or -1 to centre horizontally
        minimum: -1
        maximum: 65535
      - description: Y coordinate, or -1 to centre vertically
        minimum: -1
        maximum: 65535

  logo-offset:
    $ref: /schemas/types.yaml#/definitions/int32-array
    description:
      X and Y displacement, in screen pixels, applied after the logo has been
      placed.
      Mostly useful together with a centred axis, to land the logo somewhere
      other than the middle of a panel whose usable area is not its centre.
    items:
      - description: X displacement
        minimum: -65535
        maximum: 65535
      - description: Y displacement
        minimum: -65535
        maximum: 65535

  logo-rotation:
    $ref: /schemas/types.yaml#/definitions/string
    description:
      Rotation applied to the logo before it is drawn. It turns the logo and
      not the screen, so a quarter turn swaps how much room the logo takes
      up, but logo-position and logo-offset stay in screen pixels either
      way.
    enum: [none, cw, ccw, ud]
    default: none

required:
  - compatible

# The image either lives in the device tree or in a reserved memory region,
# never both.
oneOf:
  - required:
      - width
      - height
      - clut
      - data
  - required:
      - memory-region

additionalProperties: false

examples:
  - |
    // A 4x2 logo using three colours, centred on both axes.
    / {
        compatible = "foo";
        model = "foo";
        #address-cells = <1>;
        #size-cells = <1>;

        chosen {
            logo {
                compatible = "boot-logo-clut224";
                width = <4>;
                height = <2>;
                clut = /bits/ 8 <0xff 0x00 0x00
                                 0x00 0xff 0x00
                                 0x00 0x00 0xff>;
                data = /bits/ 8 <0x00 0x01 0x01 0x00
                                 0x02 0x00 0x00 0x02>;
                logo-position = <(-1) (-1)>;
            };
        };
    };
```
