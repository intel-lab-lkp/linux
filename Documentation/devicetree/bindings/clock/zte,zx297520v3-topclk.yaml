## Documentation/devicetree/bindings/cpufreq/airoha,en7581-cpufreq.yaml
```yaml
# SPDX-License-Identifier: (GPL-2.0-only OR BSD-2-Clause)
%YAML 1.2
---
$id: http://devicetree.org/schemas/cpufreq/airoha,en7581-cpufreq.yaml#
$schema: http://devicetree.org/meta-schemas/core.yaml#

title: Airoha EN7581 CPUFreq

maintainers:
  - Christian Marangi <ansuelsmth@gmail.com>

description: |
  On newer Airoha SoC, CPU Frequency is scaled indirectly with SMCCC commands
  to ATF and no clocks are exposed to the OS.

  The SoC have performance state described by ID for each OPP, for this a
  Power Domain is used that sets the performance state ID according to the
  required OPPs defined in the CPU OPP tables.

properties:
  compatible:
    const: airoha,en7581-cpufreq

  '#clock-cells':
    const: 0

  '#power-domain-cells':
    const: 0

  operating-points-v2: true

required:
  - compatible
  - '#clock-cells'
  - '#power-domain-cells'
  - operating-points-v2

additionalProperties: false

examples:
  - |
    / {
        model = "Airoha EN7581 Evaluation Board";
        compatible = "airoha,en7581-evb", "airoha,en7581";

        #address-cells = <2>;
      	#size-cells = <2>;

        cpus {
            #address-cells = <1>;
            #size-cells = <0>;

            cpu0: cpu@0 {
                device_type = "cpu";
                compatible = "arm,cortex-a53";
                reg = <0x0>;
                operating-points-v2 = <&cpu_opp_table>;
                enable-method = "psci";
                clocks = <&cpu_pd>;
                clock-names = "cpu";
                power-domains = <&cpu_pd>;
                power-domain-names = "perf";
                next-level-cache = <&l2>;
                #cooling-cells = <2>;
            };

            cpu1: cpu@1 {
                device_type = "cpu";
                compatible = "arm,cortex-a53";
                reg = <0x1>;
                operating-points-v2 = <&cpu_opp_table>;
                enable-method = "psci";
                clocks = <&cpu_pd>;
                clock-names = "cpu";
                power-domains = <&cpu_pd>;
                power-domain-names = "perf";
                next-level-cache = <&l2>;
                #cooling-cells = <2>;
            };

            cpu2: cpu@2 {
                device_type = "cpu";
                compatible = "arm,cortex-a53";
                reg = <0x2>;
                operating-points-v2 = <&cpu_opp_table>;
                enable-method = "psci";
                clocks = <&cpu_pd>;
                clock-names = "cpu";
                power-domains = <&cpu_pd>;
                power-domain-names = "perf";
                next-level-cache = <&l2>;
                #cooling-cells = <2>;
            };

            cpu3: cpu@3 {
                device_type = "cpu";
                compatible = "arm,cortex-a53";
                reg = <0x3>;
                operating-points-v2 = <&cpu_opp_table>;
                enable-method = "psci";
                clocks = <&cpu_pd>;
                clock-names = "cpu";
                power-domains = <&cpu_pd>;
                power-domain-names = "perf";
                next-level-cache = <&l2>;
                #cooling-cells = <2>;
            };
        };

        cpu_opp_table: opp-table-cpu {
            compatible = "operating-points-v2";
            opp-shared;

            opp-500000000 {
                opp-hz = /bits/ 64 <500000000>;
                required-opps = <&smcc_opp0>;
            };

            opp-550000000 {
                opp-hz = /bits/ 64 <550000000>;
                required-opps = <&smcc_opp1>;
            };

            opp-600000000 {
                opp-hz = /bits/ 64 <600000000>;
                required-opps = <&smcc_opp2>;
            };

            opp-650000000 {
                opp-hz = /bits/ 64 <650000000>;
                required-opps = <&smcc_opp3>;
            };

            opp-7000000000 {
                opp-hz = /bits/ 64 <700000000>;
                required-opps = <&smcc_opp4>;
            };

            opp-7500000000 {
                opp-hz = /bits/ 64 <750000000>;
                required-opps = <&smcc_opp5>;
            };

            opp-8000000000 {
                opp-hz = /bits/ 64 <800000000>;
                required-opps = <&smcc_opp6>;
            };

            opp-8500000000 {
                opp-hz = /bits/ 64 <850000000>;
                required-opps = <&smcc_opp7>;
            };

            opp-9000000000 {
                opp-hz = /bits/ 64 <900000000>;
                required-opps = <&smcc_opp8>;
            };

            opp-9500000000 {
                opp-hz = /bits/ 64 <950000000>;
                required-opps = <&smcc_opp9>;
            };

            opp-10000000000 {
                opp-hz = /bits/ 64 <1000000000>;
                required-opps = <&smcc_opp10>;
            };

            opp-10500000000 {
                opp-hz = /bits/ 64 <1050000000>;
                required-opps = <&smcc_opp11>;
            };

            opp-11000000000 {
                opp-hz = /bits/ 64 <1100000000>;
                required-opps = <&smcc_opp12>;
            };

            opp-11500000000 {
                opp-hz = /bits/ 64 <1150000000>;
                required-opps = <&smcc_opp13>;
            };

            opp-12000000000 {
                opp-hz = /bits/ 64 <1200000000>;
                required-opps = <&smcc_opp14>;
            };
        };

        cpu_smcc_opp_table: opp-table-smcc {
            compatible = "operating-points-v2";

            smcc_opp0: opp-0 {
               opp-level = <0>;
            };

            smcc_opp1: opp-1 {
                opp-level = <1>;
            };

            smcc_opp2: opp-2 {
               opp-level = <2>;
            };

            smcc_opp3: opp-3 {
               opp-level = <3>;
            };

            smcc_opp4: opp-4 {
                opp-level = <4>;
            };

            smcc_opp5: opp-5 {
                opp-level = <5>;
            };

            smcc_opp6: opp-6 {
               opp-level = <6>;
            };

            smcc_opp7: opp-7 {
               opp-level = <7>;
            };

            smcc_opp8: opp-8 {
                opp-level = <8>;
            };

            smcc_opp9: opp-9 {
               opp-level = <9>;
            };

            smcc_opp10: opp-10 {
                opp-level = <10>;
            };

            smcc_opp11: opp-11 {
                opp-level = <11>;
            };

            smcc_opp12: opp-12 {
                opp-level = <12>;
            };

            smcc_opp13: opp-13 {
                opp-level = <13>;
            };

            smcc_opp14: opp-14 {
                opp-level = <14>;
            };
        };

        cpu_pd: power-domain {
            compatible = "airoha,en7581-cpufreq";

            operating-points-v2 = <&cpu_smcc_opp_table>;

            #power-domain-cells = <0>;
            #clock-cells = <0>;
        };
    };
```

## Documentation/devicetree/bindings/cpufreq/cpufreq-mediatek-hw.yaml
```yaml
# SPDX-License-Identifier: (GPL-2.0-only OR BSD-2-Clause)
%YAML 1.2
---
$id: http://devicetree.org/schemas/cpufreq/cpufreq-mediatek-hw.yaml#
$schema: http://devicetree.org/meta-schemas/core.yaml#

title: MediaTek's CPUFREQ

maintainers:
  - Hector Yuan <hector.yuan@mediatek.com>

description:
  CPUFREQ HW is a hardware engine used by MediaTek SoCs to
  manage frequency in hardware. It is capable of controlling
  frequency for multiple clusters.

properties:
  compatible:
    contains:
      enum:
        - mediatek,cpufreq-hw
        - mediatek,mt8196-cpufreq-hw

  reg:
    minItems: 1
    maxItems: 3
    description:
      Addresses and sizes for the memory of the HW bases in
      each frequency domain. Each entry corresponds to
      a register bank for each frequency domain present.

  "#performance-domain-cells":
    description:
      Number of cells in a performance domain specifier.
      Set const to 1 here for nodes providing multiple
      performance domains.
    const: 1

required:
  - compatible
  - reg
  - "#performance-domain-cells"

additionalProperties: false

allOf:
  - if:
      properties:
        compatible:
          contains:
            enum:
              - mediatek,cpufreq-hw
    then:
      properties:
        regs:
          maxItems: 2

examples:
  - |
    cpus {
            #address-cells = <1>;
            #size-cells = <0>;

            cpu0: cpu@0 {
                device_type = "cpu";
                compatible = "arm,cortex-a55";
                enable-method = "psci";
                performance-domains = <&performance 0>;
                reg = <0x000>;
            };
    };

    /* ... */

    soc {
        #address-cells = <2>;
        #size-cells = <2>;

        performance: performance-controller@11bc00 {
            compatible = "mediatek,cpufreq-hw";
            reg = <0 0x0011bc10 0 0x120>, <0 0x0011bd30 0 0x120>;

            #performance-domain-cells = <1>;
        };
    };
  - |
    cpus {
            #address-cells = <1>;
            #size-cells = <0>;

            mt8196_cpu0: cpu@0 {
                device_type = "cpu";
                compatible = "arm,cortex-a720";
                enable-method = "psci";
                performance-domains = <&mt8196_performance 0>;
                reg = <0x000>;
            };

            /* ... */

            mt8196_cpu6: cpu@600 {
                device_type = "cpu";
                compatible = "arm,cortex-x4";
                enable-method = "psci";
                performance-domains = <&mt8196_performance 1>;
                reg = <0x600>;
            };

            mt8196_cpu7: cpu@700 {
                device_type = "cpu";
                compatible = "arm,cortex-x925";
                enable-method = "psci";
                performance-domains = <&mt8196_performance 2>;
                reg = <0x700>;
            };
    };

    /* ... */

    soc {
        #address-cells = <2>;
        #size-cells = <2>;

        mt8196_performance: performance-controller@c2c0f20 {
            compatible = "mediatek,mt8196-cpufreq-hw";
            reg = <0 0xc2c0f20 0 0x120>, <0 0xc2c1040 0 0x120>,
                  <0 0xc2c1160 0 0x120>;
            #performance-domain-cells = <1>;
        };
    };
```

## Documentation/devicetree/bindings/cpufreq/qemu,cpufreq-virtual.yaml
```yaml
# SPDX-License-Identifier: GPL-2.0-only OR BSD-2-Clause
%YAML 1.2
---
$id: http://devicetree.org/schemas/cpufreq/qemu,cpufreq-virtual.yaml#
$schema: http://devicetree.org/meta-schemas/core.yaml#

title: Virtual CPUFreq

maintainers:
  - David Dai <davidai@google.com>
  - Saravana Kannan <saravanak@google.com>

description:
  Virtual CPUFreq is a virtualized driver in guest kernels that sends frequency
  selection of its vCPUs as a hint to the host through MMIO regions. Each vCPU
  is associated with a frequency domain which can be shared with other vCPUs.
  Each frequency domain has its own set of registers for frequency controls.

properties:
  compatible:
    const: qemu,virtual-cpufreq

  reg:
    maxItems: 1
    description:
      Address and size of region containing frequency controls for each of the
      frequency domains. Regions for each frequency domain is placed
      contiugously and contain registers for controlling DVFS(Dynamic Frequency
      and Voltage) characteristics. The size of the region is proportional to
      total number of frequency domains.

required:
  - compatible
  - reg

additionalProperties: false

examples:
  - |
    // This example shows a two CPU configuration with a frequency domain
    // for each CPU.
    cpus {
      #address-cells = <1>;
      #size-cells = <0>;

      cpu@0 {
        compatible = "arm,armv8";
        device_type = "cpu";
        reg = <0x0>;
        operating-points-v2 = <&opp_table0>;
      };

      cpu@1 {
        compatible = "arm,armv8";
        device_type = "cpu";
        reg = <0x0>;
        operating-points-v2 = <&opp_table1>;
      };
    };

    opp_table0: opp-table-0 {
      compatible = "operating-points-v2";
      opp-shared;

      opp1098000000 {
        opp-hz = /bits/ 64 <1098000000>;
        opp-level = <1>;
      };

      opp1197000000 {
        opp-hz = /bits/ 64 <1197000000>;
        opp-level = <2>;
      };
    };

    opp_table1: opp-table-1 {
      compatible = "operating-points-v2";
      opp-shared;

      opp1106000000 {
        opp-hz = /bits/ 64 <1106000000>;
        opp-level = <1>;
      };

      opp1277000000 {
        opp-hz = /bits/ 64 <1277000000>;
        opp-level = <2>;
      };
    };

    soc {
      #address-cells = <1>;
      #size-cells = <1>;

      cpufreq@1040000 {
        compatible = "qemu,virtual-cpufreq";
        reg = <0x1040000 0x10>;
      };
    };
```

## Documentation/devicetree/bindings/cpufreq/shikra-cpufreq-qcom-hw.yaml
```yaml
# SPDX-License-Identifier: GPL-2.0-only OR BSD-2-Clause
%YAML 1.2
---
$id: http://devicetree.org/schemas/cpufreq/shikra-cpufreq-qcom-hw.yaml#
$schema: http://devicetree.org/meta-schemas/core.yaml#

title: CPUFREQ HW for Qualcomm Shikra SoC

maintainers:
  - Imran Shaik <imran.shaik@oss.qualcomm.com>
  - Taniya Das <taniya.das@oss.qualcomm.com>

description: |

  CPUFREQ HW is a hardware engine used by some Qualcomm SoCs to manage
  frequency in hardware. It is capable of controlling frequency for
  multiple clusters.

  The Qualcomm Shikra CPUFREQ HW supports up to 12 frequency lookup table
  (LUT) entries.

properties:
  compatible:
    enum:
      - qcom,shikra-cpufreq-epss

  reg:
    items:
      - description: Frequency domain 0 register region
      - description: Frequency domain 1 register region

  reg-names:
    items:
      - const: freq-domain0
      - const: freq-domain1

  clocks:
    items:
      - description: XO Clock
      - description: GPLL0 Clock

  clock-names:
    items:
      - const: xo
      - const: alternate

  interrupts:
    items:
      - description: IRQ line for DCVSH 0
      - description: IRQ line for DCVSH 1

  interrupt-names:
    items:
      - const: dcvsh-irq-0
      - const: dcvsh-irq-1

  '#freq-domain-cells':
    const: 1

  '#clock-cells':
    const: 1

required:
  - compatible
  - reg
  - clocks
  - clock-names
  - '#freq-domain-cells'

additionalProperties: false

examples:
  - |
    #include <dt-bindings/clock/qcom,rpmcc.h>

      cpus {
        #address-cells = <2>;
        #size-cells = <0>;

        cpu0: cpu@0 {
          device_type = "cpu";
          compatible = "arm,cortex-a55";
          reg = <0x0 0x0>;
          enable-method = "psci";
          qcom,freq-domain = <&cpufreq_hw 0>;
          clocks = <&cpufreq_hw 0>;
        };

        cpu1: cpu@100 {
          device_type = "cpu";
          compatible = "arm,cortex-a55";
          reg = <0x0 0x100>;
          enable-method = "psci";
          qcom,freq-domain = <&cpufreq_hw 0>;
          clocks = <&cpufreq_hw 0>;
        };

        cpu2: cpu@200 {
          device_type = "cpu";
          compatible = "arm,cortex-a55";
          reg = <0x0 0x200>;
          enable-method = "psci";
          qcom,freq-domain = <&cpufreq_hw 0>;
          clocks = <&cpufreq_hw 0>;
        };

        cpu3: cpu@300 {
          device_type = "cpu";
          compatible = "arm,cortex-a78c";
          reg = <0x0 0x300>;
          enable-method = "psci";
          qcom,freq-domain = <&cpufreq_hw 1>;
          clocks = <&cpufreq_hw 1>;
        };
      };

    soc {
      #address-cells = <1>;
      #size-cells = <1>;

      cpufreq@fd91000 {
        compatible = "qcom,shikra-cpufreq-epss";
        reg = <0x0fd91000 0x1000>, <0x0fd92000 0x1000>;
        reg-names = "freq-domain0", "freq-domain1";

        clocks = <&rpmcc RPM_SMD_XO_CLK_SRC>, <&gpll0>;
        clock-names = "xo", "alternate";

        #freq-domain-cells = <1>;
        #clock-cells = <1>;
      };
    };
...
```
