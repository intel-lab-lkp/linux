## Documentation/devicetree/bindings/clock/zte,zx297520v3-topclk.yaml
```yaml
# SPDX-License-Identifier: (GPL-2.0-only OR BSD-2-Clause)
%YAML 1.2
---
$id: http://devicetree.org/schemas/clock/zte,zx297520v3-topclk.yaml#
$schema: http://devicetree.org/meta-schemas/core.yaml#

title: ZTE zx297520v3 SoC top clock and reset controller

maintainers:
  - Stefan Dösinger <stefandoesinger@gmail.com>

description: |
  The zx297520v3's top clock controller generates clocks for core devices on the
  board like the main bus, USB and timers. In addition to clocks it has reset
  controls for peripherals, a global board reset and watchdog reset controls.

  The controller has two clock inputs: a 26 MHz and a 32 KHz external
  oscillator. They need to be provided as input clocks. The controller provides
  clocks to the downstream Matrix clock controller.

  All available clocks are defined as preprocessor macros in the
  'dt-bindings/clock/zte,zx297520v3-clk.h' header.

properties:
  compatible:
    items:
      - const: zte,zx297520v3-topclk
      - const: syscon

  reg:
    maxItems: 1

  clocks:
    items:
      - description: 26 MHz external oscillator
      - description: 32 KHz external oscillator

  clock-names:
    items:
      - const: osc26m
      - const: osc32k

  "#clock-cells":
    const: 1

  "#reset-cells":
    const: 1

required:
  - compatible
  - reg
  - clocks
  - clock-names
  - '#clock-cells'
  - '#reset-cells'

additionalProperties: false

examples:
  - |
    #include <dt-bindings/clock/zte,zx297520v3-clk.h>

    clock-controller@13b000 {
        compatible = "zte,zx297520v3-topclk", "syscon";
        reg = <0x0013b000 0x400>;
        clocks = <&osc26m>, <&osc32k>;
        clock-names = "osc26m", "osc32k";
        #clock-cells = <1>;
        #reset-cells = <1>;
    };
```

## Documentation/devicetree/bindings/clock/zte,zx297520v3-topcrm.yaml
```yaml
# SPDX-License-Identifier: (GPL-2.0-only OR BSD-2-Clause)
%YAML 1.2
---
$id: http://devicetree.org/schemas/clock/zte,zx297520v3-topcrm.yaml#
$schema: http://devicetree.org/meta-schemas/core.yaml#

title: ZTE zx297520v3 SoC top clock and reset controller

maintainers:
  - Stefan Dösinger <stefandoesinger@gmail.com>

description: |
  The zx297520v3 top clock and reset controller generates clocks for core
  devices on the board like the main bus, USB and timers. In addition to clocks
  it has reset controls for peripherals, a global board reset, watchdog reset
  controls and a USB status register.

  The controller has two clock inputs: a 26 MHz and a 32 KHz external
  oscillator. They need to be provided as input clocks. The controller provides
  PLL output frequencies to downstream clock controllers.

  The USB PHY functionality is exposed as a child node documented in
  zte,zx297520v3-usb-phy.yaml.

  All available clocks are defined as preprocessor macros in the
  "include/dt-bindings/clock/zte,zx297520v3-clk.h" header. The resets are
  defined in the "include/dt-bindings/reset/zte,zx297520v3-reset.h" header.

properties:
  compatible:
    items:
      - const: zte,zx297520v3-topcrm
      - const: syscon

  reg:
    maxItems: 1

  clocks:
    items:
      - description: 26 MHz external oscillator
      - description: 32 KHz external oscillator

  clock-names:
    items:
      - const: osc26m
      - const: osc32k

  "#address-cells":
    const: 1

  "#size-cells":
    const: 0

  "#clock-cells":
    const: 1

  "#reset-cells":
    const: 1

  syscon-reboot:
    type: object
    $ref: /schemas/power/reset/syscon-reboot.yaml#
    description:
      Reboot method for the SoC.

  usb-phy@84:
    type: object
    $ref: /schemas/phy/zte,zx297520v3-usb-phy.yaml#
    description:
      USB and HSIC PHY controller.

required:
  - compatible
  - reg
  - clocks
  - clock-names
  - syscon-reboot
  - usb-phy@84
  - "#address-cells"
  - "#size-cells"
  - "#clock-cells"
  - "#reset-cells"

unevaluatedProperties: false

examples:
  - |
    #include <dt-bindings/interrupt-controller/arm-gic.h>
    #include <dt-bindings/reset/zte,zx297520v3-reset.h>
    #include <dt-bindings/phy/phy-zte-zx297520v3-usb.h>
    #include <dt-bindings/clock/zte,zx297520v3-clk.h>

    topcrm: clock-controller@13b000 {
        compatible = "zte,zx297520v3-topcrm", "syscon";
        reg = <0x0013b000 0x400>;
        clocks = <&osc26m>, <&osc32k>;
        clock-names = "osc26m", "osc32k";
        #address-cells = <1>;
        #size-cells = <0>;
        #clock-cells = <1>;
        #reset-cells = <1>;

        syscon-reboot {
          compatible = "syscon-reboot";
          offset = <0x0>;
          mask = <0x1>;
          value = <0x1>;
        };

        usb-phy@84 {
          compatible = "zte,zx297520v3-usb-phy";
          reg = <0x84>;
          interrupts = <GIC_SPI 42 IRQ_TYPE_EDGE_RISING>,
            <GIC_SPI 43 IRQ_TYPE_EDGE_RISING>,
            <GIC_SPI 45 IRQ_TYPE_EDGE_RISING>,
            <GIC_SPI 46 IRQ_TYPE_EDGE_RISING>;
          interrupt-names = "usb-up", "usb-down", "hsic-up", "hsic-down";
          resets = <&topcrm ZX297520V3_USB_PHY_RESET>,
            <&topcrm ZX297520V3_HSIC_PHY_RESET>;
          reset-names = "usb", "hsic";
          #phy-cells = <1>;
        };
    };
```

## Documentation/devicetree/bindings/connector/fsl,aud-io-slot.yaml
```yaml
# SPDX-License-Identifier: (GPL-2.0-only OR BSD-2-Clause)
%YAML 1.2
---
$id: http://devicetree.org/schemas/connector/fsl,aud-io-slot.yaml#
$schema: http://devicetree.org/meta-schemas/core.yaml#

title: NXP AUD-IO Slot

maintainers:
  - Frank Li <Frank.li@nxp.com>
  - Chancel Liu <chancel.liu@nxp.com>

description:
  The NXP AUD-IO slot represents a physically present I/O connector on
  the base board. It acts as a nexus that exposes a constrained set of
  I/O resources, such as GPIOs, clocks and interrupts, through fixed
  electrical wiring. All actual hardware providers reside on the base
  board. The connector node only defines index-based mappings to those
  providers. This connector type is present on i.MX95 19x19 EVK and
  i.MX952 EVK, where it is used to attach the IMX-AUD-IO expansion card.

properties:
  compatible:
    oneOf:
      - items:
          - enum:
              - fsl,imx952-evk-aud-io
          - const: fsl,imx95-19x19-evk-aud-io
      - const: fsl,imx95-19x19-evk-aud-io

  gpio-controller: true

  '#gpio-cells':
    const: 2

  gpio-map:
    minItems: 1
    maxItems: 32

  gpio-map-mask:
    items:
      - const: 0xffff
      - const: 0x0

  gpio-map-pass-thru:
    items:
      - const: 0x0
      - const: 0x1

  '#clock-cells':
    const: 1

  clock-map:
    minItems: 1
    maxItems: 16

  clock-map-mask:
    items:
      - const: 0xff

  clock-map-pass-thru: true

  '#address-cells':
    const: 0

  interrupt-controller: true

  '#interrupt-cells':
    const: 2

  interrupt-map:
    minItems: 1
    maxItems: 32

  interrupt-map-mask:
    items:
      - const: 0xffff
      - const: 0x0

allOf:
  - $ref: /schemas/gpio/gpio-nexus-node.yaml#
  - $ref: /schemas/clock/clock-nexus-node.yaml#

required:
  - compatible
  - gpio-controller
  - '#gpio-cells'
  - gpio-map
  - gpio-map-mask
  - gpio-map-pass-thru

additionalProperties: false

examples:
  - |
    #include <dt-bindings/interrupt-controller/irq.h>

    connector {
      compatible = "fsl,imx95-19x19-evk-aud-io";
      gpio-controller;
      #gpio-cells = <2>;
      gpio-map = <0 0 &gpio1 8 1>;
      gpio-map-mask = <0xffff 0x0>;
      gpio-map-pass-thru = <0x0 0x1>;
      #clock-cells = <1>;
      clock-map = <0 &clk 1>;
      clock-map-mask = <0xff>;
      #address-cells = <0>;
      interrupt-controller;
      #interrupt-cells = <2>;
      interrupt-map-mask = <0xffff 0x0>;
      interrupt-map = <0 0 &gpio2 27 IRQ_TYPE_LEVEL_LOW>;
    };
```

## Documentation/devicetree/bindings/connector/fsl,io-connector.yaml
```yaml
# SPDX-License-Identifier: (GPL-2.0-only OR BSD-2-Clause)
%YAML 1.2
---
$id: http://devicetree.org/schemas/connector/fsl,io-connector.yaml#
$schema: http://devicetree.org/meta-schemas/core.yaml#

title: NXP I/O Connector

maintainers:
  - Frank Li <Frank.li@nxp.com>
  - Chancel Liu <chancel.liu@nxp.com>

description:
  The NXP I/O connector represents a physically present I/O connector on the
  base board. It acts as a nexus that exposes a constrained set of I/O
  resources, such as GPIOs, clocks, PWMs and interrupts, through fixed
  electrical wiring. All actual hardware providers reside on the base board.
  The connector node only defines index-based mappings to those providers.

properties:
  compatible:
    const: fsl,io-connector

  gpio-controller: true

  '#gpio-cells':
    const: 2

  gpio-map:
    $ref: /schemas/types.yaml#/definitions/uint32-matrix

  gpio-map-mask:
    $ref: /schemas/types.yaml#/definitions/uint32-array

  gpio-map-pass-thru:
    $ref: /schemas/types.yaml#/definitions/uint32-array

  '#clock-cells':
    const: 1

  clock-map:
    $ref: /schemas/types.yaml#/definitions/uint32-matrix

  clock-map-mask:
    $ref: /schemas/types.yaml#/definitions/uint32-array

  clock-map-pass-thru:
    $ref: /schemas/types.yaml#/definitions/uint32-array

  pwm-map:
    $ref: /schemas/types.yaml#/definitions/uint32-matrix

  pwm-map-mask:
    $ref: /schemas/types.yaml#/definitions/uint32-array

  pwm-map-pass-thru:
    $ref: /schemas/types.yaml#/definitions/uint32-array

  '#address-cells':
    const: 0

  interrupt-controller: true

  "#interrupt-cells":
    const: 2

  interrupt-map: true

  interrupt-map-mask: true

required:
  - compatible

additionalProperties: false

examples:
  - |
    #include <dt-bindings/interrupt-controller/irq.h>

    connector {
        compatible = "fsl,io-connector";
        gpio-controller;
        #gpio-cells = <2>;
        gpio-map = <0 0 &gpio1 8 1>;
        gpio-map-mask = <0xff 0x0>;
        gpio-map-pass-thru = <0x0 0x1>;
        #clock-cells = <1>;
        clock-map = <0 &clk 1>;
        #address-cells = <0>;
        interrupt-controller;
        #interrupt-cells = <2>;
        interrupt-map-mask = <0xff 0x0>;
        interrupt-map = <0 0 &gpio2 27 IRQ_TYPE_LEVEL_LOW>;
    };
```

## Documentation/devicetree/bindings/counter/gpio-counter.yaml
```yaml
# SPDX-License-Identifier: GPL-2.0-only OR BSD-2-Clause
%YAML 1.2
---
$id: http://devicetree.org/schemas/counter/gpio-counter.yaml#
$schema: http://devicetree.org/meta-schemas/core.yaml#

title: GPIO-based Counter

maintainers:
  - Wadim Mueller <wafgo01@gmail.com>

description: |
  GPIO-based software counter with two Counts:
    * Count 1: A + B. Quadrature X1/X2/X4, pulse-direction, inc/dec.
    * Count 2: B. Inc / dec.
  The function is selected at runtime via the counter sysfs ABI. Each
  Count has an optional Index (Z) that loads its preset on rising edge.

properties:
  compatible:
    const: gpio-counter

  signal-a-gpios:
    maxItems: 1
    description: Signal A (phase A; pulse input in pulse-direction/inc/dec).

  signal-b-gpios:
    maxItems: 1
    description:
      Signal B (phase B; direction in pulse-direction; pulse input for
      Count 2).

  index-gpios:
    minItems: 1
    maxItems: 2
    description:
      Optional Index (Z) inputs. First entry indexes Count 1, second
      (optional) indexes Count 2.

required:
  - compatible
  - signal-a-gpios
  - signal-b-gpios

additionalProperties: false

examples:
  - |
    #include <dt-bindings/gpio/gpio.h>

    counter {
        compatible = "gpio-counter";
        signal-a-gpios = <&gpio0 10 GPIO_ACTIVE_LOW>;
        signal-b-gpios = <&gpio0 11 GPIO_ACTIVE_LOW>;
        index-gpios = <&gpio0 12 GPIO_ACTIVE_LOW>,
                      <&gpio0 13 GPIO_ACTIVE_LOW>;
    };

...
```

## Documentation/devicetree/bindings/counter/gpio-quadrature-encoder.yaml
```yaml
# SPDX-License-Identifier: GPL-2.0-only OR BSD-2-Clause
%YAML 1.2
---
$id: http://devicetree.org/schemas/counter/gpio-quadrature-encoder.yaml#
$schema: http://devicetree.org/meta-schemas/core.yaml#

title: GPIO-based Quadrature Encoder

maintainers:
  - Wadim Mueller <wadim.mueller@cmblu.de>

description: |
  A generic GPIO-based quadrature encoder counter.  Reads A/B quadrature
  signals and an optional index pulse via edge-triggered GPIO interrupts.
  Supports X1, X2, X4 quadrature decoding and pulse-direction mode.

  This driver is useful on SoCs that lack a dedicated hardware quadrature
  decoder (eQEP, QEI, etc.) or where the encoder is wired to generic GPIO
  pins rather than to a dedicated peripheral.

properties:
  compatible:
    const: gpio-quadrature-encoder

  encoder-a-gpios:
    maxItems: 1
    description:
      GPIO connected to the encoder's A (phase A) output.

  encoder-b-gpios:
    maxItems: 1
    description:
      GPIO connected to the encoder's B (phase B) output.

  encoder-index-gpios:
    maxItems: 1
    description:
      Optional GPIO connected to the encoder's index (Z) output.
      When the index input is enabled via sysfs, the count resets
      to zero on each index pulse.

required:
  - compatible
  - encoder-a-gpios
  - encoder-b-gpios

additionalProperties: false

examples:
  - |
    #include <dt-bindings/gpio/gpio.h>

    quadrature-encoder-0 {
        compatible = "gpio-quadrature-encoder";
        encoder-a-gpios = <&gpio0 10 GPIO_ACTIVE_HIGH>;
        encoder-b-gpios = <&gpio0 11 GPIO_ACTIVE_HIGH>;
    };

  - |
    #include <dt-bindings/gpio/gpio.h>

    quadrature-encoder-1 {
        compatible = "gpio-quadrature-encoder";
        encoder-a-gpios = <&gpio0 10 GPIO_ACTIVE_LOW>;
        encoder-b-gpios = <&gpio0 11 GPIO_ACTIVE_LOW>;
        encoder-index-gpios = <&gpio0 12 GPIO_ACTIVE_LOW>;
    };

...
```

## Documentation/devicetree/bindings/counter/nxp,pcf85363-stopwatch.yaml
```yaml
# SPDX-License-Identifier: (GPL-2.0-only OR BSD-2-Clause)
%YAML 1.2
---
$id: http://devicetree.org/schemas/counter/nxp,pcf85363-stopwatch.yaml#
$schema: http://devicetree.org/meta-schemas/core.yaml#

title: NXP PCF85263ATL/PCF85363ATL Stopwatch (counter) mode

maintainers:
  - Lakshay Piplani <lakshay.piplani@nxp.com>

description: |
  Binding for NXP PCF82563ATL/PCF85363ATL devices when used in the
  stopwatch mode. In this mode, the device provides a centi-seconds
  (1/100th of a second) resolution operating over i2c.

properties:
  compatible:
    enum:
      - nxp,pcf85263atl
      - nxp,pcf85363atl

  reg:
    maxItems: 1

  quartz-load-femtofarads:
    description:
      The capacitive load of the quartz(x-tal).
    enum: [6000, 7000, 12500]
    default: 7000

required:
  - compatible
  - reg

additionalProperties: false

examples:
  - |
    i2c {
      #address-cells = <1>;
      #size-cells = <0>;

      counter@51 {
        compatible = "nxp,pcf85363atl";
        reg = <0x51>;
        quartz-load-femtofarads = <7000>;
      };
    };
```

## Documentation/devicetree/bindings/counter/ti,omap-dmtimer-cap.yaml
```yaml
# SPDX-License-Identifier: GPL-2.0-only OR BSD-2-Clause
%YAML 1.2
---
$id: http://devicetree.org/schemas/counter/ti,omap-dmtimer-cap.yaml#
$schema: http://devicetree.org/meta-schemas/core.yaml#

title: TI dual mode timer Capture Module

maintainers:
  - Gokul Praveen <g-praveen@ti.com>

description:
  TI dual mode timer instances have an IO pin for Capture capability.

properties:
  compatible:
    const: ti,omap-dmtimer-cap

  ti,timers:
    description: Timer instance phandle for the Capture
    $ref: /schemas/types.yaml#/definitions/phandle

required:
  - compatible
  - ti,timers

unevaluatedProperties: false

examples:
  - |
    main_cap10: dmtimer-main-cap-10 {
      compatible = "ti,omap-dmtimer-cap";
      ti,timers = <&main_timer10>;
    };
```
