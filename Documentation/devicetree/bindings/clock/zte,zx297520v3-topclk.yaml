## Documentation/devicetree/bindings/crypto/amlogic,gxl-crypto.yaml
```yaml
# SPDX-License-Identifier: GPL-2.0
%YAML 1.2
---
$id: http://devicetree.org/schemas/crypto/amlogic,gxl-crypto.yaml#
$schema: http://devicetree.org/meta-schemas/core.yaml#

title: Amlogic GXL Cryptographic Offloader

maintainers:
  - Corentin Labbe <clabbe@baylibre.com>

properties:
  compatible:
    oneOf:
      - items:
          - enum:
              - amlogic,s4-crypto
          - const: amlogic,a1-crypto
      - enum:
          - amlogic,gxl-crypto
          - amlogic,axg-crypto
          - amlogic,g12a-crypto
          - amlogic,a1-crypto

  reg:
    maxItems: 1

  interrupts:
    items:
      - description: Interrupt for flow 0

  clocks:
    maxItems: 1

  power-domains:
    maxItems: 1

required:
  - compatible
  - reg
  - interrupts
  - clocks

allOf:
  - if:
      properties:
        compatible:
          const: amlogic,a1-crypto
    then:
      required:
        - power-domains

additionalProperties: false

examples:
  - |
    #include <dt-bindings/interrupt-controller/irq.h>
    #include <dt-bindings/interrupt-controller/arm-gic.h>
    #include <dt-bindings/clock/gxbb-clkc.h>

    crypto: crypto-engine@c883e000 {
        compatible = "amlogic,gxl-crypto";
        reg = <0xc883e000 0x36>;
        interrupts = <GIC_SPI 188 IRQ_TYPE_EDGE_RISING>;
        clocks = <&clkc CLKID_CLK81>;
    };
```

## Documentation/devicetree/bindings/crypto/mediatek,mtk-eip93.yaml
```yaml
# SPDX-License-Identifier: (GPL-2.0-only OR BSD-2-Clause)
%YAML 1.2
---
$id: http://devicetree.org/schemas/crypto/mediatek,mtk-eip93.yaml#
$schema: http://devicetree.org/meta-schemas/core.yaml#

title: Mediatek EIP93 crypto engine

maintainers:
  - Christian Marangi <ansuelsmth@gmail.com>

properties:
  compatible:
    enum:
      - mediatek, mtk-eip93
      - airoha,mtk-eip93

  reg:
    maxItems: 1

  interrupts:
    maxItems: 1

required:
  - compatible
  - reg
  - interrupts

additionalProperties: false

examples:
  - |
    #include <dt-bindings/interrupt-controller/arm-gic.h>

    crypto@1e004000 {
      compatible = "airoha,mtk-eip93";
      reg = <0x1fb70000 0x1000>;

      interrupts = <GIC_SPI 44 IRQ_TYPE_LEVEL_HIGH>;
    };
```

## Documentation/devicetree/bindings/crypto/rockchip,rk3588-crypto.yaml
```yaml
# SPDX-License-Identifier: (GPL-2.0-only OR BSD-2-Clause)
%YAML 1.2
---
$id: http://devicetree.org/schemas/crypto/rockchip,rk3588-crypto.yaml#
$schema: http://devicetree.org/meta-schemas/core.yaml#

title: Rockchip cryptographic offloader

maintainers:
  - Heiko Stuebner <heiko@sntech.de>
  - Corentin Labbe <clabbe@baylibre.com>
  - Dawid Olesinski <dawidro@gmail.com>

properties:
  compatible:
    enum:
      - rockchip,rk3568-crypto
      - rockchip,rk3588-crypto

  reg:
    maxItems: 1

  interrupts:
    maxItems: 1

  clocks:
    items:
      - description: Core clock for the crypto IP internal logic
      - description: AXI interconnect clock interface
      - description: AHB interface clock

  clock-names:
    items:
      - const: core
      - const: aclk
      - const: hclk

  resets:
    maxItems: 1

  reset-names:
    items:
      - const: core

required:
  - compatible
  - reg
  - interrupts
  - clocks
  - clock-names
  - resets

additionalProperties: false

examples:
  - |
    #include <dt-bindings/interrupt-controller/arm-gic.h>

    crypto@fe370000 {
        compatible = "rockchip,rk3588-crypto";
        reg = <0x0 0xfe370000 0x0 0x2000>;
        interrupts = <GIC_SPI 209 IRQ_TYPE_LEVEL_HIGH 0>;
        clocks = <&scmi_clk SCMI_CRYPTO_CORE>,
                 <&scmi_clk SCMI_ACLK_SECURE_NS>,
                 <&scmi_clk SCMI_HCLK_SECURE_NS>;
        clock-names = "core", "aclk", "hclk";
        resets = <&scmi_reset SCMI_SRST_CRYPTO_CORE>;
        reset-names = "core";
    };
```

## Documentation/devicetree/bindings/crypto/snps,dwc-spacc.yaml
```yaml
# SPDX-License-Identifier: (GPL-2.0-only OR BSD-2-Clause)
%YAML 1.2
---
$id: http://devicetree.org/schemas/crypto/snps,dwc-spacc.yaml#
$schema: http://devicetree.org/meta-schemas/core.yaml#

title: Synopsys DesignWare Security Protocol Accelerator(SPAcc) Crypto Engine

maintainers:
  - Ruud Derwig <Ruud.Derwig@synopsys.com>

description: |
  The Synopsys DWC Security Protocol Accelerator (SPAcc), which is a
  semiconductor IP designed to accelerate cryptographic operations,
  such as encryption, decryption, and hashing.

  In this configuration, the SPAcc IP is instantiated within the Synopsys
  NSIMOSCI virtual SoC platform, a SystemC simulation environment used for
  software development and testing. The device is accessed as a memory-mapped
  peripheral and generates interrupts to the ARC interrupt controller.

properties:
  compatible:
    items:
      - const: snps,nsimosci-hs-spacc

  reg:
    maxItems: 1

  interrupts:
    maxItems: 1

  clocks:
    maxItems: 1

required:
  - compatible
  - reg
  - interrupts

additionalProperties: false

examples:
  - |
    crypto@40000000 {
        compatible = "snps,nsimosci-hs-spacc";
        reg = <0x40000000 0x3ffff>;
        interrupts = <28>;
        clocks = <&clock>;
    };
```

## Documentation/devicetree/bindings/crypto/xlnx,versal-trng.yaml
```yaml
# SPDX-License-Identifier: (GPL-2.0-only OR BSD-2-Clause)
%YAML 1.2
---
$id: http://devicetree.org/schemas/crypto/xlnx,versal-trng.yaml#
$schema: http://devicetree.org/meta-schemas/core.yaml#

title: Xilinx Versal True Random Number Generator Hardware Accelerator

maintainers:
  - Harsh Jain <h.jain@amd.com>
  - Mounika Botcha <mounika.botcha@amd.com>

description:
  The Versal True Random Number Generator cryptographic accelerator
  is used to generate the random number.

properties:
  compatible:
    const: xlnx,versal-trng

  reg:
    maxItems: 1

required:
  - reg

additionalProperties: false

examples:
  - |
    trng@f1230000 {
        compatible = "xlnx,versal-trng";
        reg = <0xf1230000 0x1000>;
    };
...
```

## Documentation/devicetree/bindings/devfreq/airoha,devfreq.yaml
```yaml
# SPDX-License-Identifier: (GPL-2.0-only OR BSD-2-Clause)
%YAML 1.2
---
$id: http://devicetree.org/schemas/devfreq/airoha,devfreq.yaml#
$schema: http://devicetree.org/meta-schemas/core.yaml#

title: Airoha SoC Subsystem Devfreq

maintainers:
  - Christian Marangi <ansuelsmth@gmail.com>

description:
  Airoha SoC contains multiple subsystem that are scaled to a
  specific OPP taking the CPU clock as reference. Such sybsystem
  can enter idle or performance state based on the system load
  and power consumption conditions.

  Example of such subsystem are GSW (Gigabit Switch), NPU (Custom
  Risc Co-Processor for Network acceleration), SOE (Crypto Module) BUS...

properties:
  compatible:
    const: airoha,devfreq

  clocks:
    maxItems: 1

  operating-points-v2:
    description:
      OPP table of the related subsystem supported rates that referenced
      clocks will be scaled to.

required:
  - compatible
  - clocks
  - operating-points-v2

additionalProperties: false

examples:
  - |
    #include <dt-bindings/clock/en7523-clk.h>

    npu_opp_table: opp-table-npu {
        compatible = "operating-points-v2";

        npu_low: opp-400000000 {
           opp-hz = /bits/ 64 <400000000>;
        };

        npu_high: opp-720000000 {
           opp-hz = /bits/ 64 <720000000>;
        };
    };

    emi_opp_table: opp-table-emi {
        compatible = "operating-points-v2";

        emi_low: opp-400000000 {
            opp-hz = /bits/ 64 <400000000>;
        };

        emi_high: opp-540000000 {
           opp-hz = /bits/ 64 <540000000>;
        };
    };

    bus_opp_table: opp-table-bus {
        compatible = "operating-points-v2";

        bus_low: opp-200000000 {
           opp-hz = /bits/ 64 <200000000>;
        };

        bus_high: opp-300000000 {
           opp-hz = /bits/ 64 <300000000>;
        };
    };

    gsw_opp_table: opp-table-gsw {
        compatible = "operating-points-v2";

        gsw_low: opp-200000000 {
            opp-hz = /bits/ 64 <200000000>;
        };

        gsw_high: opp-500000000 {
           opp-hz = /bits/ 64 <500000000>;
        };
    };

    npu-devfreq {
        compatible = "airoha,devfreq";
        operating-points-v2 = <&npu_opp_table>;
        clocks = <&scuclk EN7523_CLK_NPU>;
    };

    emi-devfreq {
        compatible = "airoha,devfreq";
        operating-points-v2 = <&emi_opp_table>;
        clocks = <&scuclk EN7523_CLK_EMI>;
    };

    bus-devfreq {
        compatible = "airoha,devfreq";
        operating-points-v2 = <&bus_opp_table>;
        clocks = <&scuclk EN7523_CLK_BUS>;
    };

    gsw-devfreq {
        compatible = "airoha,devfreq";
        operating-points-v2 = <&gsw_opp_table>;
        clocks = <&scuclk EN7523_CLK_GSW>;
    };
```

## Documentation/devicetree/bindings/devfreq/airoha,subsystem-scale.yaml
```yaml
# SPDX-License-Identifier: (GPL-2.0-only OR BSD-2-Clause)
%YAML 1.2
---
$id: http://devicetree.org/schemas/devfreq/airoha,subsystem-scale.yaml#
$schema: http://devicetree.org/meta-schemas/core.yaml#

title: Airoha SoC Subsystem Scale Driver

maintainers:
  - Christian Marangi <ansuelsmth@gmail.com>

description:
  Airoha SoC contains multiple subsystems that are scaled to a
  specific OPP taking the CPU clock as reference. Such subsystem
  can enter idle or performance state based on the system load
  and power consumption conditions.

  Example of such subsystems are GSW (Gigabit Switch), NPU (Custom
  Risc Co-Processor for Network acceleration), SOE (Crypto Module) BUS...

properties:
  compatible:
    const: airoha,an7581-subsystem-scale

  clocks:
    maxItems: 1

  operating-points-v2:
    description:
      OPP table of the related subsystem supported rates that referenced
      clocks will be scaled to.

required:
  - compatible
  - clocks
  - operating-points-v2

additionalProperties: false

examples:
  - |
    #include <dt-bindings/clock/en7523-clk.h>

    npu_opp_table: opp-table-npu {
        compatible = "operating-points-v2";

        npu_low: opp-400000000 {
           opp-hz = /bits/ 64 <400000000>;
        };

        npu_high: opp-720000000 {
           opp-hz = /bits/ 64 <720000000>;
        };
    };

    emi_opp_table: opp-table-emi {
        compatible = "operating-points-v2";

        emi_low: opp-400000000 {
            opp-hz = /bits/ 64 <400000000>;
        };

        emi_high: opp-540000000 {
           opp-hz = /bits/ 64 <540000000>;
        };
    };

    bus_opp_table: opp-table-bus {
        compatible = "operating-points-v2";

        bus_low: opp-200000000 {
           opp-hz = /bits/ 64 <200000000>;
        };

        bus_high: opp-300000000 {
           opp-hz = /bits/ 64 <300000000>;
        };
    };

    gsw_opp_table: opp-table-gsw {
        compatible = "operating-points-v2";

        gsw_low: opp-200000000 {
            opp-hz = /bits/ 64 <200000000>;
        };

        gsw_high: opp-500000000 {
           opp-hz = /bits/ 64 <500000000>;
        };
    };

    npu-subsystem {
        compatible = "airoha,an7581-subsystem-scale";
        operating-points-v2 = <&npu_opp_table>;
        clocks = <&scuclk EN7523_CLK_NPU>;
    };

    emi-subsystem {
        compatible = "airoha,an7581-subsystem-scale";
        operating-points-v2 = <&emi_opp_table>;
        clocks = <&scuclk EN7523_CLK_EMI>;
    };

    bus-subsystem {
        compatible = "airoha,an7581-subsystem-scale";
        operating-points-v2 = <&bus_opp_table>;
        clocks = <&scuclk EN7523_CLK_BUS>;
    };

    gsw-subsystem {
        compatible = "airoha,an7581-subsystem-scale";
        operating-points-v2 = <&gsw_opp_table>;
        clocks = <&scuclk EN7523_CLK_GSW>;
    };
```

## Documentation/devicetree/bindings/display/apple,display-pipe.yaml
```yaml
# SPDX-License-Identifier: (GPL-2.0 OR BSD-2-Clause)
%YAML 1.2
---
$id: http://devicetree.org/schemas/display/apple,display-pipe.yaml#
$schema: http://devicetree.org/meta-schemas/core.yaml#

title: Apple pre-DCP display controller.

maintainers:
  - asahi@lists.linux.dev
  - Sasha Finkelstein <fnkl.kernel@gmail.com>

description: |
  A secondary display controller used to drive the "touchbar" on certain
  Apple laptops.

properties:
  compatible:
    items:
      - enum:
        - "apple,t8112-display-pipe"
        - "apple,t8103-display-pipe"
      - const: "apple,h7-display-pipe"

  reg:
    minItems: 3
    maxItems: 3

  reg-names:
    items:
      - const: be
      - const: fe
      - const: mipi

  power-domains: true

  interrupts:
    minItems: 2
    maxItems: 2

  interrupt-names:
    items:
      - const: be
      - const: fe

  iommus: true

  "#address-cells":
    const: 1

  "#size-cells":
    const: 0

additionalProperties: true

required:
  - compatible
  - reg
  - interrupts
```

## Documentation/devicetree/bindings/display/apple,h7-display-pipe-mipi.yaml
```yaml
# SPDX-License-Identifier: (GPL-2.0 OR BSD-2-Clause)
%YAML 1.2
---
$id: http://devicetree.org/schemas/display/apple,h7-display-pipe-mipi.yaml#
$schema: http://devicetree.org/meta-schemas/core.yaml#

title: Apple pre-DCP display controller MIPI interface.

maintainers:
  - asahi@lists.linux.dev
  - Sasha Finkelstein <fnkl.kernel@gmail.com>

description:
  The MIPI controller part of the pre-DCP Apple display controller

allOf:
  - $ref: dsi-controller.yaml#

properties:
  compatible:
    items:
      - enum:
          - apple,t8112-display-pipe-mipi
          - apple,t8103-display-pipe-mipi
      - const: apple,h7-display-pipe-mipi

  reg:
    maxItems: 1

  reg-names:
    const: mipi

  power-domains:
    maxItems: 1

  ports:
    $ref: /schemas/graph.yaml#/properties/ports

    properties:
      port@0:
        $ref: /schemas/graph.yaml#/properties/port

      port@1:
        $ref: /schemas/graph.yaml#/properties/port

    required:
      - port@0
      - port@1

  '#address-cells': true

  '#size-cells': true

patternProperties:
  "^panel@[0-3]$": true

required:
  - compatible
  - reg
  - ports

additionalProperties: false

examples:
  - |
    display_dfr: dsi@228200000 {
    	compatible = "apple,t8103-display-pipe-mipi", "apple,h7-display-pipe-mipi";
    	reg-names = "mipi";
    	reg = <0x28200000 0xc000>;
    	power-domains = <&ps_dispdfr_mipi>;

    	ports {
    		#address-cells = <1>;
    		#size-cells = <0>;

    		dfr_mipi_in: port@0 {
    			#address-cells = <1>;
    			#size-cells = <0>;
    			reg = <0>;
    		};

    		dfr_mipi_out: port@1 {
    			#address-cells = <1>;
    			#size-cells = <0>;
    			reg = <1>;
    		};
    	};
    };
...
```
