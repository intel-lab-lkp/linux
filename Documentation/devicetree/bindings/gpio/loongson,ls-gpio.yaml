## Documentation/devicetree/bindings/gpu/img,powervr-rogue.yaml
```yaml
# SPDX-License-Identifier: (GPL-2.0-only OR BSD-2-Clause)
# Copyright (c) 2023 Imagination Technologies Ltd.
%YAML 1.2
---
$id: http://devicetree.org/schemas/gpu/img,powervr-rogue.yaml#
$schema: http://devicetree.org/meta-schemas/core.yaml#

title: Imagination Technologies PowerVR and IMG Rogue GPUs

maintainers:
  - Frank Binns <frank.binns@imgtec.com>

properties:
  compatible:
    oneOf:
      - items:
          - enum:
              - ti,am62-gpu
          - const: img,img-axe-1-16m
          - const: img,img-rogue
      - items:
          - enum:
              - ti,j721s2-gpu
          - const: img,img-bxs-4-64
          - const: img,img-rogue

      # This legacy combination of compatible strings was introduced early on before the more
      # specific GPU identifiers were used. Keep it around here for compatibility, but never use
      # "img,img-axe" in new devicetrees.
      - items:
          - const: ti,am62-gpu
          - const: img,img-axe

  reg:
    maxItems: 1

  clocks:
    oneOf:
      - minItems: 1
        maxItems: 1
      - minItems: 3
        maxItems: 3

  clock-names:
    oneOf:
      - items:
          - const: core
      - items:
          - const: core
          - const: mem
          - const: sys

  interrupts:
    maxItems: 1

  power-domains:
    minItems: 1
    maxItems: 2

  power-domain-names:
    oneOf:
      - items:
          - const: a
      - items:
          - const: a
          - const: b

  dma-coherent: true

required:
  - compatible
  - reg
  - clocks
  - clock-names
  - interrupts
  - power-domains
  - power-domain-names

additionalProperties: false

allOf:
  # Cores with a single power domain
  - if:
      properties:
        compatible:
          contains:
            anyOf:
              - const: img,img-axe-1-16m
    then:
      properties:
        power-domains:
          minItems: 1
          maxItems: 1
        power-domain-names:
          items:
            - const: a
  # Cores with two power domains
  - if:
      properties:
        compatible:
          contains:
            anyOf:
              - const: img,img-bxs-4-64
    then:
      properties:
        power-domains:
          minItems: 2
          maxItems: 2
        power-domain-names:
          items:
            - const: a
            - const: b
  # Vendor integrations using a single clock domain
  - if:
      properties:
        compatible:
          contains:
            anyOf:
              - const: ti,am62-gpu
              - const: ti,j721s2-gpu
    then:
      properties:
        clocks:
          minItems: 1
          maxItems: 1
        clock-names:
          items:
            - const: core

examples:
  - |
    #include <dt-bindings/interrupt-controller/irq.h>
    #include <dt-bindings/interrupt-controller/arm-gic.h>
    #include <dt-bindings/soc/ti,sci_pm_domain.h>

    gpu@fd00000 {
        compatible = "ti,am62-gpu", "img,img-axe-1-16m", "img,img-rogue";
        reg = <0x0fd00000 0x20000>;
        clocks = <&k3_clks 187 0>;
        clock-names = "core";
        interrupts = <GIC_SPI 86 IRQ_TYPE_LEVEL_HIGH>;
        power-domains = <&k3_pds 187 TI_SCI_PD_EXCLUSIVE>;
        power-domain-names = "a";
    };
  - |
    #include <dt-bindings/interrupt-controller/irq.h>
    #include <dt-bindings/interrupt-controller/arm-gic.h>
    #include <dt-bindings/soc/ti,sci_pm_domain.h>

    / {
        #address-cells = <2>;
        #size-cells = <2>;
        interrupt-controller;
        #interrupt-cells = <3>;

        gpu@4e20000000 {
            compatible = "ti,j721s2-gpu", "img,img-bxs-4-64", "img,img-rogue";
            reg = /bits/ 64 <0x4e20000000 0x80000>;
            clocks = <&k3_clks 130 1>;
            clock-names = "core";
            interrupts = <GIC_SPI 24 IRQ_TYPE_LEVEL_HIGH>;
            power-domains = <&k3_pds 130 TI_SCI_PD_EXCLUSIVE>,
                            <&k3_pds 373 TI_SCI_PD_EXCLUSIVE>;
            power-domain-names = "a", "b";
            dma-coherent;
        };
    };
```

## Documentation/devicetree/bindings/gpu/img,powervr.yaml
```yaml
# SPDX-License-Identifier: (GPL-2.0-only OR BSD-2-Clause)
# Copyright (c) 2023 Imagination Technologies Ltd.
%YAML 1.2
---
$id: http://devicetree.org/schemas/gpu/img,powervr.yaml#
$schema: http://devicetree.org/meta-schemas/core.yaml#

title: Imagination Technologies PowerVR and IMG GPU

maintainers:
  - Frank Binns <frank.binns@imgtec.com>

properties:
  $nodename:
    pattern: '^gpu@[a-f0-9]+$'

  compatible:
    oneOf:
      - items:
          - enum:
              - ti,am62-gpu
          - const: img,img-axe # IMG AXE GPU model/revision is fully discoverable
      - items:
          - enum:
              - ti,omap3430-gpu # Rev 121
              - ti,omap3630-gpu # Rev 125
          - const: img,powervr-sgx530
      - items:
          - enum:
              - ingenic,jz4780-gpu # Rev 130
              - ti,omap4430-gpu # Rev 120
          - const: img,powervr-sgx540
      - items:
          - enum:
              - allwinner,sun6i-a31-gpu # MP2 Rev 115
              - ti,omap4470-gpu # MP1 Rev 112
              - ti,omap5432-gpu # MP2 Rev 105
              - ti,am5728-gpu # MP2 Rev 116
              - ti,am6548-gpu # MP1 Rev 117
          - const: img,powervr-sgx544

  reg:
    maxItems: 1

  clocks:
    minItems: 1
    maxItems: 3

  clock-names:
    items:
      - const: core
      - const: mem
      - const: sys
    minItems: 1

  interrupts:
    maxItems: 1

  power-domains:
    maxItems: 1

required:
  - compatible
  - reg
  - interrupts

additionalProperties: false

allOf:
  - if:
      properties:
        compatible:
          contains:
            const: ti,am62-gpu
    then:
      properties:
        clocks:
          maxItems: 1
      required:
        - clocks
        - clock-names
  - if:
      properties:
        compatible:
          contains:
            const: ti,am654-sgx544
    then:
      properties:
        power-domains:
          minItems: 1
      required:
        - power-domains
  - if:
      properties:
        compatible:
          contains:
            const: allwinner,sun6i-a31-gpu
    then:
      properties:
        clocks:
          minItems: 2
        clock-names:
          minItems: 2
      required:
        - clocks
        - clock-names
  - if:
      properties:
        compatible:
          contains:
            const: ingenic,jz4780-gpu
    then:
      required:
        - clocks
        - clock-names

examples:
  - |
    #include <dt-bindings/interrupt-controller/irq.h>
    #include <dt-bindings/interrupt-controller/arm-gic.h>
    #include <dt-bindings/soc/ti,sci_pm_domain.h>

    gpu@fd00000 {
        compatible = "ti,am62-gpu", "img,img-axe";
        reg = <0x0fd00000 0x20000>;
        clocks = <&k3_clks 187 0>;
        clock-names = "core";
        interrupts = <GIC_SPI 86 IRQ_TYPE_LEVEL_HIGH>;
        power-domains = <&k3_pds 187 TI_SCI_PD_EXCLUSIVE>;
    };
```

## Documentation/devicetree/bindings/greybus/google,arche-platform.yaml
```yaml
# SPDX-License-Identifier: (GPL-2.0-only OR BSD-2-Clause)
%YAML 1.2
---
$id: http://devicetree.org/schemas/greybus/google,arche-platform.yaml#
$schema: http://devicetree.org/meta-schemas/core.yaml#

title: Google Arche Platform

maintainers:
  - Vaibhav Hiremath <hvaibhav.linux@gmail.com>

description:
  The Arche platform driver enables the Unipro link between the
  application processor and the SVC (Supervisory Controller) in
  a Greybus-based system.

properties:
  compatible:
    const: google,arche-platform

  svc,reset-gpios:
    description: GPIO used to reset the SVC
    maxItems: 1

  svc,sysboot-gpios:
    description: GPIO used for SVC sysboot signal
    maxItems: 1

  svc,refclk-req-gpios:
    description: GPIO used to request the SVC reference clock
    maxItems: 1

  svc,wake-detect-gpios:
    description: Bidirectional GPIO for wake/detect signal between AP and SVC
    maxItems: 1

  clocks:
    description: SVC reference clock
    maxItems: 1

  clock-names:
    items:
      - const: svc_ref_clk

  svc,reset-active-high:
    description: Present if the SVC reset GPIO is active high
    type: boolean

additionalProperties: false

required:
  - compatible
  - svc,reset-gpios
  - svc,sysboot-gpios
  - svc,refclk-req-gpios
  - svc,wake-detect-gpios
  - clocks
  - clock-names

examples:
  - |
    #include <dt-bindings/gpio/gpio.h>
    arche-platform {
        compatible = "google,arche-platform";
        svc,reset-gpios = <&gpio 0 GPIO_ACTIVE_LOW>;
        svc,sysboot-gpios = <&gpio 1 GPIO_ACTIVE_HIGH>;
        svc,refclk-req-gpios = <&gpio 2 GPIO_ACTIVE_HIGH>;
        svc,wake-detect-gpios = <&gpio 3 GPIO_ACTIVE_HIGH>;
        clocks = <&svc_ref_clk>;
        clock-names = "svc_ref_clk";
    };
```

## Documentation/devicetree/bindings/hsi/hsi-client.yaml
```yaml
# SPDX-License-Identifier: (GPL-2.0-only OR BSD-2-Clause)
%YAML 1.2
---
$id: http://devicetree.org/schemas/hsi/hsi-client.yaml#
$schema: http://devicetree.org/meta-schemas/core.yaml#

title: HSI bus peripheral

description:
  Each HSI port is supposed to have one child node, which
  symbols the remote device connected to the HSI port.

maintainers:
  - Sebastian Reichel <sre@kernel.org>

properties:
  $nodename:
    const: hsi-client

  hsi-channel-ids:
    $ref: /schemas/types.yaml#/definitions/uint32-array
    minItems: 1
    maxItems: 8

  hsi-channel-names:
    minItems: 1
    maxItems: 8

  hsi-rx-mode:
    enum: [stream, frame]
    description: Receiver Bit transmission mode

  hsi-tx-mode:
    enum: [stream, frame]
    description: Transmitter Bit transmission mode

  hsi-mode:
    enum: [stream, frame]
    description:
      May be used instead hsi-rx-mode and hsi-tx-mode if the
      transmission mode is the same for receiver and transmitter.

  hsi-speed-kbps:
    description: Max bit transmission speed in kbit/s
    $ref: /schemas/types.yaml#/definitions/uint32

  hsi-flow:
    enum: [synchronized, pipeline]
    description: RX flow type

  hsi-arb-mode:
    enum: [round-robin, priority]
    description: Arbitration mode for TX frame

additionalProperties: true

required:
  - compatible
  - hsi-channel-ids
  - hsi-speed-kbps
  - hsi-flow
  - hsi-arb-mode

anyOf:
  - required:
      - hsi-mode
  - required:
      - hsi-rx-mode
      - hsi-tx-mode

allOf:
  - if:
      required:
        - hsi-mode
    then:
      properties:
        hsi-rx-mode: false
        hsi-tx-mode: false
  - if:
      required:
        - hsi-rx-mode
    then:
      properties:
        hsi-mode: false
```

## Documentation/devicetree/bindings/hsi/nokia-modem.yaml
```yaml
# SPDX-License-Identifier: (GPL-2.0-only OR BSD-2-Clause)
%YAML 1.2
---
$id: http://devicetree.org/schemas/hsi/nokia-modem.yaml#
$schema: http://devicetree.org/meta-schemas/core.yaml#

title: Nokia modem

maintainers:
  - Sebastian Reichel <sre@kernel.org>

properties:
  compatible:
    enum:
      - nokia,n900-modem
      - nokia,n950-modem
      - nokia,n9-modem

  hsi-channel-names:
    items:
      - const: mcsaab-control
      - const: speech-control
      - const: speech-data
      - const: mcsaab-data

  interrupts:
    items:
      - description: modem reset indication

  gpios:
    minItems: 3
    maxItems: 5

  gpio-names:
    items:
      - const: cmt_apeslpx
      - const: cmt_rst_rq
      - const: cmt_en
      - const: cmt_rst
      - const: cmt_bsi
    minItems: 3

required:
  - gpios
  - gpio-names
  - interrupts

allOf:
  - $ref: hsi-client.yaml#
  - if:
      properties:
        compatible:
          contains:
            enum:
              - nokia,n950-modem
              - nokia,n9-modem
    then:
      properties:
        gpios:
          maxItems: 3
        gpio-names:
          maxItems: 3
    else:
      properties:
        gpios:
          minItems: 5
        gpio-names:
          minItems: 5

unevaluatedProperties: false

examples:
  - |
    #include <dt-bindings/gpio/gpio.h>
    #include <dt-bindings/interrupt-controller/irq.h>
    hsi-client {
        compatible = "nokia,n900-modem";

        hsi-channel-ids = <0>, <1>, <2>, <3>;
        hsi-channel-names = "mcsaab-control",
                            "speech-control",
                            "speech-data",
                            "mcsaab-data";
        hsi-speed-kbps = <55000>;
        hsi-mode = "frame";
        hsi-flow = "synchronized";
        hsi-arb-mode = "round-robin";

        interrupts-extended = <&gpio3 8 IRQ_TYPE_EDGE_FALLING>;

        gpios = <&gpio3  6 GPIO_ACTIVE_HIGH>,
                <&gpio3  9 GPIO_ACTIVE_HIGH>,
                <&gpio3 10 GPIO_ACTIVE_HIGH>,
                <&gpio3 11 GPIO_ACTIVE_HIGH>,
                <&gpio5 29 GPIO_ACTIVE_HIGH>;
        gpio-names = "cmt_apeslpx",
                     "cmt_rst_rq",
                     "cmt_en",
                     "cmt_rst",
                     "cmt_bsi";
    };
```
