## Documentation/devicetree/bindings/gpio/loongson,ls-gpio.yaml
```yaml
# SPDX-License-Identifier: (GPL-2.0-only OR BSD-2-Clause)
%YAML 1.2
---
$id: http://devicetree.org/schemas/gpio/loongson,ls-gpio.yaml#
$schema: http://devicetree.org/meta-schemas/core.yaml#

title: Loongson GPIO controller.

maintainers:
  - Yinbo Zhu <zhuyinbo@loongson.cn>

properties:
  compatible:
    enum:
      - loongson,ls2k-gpio
      - loongson,ls7a-gpio
      - loongson,ls2k1000-gpio

  reg:
    maxItems: 1

  ngpios:
    minimum: 1
    maximum: 64

  "#gpio-cells":
    const: 2

  gpio-controller: true

  gpio-ranges: true

  loongson,gpio-conf-offset:
    $ref: /schemas/types.yaml#/definitions/uint32
    description:
      This option indicate this GPIO configuration register offset address.

  loongson,gpio-out-offset:
    $ref: /schemas/types.yaml#/definitions/uint32
    description:
      This option indicate this GPIO output register offset address.

  loongson,gpio-in-offset:
    $ref: /schemas/types.yaml#/definitions/uint32
    description:
      This option indicate this GPIO input register offset address.

  loongson,gpio-ctrl-mode:
    $ref: /schemas/types.yaml#/definitions/uint32
    description:
      This option indicate this GPIO control mode, where '0' represents
      bit control mode and '1' represents byte control mode.

  loongson,gpio-inten-offset:
    $ref: /schemas/types.yaml#/definitions/uint32
    description:
      This option indicate this GPIO interrupt enable register offset
      address.

  interrupts:
    minItems: 1
    maxItems: 64

required:
  - compatible
  - reg
  - ngpios
  - "#gpio-cells"
  - gpio-controller
  - loongson,gpio-conf-offset
  - loongson,gpio-in-offset
  - loongson,gpio-out-offset
  - loongson,gpio-ctrl-mode
  - loongson,gpio-inten-offset
  - gpio-ranges
  - interrupts

additionalProperties: false

examples:
  - |
    #include <dt-bindings/interrupt-controller/irq.h>

    gpio0: gpio@1fe00500 {
      compatible = "loongson,ls2k1000-gpio";
      reg = <0x1fe00500 0x38>;
      ngpios = <64>;
      #gpio-cells = <2>;
      gpio-controller;
      loongson,gpio-conf-offset = <0>;
      loongson,gpio-in-offset = <0x20>;
      loongson,gpio-out-offset = <0x10>;
      loongson,gpio-ctrl-mode = <0>;
      loongson,gpio-inten-offset = <0x30>;
      gpio-ranges = <&pctrl 0 0 15>,
                    <&pctrl 16 16 15>,
                    <&pctrl 32 32 10>,
                    <&pctrl 44 44 20>;
      interrupt-parent = <&liointc1>;
      interrupts = <28 IRQ_TYPE_LEVEL_LOW>,
                   <29 IRQ_TYPE_LEVEL_LOW>,
                   <30 IRQ_TYPE_LEVEL_LOW>,
                   <30 IRQ_TYPE_LEVEL_LOW>,
                   <26 IRQ_TYPE_LEVEL_LOW>,
                   <26 IRQ_TYPE_LEVEL_LOW>,
                   <26 IRQ_TYPE_LEVEL_LOW>,
                   <26 IRQ_TYPE_LEVEL_LOW>,
                   <26 IRQ_TYPE_LEVEL_LOW>,
                   <26 IRQ_TYPE_LEVEL_LOW>,
                   <26 IRQ_TYPE_LEVEL_LOW>,
                   <26 IRQ_TYPE_LEVEL_LOW>,
                   <26 IRQ_TYPE_LEVEL_LOW>,
                   <26 IRQ_TYPE_LEVEL_LOW>,
                   <26 IRQ_TYPE_LEVEL_LOW>,
                   <>,
                   <26 IRQ_TYPE_LEVEL_LOW>,
                   <26 IRQ_TYPE_LEVEL_LOW>,
                   <26 IRQ_TYPE_LEVEL_LOW>,
                   <26 IRQ_TYPE_LEVEL_LOW>,
                   <26 IRQ_TYPE_LEVEL_LOW>,
                   <26 IRQ_TYPE_LEVEL_LOW>,
                   <26 IRQ_TYPE_LEVEL_LOW>,
                   <26 IRQ_TYPE_LEVEL_LOW>,
                   <26 IRQ_TYPE_LEVEL_LOW>,
                   <26 IRQ_TYPE_LEVEL_LOW>,
                   <26 IRQ_TYPE_LEVEL_LOW>,
                   <26 IRQ_TYPE_LEVEL_LOW>,
                   <26 IRQ_TYPE_LEVEL_LOW>,
                   <26 IRQ_TYPE_LEVEL_LOW>,
                   <26 IRQ_TYPE_LEVEL_LOW>,
                   <26 IRQ_TYPE_LEVEL_LOW>,
                   <27 IRQ_TYPE_LEVEL_LOW>,
                   <27 IRQ_TYPE_LEVEL_LOW>,
                   <27 IRQ_TYPE_LEVEL_LOW>,
                   <27 IRQ_TYPE_LEVEL_LOW>,
                   <27 IRQ_TYPE_LEVEL_LOW>,
                   <>,
                   <27 IRQ_TYPE_LEVEL_LOW>,
                   <27 IRQ_TYPE_LEVEL_LOW>,
                   <27 IRQ_TYPE_LEVEL_LOW>,
                   <27 IRQ_TYPE_LEVEL_LOW>,
                   <>,
                   <>,
                   <27 IRQ_TYPE_LEVEL_LOW>,
                   <27 IRQ_TYPE_LEVEL_LOW>,
                   <27 IRQ_TYPE_LEVEL_LOW>,
                   <27 IRQ_TYPE_LEVEL_LOW>,
                   <27 IRQ_TYPE_LEVEL_LOW>,
                   <27 IRQ_TYPE_LEVEL_LOW>,
                   <27 IRQ_TYPE_LEVEL_LOW>,
                   <27 IRQ_TYPE_LEVEL_LOW>,
                   <27 IRQ_TYPE_LEVEL_LOW>,
                   <27 IRQ_TYPE_LEVEL_LOW>,
                   <27 IRQ_TYPE_LEVEL_LOW>,
                   <27 IRQ_TYPE_LEVEL_LOW>,
                   <27 IRQ_TYPE_LEVEL_LOW>,
                   <27 IRQ_TYPE_LEVEL_LOW>,
                   <27 IRQ_TYPE_LEVEL_LOW>,
                   <27 IRQ_TYPE_LEVEL_LOW>,
                   <27 IRQ_TYPE_LEVEL_LOW>,
                   <27 IRQ_TYPE_LEVEL_LOW>,
                   <27 IRQ_TYPE_LEVEL_LOW>,
                   <27 IRQ_TYPE_LEVEL_LOW>;
    };
```

## Documentation/devicetree/bindings/gpio/lsi,zevio-gpio.yaml
```yaml
# SPDX-License-Identifier: (GPL-2.0-only OR BSD-2-Clause)
%YAML 1.2
---
$id: http://devicetree.org/schemas/gpio/lsi,zevio-gpio.yaml#
$schema: http://devicetree.org/meta-schemas/core.yaml#

title: Zevio GPIO controller

maintainers:
  - Andrew Davis <afd@ti.com>

properties:
  compatible:
    const: lsi,zevio-gpio

  reg:
    maxItems: 1

  interrupts:
    maxItems: 1

  gpio-controller: true

  "#gpio-cells":
    description: The first cell is the pin number and the second cell is used
      to specify optional parameters (currently unused).
    const: 2

required:
  - compatible
  - reg
  - interrupts
  - gpio-controller
  - "#gpio-cells"

additionalProperties: false

examples:
  - |
    gpio: gpio@90000000 {
        compatible = "lsi,zevio-gpio";
        reg = <0x90000000 0x1000>;
        interrupts = <7>;
        gpio-controller;
        #gpio-cells = <2>;
    };
```

## Documentation/devicetree/bindings/gpio/max7360-gpio.yaml
```yaml
# SPDX-License-Identifier: (GPL-2.0-only OR BSD-2-Clause)
%YAML 1.2
---
$id: http://devicetree.org/schemas/gpio/max7360-gpio.yaml#
$schema: http://devicetree.org/meta-schemas/core.yaml#

title: Maxim MAX7360 GPIO controller

maintainers:
  - Kamel Bouhara <kamel.bouhara@bootlin.com>
  - Mathieu Dubois-Briand <mathieu.dubois-briand@bootlin.com>

description: |
  Maxim MAX7360 GPIO controller, in MAX7360 MFD
  https://www.analog.com/en/products/max7360.html

properties:
  compatible:
    enum:
      - maxim,max7360-gpio
      - maxim,max7360-gpo

  gpio-controller: true

  "#gpio-cells":
    const: 2

  ngpios:
    minimum: 0
    maximum: 8

  interrupt-controller: true

  "#interrupt-cells":
    const: 2

  interrupts:
    description: The interrupt line the device is connected to.
    maxItems: 1

  constant-current-disable:
    $ref: /schemas/types.yaml#/definitions/uint32
    description: Bit field, each bit disables constant-current output of the
                 associated GPIO.


required:
  - compatible
  - gpio-controller
  - ngpios

if:
  properties:
    compatible:
      contains:
        enum:
          - maxim,max7360-gpio
then:
  required:
    - interrupt-controller
    - interrupts
else:
  properties:
    interrupt-controller: false
    interrupts: false
    constant-current-disable: false

    ngpios:
      maximum: 6

additionalProperties: false

examples:
  - |
    #include <dt-bindings/interrupt-controller/arm-gic.h>

    max7360_gpo: max7360_gpo {
            compatible = "maxim,max7360-gpo";
            gpio-controller;
            #gpio-cells = <0x2>;
            ngpios = <4>;
    };

    max7360_gpio: max7360_gpio {
            compatible = "maxim,max7360-gpio";

            gpio-controller;
            #gpio-cells = <0x2>;
            ngpios = <8>;
            constant-current-disable = <0x06>;

            interrupt-controller;
            #interrupt-cells = <0x2>;
            interrupt-parent = <&gpio1>;
            interrupts = <23 IRQ_TYPE_LEVEL_LOW>;
    };
```

## Documentation/devicetree/bindings/gpio/maxim,max7360-gpio.yaml
```yaml
# SPDX-License-Identifier: (GPL-2.0-only OR BSD-2-Clause)
%YAML 1.2
---
$id: http://devicetree.org/schemas/gpio/maxim,max7360-gpio.yaml#
$schema: http://devicetree.org/meta-schemas/core.yaml#

title: Maxim MAX7360 GPIO controller

maintainers:
  - Kamel Bouhara <kamel.bouhara@bootlin.com>
  - Mathieu Dubois-Briand <mathieu.dubois-briand@bootlin.com>

description: |
  Maxim MAX7360 GPIO controller, in MAX7360 chipset
  https://www.analog.com/en/products/max7360.html

properties:
  compatible:
    enum:
      - maxim,max7360-gpio
      - maxim,max7360-gpo

  gpio-controller: true

  "#gpio-cells":
    const: 2

  ngpios:
    minimum: 0
    maximum: 8

  interrupt-controller: true

  "#interrupt-cells":
    const: 2

  maxim,constant-current-disable:
    $ref: /schemas/types.yaml#/definitions/uint32
    description: |
      Bit field, each bit disables constant-current output of the associated
      GPIO, starting from the least significant bit for the first GPIO.


required:
  - compatible
  - gpio-controller
  - ngpios

if:
  properties:
    compatible:
      contains:
        enum:
          - maxim,max7360-gpio
then:
  required:
    - interrupt-controller
else:
  properties:
    interrupt-controller: false
    maxim,constant-current-disable: false

    ngpios:
      maximum: 6

additionalProperties: false

examples:
  - |
    gpio {
      compatible = "maxim,max7360-gpio";

      gpio-controller;
      #gpio-cells = <0x2>;
      ngpios = <8>;
      maxim,constant-current-disable = <0x06>;

      interrupt-controller;
      #interrupt-cells = <0x2>;
      };
```
