## Documentation/devicetree/bindings/hsi/ti,omap-ssi.yaml
```yaml
# SPDX-License-Identifier: (GPL-2.0-only OR BSD-2-Clause)
%YAML 1.2
---
$id: http://devicetree.org/schemas/hsi/ti,omap-ssi.yaml#
$schema: http://devicetree.org/meta-schemas/core.yaml#

title: SSI Controller on OMAP SoCs

description:
  OMAP3's Synchronous Serial Interface (SSI) controller implements a
  legacy variant of MIPI's High Speed Synchronous Serial Interface (HSI),
  while the controller found inside OMAP4 is supposed to be fully compliant
  with the HSI standard.

maintainers:
  - Sebastian Reichel <sre@kernel.org>

properties:
  compatible:
    enum:
      - ti,omap3-ssi
      - ti,omap4-hsi

  reg:
    items:
      - description: registers for sys
      - description: registers for gdd

  reg-names:
    items:
      - const: sys
      - const: gdd

  ranges: true

  "#address-cells":
    const: 1

  "#size-cells":
    const: 1

  clocks:
    minItems: 1
    maxItems: 3

  clock-names:
    minItems: 1
    maxItems: 3

  interrupts:
    maxItems: 1

  interrupt-names:
    const: gdd_mpu

  ti,hwmods:
    const: ssi
    deprecated: true

patternProperties:
  "[hs]si-port@[0-9a-f]+":
    type: object

    additionalProperties: false

    properties:
      compatible:
        enum:
          - ti,omap3-ssi-port
          - ti,omap4-hsi-port

      reg:
        items:
          - description: TX registers
          - description: RX registers

      reg-names:
        items:
          - const: tx
          - const: rx

      interrupts:
        items:
          - description: MPU interrupt 0
          - description: MPU interrupt 1
        minItems: 1

      ti,ssi-cawake-gpio:
        description: GPIO signifying CAWAKE events
        maxItems: 1

      hsi-client:
        type: object
        $ref: /schemas/hsi/hsi-client.yaml#

    required:
      - compatible
      - reg
      - reg-names
      - interrupts

    allOf:
      - if:
          properties:
            compatible:
              contains:
                const: ti,omap3-ssi-port
        then:
          properties:
            $nodename:
              pattern: "^ssi-port@(.*)?$"
            interrupts:
              minItems: 2
        else:
          properties:
            $nodename:
              pattern: "^hsi-port@(.*)?$"
            interrupts:
              maxItems: 1

additionalProperties: false

required:
  - compatible
  - reg
  - reg-names
  - ranges
  - "#address-cells"
  - "#size-cells"
  - clocks
  - clock-names
  - interrupts
  - interrupt-names

allOf:
  - if:
      properties:
        compatible:
          contains:
            const: ti,omap3-ssi
    then:
      properties:
        clocks:
          minItems: 3
        clock-names:
          items:
            - const: ssi_ssr_fck
            - const: ssi_sst_fck
            - const: ssi_ick
    else:
      properties:
        clocks:
          maxItems: 1
        clock-names:
          items:
            - const: hsi_fck

examples:
  - |
    #include <dt-bindings/gpio/gpio.h>
    ssi-controller@48058000 {
        compatible = "ti,omap3-ssi";
        reg = <0x48058000 0x1000>,
              <0x48059000 0x1000>;
        reg-names = "sys", "gdd";
        ranges;
        #address-cells = <1>;
        #size-cells = <1>;
        clocks = <&ssi_ssr_fck>,
                 <&ssi_sst_fck>,
                 <&ssi_ick>;
        clock-names = "ssi_ssr_fck",
                      "ssi_sst_fck",
                      "ssi_ick";
        interrupts = <55>;
        interrupt-names = "gdd_mpu";

        ssi-port@4805a000 {
                compatible = "ti,omap3-ssi-port";
                reg = <0x4805a000 0x800>,
                      <0x4805a800 0x800>;
                reg-names = "tx", "rx";
                interrupt-parent = <&intc>;
                interrupts = <67>, <68>;
                ti,ssi-cawake-gpio = <&gpio5 23 GPIO_ACTIVE_HIGH>;
        };

        ssi-port@4805b000 {
                compatible = "ti,omap3-ssi-port";
                reg = <0x4805b000 0x800>,
                      <0x4805b800 0x800>;
                reg-names = "tx", "rx";
                interrupt-parent = <&intc>;
                interrupts = <69>, <70>;
        };
    };
```

## Documentation/devicetree/bindings/hwinfo/board-id.yaml
```yaml
# SPDX-License-Identifier: (GPL-2.0-only OR BSD-2-Clause)
%YAML 1.2
---
$id: http://devicetree.org/schemas/hwinfo/board-id.yaml#
$schema: http://devicetree.org/meta-schemas/core.yaml#

title: Board Identifier for Devicetree Selection

maintainers:
  - Amrit Anand <quic_amrianan@quicinc.com>
  - Elliot Berman <quic_eberman@quicinc.com>

description: |
  Device manufacturers frequently ship multiple boards under a single
  software package. These software packages will ship multiple devicetree
  blobs and require some mechanism to pick the correct DTB for the board
  the software package was deployed. board-id provides a mechanism for
  bootloaders to select the appropriate DTB which is vendor/OEM-agnostic.

select:
  anyOf:
    - required:
        - 'board-id'
    - required:
        - 'board-id-types'
    - required:
        - '#board-id-cells'

properties:
  $nodename:
    const: "/"
  board-id:
    $ref: /schemas/types.yaml#/definitions/uint32-matrix
    description: |
      A list of identifiers that can be used to match with this devicetree.
      The interpretatation of each cell can be matched with the
      board-id-type at the same index.

  board-id-types:
    $ref: /schemas/types.yaml#/definitions/non-unique-string-array
    description:
      Defines the type of each cell, indicating to the DeviceTree selection
      mechanism how to parse the board-id.

  '#board-id-cells':
    minimum: 1

required:
  - board-id
  - board-id-types
  - '#board-id-cells'

additionalProperties: true
```

## Documentation/devicetree/bindings/hwinfo/mtk-socinfo.yaml
```yaml
# SPDX-License-Identifier: (GPL-2.0-only OR BSD-2-Clause)
%YAML 1.2
---
$id: http://devicetree.org/schemas/hwinfo/mtk-socinfo.yaml#
$schema: http://devicetree.org/meta-schemas/core.yaml#

title: MediaTek SoC ChipID

maintainers:
  - William Lin <william-tw.lin@mediatek.com>
  - Matthias Brugger <matthias.bgg@gmail.com>
  - Kevin Hilman <khilman@kernel.org>
  - AngeloGioacchino Del Regno <angelogioacchino.delregno@collabora.com>

description:
  MediaTek SoCs store various product information in eFuses, including
  Chip ID and Revision fields, usable to identify the manufacturer,
  SoC version, plus segment and marketing names.

properties:
  compatible:
    const: mediatek,socinfo

  nvmem-cells:
    maxItems: 2
    description: Phandle to nvmem cells containing SoC identification data

  nvmem-cell-names:
    minItems: 1
    items:
      - const: socinfo-data1
      - const: socinfo-data2

required:
  - compatible
  - nvmem-cells
  - nvmem-cell-names

additionalProperties: false

examples:
  - |
        socinfo {
            compatible = "mediatek,socinfo";
            nvmem-cells = <&socinfo_data1>, <&socinfo_data2>;
            nvmem-cell-names = "socinfo-data1", "socinfo-data2";
        };
```

## Documentation/devicetree/bindings/hwinfo/qcom,board-id.yaml
```yaml
# SPDX-License-Identifier: (GPL-2.0-only OR BSD-2-Clause)
%YAML 1.2
---
$id: http://devicetree.org/schemas/hwinfo/qcom,board-id.yaml#
$schema: http://devicetree.org/meta-schemas/core.yaml#

title: QCOM Board Identifier for Devicetree Selection

maintainers:
  - Amrit Anand <quic_amrianan@quicinc.com>
  - Elliot Berman <quic_eberman@quicinc.com>

description: |
  Qualcomm uses two and sometimes three hardware identifiers to describe
  its boards
      - a SoC identifier is used to match chipsets (e.g. sm8550 vs sm8450)
      - a board identifier is used to match board form factor (e.g. MTP, QRD,
        ADP, CRD)
      - a PMIC identifier is occasionally used when different PMICs are used
        for a given board/SoC combination.
  Each field and helper macros are defined at::
      - include/dt-bindings/arm/qcom,ids.h

  For example,
    / {
        #board-id-cells = <2>;
        board-id = <456 0>, <457 0>, <10 0>;
        board-id-types = "qcom,soc-id", "qcom,soc-id", "qcom,board-id";
     }

allOf:
  - $ref: board-id.yaml#

properties:
  board-id:
    minItems: 2

  board-id-types:
    minItems: 2
    items:
      oneOf:
        - const: qcom,soc-id
          description: |
            Matches Qualcomm Technologies, Inc. boards with the specified SoC.
            2 integers are needed to describe a soc-id. The first integer is the
            SoC ID and the second integer is the SoC revision.
            qcom,soc-id = <soc-id  soc-revision>
        - const: qcom,board-id
          description: |
            Matches Qualcomm Technologies, Inc. boards with the specified board.
            2 integers are needed to describe a board-id. The first integer is the
            board ID. The second integer is the board-subtype.
            qcom,board-id = <board-id  board-subtype>
        - const: qcom,pmic-id
          description: |
            QUALCOMM boards can be atached to mutliple PMICs where slave-id (SID)
            indicates the address of the bus on which the PMIC is attached. It can be
            any number. The model for a PMIC indicates the PMIC name attached to bus
            described by SID along with  major and minor version. 2 integers are needed
            to describe qcom,pmic-id. The first integer is the slave-id and the second integer
            is the pmic model.
            qcom,pmic-id = <pmic-sid pmic-model>

  '#board-id-cells':
    minimum: 2

additionalProperties: true

examples:
   - |
     #include <dt-bindings/arm/qcom,ids.h>
     / {
         model = "Qualcomm Technologies, Inc. sc7280 IDP SKU1 platform";
         compatible = "qcom,sc7280-idp", "google,senor", "qcom,sc7280";

         #board-id-cells = <2>;
         board-id = <QCOM_SOC_ID(SC7280) QCOM_SOC_REVISION(1)>,
                    <QCOM_SOC_ID(SC7280) QCOM_SOC_REVISION(2)>,
                    <QCOM_BOARD_ID(IDP, 1, 0) QCOM_BOARD_SUBTYPE(UFS, ANY, 1)>;
         board-id-types = "qcom,soc-id",
                          "qcom,soc-id",
                          "qcom,board-id";

         #address-cells = <2>;
         #size-cells = <2>;
      };
```

## Documentation/devicetree/bindings/hwinfo/samsung,exynos-chipid.yaml
```yaml
# SPDX-License-Identifier: GPL-2.0
%YAML 1.2
---
$id: http://devicetree.org/schemas/hwinfo/samsung,exynos-chipid.yaml#
$schema: http://devicetree.org/meta-schemas/core.yaml#

title: Samsung Exynos SoC series Chipid driver

maintainers:
  - Krzysztof Kozlowski <krzk@kernel.org>

properties:
  compatible:
    oneOf:
      - enum:
          - samsung,exynos4210-chipid
          - samsung,exynos850-chipid
      - items:
          - enum:
              - samsung,exynos5433-chipid
              - samsung,exynos7-chipid
              - samsung,exynos7870-chipid
              - samsung,exynos8890-chipid
          - const: samsung,exynos4210-chipid
      - items:
          - enum:
              - samsung,exynos2200-chipid
              - samsung,exynos7885-chipid
              - samsung,exynos8895-chipid
              - samsung,exynos9610-chipid
              - samsung,exynos9810-chipid
              - samsung,exynos990-chipid
              - samsung,exynosautov9-chipid
              - samsung,exynosautov920-chipid
          - const: samsung,exynos850-chipid
      - items:
          - const: google,gs101-chipid

  nvmem-cells:
    maxItems: 2

  nvmem-cell-names:
    items:
      - const: product-id
      - const: chip-id

  reg:
    maxItems: 1

  samsung,asv-bin:
    description:
      Adaptive Supply Voltage bin selection. This can be used
      to determine the ASV bin of an SoC if respective information
      is missing in the CHIPID registers or in the OTP memory.
    $ref: /schemas/types.yaml#/definitions/uint32
    enum: [0, 1, 2, 3]

required:
  - compatible

allOf:
  - if:
      properties:
        compatible:
          contains:
            oneOf:
              - enum:
                  - samsung,exynos4210-chipid
                  - samsung,exynos850-chipid
              - items:
                  - enum:
                      - samsung,exynos5433-chipid
                      - samsung,exynos7-chipid
                      - samsung,exynos7870-chipid
                      - samsung,exynos8890-chipid
                  - const: samsung,exynos4210-chipid
              - items:
                  - enum:
                      - samsung,exynos2200-chipid
                      - samsung,exynos7885-chipid
                      - samsung,exynos8895-chipid
                      - samsung,exynos9610-chipid
                      - samsung,exynos9810-chipid
                      - samsung,exynos990-chipid
                      - samsung,exynosautov9-chipid
                      - samsung,exynosautov920-chipid
                  - const: samsung,exynos850-chipid
    then:
      required:
        - reg
  - if:
      properties:
        compatible:
          contains:
            const: google,gs101-chipid
    then:
      required:
        - nvmem-cells
        - nvmem-cell-names

additionalProperties: false

examples:
  - |
    chipid@10000000 {
        compatible = "samsung,exynos4210-chipid";
        reg = <0x10000000 0x100>;
        samsung,asv-bin = <2>;
    };
```
