## Documentation/devicetree/bindings/gpio/pin-control-gpio.yaml
```yaml
# SPDX-License-Identifier: GPL-2.0-only OR BSD-2-Clause
%YAML 1.2
---
$id: http://devicetree.org/schemas/gpio/pin-control-gpio.yaml#
$schema: http://devicetree.org/meta-schemas/core.yaml#

title: Pin control based generic GPIO controller

description:
  The pin control-based GPIO will facilitate a pin controller's ability
  to drive electric lines high/low and other generic properties of a
  pin controller to perform general-purpose one-bit binary I/O.

maintainers:
  - AKASHI Takahiro <akashi.takahiro@linaro.org>

properties:
  compatible:
    const: pin-control-gpio

  gpio-controller: true

  "#gpio-cells":
    const: 2

  gpio-ranges: true

  gpio-ranges-group-names: true

patternProperties:
  "^.+-hog(-[0-9]+)?$":
    type: object

    required:
      - gpio-hog

required:
  - compatible
  - gpio-controller
  - "#gpio-cells"
  - gpio-ranges

additionalProperties: false

examples:
  - |
    gpio0: gpio@0 {
        compatible = "pin-control-gpio";
        gpio-controller;
        #gpio-cells = <2>;
        gpio-ranges = <&scmi_pinctrl 0 10 5>,
                      <&scmi_pinctrl 5 0 0>;
        gpio-ranges-group-names = "",
                                  "pinmux_gpio";
    };
```

## Documentation/devicetree/bindings/gpio/pl061-gpio.yaml
```yaml
# SPDX-License-Identifier: (GPL-2.0 OR BSD-2-Clause)
%YAML 1.2
---
$id: http://devicetree.org/schemas/gpio/pl061-gpio.yaml#
$schema: http://devicetree.org/meta-schemas/core.yaml#

title: ARM PL061 GPIO controller

maintainers:
  - Linus Walleij <linusw@kernel.org>
  - Rob Herring <robh@kernel.org>

# We need a select here so we don't match all nodes with 'arm,primecell'
select:
  properties:
    compatible:
      contains:
        enum:
          - arm,pl061
          - ambarella,cv75-gpio
  required:
    - compatible

properties:
  $nodename:
    pattern: "^gpio@[0-9a-f]+$"

  compatible:
    oneOf:
      - items:
          - const: arm,pl061
          - const: arm,primecell
      - items:
          - const: ambarella,cv75-gpio
          - const: arm,primecell

  reg:
    maxItems: 1

  interrupts:
    oneOf:
      - maxItems: 1
      - maxItems: 8

  interrupt-controller: true

  "#interrupt-cells":
    const: 2

  clocks:
    maxItems: 1

  clock-names: true

  arm,primecell-periphid:
    $ref: /schemas/types.yaml#/definitions/uint32
    description: Override for the PrimeCell peripheral ID.

  "#gpio-cells":
    const: 2

  gpio-controller: true

  gpio-line-names: true

  gpio-ranges:
    minItems: 1
    maxItems: 8

required:
  - compatible
  - reg
  - clocks
  - "#gpio-cells"
  - gpio-controller

allOf:
  - if:
      properties:
        compatible:
          contains:
            const: ambarella,cv75-gpio
    then:
      properties:
        arm,primecell-periphid:
          const: 0x000e8061
      required:
        - arm,primecell-periphid
        - gpio-ranges

additionalProperties: false

...
```

## Documentation/devicetree/bindings/gpio/realtek,rtd-gpio.yaml
```yaml
# SPDX-License-Identifier: (GPL-2.0 OR BSD-2-Clause)
# Copyright 2023 Realtek Semiconductor Corporation
%YAML 1.2
---
$id: http://devicetree.org/schemas/gpio/realtek,rtd-gpio.yaml#
$schema: http://devicetree.org/meta-schemas/core.yaml#

title: Realtek DHC GPIO controller

maintainers:
  - TY Chang <tychang@realtek.com>

properties:
  compatible:
    enum:
      - realtek,rtd-gpio
      - realtek,rtd1295-misc-gpio
      - realtek,rtd1295-iso-gpio
      - realtek,rtd1395-iso-gpio
      - realtek,rtd1619-iso-gpio

  reg:
    maxItems: 2

  interrupts:
    maxItems: 2

  gpio-ranges: true

  gpio-controller: true

  "#gpio-cells":
    const: 2

required:
  - compatible
  - reg
  - interrupts
  - gpio-ranges
  - gpio-controller
  - "#gpio-cells"

additionalProperties: false

examples:
  - |
    gpio@100 {
      compatible = "realtek,rtd-gpio";
      reg = <0x100 0x100>,
            <0x000 0x0b0>;
      interrupt-parent = <&iso_irq_mux>;
      interrupts = <19>, <20>;
      gpio-ranges = <&pinctrl 0 0 82>;
      gpio-controller;
      #gpio-cells = <2>;
    };
```

## Documentation/devicetree/bindings/gpio/zte,zx279128s-gpio.yaml
```yaml
# SPDX-License-Identifier: (GPL-2.0-only OR BSD-2-Clause)
%YAML 1.2
---
$id: http://devicetree.org/schemas/gpio/zte,zx279128s-gpio.yaml#
$schema: http://devicetree.org/meta-schemas/core.yaml#

title: ZTE zx279128s GPIO controller

maintainers:
  - Navid Ghahremani <ghahramani.navid@gmail.com>

description:
  The ZTE zx279128s has several identical GPIO banks. Each bank has 16
  lines and is described by its own node.

properties:
  compatible:
    const: zte,zx279128s-gpio

  reg:
    maxItems: 1

  clocks:
    maxItems: 1

  gpio-controller: true

  '#gpio-cells':
    const: 2

  gpio-line-names:
    maxItems: 16

required:
  - compatible
  - reg
  - clocks
  - gpio-controller
  - '#gpio-cells'

additionalProperties: false

examples:
  - |
    #include <dt-bindings/clock/zte,zx279128s-crm.h>

    gpio@94407000 {
        compatible = "zte,zx279128s-gpio";
        reg = <0x94407000 0x40>;
        clocks = <&lsp0crpm ZX279128S_LSP0_GPIO_PCLK>;
        gpio-controller;
        #gpio-cells = <2>;
    };
```

## Documentation/devicetree/bindings/gpu/apple,agx.yaml
```yaml
# SPDX-License-Identifier: (GPL-2.0 OR BSD-2-Clause)
%YAML 1.2
---
$id: http://devicetree.org/schemas/gpu/apple,agx.yaml#
$schema: http://devicetree.org/meta-schemas/core.yaml#

title: Apple SoC GPU

maintainers:
  - Sasha Finkelstein <fnkl.kernel@gmail.com>

properties:
  compatible:
    oneOf:
      - items:
          - const: apple,agx-g13g
      - items:
          - enum:
              - apple,agx-g13s
              - apple,agx-g13c
              - apple,agx-g13d
          - const: apple,agx-g13x
      - items:
          - const: apple,agx-g14g
  reg:
    items:
      - description: ASC coprocessor control
      - description: GPU block MMIO registers

  reg-names:
    items:
      - const: asc
      - const: sgx

  power-domains:
    maxItems: 1

  mboxes:
    maxItems: 1

  memory-region:
    items:
      - description: Region containing GPU MMU TTBs
      - description: Region containing GPU MMU page tables
      - description:
          Region containing a shared handoff structure for VM
          management coordination
      - description: Driver-opaque calibration blob
      - description: Calibration blob
      - description: Shared global variables with GPU firmware

  memory-region-names:
    items:
      - const: ttbs
      - const: pagetables
      - const: handoff
      - const: hw-cal-a
      - const: hw-cal-b
      - const: globals

  apple,firmware-compat:
    $ref: /schemas/types.yaml#/definitions/uint32-array
    minItems: 3
    description:
      MacOS version the current firmware is paired with, used to pick
      the version of firmware ABI to be used.
      Bootloader will overwrite this

required:
  - compatible
  - reg
  - mboxes
  - memory-region
  - apple,firmware-compat

additionalProperties: false

examples:
  - |
    #include <dt-bindings/interrupt-controller/apple-aic.h>
    gpu@6400000 {
        compatible = "apple,agx-g13g";
        reg = <0x6400000 0x40000>,
              <0x4000000 0x1000000>;
        reg-names = "asc", "sgx";
        mboxes = <&agx_mbox>;
        power-domains = <&ps_gfx>;
        memory-region = <&uat_ttbs>, <&uat_pagetables>, <&uat_handoff>,
                        <&gpu_hw_cal_a>, <&gpu_hw_cal_b>, <&gpu_globals>;
        memory-region-names = "ttbs", "pagetables", "handoff",
                              "hw-cal-a", "hw-cal-b", "globals";

        apple,firmware-compat = <0 0 0>;
    };
...
```

## Documentation/devicetree/bindings/gpu/arm,mali-gen5-am-arbitration.yaml
```yaml
# SPDX-License-Identifier: GPL-2.0-only OR BSD-2-Clause
# Copyright 2026 ARM Limited. All rights reserved.
%YAML 1.2
---
$id: http://devicetree.org/schemas/gpu/arm,mali-gen5-am-arbitration.yaml#
$schema: http://devicetree.org/meta-schemas/core.yaml#

title: ARM Mali 5th-Gen GPU Arbitration Device

maintainers:
  - Liviu Dudau <liviu.dudau@arm.com>
  - Boris Brezillon <boris.brezillon@collabora.com>

description:
  The arbitration device manages partition-control and resource-group blocks.
  Each block is described by a child node with its own register range,
  interrupt and hardware ID. Partition and resource-group IDs are separate
  namespaces. Access-window IDs are global to the GPU.

properties:
  $nodename:
    const: panthor-arbitration

  compatible:
    const: arm,mali-gen5-am-arbitration

  "#address-cells": true

  "#size-cells": true

  ranges: true

patternProperties:
  "^partition@[0-9a-f]+$":
    type: object
    additionalProperties: false
    description:
      Partition control block and its initial resource assignments.

    properties:
      reg:
        maxItems: 1
        description: Partition control register range.

      interrupts:
        maxItems: 1
        description: Partition control interrupt.

      arm,id:
        $ref: /schemas/types.yaml#/definitions/uint32
        description:
          Hardware partition control index. Must identify a partition present on
          the GPU and be unique among this device's partition nodes.

      arm,access-window-mask:
        $ref: /schemas/types.yaml#/definitions/uint32
        maximum: 0xffff
        default: 0
        description:
          Initial access window assignment mask. Bit N selects global
          access window ID N. Masks must be disjoint across partitions.
          If omitted, no access windows are assigned by default.

    required:
      - reg
      - interrupts
      - arm,id

  "^resource-group@[0-9a-f]+$":
    type: object
    additionalProperties: false
    description:
      Resource group block used for access-window messaging.

    properties:
      reg:
        maxItems: 1
        description: Resource group register range.

      interrupts:
        maxItems: 1
        description: Resource group interrupt.

      arm,id:
        $ref: /schemas/types.yaml#/definitions/uint32
        description:
          Hardware resource group index. Must identify a resource group
          present on the GPU and be unique among this device's resource group
          nodes.

    required:
      - reg
      - interrupts
      - arm,id

  "^gpu@[0-9a-f]+$":
    $ref: arm,mali-valhall-csf.yaml#
    properties:
      compatible:
        const: arm,mali-gen5-am

required:
  - compatible
  - "#address-cells"
  - "#size-cells"
  - ranges

additionalProperties: false

examples:
  - |
    #include <dt-bindings/interrupt-controller/irq.h>
    #include <dt-bindings/interrupt-controller/arm-gic.h>

    panthor-arbitration {
        compatible = "arm,mali-gen5-am-arbitration";
        #address-cells = <1>;
        #size-cells = <1>;
        ranges;

        partition@50000 {
            reg = <0x50000 0x10000>;
            interrupts = <GIC_SPI 92 IRQ_TYPE_LEVEL_HIGH 0>;
            arm,id = <0>;
            arm,access-window-mask = <0xffff>;
        };

        resource-group@c0000 {
            reg = <0xc0000 0x10000>;
            interrupts = <GIC_SPI 92 IRQ_TYPE_LEVEL_HIGH 0>;
            arm,id = <0>;
        };
    };

...
```

## Documentation/devicetree/bindings/gpu/arm,mali-gen5-am-system.yaml
```yaml
# SPDX-License-Identifier: GPL-2.0-only OR BSD-2-Clause
# Copyright 2026 ARM Limited. All rights reserved.
%YAML 1.2
---
$id: http://devicetree.org/schemas/gpu/arm,mali-gen5-am-system.yaml#
$schema: http://devicetree.org/meta-schemas/core.yaml#

title: ARM Mali 5th-Gen GPU System Device

maintainers:
  - Liviu Dudau <liviu.dudau@arm.com>
  - Boris Brezillon <boris.brezillon@collabora.com>

properties:
  $nodename:
    pattern: '^panthor-system@[a-f0-9]+$'

  compatible:
    oneOf:
      - items:
          - const: arm,mali-gen5-am-system

  reg:
    items:
      - description: System register

  reg-names:
    items:
      - const: system

  interrupts:
    items:
      - description: System interrupt

  clocks:
    maxItems: 1
    description:
      Phandle to the GPU clock.

  gpu-supply: true

  dma-coherent: true

  "#address-cells": true

  "#size-cells": true

  ranges: true

  panthor-arbitration:
    $ref: arm,mali-gen5-am-arbitration.yaml#

required:
  - compatible
  - reg
  - reg-names
  - interrupts
  - clocks

additionalProperties: false

examples:
  - |
    #include <dt-bindings/interrupt-controller/irq.h>
    #include <dt-bindings/interrupt-controller/arm-gic.h>

    panthor_system: panthor-system@68000000 {
      compatible = "arm,mali-gen5-am-system";
      reg = <0x68000000 0x10000>;
      reg-names = "system";
      interrupts = <GIC_SPI 168 IRQ_TYPE_LEVEL_HIGH>;
      clocks = <&mali_gpu_clk>;
      gpu-supply = <&gpu_supply>;
    };

...
```
