## Documentation/devicetree/bindings/scsi/hisilicon,hip05-sas-v1.yaml
```yaml
# SPDX-License-Identifier: (GPL-2.0-only OR BSD-2-Clause)
%YAML 1.2
---
$id: http://devicetree.org/schemas/scsi/hisilicon,hip05-sas-v1.yaml#
$schema: http://devicetree.org/meta-schemas/core.yaml#

title: HiSilicon SAS controller

maintainers:
  - Xingui Yang <yangxingui@huawei.com>

properties:
  compatible:
    items:
      - enum:
          - hisilicon,hip05-sas-v1
          - hisilicon,hip06-sas-v2
          - hisilicon,hip07-sas-v2

  reg:
    minItems: 1
    items:
      - description: SAS registers
      - description: CPLD SGPIO control registers

  clocks:
    minItems: 1
    maxItems: 2

  dma-coherent: true

  interrupts:
    description: >
      Interrupt specifiers for PHY, SATA, and completion queues; ordering and
      number depend on controller version.

      For v1 hw: Interrupts for phys, completion queues, and fatal
      sources; the interrupts are ordered in 3 groups, as follows:

        - Phy interrupts - Each phy has 3 interrupt sources:
            - broadcast
            - phyup
            - abnormal
          The phy interrupts are ordered into groups of 3 per phy
          (broadcast, phyup, and abnormal) in increasing order.
        - Completion queue interrupts - each completion queue has 1 interrupt
          source.
        - Fatal interrupts - the fatal interrupts are ordered as follows:
            - ECC
            - AXI bus

      For v2 hw: Interrupts for phys, Sata, and completion queues;
      the interrupts are ordered in 3 groups, as follows:

        - Phy interrupts - Each controller has 2 phy interrupts:
            - phy up/down
            - channel interrupt
        - Sata interrupts - Each phy on the controller has 1 Sata interrupt.
        - Completion queue interrupts - each completion queue has 1 interrupt
          source

    minItems: 53
    maxItems: 128

  ctrl-reset-reg:
    description: Offset to controller reset register in SAS register region.
    $ref: /schemas/types.yaml#/definitions/uint32

  ctrl-reset-sts-reg:
    description: Offset to controller reset status register in SAS register region.
    $ref: /schemas/types.yaml#/definitions/uint32

  ctrl-clock-ena-reg:
    description: Offset to controller clock enable register in SAS register region.
    $ref: /schemas/types.yaml#/definitions/uint32

  hip06-sas-v2-quirk-amt:
    description:
      Indicates that the v2 controller has the "am-max-transmissions" limitation.
    type: boolean

  hisilicon,sas-syscon:
    description: Phandle of syscon used for SAS control.
    $ref: /schemas/types.yaml#/definitions/phandle

  hisilicon,signal-attenuation:
    description:
      De-emphasis, preshoot, and boost attenuation readings for the board,
      used to calculate signal attenuation (y = (x-10000)/10000).
    $ref: /schemas/types.yaml#/definitions/uint32-array
    minItems: 3
    maxItems: 3
    items:
      minimum: 7600
      maximum: 12400

  phy-count:
    description: Number of PHYs accessible by the controller.
    $ref: /schemas/types.yaml#/definitions/uint32

  queue-count:
    description: Number of delivery and completion queues in the controller.
    $ref: /schemas/types.yaml#/definitions/uint32

  sas-addr:
    description: SAS address, array of 8 bytes representing host SAS address.
    $ref: /schemas/types.yaml#/definitions/uint8-array
    minItems: 8
    maxItems: 8

required:
  - compatible
  - reg
  - interrupts
  - ctrl-reset-reg
  - ctrl-reset-sts-reg
  - ctrl-clock-ena-reg
  - hisilicon,sas-syscon
  - phy-count
  - queue-count
  - sas-addr

additionalProperties: false

examples:
  - |
    sas@c1000000 {
        compatible = "hisilicon,hip05-sas-v1";
        sas-addr = [50 01 88 20 16 00 00 0a];
        reg = <0x0 0xc1000000 0x0 0x10000>;
        hisilicon,sas-syscon = <&pcie_sas>;
        ctrl-reset-reg = <0xa60>;
        ctrl-reset-sts-reg = <0x5a30>;
        ctrl-clock-ena-reg = <0x338>;
        queue-count = <32>;
        phy-count = <8>;
        dma-coherent;
        interrupts = <259 4>, <263 4>, <264 4>,
                     <269 4>, <273 4>, <274 4>,
                     <279 4>, <283 4>, <284 4>,
                     <289 4>, <293 4>, <294 4>,
                     <299 4>, <303 4>, <304 4>,
                     <309 4>, <313 4>, <314 4>,
                     <319 4>, <323 4>, <324 4>,
                     <329 4>, <333 4>, <334 4>,
                     <339 1>, <340 1>, <341 1>,
                     <342 1>, <343 1>, <344 1>,
                     <345 1>, <346 1>, <347 1>,
                     <348 1>, <349 1>, <350 1>,
                     <351 1>, <352 1>, <353 1>,
                     <354 1>, <355 1>, <356 1>,
                     <357 1>, <358 1>, <359 1>,
                     <360 1>, <361 1>, <362 1>,
                     <363 1>, <364 1>, <365 1>,
                     <366 1>, <367 1>;
    };
```

## Documentation/devicetree/bindings/security/tpm/infineon,slb9670.yaml
```yaml
# SPDX-License-Identifier: (GPL-2.0-only OR BSD-2-Clause)
%YAML 1.2
---
$id: http://devicetree.org/schemas/security/tpm/infineon,slb9670.yaml#
$schema: http://devicetree.org/meta-schemas/core.yaml#

title: Trusted Platform Module (TPM) with a SPI interface

maintainers:
  - Peter Huewe <peterhuewe@gmx.de>
  - Jarkko Sakkinen <jarkko@kernel.org>

properties:
  $nodename:
    pattern: "^tpm@[0-9a-f]{1,2}$"

  compatible:
    oneOf:
      - enum:
          - st,st33htpm-spi
          - infineon,slb9670
          - google,cr50
      - const: tcg,tpm_tis-spi
        deprecated: true

  reg:
    maxItems: 1

  interrupts:
    maxItems: 1

required:
  - compatible
  - reg
  - spi-max-frequency

allOf:
  - $ref: /schemas/spi/spi-peripheral-props.yaml#

unevaluatedProperties: false

examples:
  - |
    spi {
      #address-cells = <1>;
      #size-cells = <0>;
      tpm@1 {
        compatible = "infineon,slb9670";
        reg = <0x1>;
        pinctrl-names = "default";
        pinctrl-0 = <&pinctrl_tpm>;
        spi-max-frequency = <20000000>;
      };
    };
```

## Documentation/devicetree/bindings/serial/adi,uart.yaml
```yaml
# SPDX-License-Identifier: (GPL-2.0-only OR BSD-2-Clause)
%YAML 1.2
---
$id: http://devicetree.org/schemas/serial/adi,uart4.yaml#
$schema: http://devicetree.org/meta-schemas/core.yaml#

title: Analog Devices UART Driver for SC5XX-family processors

maintainers:
  - Arturs Artamonovs <arturs.artamonovs@analog.com>
  - Utsav Agarwal <Utsav.Agarwal@analog.com>

description: |
  Analog Devices UART Driver for SC59X-family processors

properties:
  compatible:
    enum:
      - adi,uart

  reg:
    maxItems: 1

  dmas:
    maxItems: 2
    minItems: 2
    description: TX and RX DMA cluster numbers

  dma-names:
    maxItems: 2
    minItems: 2
    description: DMA channel names (tx and rx)

  clocks:
    maxItems: 1
    description: Clock being used for UART

  clock-names:
    maxItems: 1
    description: Clock name (sclk0)

  interrupt-names:
    minItems: 3
    maxItems: 3
    description: Interrupt names (tx + rx + status)

  interrupts:
    minItems: 3
    maxItems: 3
    description: GIC interrupt numbers

  adi,use-edbo:
    type: boolean
    description: Enable divide by one in divisor

required:
  - compatible
  - reg
  - clocks
  - clock-names
  - interrupt-names
  - interrupts

additionalProperties: false

examples:
  - |
    #include <dt-bindings/interrupt-controller/arm-gic.h>
    #include <dt-bindings/interrupt-controller/irq.h>
    #include <dt-bindings/clock/adi-sc5xx-clock.h>

    uart0: uart@31003000 {
      compatible = "adi,uart";
      reg = <0x31003000 0x40>;
      clocks = <&clk ADSP_SC598_CLK_CGU0_SCLK0>;
      clock-names = "sclk0";
      interrupt-parent = <&gic>;
      interrupt-names = "tx", "rx", "status";
      interrupts = <GIC_SPI 138 IRQ_TYPE_LEVEL_HIGH>,
                   <GIC_SPI 139 IRQ_TYPE_LEVEL_HIGH>,
                   <GIC_SPI 140 IRQ_TYPE_LEVEL_HIGH>;
      adi,use-edbo;
      status = "disabled";
    };
```

## Documentation/devicetree/bindings/serial/ambarella,cv75-uart.yaml
```yaml
# SPDX-License-Identifier: GPL-2.0-only OR BSD-2-Clause
%YAML 1.2
---
$id: http://devicetree.org/schemas/serial/ambarella,cv75-uart.yaml#
$schema: http://devicetree.org/meta-schemas/core.yaml#

title: Ambarella CV75 UART

maintainers:
  - Long Zhao <longzhao@ambarella.com>

allOf:
  - $ref: serial.yaml#

properties:
  compatible:
    const: ambarella,cv75-uart

  reg:
    maxItems: 1

  interrupts:
    maxItems: 1

  clocks:
    maxItems: 1

required:
  - compatible
  - reg
  - interrupts
  - clocks

unevaluatedProperties: false

examples:
  - |
    #include <dt-bindings/interrupt-controller/arm-gic.h>

    serial@e4000000 {
        compatible = "ambarella,cv75-uart";
        reg = <0xe4000000 0x1000>;
        interrupts = <GIC_SPI 170 IRQ_TYPE_LEVEL_HIGH>;
        clocks = <&uart_clk>;
    };
```

## Documentation/devicetree/bindings/serial/brcm,bcm63138-hs-uart.yaml
```yaml
# SPDX-License-Identifier: GPL-2.0-only OR BSD-2-Clause
%YAML 1.2
---
$id: http://devicetree.org/schemas/serial/brcm,bcm63138-hs-uart.yaml#
$schema: http://devicetree.org/meta-schemas/core.yaml#

title: Broadcom's BCM63138 High Speed UART

description:
  High speed serial port controller that was designed to handle Bluetooth
  devices communication. It supports sending custom frames that need to be
  processed by a host system.

maintainers:
  - Rafał Miłecki <rafal@milecki.pl>

allOf:
  - $ref: serial.yaml#

properties:
  compatible:
    const: brcm,bcm63138-hs-uart

  reg:
    maxItems: 1

  interrupts:
    maxItems: 1

required:
  - reg
  - interrupts

unevaluatedProperties: false

examples:
  - |
    #include <dt-bindings/interrupt-controller/arm-gic.h>

    serial@fffec400 {
        compatible = "brcm,bcm63138-hs-uart";
        reg = <0xfffec400 0x1e0>;
        interrupts = <GIC_SPI 34 IRQ_TYPE_LEVEL_HIGH>;
    };
```

## Documentation/devicetree/bindings/serial/brcm,bcmbca-hs-uart.yaml
```yaml
# SPDX-License-Identifier: GPL-2.0-only OR BSD-2-Clause
%YAML 1.2
---
$id: http://devicetree.org/schemas/serial/brcm,bcmbca-hs-uart.yaml#
$schema: http://devicetree.org/meta-schemas/core.yaml#

title: Broadcom Broadband SoC High Speed UART

description:
  High speed serial port controller that was designed to handle Bluetooth
  devices communication. It supports sending custom frames that need to be
  processed by a host system.

maintainers:
  - Rafał Miłecki <rafal@milecki.pl>

allOf:
  - $ref: serial.yaml#

properties:
  compatible:
    items:
      - enum:
          - brcm,bcm4908-hs-uart
          - brcm,bcm4912-hs-uart
          - brcm,bcm6756-hs-uart
          - brcm,bcm6813-hs-uart
          - brcm,bcm6846-hs-uart
          - brcm,bcm6855-hs-uart
          - brcm,bcm6856-hs-uart
          - brcm,bcm6858-hs-uart
          - brcm,bcm6878-hs-uart
          - brcm,bcm47622-hs-uart
          - brcm,bcm63138-hs-uart
          - brcm,bcm63146-hs-uart
          - brcm,bcm63158-hs-uart
          - brcm,bcm63178-hs-uart
      - const: brcm,bcmbca-hs-uart

  reg:
    maxItems: 1

  interrupts:
    maxItems: 1

required:
  - reg
  - interrupts

unevaluatedProperties: false

examples:
  - |
    #include <dt-bindings/interrupt-controller/arm-gic.h>

    serial@fffec400 {
        compatible = "brcm,bcm63138-hs-uart", "brcm,bcmbca-hs-uart";
        reg = <0xfffec400 0x1e0>;
        interrupts = <GIC_SPI 34 IRQ_TYPE_LEVEL_HIGH>;
    };
```
