## Documentation/devicetree/bindings/rtc/nvidia,vrs10-rtc.yaml
```yaml
# SPDX-License-Identifier: (GPL-2.0-only OR BSD-2-Clause)
%YAML 1.2
---
$id: http://devicetree.org/schemas/rtc/nvidia,vrs10-rtc.yaml#
$schema: http://devicetree.org/meta-schemas/core.yaml#

title: NVIDIA Voltage Regulator Specification Real Time Clock

maintainers:
  - Shubhi Garg <shgarg@nvidia.com>

description:
  NVIDIA VRS (Voltage Regulator Specification) RTC provides 32kHz RTC clock
  support with backup battery for system timing. It provides alarm functionality
  to wake system from suspend and shutdown state. The device also acts as an
  interrupt controller for managing interrupts from the VRS.

properties:
  compatible:
    const: nvidia,vrs10-rtc

  reg:
    maxItems: 1

  interrupts:
    maxItems: 1

  interrupt-controller: true

  '#interrupt-cells':
    const: 2

required:
  - compatible
  - reg
  - interrupts
  - interrupt-controller
  - '#interrupt-cells'

additionalProperties: false

examples:
  - |
    #include <dt-bindings/interrupt-controller/irq.h>
    i2c {
        #address-cells = <1>;
        #size-cells = <0>;

        rtc@3c {
            compatible = "nvidia,vrs10-rtc";
            reg = <0x3c>;
            interrupt-parent = <&pmc>;
            interrupts = <24 IRQ_TYPE_LEVEL_LOW>;
            interrupt-controller;
            #interrupt-cells = <2>;
        };
    };
```

## Documentation/devicetree/bindings/rtc/nxp,pcf2123.yaml
```yaml
# SPDX-License-Identifier: (GPL-2.0-only OR BSD-2-Clause)
%YAML 1.2
---
$id: http://devicetree.org/schemas/rtc/nxp,pcf2123.yaml#
$schema: http://devicetree.org/meta-schemas/core.yaml#

title: NXP PCF2123 SPI Real Time Clock

maintainers:
  - Chris Verges <chrisv@cyberswitching.com>

allOf:
  - $ref: /schemas/spi/spi-peripheral-props.yaml#
  - $ref: rtc.yaml#

properties:
  compatible:
    enum:
      - nxp,pcf2123

  reg:
    maxItems: 1

  interrupts:
    maxItems: 1

required:
  - compatible
  - reg

unevaluatedProperties: false

examples:
  - |
    spi {
        #address-cells = <1>;
        #size-cells = <0>;

        rtc@3 {
            compatible = "nxp,pcf2123";
            reg = <3>;
            spi-cs-high;
        };
    };
...
```

## Documentation/devicetree/bindings/rtc/nxp,pcf85053.yaml
```yaml
# SPDX-License-Identifier: (GPL-2.0-only OR BSD-2-Clause)
# Copyright 2025-2026 NXP
%YAML 1.2
---
$id: http://devicetree.org/schemas/rtc/nxp,pcf85053.yaml#
$schema: http://devicetree.org/meta-schemas/core.yaml#

title: NXP PCF85053 Real Time Clock

maintainers:
  - Pankit Garg <pankit.garg@nxp.com>
  - Lakshay Piplani <lakshay.piplani@nxp.com>

properties:
  compatible:
    const: nxp,pcf85053

  reg:
    maxItems: 1

  interrupts:
    maxItems: 1

  "#clock-cells":
    const: 0
    description: |
      Present when the CLKOUT pin is exposed as a clock provider. In a
      dual-host configuration, only one PCF85053 interface node should
      expose CLKOUT as a clock provider.

  clock-output-names:
    maxItems: 1

  nxp,interface:
    $ref: /schemas/types.yaml#/definitions/string
    enum: [ primary, secondary ]
    description: |
      Identifies this host's logical role in a multi-host topology for the
      PCF85053 RTC. The device exposes a "TWO" ownership bit in the CTRL
      register that gates which host may write the time registers.
        - "primary": Designated host that *may* claim write ownership (set
          CTRL.TWO=1) **if** write-access is explicitly requested.
        - "secondary": Peer host that writes only when CTRL.TWO=0 (default).

      This property determines the intended role of the host in relation to
      the write ownership.

      The actual role depends on whether 'nxp,write-access' is also specified.
      Supported configurations are:
        1. Primary with 'nxp,write-access' -> primary claims write ownership.
        2. Primary without 'nxp,write-access' -> secondary owns time-register writes.
        3. Secondary (must not specify 'nxp,write-access') -> secondary may write
           the time registers when CTRL.TWO=0.

  nxp,write-access:
    type: boolean
    description: |
      Indicates that write ownership of the PCF85053 RTC should be claimed by setting
      CTRL.TWO=1. This property is only valid when acting as the primary interface
      (nxp,interface="primary").

required:
  - compatible
  - reg
  - nxp,interface

unevaluatedProperties: false

allOf:
  - $ref: rtc.yaml#
  - if:
      properties:
        nxp,interface:
          const: secondary
    then:
      properties:
        # The secondary interface has read-only access to the control and
        # status registers, so it cannot service or clear the alarm IRQ and
        # cannot claim write ownership.
        interrupts: false
        nxp,write-access: false

examples:
  # Single host example.
  - |
    #include <dt-bindings/interrupt-controller/irq.h>
    i2c {
      #address-cells = <1>;
      #size-cells = <0>;

      rtc@6f {
        compatible = "nxp,pcf85053";
        reg = <0x6f>;
        nxp,interface = "primary";
        nxp,write-access;
        #clock-cells = <0>;
        clock-output-names = "pcf85053-clkout";
        interrupt-parent = <&gpio2>;
        interrupts = <3 IRQ_TYPE_LEVEL_LOW>;
      };
    };

  # Dual-host example: one primary that claims writes; one secondary that never claims writes.
  - |
    #include <dt-bindings/interrupt-controller/irq.h>
    i2c0 {
      #address-cells = <1>;
      #size-cells = <0>;

      rtc@6f {
        compatible = "nxp,pcf85053";
        reg = <0x6f>;
        nxp,interface = "primary";
        nxp,write-access;
        interrupt-parent = <&gpio2>;
        interrupts = <3 IRQ_TYPE_LEVEL_LOW>;
      };
    };

    i2c1 {
      #address-cells = <1>;
      #size-cells = <0>;

      rtc@6f {
        compatible = "nxp,pcf85053";
        reg = <0x6f>;
        nxp,interface = "secondary";
      };
    };
```

## Documentation/devicetree/bindings/rtc/nxp,pcf85053a.yaml
```yaml
# SPDX-License-Identifier: (GPL-2.0-only OR BSD-2-Clause)
# Copyright 2025 NXP
%YAML 1.2
---
$id: http://devicetree.org/schemas/rtc/nxp,pcf85053a.yaml#
$schema: http://devicetree.org/meta-schemas/core.yaml#

title: NXP PCF85053A Real Time Clock

allOf:
  - $ref: rtc.yaml#

maintainers:
  - Pankit Garg <pankit.garg@nxp.com>

properties:
  compatible:
    enum:
      - nxp,pcf85053a

  reg:
    maxItems: 1

  interrupts:
    maxItems: 1

required:
  - compatible
  - reg

additionalProperties: false

examples:
  - |
    i2c {
        #address-cells = <1>;
        #size-cells = <0>;

        rtc@6f {
          compatible = "nxp,pcf85053a";
          reg = <0x6f>;
        };
      };
...
```

## Documentation/devicetree/bindings/rtc/nxp,pcf8525.yaml
```yaml
# SPDX-License-Identifier: GPL-2.0-only OR BSD-2-Clause
%YAML 1.2
---
$id: http://devicetree.org/schemas/rtc/nxp,pcf8525.yaml#
$schema: http://devicetree.org/meta-schemas/core.yaml#

title: NXP PCF8525 Real Time Clock

description:
  The PCF8525 is an I2C real-time clock with alarm, timestamp, watchdog,
  backup battery switch-over, and temperature compensation for an external
  32.768 kHz crystal.

allOf:
  - $ref: rtc.yaml#

maintainers:
  - Lakshay Piplani <lakshay.piplani@nxp.com>
  - Shiv Prakash Gupta <shivprakash.gupta@nxp.com>

properties:
  compatible:
    enum:
      - nxp,pcf8525

  reg:
    maxItems: 1

  interrupts:
    minItems: 1
    maxItems: 2
    description:
      INTA, followed by INTB when both interrupt outputs are connected.

  interrupt-names:
    minItems: 1
    items:
      - const: inta
      - const: intb

  quartz-load-femtofarads:
    description:
      Effective load capacitance of the external 32.768 kHz crystal.
    enum: [6000, 7000]
    default: 6000

  nxp,xtal-type:
    $ref: /schemas/types.yaml#/definitions/uint32
    description:
      Crystal model used by the temperature compensation engine.
      Value 1 selects -0.035 ppm/degC^2 and value 2 selects
      -0.04 ppm/degC^2.
    enum: [1, 2]
    default: 1

  start-year: true

  wakeup-source: true

  reset-source: true

required:
  - compatible
  - reg

additionalProperties: false

examples:
  - |
    #include <dt-bindings/interrupt-controller/irq.h>
    i2c {
        #address-cells = <1>;
        #size-cells = <0>;

        rtc@51 {
            compatible = "nxp,pcf8525";
            reg = <0x51>;
            interrupt-parent = <&gpio2>;
            interrupts = <2 IRQ_TYPE_EDGE_FALLING>,
                          <3 IRQ_TYPE_EDGE_FALLING>;
            interrupt-names = "inta", "intb";
            quartz-load-femtofarads = <7000>;
            nxp,xtal-type = <2>;
            reset-source;
        };
    };
```

## Documentation/devicetree/bindings/rtc/nxp,pcf85363.yaml
```yaml
# SPDX-License-Identifier: (GPL-2.0-only OR BSD-2-Clause)
%YAML 1.2
---
$id: http://devicetree.org/schemas/rtc/nxp,pcf85363.yaml#
$schema: http://devicetree.org/meta-schemas/core.yaml#

title: NXP PCF85263/PCF85363 Real Time Clock

maintainers:
  - Alexandre Belloni <alexandre.belloni@bootlin.com>

allOf:
  - $ref: rtc.yaml#

properties:
  compatible:
    enum:
      - nxp,pcf85263
      - nxp,pcf85363

  reg:
    maxItems: 1

  "#clock-cells":
    const: 0

  clock-output-names:
    maxItems: 1

  interrupts:
    maxItems: 1

  quartz-load-femtofarads:
    description:
      The capacitive load of the quartz(x-tal).
    enum: [6000, 7000, 12500]
    default: 7000

  start-year: true
  wakeup-source: true

  nxp,timestamp-mode:
    $ref: /schemas/types.yaml#/definitions/uint32-array
    items:
      - enum: [0, 1, 2] # TSR1: NONE, FE, LE
        description: TSR1 mode
      - enum: [0, 1, 2, 3, 4, 5] # TSR2: NONE, FB, LB, LV, FE, LE
        description: TSR2 mode
      - enum: [0, 1, 2, 3] # TSR3: NONE, FB, LB, LV
        description: TSR3 mode
    description: |
      Defines timestamp modes for TSR1, TSR2, and TSR3.
      Use macros from <dt-bindings/rtc/pcf85363-tsr.h>.

      Each value corresponds to a mode constant:
        - TSR1: NONE, FE, LE
        - TSR2: NONE, FB, LB, LV, FE, LE
        - TSR3: NONE, FB, LB, LV

required:
  - compatible
  - reg

additionalProperties: false

examples:
  - |
    #include <dt-bindings/rtc/pcf85363-tsr.h>
    i2c {
        #address-cells = <1>;
        #size-cells = <0>;

        rtc@51 {
            compatible = "nxp,pcf85363";
            reg = <0x51>;
            #clock-cells = <0>;
            quartz-load-femtofarads = <12500>;
            wakeup-source;
            nxp,timestamp-mode = <PCF85363_TSR1_FE PCF85363_TSR2_LB PCF85363_TSR3_LV>;
        };
    };
```

## Documentation/devicetree/bindings/rtc/nxp,s32g-rtc.yaml
```yaml
# SPDX-License-Identifier: (GPL-2.0 OR BSD-2-Clause)
%YAML 1.2
---
$id: http://devicetree.org/schemas/rtc/nxp,s32g-rtc.yaml#
$schema: http://devicetree.org/meta-schemas/core.yaml#

title: NXP S32G2/S32G3 Real Time Clock (RTC)

maintainers:
  - Bogdan Hamciuc <bogdan.hamciuc@nxp.com>
  - Ciprian Marian Costea <ciprianmarian.costea@nxp.com>

properties:
  compatible:
    oneOf:
      - enum:
          - nxp,s32g2-rtc
      - items:
          - const: nxp,s32g3-rtc
          - const: nxp,s32g2-rtc

  reg:
    maxItems: 1

  interrupts:
    maxItems: 1

  "#clock-cells":
    const: 1

  clocks:
    items:
      - description: ipg clock drives the access to the
          RTC iomapped registers

  clock-names:
    items:
      - const: ipg

  assigned-clocks:
    minItems: 1
    items:
      - description: Runtime clock source. It must be a clock
            source for the RTC module. It will be disabled by hardware
            during Standby/Suspend.
      - description: Standby/Suspend clock source. It is optional
            and can be used in case the RTC will continue ticking during
            platform/system suspend. RTC hardware module contains a
            hardware mux for clock source selection.

  assigned-clock-parents:
    description: List of phandles to each parent clock.

  assigned-clock-rates:
    description: List of frequencies for RTC clock sources.
            RTC module contains 2 hardware divisors which can be
            enabled or not. Hence, available frequencies are the following
            parent_freq, parent_freq / 512, parent_freq / 32 or
            parent_freq / (512 * 32)

required:
  - compatible
  - reg
  - interrupts
  - "#clock-cells"
  - clocks
  - clock-names

additionalProperties: false

examples:
  - |
    #include <dt-bindings/interrupt-controller/arm-gic.h>
    #include <dt-bindings/interrupt-controller/irq.h>

    rtc0: rtc@40060000 {
        compatible = "nxp,s32g3-rtc",
                   "nxp,s32g2-rtc";
        reg = <0x40060000 0x1000>;
        interrupts = <GIC_SPI 121 IRQ_TYPE_LEVEL_HIGH>;
        #clock-cells = <1>;
        clocks = <&clks 54>;
        clock-names = "ipg";
        /*
         * Configuration of default parent clocks.
         * 'assigned-clocks' 0-3 IDs are Runtime clock sources
         * 4-7 IDs are Suspend/Standby clock sources.
         */
        assigned-clocks = <&rtc0 2>, <&rtc0 4>;
        assigned-clock-parents = <&clks 56>, <&clks 55>;
        /*
         * Clock frequency can be divided by value
         * 512 or 32 (or both) via hardware divisors.
         * Below configuration:
         * Runtime clock source: FIRC (51 MHz) / 512 (DIV512)
         * Suspend/Standby clock source: SIRC (32 KHz)
         */
        assigned-clock-rates = <99609>, <32000>;
    };
```

## Documentation/devicetree/bindings/rtc/olpc-xo1-rtc.yaml
```yaml
# SPDX-License-Identifier: GPL-2.0-only OR BSD-2-Clause
%YAML 1.2
---
$id: http://devicetree.org/schemas/rtc/olpc-xo1-rtc.yaml#
$schema: http://devicetree.org/meta-schemas/core.yaml#

title: OLPC XO-1 RTC

maintainers:
  - Alexandre Belloni <alexandre.belloni@bootlin.com>

properties:
  compatible:
    enum:
      - olpc,xo1-rtc

required:
  - compatible

additionalProperties: false

examples:
  - |
    rtc {
       compatible = "olpc,xo1-rtc";
    };
```

## Documentation/devicetree/bindings/rtc/raspberrypi,rtc-rpi.yaml
```yaml
# SPDX-License-Identifier: GPL-2.0-only OR BSD-2-Clause

%YAML 1.2
---
$id: http://devicetree.org/schemas/rtc/raspberrypi,rtc-rpi.yaml#
$schema: http://devicetree.org/meta-schemas/core.yaml#

title: Raspberry Pi firmware RTC

maintainers:
  - Jonathan Bell <jonathan@raspberrypi.com>

description: |
  Raspberry Pi RTC from the DA9091 accessed through the Raspberry Pi firmware
  property interface.

properties:
  compatible:
    const: raspberrypi,rpi-rtc

  firmware:
    $ref: /schemas/types.yaml#/definitions/phandle
    description:
      Phandle to the Raspberry Pi firmware device.

  trickle-charge-microvolt:
    description:
      RTC backup battery trickle-charge voltage. A value of 0 disables
      trickle charging.
    anyOf:
      - const: 0
      - minimum: 1300000
        maximum: 4400000

required:
  - compatible
  - firmware

additionalProperties: false

examples:
  - |
    rtc {
        compatible = "raspberrypi,rpi-rtc";
        firmware = <&firmware>;
        status = "okay";
        trickle-charge-microvolt = <0>;
    };
```

## Documentation/devicetree/bindings/rtc/rda,8810pl-rtc.yaml
```yaml
# SPDX-License-Identifier: (GPL-2.0-only OR BSD-2-Clause)
%YAML 1.2
---
$id: http://devicetree.org/schemas/rtc/rda,8810pl-rtc.yaml#
$schema: http://devicetree.org/meta-schemas/core.yaml#

title: RDA Micro RDA8810PL Real Time Clock

maintainers:
  - Dang Huynh <dang.huynh@mainlining.org>

properties:
  compatible:
    const: rda,8810pl-rtc

  reg:
    maxItems: 1

required:
  - compatible
  - reg

additionalProperties: false

examples:
  - |
    rtc@1a06000 {
      compatible = "rda,8810pl-rtc";
      reg = <0x1a06000 0x1000>;
    };
```
