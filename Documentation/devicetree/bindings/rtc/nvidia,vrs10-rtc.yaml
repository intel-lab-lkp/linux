## Documentation/devicetree/bindings/rtc/renesas,rz-rtca3.yaml
```yaml
# SPDX-License-Identifier: (GPL-2.0-only OR BSD-2-Clause)
%YAML 1.2
---
$id: http://devicetree.org/schemas/rtc/renesas,rz-rtca3.yaml#
$schema: http://devicetree.org/meta-schemas/core.yaml#

title: Renesas RTCA-3 Real Time Clock

maintainers:
  - Claudiu Beznea <claudiu.beznea.uj@bp.renesas.com>

allOf:
  - $ref: rtc.yaml#

properties:
  compatible:
    items:
      - enum:
          - renesas,r9a08g045-rtca3 # RZ/G3S
      - const: renesas,rz-rtca3

  reg:
    maxItems: 1

  interrupts:
    items:
      - description: Alarm interrupt
      - description: Periodic interrupt
      - description: Carry interrupt

  interrupt-names:
    items:
      - const: alarm
      - const: period
      - const: carry

  clocks:
    items:
      - description: RTC counter clock

  clock-names:
    items:
      - const: counter

required:
  - compatible
  - reg
  - interrupts
  - interrupt-names
  - clocks
  - clock-names

additionalProperties: false

examples:
  - |
    #include <dt-bindings/interrupt-controller/arm-gic.h>
    #include <dt-bindings/interrupt-controller/irq.h>

    rtc@1004ec00 {
        compatible = "renesas,r9a08g045-rtca3", "renesas,rz-rtca3";
        reg = <0x1004ec00 0x400>;
        interrupts = <GIC_SPI 315 IRQ_TYPE_LEVEL_HIGH>,
                     <GIC_SPI 316 IRQ_TYPE_LEVEL_HIGH>,
                     <GIC_SPI 317 IRQ_TYPE_LEVEL_HIGH>;
        interrupt-names = "alarm", "period", "carry";
        clocks = <&vbattclk>;
        clock-names = "counter";
    };
```

## Documentation/devicetree/bindings/rtc/renesas,rzg3s-rtc.yaml
```yaml
# SPDX-License-Identifier: (GPL-2.0-only OR BSD-2-Clause)
%YAML 1.2
---
$id: http://devicetree.org/schemas/rtc/renesas,rzg3s-rtc.yaml#
$schema: http://devicetree.org/meta-schemas/core.yaml#

title: Real Time Clock for Renesas RZ/G3S SoC

maintainers:
  - Claudiu Beznea <claudiu.beznea.uj@bp.renesas.com>

properties:
  compatible:
    const: renesas,rzg3s-rtc

  reg:
    maxItems: 1

  interrupts:
    maxItems: 3

  interrupt-names:
    items:
      - const: alarm
      - const: period
      - const: carry

  clocks:
    maxItems: 1
    description: RTC counter clock

  clock-names:
    maxItems: 1

required:
  - compatible
  - reg
  - interrupts
  - interrupt-names
  - clocks
  - clock-names

additionalProperties: false

examples:
  - |
    #include <dt-bindings/interrupt-controller/arm-gic.h>
    #include <dt-bindings/interrupt-controller/irq.h>

    rtc: rtc@1004ec00 {
        compatible = "renesas,rzg3s-rtc";
        reg = <0x1004ec00 0x400>;
        interrupts = <GIC_SPI 315 IRQ_TYPE_LEVEL_HIGH>,
                     <GIC_SPI 316 IRQ_TYPE_LEVEL_HIGH>,
                     <GIC_SPI 317 IRQ_TYPE_LEVEL_HIGH>;
        interrupt-names = "alarm", "period", "carry";
        clocks = <&vbattclk>;
        clock-names = "counter";
        status = "disabled";
    };
```

## Documentation/devicetree/bindings/rtc/rtc-cmos.yaml
```yaml
# SPDX-License-Identifier: (GPL-2.0-only OR BSD-2-Clause)
%YAML 1.2
---
$id: http://devicetree.org/schemas/rtc/rtc-cmos.yaml#
$schema: http://devicetree.org/meta-schemas/core.yaml#

title: Motorola mc146818 compatible RTC

maintainers:
  - Alexandre Belloni <alexandre.belloni@bootlin.com>

properties:
  compatible:
    const: motorola,mc146818

  reg:
    maxItems: 1

  interrupts:
    maxItems: 1

  ctrl-reg:
    $ref: /schemas/types.yaml#/definitions/uint32
    description:
      Initial value of the control register
      (also known as Register B).

  freq-reg:
    $ref: /schemas/types.yaml#/definitions/uint32
    description:
      Initial value of the frequency register
      (also known as Register A).

required:
  - compatible
  - reg

additionalProperties: false

examples:
  - |
    bus {
        #address-cells = <2>;
        #size-cells = <1>;

        rtc@70 {
            compatible = "motorola,mc146818";
            reg = <1 0x70 2>;

            interrupts = <8 3>;

            ctrl-reg = <2>;
            freq-reg = <0x26>;
        };
    };
```

## Documentation/devicetree/bindings/rtc/rtc-fsl-ftm-alarm.yaml
```yaml
# SPDX-License-Identifier: (GPL-2.0-only OR BSD-2-Clause)
%YAML 1.2
---
$id: http://devicetree.org/schemas/rtc/rtc-fsl-ftm-alarm.yaml#
$schema: http://devicetree.org/meta-schemas/core.yaml#

title: Freescale FlexTimer Module (FTM) Alarm

maintainers:
  - Frank Li <Frank.Li@nxp.com>

properties:
  compatible:
    enum:
      - fsl,ls1012a-ftm-alarm
      - fsl,ls1021a-ftm-alarm
      - fsl,ls1028a-ftm-alarm
      - fsl,ls1043a-ftm-alarm
      - fsl,ls1046a-ftm-alarm
      - fsl,ls1088a-ftm-alarm
      - fsl,ls208xa-ftm-alarm
      - fsl,lx2160a-ftm-alarm

  reg:
    description:
      Specifies base physical address and size of the register sets for the
      FlexTimer Module.
    maxItems: 1

  interrupts:
    description: Should be the FlexTimer Module interrupt.
    maxItems: 1

  fsl,rcpm-wakeup:
    $ref: /schemas/types.yaml#/definitions/phandle-array
    description:
      phandle to rcpm node, Please refer
      documentation/devicetree/bindings/soc/fsl/rcpm.txt

  big-endian:
    $ref: /schemas/types.yaml#/definitions/flag
    description:
      If the host controller is big-endian mode, specify this property.
      The default endian mode is little-endian.

required:
  - compatible
  - reg
  - interrupts
  - fsl,rcpm-wakeup

unevaluatedProperties: false

examples:
  - |
    timer@2800000 {
        compatible = "fsl,ls1088a-ftm-alarm";
        reg = <0x2800000 0x10000>;
        fsl,rcpm-wakeup = <&rcpm 0x0 0x0 0x0 0x0 0x4000 0x0>;
        interrupts = <0 44 4>;
    };
```

## Documentation/devicetree/bindings/rtc/sii,s35390a.yaml
```yaml
# SPDX-License-Identifier: (GPL-2.0-only OR BSD-2-Clause)
%YAML 1.2
---
$id: http://devicetree.org/schemas/rtc/sii,s35390a.yaml#
$schema: http://devicetree.org/meta-schemas/core.yaml#

title: S-35390A 2-WIRE REAL-TIME CLOCK

maintainers:
  - Alexandre Belloni <alexandre.belloni@bootlin.com>

description:
  The S-35390A is a CMOS 2-wire real-time clock IC which operates with the
  very low current consumption in the wide range of operation voltage.

allOf:
  - $ref: rtc.yaml#

properties:
  compatible:
    const: sii,s35390a

  reg:
    maxItems: 1

  sii,wakealarm-output-pin:
    $ref: /schemas/types.yaml#/definitions/uint32
    enum: [1, 2]
    description: |
      The output pin to wake up the system.
      Default will use the output pin for interrupt signal 2.
        <S35390A_OUTPUT_PIN_INT1> : Output pin for interrupt signal 1
        <S35390A_OUTPUT_PIN_INT2> : Output pin for interrupt signal 2

required:
  - compatible
  - reg

unevaluatedProperties: false

examples:
  - |
    #include <dt-bindings/rtc/s35390a.h>

    i2c {
        #address-cells = <1>;
        #size-cells = <0>;

        rtc: rtc@30 {
            compatible = "sii,s35390a";
            reg = <0x30>;
            sii,wakealarm-output-pin = <S35390A_OUTPUT_PIN_INT2>;
        };
    };
```

## Documentation/devicetree/bindings/rtc/sophgo,cv1800-rtc.yaml
```yaml
# SPDX-License-Identifier: (GPL-2.0-only OR BSD-2-Clause)
%YAML 1.2
---
$id: http://devicetree.org/schemas/rtc/sophgo,cv1800-rtc.yaml#
$schema: http://devicetree.org/meta-schemas/core.yaml#

title: Real Time Clock of the Sophgo CV1800 SoC

maintainers:
  - Jingbao Qiu <qiujingbao.dlmu@gmail.com>

allOf:
  - $ref: rtc.yaml#

properties:
  compatible:
    const: sophgo,cv1800-rtc

  reg:
    items:
      - description: data register
      - description: control register

  clocks:
    maxItems: 1

  interrupts:
    maxItems: 1

required:
  - compatible
  - reg
  - clocks
  - interrupts

unevaluatedProperties: false

examples:
  - |
    #include <dt-bindings/interrupt-controller/irq.h>

    rtc@5025000{
      compatible = "sophgo,cv1800-rtc";
      reg = <0x5025000 0x1000>, <0x5026000 0x1000>;
      clocks = <&osc>;
      interrupts = <17 IRQ_TYPE_LEVEL_HIGH>;
    };
```

## Documentation/devicetree/bindings/rtc/sophgo,cv1800b-rtc.yaml
```yaml
# SPDX-License-Identifier: GPL-2.0-only OR BSD-2-Clause
%YAML 1.2
---
$id: http://devicetree.org/schemas/rtc/sophgo,cv1800b-rtc.yaml#
$schema: http://devicetree.org/meta-schemas/core.yaml#

title: Sophgo CV1800B SoC RTC Controller

maintainers:
  - Jingbao Qiu <qiujingbao.dlmu@gmail.com>

properties:
  compatible:
    enum:
      - sophgo,cv1800b-rtc
  reg:
    maxItems: 1

  interrupts:
    maxItems: 1

required:
  - compatible
  - reg
  - interrupts

additionalProperties: false

examples:
  - |
    rtc-controller@05026000{
      compatible = "sophgo,cv800b-rtc";
      reg = <0x05026000 0x1000>;
      interrupts = <17 IRQ_TYPE_LEVEL_HIGH>;
      interrupt-parent = <&plic0>;
      clocks = <&osc>;
    };
```

## Documentation/devicetree/bindings/rtc/st,m41t93.yaml
```yaml
# SPDX-License-Identifier: (GPL-2.0-only OR BSD-2-Clause)
%YAML 1.2
---
$id: http://devicetree.org/schemas/rtc/st,m41t93.yaml#
$schema: http://devicetree.org/meta-schemas/core.yaml#

title: ST M41T93 RTC and compatible

maintainers:
  - Alexandre Belloni <alexandre.belloni@bootlin.com>

properties:
  compatible:
    enum:
      - st,m41t93

  reg:
    maxItems: 1

  "#clock-cells":
    const: 1

allOf:
  - $ref: rtc.yaml

unevaluatedProperties: false

required:
  - compatible
  - reg

examples:
  - |
    spi {
      #address-cells = <1>;
      #size-cells = <0>;
      rtc@0 {
        spi-max-frequency = <2000000>;
        compatible = "st,m41t93";
        reg = <0>;
      };
    };
```

## Documentation/devicetree/bindings/rtc/ti,omap-rtc.yaml
```yaml
# SPDX-License-Identifier: (GPL-2.0-only OR BSD-2-Clause)
%YAML 1.2
---
$id: http://devicetree.org/schemas/rtc/ti,omap-rtc.yaml#
$schema: http://devicetree.org/meta-schemas/core.yaml#

title: Texas Instruments OMAP Real Time Clock

maintainers:
  - Keerthy <j-keerthy@ti.com>
  - Afzal Mohammed <afzal@ti.com>

description:
  The OMAP RTC is a year/month/day/hours/minutes/seconds BCD clock with
  century-range alarm matching, driven by the 32kHz clock.

allOf:
  - $ref: rtc.yaml#

properties:
  compatible:
    oneOf:
      - const: ti,da830-rtc
      - const: ti,am3352-rtc
      - items:
          - const: ti,am3352-rtc
          - const: ti,da830-rtc
      - items:
          - const: ti,am4372-rtc
          - const: ti,am3352-rtc
          - const: ti,da830-rtc

  reg:
    maxItems: 1

  interrupts:
    minItems: 2
    maxItems: 2

  system-power-controller:
    type: boolean
    description:
      Indicates that this RTC controls system power via the pmic_power_en pin.

  clocks:
    minItems: 1
    maxItems: 2

  clock-names:
    oneOf:
      - items:
          - const: ext-clk
          - const: int-clk
      - items:
          - const: ext-clk
      - items:
          - const: int-clk

  pinctrl-0:
    description:
      Phandle to pin configuration for the external wakeup pins.

  pinctrl-names:
    minItems: 1

  ti,hwmods:
    $ref: /schemas/types.yaml#/definitions/string
    description:
      Name of the hwmod associated with the RTC.
    const: rtc
    deprecated: true

patternProperties:
  "^ext-wakeup(-[0-9]+)?$":
    type: object

    description:
      Child node describing external wakeup pin configuration.

    properties:
      pins:
        enum:
          - ext_wakeup0
          - ext_wakeup1
          - ext_wakeup2
          - ext_wakeup3

      input-enable:
        type: boolean
        description:
          Enables the external wakeup input on the selected pin.

      ti,active-high:
        type: boolean
        description:
          Sets the wakeup input polarity to active high. By default the
          input is active low.

    required:
      - pins

    additionalProperties: false

required:
  - compatible
  - reg
  - interrupts

unevaluatedProperties: false

examples:
  - |
    rtc@23000 {
        compatible = "ti,da830-rtc";
        reg = <0x23000 0x1000>;
        interrupts = <19>, <19>;
        system-power-controller;
        clocks = <&clk_32k_rtc>, <&clk_32768_ck>;
        clock-names = "ext-clk", "int-clk";

        pinctrl-0 = <&ext_wakeup>;
        pinctrl-names = "default";

        ext-wakeup {
            pins = "ext_wakeup0";
            input-enable;
            ti,active-high;
        };
    };
```
