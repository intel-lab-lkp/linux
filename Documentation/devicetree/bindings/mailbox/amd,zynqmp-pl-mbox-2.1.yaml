## Documentation/devicetree/bindings/pinctrl/mediatek,mt6895-pinctrl.yaml
```yaml
# SPDX-License-Identifier: (GPL-2.0-only OR BSD-2-Clause)
%YAML 1.2
---
$id: http://devicetree.org/schemas/pinctrl/mediatek,mt6895-pinctrl.yaml#
$schema: http://devicetree.org/meta-schemas/core.yaml#

title: MediaTek MT6895 Pin Controller

maintainers:
  - Alexander Letuchiy <asalde.le1@gmail.com>

description:
  The MediaTek MT6895 Pin controller is used to control SoC pins.

properties:
  compatible:
    const: mediatek,mt6895-pinctrl

  reg:
    items:
      - description: pin controller base
      - description: rm group IO
      - description: rt group IO
      - description: rmm group IO
      - description: bl group IO
      - description: bm group IO
      - description: br group IO
      - description: brr group IO
      - description: lb group IO
      - description: lm group IO
      - description: rtt group IO
      - description: tr group IO
      - description: tl group IO
      - description: lt group IO
      - description: EINT controller W block
      - description: EINT controller E block
      - description: EINT controller S block
      - description: EINT controller N block
      - description: EINT controller C block

  reg-names:
    items:
      - const: base
      - const: rm
      - const: rt
      - const: rmm
      - const: bl
      - const: bm
      - const: br
      - const: brr
      - const: lb
      - const: lm
      - const: rtt
      - const: tr
      - const: tl
      - const: lt
      - const: eint-w
      - const: eint-e
      - const: eint-s
      - const: eint-n
      - const: eint-c

  gpio-controller: true

  '#gpio-cells':
    description:
      Number of cells in GPIO specifier. Since the generic GPIO binding is used,
      the amount of cells must be specified as 2. See the below mentioned gpio
      binding representation for description of particular cells.
    const: 2

  gpio-ranges:
    maxItems: 1

  gpio-line-names:
    maxItems: 247

  interrupts:
    description: EINT controller interrupt
    maxItems: 1

  interrupt-controller: true

  '#interrupt-cells':
    const: 2

# PIN CONFIGURATION NODES
patternProperties:
  '-pins$':
    type: object
    additionalProperties: false

    patternProperties:
      '^pins':
        type: object
        allOf:
          - $ref: /schemas/pinctrl/pincfg-node.yaml
          - $ref: /schemas/pinctrl/pinmux-node.yaml
        description:
          A pinctrl node should contain at least one subnodes representing the
          pinctrl groups available on the machine. Each subnode will list the
          pins it needs, and how they should be configured, with regard to muxer
          configuration, pullups, drive strength, input enable/disable and input
          schmitt.

        properties:
          pinmux:
            description:
              Integer array, represents gpio pin number and mux setting.
              Supported pin number and mux are defined as macros in
              arch/arm64/boot/dts/mediatek/mt6895-pinfunc.h for this SoC.

          drive-strength:
            enum: [2, 4, 6, 8, 10, 12, 14, 16]

          drive-strength-microamp:
            enum: [125, 250, 500, 1000]

          bias-pull-down:
            oneOf:
              - type: boolean
                description: normal pull down.
              - enum: [100, 101, 102, 103]
                description: PUPD/R1/R0 pull down type. See MTK_PUPD_SET_R1R0_
                  defines in dt-bindings/pinctrl/mt65xx.h.
              - enum: [200, 201, 202, 203, 204, 205, 206, 207]
                description: RSEL pull down type. See MTK_PULL_SET_RSEL_ defines
                  in dt-bindings/pinctrl/mt65xx.h.

          bias-pull-up:
            oneOf:
              - type: boolean
                description: normal pull up.
              - enum: [100, 101, 102, 103]
                description: PUPD/R1/R0 pull up type. See MTK_PUPD_SET_R1R0_
                  defines in dt-bindings/pinctrl/mt65xx.h.
              - enum: [200, 201, 202, 203, 204, 205, 206, 207]
                description: RSEL pull up type. See MTK_PULL_SET_RSEL_ defines
                  in dt-bindings/pinctrl/mt65xx.h.

          bias-disable: true

          output-high: true

          output-low: true

          input-enable: true

          input-disable: true

          input-schmitt-enable: true

          input-schmitt-disable: true

        required:
          - pinmux

        additionalProperties: false

required:
  - compatible
  - reg
  - reg-names
  - interrupts
  - interrupt-controller
  - '#interrupt-cells'
  - gpio-controller
  - '#gpio-cells'
  - gpio-ranges

additionalProperties: false

examples:
  - |
    #include <dt-bindings/interrupt-controller/arm-gic.h>
    #include <dt-bindings/pinctrl/mt65xx.h>
    #define PINMUX_GPIO0__FUNC_GPIO0 (MTK_PIN_NO(0) | 0)
    #define PINMUX_GPIO6__FUNC_SCL0 (MTK_PIN_NO(6) | 1)
    #define PINMUX_GPIO7__FUNC_SDA0 (MTK_PIN_NO(7) | 1)

    pio: pinctrl@10005000 {
        compatible = "mediatek,mt6895-pinctrl";
        reg = <0x10005000 0x1000>,
              <0x11c20000 0x1000>,
              <0x11c30000 0x1000>,
              <0x11c40000 0x1000>,
              <0x11d10000 0x1000>,
              <0x11d30000 0x1000>,
              <0x11d40000 0x1000>,
              <0x11d50000 0x1000>,
              <0x11d60000 0x1000>,
              <0x11e10000 0x1000>,
              <0x11ea0000 0x1000>,
              <0x11eb0000 0x1000>,
              <0x11f20000 0x1000>,
              <0x11f30000 0x1000>,
              <0x11e50000 0x1000>,
              <0x11ce0000 0x1000>,
              <0x11de0000 0x1000>,
              <0x11fe0000 0x1000>,
              <0x1c01e000 0x1000>;
        reg-names = "base", "rm", "rt", "rmm", "bl", "bm", "br",
                    "brr", "lb", "lm", "rtt", "tr", "tl", "lt",
                    "eint-w", "eint-e", "eint-s", "eint-n", "eint-c";
        gpio-controller;
        #gpio-cells = <2>;
        gpio-ranges = <&pio 0 0 227>;
        interrupt-controller;
        interrupts = <GIC_SPI 259 IRQ_TYPE_LEVEL_HIGH 0>;
        #interrupt-cells = <2>;

        gpio-pins {
            pins {
                pinmux = <PINMUX_GPIO0__FUNC_GPIO0>;
                bias-pull-up;
                drive-strength = <6>;
            };
        };

        i2c0-pins {
            pins-bus {
                pinmux = <PINMUX_GPIO6__FUNC_SCL0>,
                         <PINMUX_GPIO7__FUNC_SDA0>;
                bias-pull-up = <MTK_PULL_SET_RSEL_111>;
                drive-strength-microamp = <1000>;
            };
        };
    };
```

## Documentation/devicetree/bindings/pinctrl/ti,tda54-pinctrl.yaml
```yaml
# SPDX-License-Identifier: (GPL-2.0-only OR BSD-2-Clause)
%YAML 1.2
---
$id: http://devicetree.org/schemas/pinctrl/ti,tda54-pinctrl.yaml#
$schema: http://devicetree.org/meta-schemas/core.yaml#

title: TI TDA54 SoC pin controller

maintainers:
  - Yemike Abhilash Chandra <y-abhilashchandra@ti.com>

description: |
  Pinmux and pinconf controller in the TI TDA54 SoC. There are two instances,
  one in the MAIN domain and one in the MCU domain.

  The configuration of each pad is split across two registers:

    PADCFGA  mux mode and functional pin configuration
    PADCFGB  wakeup and retention configuration

properties:
  compatible:
    const: ti,tda54-pinctrl

  reg:
    maxItems: 1
    description:
      The register space is divided into two proxy addressing regions, each
      covering the same registers. This covers the entire register space,
      including both proxy addressing regions.

  ti,npins:
    $ref: /schemas/types.yaml#/definitions/uint32
    minimum: 1
    description:
      Number of pins on this instance.

  ti,proxy-id:
    $ref: /schemas/types.yaml#/definitions/uint32
    enum: [0, 1]
    default: 0
    description:
      Proxy 0 is the default access path and can write any register
      that proxy 1 has not claimed. A register claimed through proxy 1
      becomes read-only at proxy 0 and can only be written through proxy 1.
      This selects the proxy region to use.

allOf:
  - $ref: pinctrl.yaml#

required:
  - compatible
  - reg
  - ti,npins

patternProperties:
  '-pins$':
    type: object
    allOf:
      - $ref: pinmux-node.yaml#
      - $ref: pincfg-node.yaml#

    additionalProperties: false

    description:
      Pin configuration node describing one or more pads, their mux mode and
      the configuration to apply.

    properties:
      pinmux:
        description:
          Values are constructed from pad number and mux mode, pad
          number is left shifted by 8 bits, then ORed with mux mode

      bias-disable: true
      bias-pull-up: true
      bias-pull-down: true
      input-enable: true
      input-disable: true
      output-enable: true
      output-disable: true
      input-schmitt-enable: true
      input-schmitt-disable: true

      slew-rate:
        description:
          I/O slew rate. 0 = slew control disabled, 1 = mild, 2 = moderate,
          3 = high.
        enum: [0, 1, 2, 3]

      ti,debounce-select:
        $ref: /schemas/types.yaml#/definitions/uint32
        enum: [0, 1, 2, 3, 4, 5, 6]
        description:
          Selects which DBOUNCE_CFGn period register in the control module
          drives the debounce filter for this pad. 0 disables debouncing,
          1 to 6 select DBOUNCE_CFG1 to DBOUNCE_CFG6.

      ti,virt-gpio-instance:
        $ref: /schemas/types.yaml#/definitions/uint32
        enum: [0, 1, 2, 3, 4, 5, 6, 7]
        description:
          Selects which virtual GPIO instance controls this pad, allowing
          protection between multiple virtual views of the GPIO control
          registers. Has no effect unless the pad is muxed to GPIO mode
          (muxmode 7).

      ti,wakeup:
        $ref: /schemas/types.yaml#/definitions/uint32
        enum: [0, 1, 2, 3]
        description: |
          Wakeup event configuration for this pad.
          0 - wakeup disabled
          1 - wakeup triggered by any change of the pin input value
          2 - wakeup triggered by a low value on the pin
          3 - wakeup triggered by a high value on the pin

      ti,retention-bias:
        $ref: /schemas/types.yaml#/definitions/uint32
        enum: [0, 1, 2]
        description: |
          Enables the internal I/O pullup/pulldown resistor when pin enters
          TDA54 I/O retention mode, and configures the I/O pull resistor
          direction.
          0 - OFF mode pad pull resistor disable
          1 - Select OFF mode pulldown resistor
          2 - Select OFF mode pullup resistor

      ti,retention-offmode:
        $ref: /schemas/types.yaml#/definitions/uint32
        enum: [0, 1]
        description: |
          I/O behaviour when retention mode is active.
          0 - I/O maintains its previous state
          1 - I/O state is forced to the OFF mode value

      ti,retention-output:
        $ref: /schemas/types.yaml#/definitions/uint32
        enum: [0, 1, 2]
        description: |
          Output driver behaviour while the pad is in retention mode.
          0 - output driver disabled
          1 - output driver enabled, pad driven low
          2 - output driver enabled, pad driven high

      ti,retention-force:
        $ref: /schemas/types.yaml#/definitions/uint32
        enum: [0, 1]
        description: |
          I/O retention controls.
          0 - gated by the Device Manager logic
          1 - forced active, overriding the Device Manager gating logic

      ti,isolation-bypass:
        $ref: /schemas/types.yaml#/definitions/uint32
        enum: [0, 1]
        description: |
          I/O isolation for this pad.
          0 - isolation preserved
          1 - isolation bypassed

    required:
      - pinmux

additionalProperties: false

examples:
  - |
    #define TDA54_PINMUX(pad, mux) (((pad) << 8) | ((mux) & 0xf))
    #define TDA54_MUX_MODE0 0
    #define TDA54_MUX_MODE7 7

    pinctrl@5e200000 {
        compatible = "ti,tda54-pinctrl";
        reg = <0x5e200000 0x8000>;
        ti,npins = <161>;
        ti,proxy-id = <1>;

        mcu-uart0-rx-pins {
            pinmux = <TDA54_PINMUX(58, TDA54_MUX_MODE0)>,
                     <TDA54_PINMUX(60, TDA54_MUX_MODE0)>;
            input-enable;
            bias-disable;
        };

        mcu-uart0-tx-pins {
            pinmux = <TDA54_PINMUX(59, TDA54_MUX_MODE0)>,
                     <TDA54_PINMUX(61, TDA54_MUX_MODE0)>;
            output-enable;
            bias-disable;
        };

        mcu-gpio0-button-pins {
            pinmux = <TDA54_PINMUX(42, TDA54_MUX_MODE7)>;
            input-enable;
            bias-pull-up;
            ti,debounce-select = <2>;
            ti,virt-gpio-instance = <1>;
            ti,wakeup = <2>;
        };

        mcu-i2c0-pins {
            pinmux = <TDA54_PINMUX(0, TDA54_MUX_MODE0)>,
                     <TDA54_PINMUX(1, TDA54_MUX_MODE0)>;
            input-enable;
            bias-pull-up;
            ti,retention-bias = <2>;
        };
    };
```

## Documentation/devicetree/bindings/power/reset/metanoia,reboot.yaml
```yaml
# SPDX-License-Identifier: (GPL-2.0-only OR BSD-2-Clause)
%YAML 1.2
---
$id: http://devicetree.org/schemas/power/reset/metanoia,reboot.yaml#
$schema: http://devicetree.org/meta-schemas/core.yaml#

title: Metanoia MT2824 Reboot Controller

maintainers:
  - Jun Chang <jun.chang@metanoia-comm.com>

description:
  The Metanoia MT2824 reboot controller provides a system warm reboot through
  a memory-mapped register. It is used by the firmware in machine mode.

properties:
  compatible:
    const: metanoia,mt2824-reboot

  reg:
    maxItems: 1

required:
  - compatible
  - reg

additionalProperties: false

examples:
  - |
    reboot: reboot@10000004 {
      compatible = "metanoia,mt2824-reboot";
      reg = <0x10000004 0x8>;
    };
```

## Documentation/devicetree/bindings/power/supply/maxim,ds28e16.yaml
```yaml
# SPDX-License-Identifier: (GPL-2.0-only OR BSD-2-Clause)
%YAML 1.2
---
$id: http://devicetree.org/schemas/power/supply/maxim,ds28e16.yaml#
$schema: http://devicetree.org/meta-schemas/core.yaml#

title: Maxim DS28E16 battery pack authenticator

maintainers:
  - Armandas Kvietkus <armandas.kvietkus@proton.me>

description:
  The DS28E16 is a secure authenticator inside some battery packs, for
  example in Xiaomi SM8250 phones. It is connected to a GPIO that is used as
  a 1-Wire data line. Page 2 of its memory holds a one way decrement counter
  that stores the charge cycle count of the pack.

properties:
  compatible:
    const: maxim,ds28e16

  onewire-gpios:
    maxItems: 1
    description: GPIO used as the 1-Wire data line.

required:
  - compatible
  - onewire-gpios

additionalProperties: false

examples:
  - |
    #include <dt-bindings/gpio/gpio.h>

    battery-id {
        compatible = "maxim,ds28e16";
        onewire-gpios = <&tlmm 25 GPIO_ACTIVE_HIGH>;
    };
```
