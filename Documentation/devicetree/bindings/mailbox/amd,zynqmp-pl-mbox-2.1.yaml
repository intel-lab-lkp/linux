## Documentation/devicetree/bindings/mailbox/amd,zynqmp-pl-mbox-2.1.yaml
```yaml
# SPDX-License-Identifier: (GPL-2.0-only OR BSD-2-Clause)
%YAML 1.2
---
$id: http://devicetree.org/schemas/mailbox/amd,zynqmp-pl-mbox-2.1.yaml#
$schema: http://devicetree.org/meta-schemas/core.yaml#

title: AMD Programmable Logic Mailbox IP

maintainers:
  - Ben Levinsky <ben.levinsky@amd.com>

description: |
  The AMD Programmable Logic Mailbox IP provides bidirectional message passing
  between two processor-facing interfaces. Each interface writes messages to
  a send FIFO and reads messages from a receive FIFO. The register aperture,
  interrupt, and clock described by a node belong to one processor-facing
  interface. Channel 0 represents transmit and channel 1 represents receive
  for that interface.

properties:
  compatible:
    oneOf:
      - const: amd,zynqmp-pl-mbox-2.1
      - items:
          - enum:
              - amd,versal-pl-mbox-2.1
              - amd,versal-net-pl-mbox-2.1
              - amd,versal2-pl-mbox-2.1
          - const: amd,zynqmp-pl-mbox-2.1

  reg:
    maxItems: 1

  interrupts:
    maxItems: 1

  clocks:
    maxItems: 1

  amd,mbox-pl-fifo-len:
    $ref: /schemas/types.yaml#/definitions/uint32
    minimum: 16
    maximum: 8192
    default: 16
    description:
      Depth of the send and receive FIFOs in 32-bit words, as configured by
      the C_MAILBOX_DEPTH parameter of the IP. Must match the configured
      depth.

  '#mbox-cells':
    const: 1

required:
  - compatible
  - reg
  - interrupts
  - clocks
  - '#mbox-cells'

additionalProperties: false

examples:
  - |
    #include <dt-bindings/interrupt-controller/arm-gic.h>

    mailbox@b2060000 {
        compatible = "amd,zynqmp-pl-mbox-2.1";
        reg = <0xb2060000 0x10000>;
        interrupts = <GIC_SPI 106 IRQ_TYPE_LEVEL_HIGH>;
        clocks = <&pl_clk>;
        amd,mbox-pl-fifo-len = <16>;
        #mbox-cells = <1>;
    };
...
```

## Documentation/devicetree/bindings/media/arm,mali-c720.yaml
```yaml
# SPDX-License-Identifier: (GPL-2.0-only OR BSD-2-Clause)
%YAML 1.2
---
$id: http://devicetree.org/schemas/media/arm,mali-c720.yaml#
$schema: http://devicetree.org/meta-schemas/core.yaml#

title: ARM Mali-C720 Image Signal Processor

maintainers:
  - Anthony McGivern <anthony.mcgivern@arm.com>

properties:
  compatible:
    const: arm,mali-c720

  reg:
    maxItems: 1

  interrupts:
    minItems: 1
    items:
      - description: ISP main interrupt
      - description: ISP fault interrupt

  interrupt-names:
    minItems: 1
    items:
      - const: isp
      - const: fault

  iommus:
    minItems: 1
    maxItems: 3

  clocks:
    items:
      - description: ISP main processing clock

  clock-names:
    items:
      - const: vclk

  resets:
    items:
      - description: ISP main processing clock domain reset

  reset-names:
    items:
      - const: reset

  memory-region:
    maxItems: 1
    description: Reserved memory pool for ISP DMA allocations.

  power-domains:
    description: Power domain containing the ISP.
    maxItems: 1

  ports:
    $ref: /schemas/graph.yaml#/properties/ports
    description: Parallel video input ports.

    properties:
      port@0:
        $ref: /schemas/graph.yaml#/properties/port
        description: Input port 0

        properties:
          reg:
            const: 0

      port@1:
        $ref: /schemas/graph.yaml#/properties/port
        description: Input port 1

        properties:
          reg:
            const: 1

      port@2:
        $ref: /schemas/graph.yaml#/properties/port
        description: Input port 2

        properties:
          reg:
            const: 2

      port@3:
        $ref: /schemas/graph.yaml#/properties/port
        description: Input port 3

        properties:
          reg:
            const: 3

required:
  - compatible
  - reg
  - interrupts
  - interrupt-names
  - clocks
  - clock-names
  - resets
  - reset-names

additionalProperties: false

examples:
  - |
    mali_c720: isp@400000 {
      compatible = "arm,mali-c720";
      reg = <0x400000 0x200000>;
      clocks = <&clk 0>;
      clock-names = "vclk";
      resets = <&resets 0>;
      reset-names = "reset";
      memory-region = <&isp_reserved>;
      interrupts = <0>;
      interrupt-names = "isp";
      power-domains = <&power 0>;

      ports {
        #address-cells = <1>;
        #size-cells = <0>;

        port@0 {
          reg = <0>;
          isp_in: endpoint {
            remote-endpoint = <&csi2_rx_out>;
          };
        };
      };
    };
...
```

## Documentation/devicetree/bindings/media/arm,mali-v76.yaml
```yaml
# SPDX-License-Identifier: (GPL-2.0-only OR BSD-2-Clause)
%YAML 1.2
---
$id: http://devicetree.org/schemas/media/arm,mali-v76.yaml#
$schema: http://devicetree.org/meta-schemas/core.yaml#

title: ARM Mali-V76 Video Processing Unit

maintainers:
  - Charvi Mehta <charvi.mehta@arm.com>

description:
  The ARM Mali-V76 VPU is a hardware accelerator for video encoding and
  decoding present on ARM platforms.

properties:
  compatible:
    const: arm,mali-v76

  reg:
    maxItems: 1

  interrupts:
    maxItems: 1

  clocks:
    items:
      - description: VPU core clock

  clock-names:
    items:
      - const: core

  resets:
    description:
      Optional VPU warm reset control. Platforms without this control must
      ensure that the VPU is released from external reset before the driver
      accesses it. The driver performs initialization and recovery resets
      through the VPU's software reset register.
    items:
      - description: VPU warm reset

  reset-names:
    items:
      - const: warm

required:
  - compatible
  - reg
  - interrupts
  - clocks
  - clock-names

dependencies:
  resets: [ reset-names ]
  reset-names: [ resets ]

additionalProperties: false

examples:
  - |
    #include <dt-bindings/interrupt-controller/arm-gic.h>

    mali_v76: video-codec@6f030000 {
        compatible = "arm,mali-v76";
        reg = <0x6f030000 0x300>;
        interrupts = <GIC_SPI 168 IRQ_TYPE_LEVEL_HIGH>;
        clocks = <&clock 0>;
        clock-names = "core";
    };
```

## Documentation/devicetree/bindings/media/i2c/ti,tvp514x.yaml
```yaml
# SPDX-License-Identifier: (GPL-2.0-only OR BSD-2-Clause)
%YAML 1.2
---
$id: http://devicetree.org/schemas/media/i2c/ti,tvp514x.yaml#
$schema: http://devicetree.org/meta-schemas/core.yaml#

title: Texas Instruments TVP514x video decoders

maintainers:
  - Vaibhav Hiremath <hvaibhav@ti.com>
  - Mauro Carvalho Chehab <mchehab@kernel.org>

description:
  The TVP5146/TVP5146m2/TVP5147/TVP5147m1 device is high quality, single-chip
  digital video decoder that digitizes and decodes all popular baseband analog
  video formats into digital video component. The tvp514x decoder supports
  analog- to-digital (A/D) conversion of component RGB and YPbPr signals as
  well as A/D conversion and decoding of NTSC, PAL and SECAM composite and
  S-video into component YCbCr.

properties:
  compatible:
    enum:
      - ti,tvp5146
      - ti,tvp5146m2
      - ti,tvp5147
      - ti,tvp5147m1

  reg:
    maxItems: 1

  port:
    $ref: /schemas/graph.yaml#/$defs/port-base
    unevaluatedProperties: false

    properties:
      endpoint:
        $ref: /schemas/media/video-interfaces.yaml#
        unevaluatedProperties: false
        required:
          - hsync-active
          - vsync-active
          - pclk-sample

    required:
      - endpoint

required:
  - compatible
  - reg

additionalProperties: false

examples:
  - |
    i2c {
        #address-cells = <1>;
        #size-cells = <0>;

        video-decoder@5c {
            compatible = "ti,tvp5146m2";
            reg = <0x5c>;

            port {
                endpoint {
                    hsync-active = <1>;
                    vsync-active = <1>;
                    pclk-sample = <0>;
                };
            };
        };
    };
```

## Documentation/devicetree/bindings/media/qcom,sm8250-jpeg-enc.yaml
```yaml
# SPDX-License-Identifier: (GPL-2.0 OR BSD-2-Clause)
%YAML 1.2
---
$id: http://devicetree.org/schemas/media/qcom,sm8250-jpeg-enc.yaml#
$schema: http://devicetree.org/meta-schemas/core.yaml#

title: Qualcomm JPEG Encoder

maintainers:
  - Atanas Filipov <atanas.filipov@oss.qualcomm.com>

description:
  Qualcomm JPEG Encoder is the JPEG encode hardware present in Qualcomm SoCs.
  The encoder is a standalone hardware IP within the camera subsystem that
  performs JPEG compression in memory-to-memory fashion.

properties:
  compatible:
    enum:
      - qcom,sc7280-jpeg-enc
      - qcom,sm8250-jpeg-enc

  reg:
    maxItems: 1

  interrupts:
    maxItems: 1

  clocks:
    maxItems: 6

  clock-names:
    items:
      - const: bus
      - const: config
      - const: cpas
      - const: camnoc_axi
      - const: camnoc_axi_src
      - const: core

  power-domains:
    minItems: 2
    maxItems: 3

  power-domain-names:
    minItems: 2
    maxItems: 3

  interconnects:
    maxItems: 1

  interconnect-names:
    items:
      - const: camnoc

  iommus:
    description:
      SMMU stream ID for the JPEG hardware.
    maxItems: 1

  operating-points-v2: true

  opp-table:
    type: object

required:
  - compatible
  - reg
  - clocks
  - clock-names
  - interrupts
  - power-domains
  - power-domain-names
  - interconnects
  - interconnect-names
  - iommus
  - operating-points-v2

allOf:
  - if:
      properties:
        compatible:
          contains:
            const: qcom,sc7280-jpeg-enc
    then:
      properties:
        power-domains:
          items:
            - description: Titan top GDSC
            - description: CX power domain
        power-domain-names:
          items:
            - const: titan_top
            - const: cx

  - if:
      properties:
        compatible:
          contains:
            const: qcom,sm8250-jpeg-enc
    then:
      properties:
        power-domains:
          items:
            - description: Titan top GDSC
            - description: MX power domain
            - description: MMCX power domain
        power-domain-names:
          items:
            - const: titan_top
            - const: mx
            - const: mmcx

additionalProperties: false

examples:
  - |
    #include <dt-bindings/clock/qcom,camcc-sm8250.h>
    #include <dt-bindings/clock/qcom,gcc-sm8250.h>
    #include <dt-bindings/interconnect/qcom,sm8250.h>
    #include <dt-bindings/interrupt-controller/arm-gic.h>
    #include <dt-bindings/power/qcom,rpmhpd.h>

    jpeg-encoder@ac53000 {
        compatible = "qcom,sm8250-jpeg-enc";
        reg = <0x0ac53000 0x1000>;

        interrupts = <GIC_SPI 474 IRQ_TYPE_EDGE_RISING>;

        power-domains = <&camcc TITAN_TOP_GDSC>,
                        <&rpmhpd RPMHPD_MX>,
                        <&rpmhpd RPMHPD_MMCX>;
        power-domain-names = "titan_top", "mx", "mmcx";

        clocks = <&gcc GCC_CAMERA_SF_AXI_CLK>,
                 <&camcc CAM_CC_CORE_AHB_CLK>,
                 <&camcc CAM_CC_CPAS_AHB_CLK>,
                 <&camcc CAM_CC_CAMNOC_AXI_CLK>,
                 <&camcc CAM_CC_CAMNOC_AXI_CLK_SRC>,
                 <&camcc CAM_CC_JPEG_CLK>;
        clock-names = "bus",
                      "config",
                      "cpas",
                      "camnoc_axi",
                      "camnoc_axi_src",
                      "core";

        interconnects = <&mmss_noc MASTER_CAMNOC_SF 0 &mc_virt SLAVE_EBI_CH0 0>;
        interconnect-names = "camnoc";

        iommus = <&apps_smmu 0x2040 0x400>;

        operating-points-v2 = <&jpeg_opp_table>;

        jpeg_opp_table: opp-table {
            compatible = "operating-points-v2";

            opp-100000000 {
                opp-hz = /bits/ 64 <100000000>;
                opp-peak-kBps = <262560>;
                required-opps = <&rpmhpd_opp_svs_l1>,
                                <&rpmhpd_opp_low_svs>;
            };

            opp-200000000 {
                opp-hz = /bits/ 64 <200000000>;
                opp-peak-kBps = <524760>;
                required-opps = <&rpmhpd_opp_svs_l1>,
                                <&rpmhpd_opp_svs>;
            };

            opp-400000000 {
                opp-hz = /bits/ 64 <400000000>;
                opp-peak-kBps = <978600>;
                required-opps = <&rpmhpd_opp_svs_l1>,
                                <&rpmhpd_opp_svs_l1>;
            };

            opp-480000000 {
                opp-hz = /bits/ 64 <480000000>;
                opp-peak-kBps = <1095600>;
                required-opps = <&rpmhpd_opp_svs_l1>,
                                <&rpmhpd_opp_nom>;
            };

            opp-600000000 {
                opp-hz = /bits/ 64 <600000000>;
                opp-peak-kBps = <1095600>;
                required-opps = <&rpmhpd_opp_svs_l1>,
                                <&rpmhpd_opp_turbo>;
            };
        };
    };
```

## Documentation/devicetree/bindings/media/rockchip,rk3568-iep2.yaml
```yaml
# SPDX-License-Identifier: (GPL-2.0-only OR BSD-2-Clause)
%YAML 1.2
---
$id: http://devicetree.org/schemas/media/rockchip,rk3568-iep2.yaml#
$schema: http://devicetree.org/meta-schemas/core.yaml#

title: Rockchip IEP2 image enhancement processor

maintainers:
  - Arun Iyengar <aiyengar1990@gmail.com>

description:
  Memory to memory video deinterlacer of the Rockchip RK3568 and RK3588
  SoCs. It has its own IOMMU, with which it shares its interrupt line.

properties:
  compatible:
    oneOf:
      - const: rockchip,rk3568-iep2
      - items:
          - const: rockchip,rk3588-iep2
          - const: rockchip,rk3568-iep2

  reg:
    maxItems: 1

  interrupts:
    maxItems: 1

  clocks:
    items:
      - description: AXI bus clock
      - description: AHB bus clock
      - description: Core clock

  clock-names:
    items:
      - const: aclk
      - const: hclk
      - const: sclk

  resets:
    items:
      - description: AXI reset
      - description: AHB reset
      - description: Core reset

  reset-names:
    items:
      - const: axi
      - const: ahb
      - const: core

  power-domains:
    maxItems: 1

  iommus:
    maxItems: 1

required:
  - compatible
  - reg
  - interrupts
  - clocks
  - clock-names
  - power-domains
  - iommus

additionalProperties: false

examples:
  - |
    #include <dt-bindings/clock/rockchip,rk3588-cru.h>
    #include <dt-bindings/interrupt-controller/arm-gic.h>
    #include <dt-bindings/power/rk3588-power.h>
    #include <dt-bindings/reset/rockchip,rk3588-cru.h>

    bus {
      #address-cells = <2>;
      #size-cells = <2>;

      deinterlace@fdbb0000 {
        compatible = "rockchip,rk3588-iep2", "rockchip,rk3568-iep2";
        reg = <0x0 0xfdbb0000 0x0 0x500>;
        interrupts = <GIC_SPI 117 IRQ_TYPE_LEVEL_HIGH>;
        clocks = <&cru ACLK_IEP2P0>, <&cru HCLK_IEP2P0>,
                 <&cru CLK_IEP2P0_CORE>;
        clock-names = "aclk", "hclk", "sclk";
        resets = <&cru SRST_A_IEP2P0>, <&cru SRST_H_IEP2P0>,
                 <&cru SRST_IEP2P0_CORE>;
        reset-names = "axi", "ahb", "core";
        power-domains = <&power RK3588_PD_VDPU>;
        iommus = <&iep_mmu>;
      };
    };
```
