## Documentation/devicetree/bindings/media/rockchip,rv1126-rkvenc.yaml
```yaml
# SPDX-License-Identifier: (GPL-2.0-only OR BSD-2-Clause)
%YAML 1.2
---
$id: http://devicetree.org/schemas/media/rockchip,rv1126-rkvenc.yaml#
$schema: http://devicetree.org/meta-schemas/core.yaml#

title: Rockchip RKVENC v1 H.264/HEVC video encoder

maintainers:
  - Daniel Golle <daniel@makrotopia.org>

description:
  The RKVENC v1 encoder found in the RV1109, RV1126, RK3566 and RK3568
  encodes H.264 and HEVC from raw YUV or RGB frames. It reads and writes
  memory through an IOMMU with two MMU instances.

properties:
  compatible:
    enum:
      - rockchip,rk3568-rkvenc
      - rockchip,rv1126-rkvenc

  reg:
    maxItems: 1

  interrupts:
    maxItems: 1

  clocks:
    items:
      - description: AXI master clock
      - description: AHB register interface clock
      - description: Encoder core clock

  clock-names:
    items:
      - const: axi
      - const: ahb
      - const: core

  assigned-clocks: true

  assigned-clock-rates: true

  operating-points-v2: true

  venc-supply:
    description: Supply of the encoder core, scaled with the operating points.

  "#cooling-cells":
    const: 2

  resets:
    items:
      - description: AXI reset
      - description: AHB reset
      - description: Encoder core reset

  reset-names:
    items:
      - const: axi
      - const: ahb
      - const: core

  power-domains:
    maxItems: 1

  iommus:
    maxItems: 1

required:
  - compatible
  - reg
  - interrupts
  - clocks
  - clock-names
  - resets
  - reset-names
  - power-domains
  - iommus

additionalProperties: false

examples:
  - |
    #include <dt-bindings/clock/rockchip,rv1126-cru.h>
    #include <dt-bindings/interrupt-controller/arm-gic.h>
    #include <dt-bindings/power/rockchip,rv1126-power.h>

    video-codec@ffbb0000 {
        compatible = "rockchip,rv1126-rkvenc";
        reg = <0xffbb0000 0xf00>;
        interrupts = <GIC_SPI 68 IRQ_TYPE_LEVEL_HIGH>;
        clocks = <&cru ACLK_VENC>, <&cru HCLK_VENC>, <&cru CLK_VENC_CORE>;
        clock-names = "axi", "ahb", "core";
        assigned-clocks = <&cru ACLK_VENC>, <&cru CLK_VENC_CORE>;
        assigned-clock-rates = <297000000>, <396000000>;
        resets = <&cru SRST_VENC_A>, <&cru SRST_VENC_H>,
                 <&cru SRST_VENC_CORE>;
        reset-names = "axi", "ahb", "core";
        iommus = <&venc_mmu>;
        power-domains = <&power RV1126_PD_VEPU>;
    };
...
```

## Documentation/devicetree/bindings/misc/fpc,fpc1540-tee.yaml
```yaml
# SPDX-License-Identifier: (GPL-2.0-only OR BSD-2-Clause)
%YAML 1.2
---
$id: http://devicetree.org/schemas/misc/fpc,fpc1540-tee.yaml#
$schema: http://devicetree.org/meta-schemas/core.yaml#

title: FPC1540 fingerprint sensor driven by a QSEE trusted application

maintainers:
  - Armandas Kvietkus <armandas.kvietkus@proton.me>

description:
  The FPC1540 is connected to a QUP serial engine that the secure world owns.
  A QSEE trusted application drives the sensor. Linux powers and resets the
  sensor, receives the finger interrupt and loads the trusted application.

properties:
  compatible:
    const: fpc,fpc1540-tee

  firmware-name:
    minItems: 1
    items:
      - description: Path of the trusted application, without the .mdt suffix.
      - description:
          Path of the QSEE common library the trusted application needs,
          without the .mdt suffix.

  vdd-supply: true

  reset-gpios:
    maxItems: 1

  interrupts:
    maxItems: 1

  irq-gpios:
    maxItems: 1
    description:
      The interrupt line read as a GPIO, so that edges where the line is
      already low again are not reported as a finger.

  memory-region:
    maxItems: 1
    description:
      Region used to pass the trusted application image to QSEE. The whole
      region is shared with QSEE because QSEE reads past the end of the image
      while it starts the application.

required:
  - compatible
  - firmware-name
  - vdd-supply
  - reset-gpios
  - interrupts
  - memory-region

additionalProperties: false

examples:
  - |
    #include <dt-bindings/gpio/gpio.h>
    #include <dt-bindings/interrupt-controller/irq.h>

    fingerprint {
        compatible = "fpc,fpc1540-tee";
        firmware-name = "qcom/sm8250/xiaomi/alioth/fpcali",
                        "qcom/sm8250/xiaomi/alioth/cmnlib64";
        vdd-supply = <&vreg_l13a_3p3>;
        reset-gpios = <&tlmm 24 GPIO_ACTIVE_LOW>;
        interrupts-extended = <&tlmm 23 IRQ_TYPE_EDGE_RISING>;
        irq-gpios = <&tlmm 23 GPIO_ACTIVE_HIGH>;
        memory-region = <&fpc_ta_mem>;
    };
```

## Documentation/devicetree/bindings/mmc/cdns,sd6hc.yaml
```yaml
# SPDX-License-Identifier: GPL-2.0-only OR BSD-2-Clause
%YAML 1.2
---
$id: http://devicetree.org/schemas/mmc/cdns,sd6hc.yaml#
$schema: http://devicetree.org/meta-schemas/core.yaml#

title: Cadence SD6HC SD/SDIO/eMMC Host Controller

maintainers:
  - Tanmay Kathpalia <tanmay.kathpalia@altera.com>

description:
  Cadence SD6HC is a sixth-generation SD/SDIO/eMMC host controller with an
  interface to a Cadence Combo PHY. The controller has separate card interface
  and bus interface clock domains.

properties:
  compatible:
    items:
      - const: altr,agilex5-sd6hc
      - const: cdns,sd6hc

  reg:
    maxItems: 1

  interrupts:
    maxItems: 1

  clocks:
    items:
      - description: card interface unit (CIU / SDMCLK) clock
      - description: bus interface unit (BIU) clock

  clock-names:
    items:
      - const: ciu
      - const: biu

  resets:
    items:
      - description: SDHC controller reset
      - description: Combo PHY reset
      - description: SDMMC OCP/AXI reset

  reset-names:
    items:
      - const: sdhc-reset
      - const: combophy
      - const: sdmmc-ocp

  iommus:
    maxItems: 1

  dma-coherent: true

  cdns,iocell-input-delay-ps:
    description:
      Input delay across the IO cells, used for SD6HC PHY timing calculations.
    minimum: 0
    maximum: 20000
    default: 2500

  cdns,iocell-output-delay-ps:
    description:
      Output delay across the IO cells, used for SD6HC PHY timing calculations.
    minimum: 0
    maximum: 20000
    default: 2500

  cdns,delay-element-ps:
    description:
      DLL delay element size, used for SD6HC PHY timing calculations.
    minimum: 1
    maximum: 1000
    default: 24

  cdns,ddr50-read-dqs-delay:
    description: |
      SD6HC DDR50 read-DQS delay (DLL_SLAVE[7:0]) used to centre the read
      eye. DDR50 has no CMD19 tuning, so this is a board/SoC-characterised
      value. If absent, the driver default is used.
    $ref: /schemas/types.yaml#/definitions/uint32
    minimum: 0
    maximum: 0xff

  cdns,ddr50-use-lpbk-dqs:
    description: |
      SD6HC DDR50 read-DQS source (DQS_TIMING[21]): 0 = phony DQS,
      1 = loopback DQS. If absent, the driver default is used.
    $ref: /schemas/types.yaml#/definitions/uint32
    enum: [0, 1]

  cdns,ddr50-phony-dqs-timing:
    description: |
      SD6HC DDR50 phony DQS assertion timing (PHY_CTRL[9:4]). Positions the
      fabricated read strobe relative to the returning DDR data; the correct
      value depends on the board's SD flight time and is not produced by the
      Cadence timing calculation. If absent, the driver default
      (REBAR_PULSE_CYCLES-1) is used.
    $ref: /schemas/types.yaml#/definitions/uint32
    minimum: 0
    maximum: 0x3f

required:
  - compatible
  - reg
  - interrupts
  - clocks
  - clock-names
  - resets
  - reset-names

allOf:
  - $ref: sdhci-common.yaml#

unevaluatedProperties: false

examples:
  - |
    #include <dt-bindings/interrupt-controller/arm-gic.h>

    mmc@10808000 {
        compatible = "altr,agilex5-sd6hc", "cdns,sd6hc";
        reg = <0x10808000 0x1000>;
        interrupts = <GIC_SPI 96 IRQ_TYPE_LEVEL_HIGH>;
        clocks = <&clkmgr 0>, <&clkmgr 1>;
        clock-names = "ciu", "biu";
        resets = <&rst 0>, <&rst 1>, <&rst 2>;
        reset-names = "sdhc-reset", "combophy", "sdmmc-ocp";
        iommus = <&smmu 5>;
        dma-coherent;
    };
```

## Documentation/devicetree/bindings/mmc/qcom,nord-sdhci.yaml
```yaml
# SPDX-License-Identifier: GPL-2.0-only OR BSD-2-Clause
%YAML 1.2
---
$id: http://devicetree.org/schemas/mmc/qcom,nord-sdhci.yaml#
$schema: http://devicetree.org/meta-schemas/core.yaml#

title: Qualcomm Nord SDHCI Controller

maintainers:
  - Anjana Hari <anjana.hari@oss.qualcomm.com>

description:
  SDHCI (SD Host Controller Interface) present on Qualcomm Nord SoC.
  Clock and power resources are managed by firmware through an SCMI
  server, so no clock entries are required in the device tree node.

properties:
  compatible:
    const: qcom,nord-sdhci

  reg:
    maxItems: 1

  reg-names:
    items:
      - const: hc

  interrupts:
    maxItems: 2

  interrupt-names:
    items:
      - const: hc_irq
      - const: pwr_irq

  iommus:
    maxItems: 1
    description: phandle to the apps SMMU node with SID mask.

  dma-coherent: true

  power-domains:
    maxItems: 2

  power-domain-names:
    items:
      - const: power
      - const: perf

required:
  - compatible
  - reg
  - reg-names
  - interrupts
  - interrupt-names
  - iommus
  - dma-coherent
  - power-domains
  - power-domain-names

allOf:
  - $ref: sdhci-common.yaml#

unevaluatedProperties: false

examples:
  - |
    #include <dt-bindings/interrupt-controller/arm-gic.h>

    mmc@b84000 {
        compatible = "qcom,nord-sdhci";
        reg = <0x000b84000 0x1000>;
        reg-names = "hc";

        interrupts = <GIC_SPI 261 IRQ_TYPE_LEVEL_HIGH>,
                     <GIC_SPI 227 IRQ_TYPE_LEVEL_HIGH>;
        interrupt-names = "hc_irq", "pwr_irq";

        bus-width = <4>;
        no-sd;
        no-mmc;
        non-removable;

        iommus = <&apps_smmu 0x1580 0x0>;
        dma-coherent;

        power-domains = <&scmi34_pd 0>, <&scmi34_dvfs 0>;
        power-domain-names = "power", "perf";
    };
```

## Documentation/devicetree/bindings/net/wireless/xradio,xr819.yaml
```yaml
# SPDX-License-Identifier: (GPL-2.0-only OR BSD-2-Clause)
%YAML 1.2
---
$id: http://devicetree.org/schemas/net/wireless/xradio,xr819.yaml#
$schema: http://devicetree.org/meta-schemas/core.yaml#

title: XRadio XR819 SDIO wireless controller

maintainers:
  - Arthur Heymans <arthur@aheymans.xyz>

description:
  The XR819 is a 2.4 GHz IEEE 802.11b/g/n controller connected to the host
  through SDIO. Its out-of-band interrupt may be connected to a host GPIO.

properties:
  compatible:
    const: xradio,xr819

  reg:
    const: 1

  interrupts:
    maxItems: 1

  local-mac-address: true

required:
  - compatible
  - reg

additionalProperties: false

examples:
  - |
    #include <dt-bindings/interrupt-controller/irq.h>

    mmc {
        #address-cells = <1>;
        #size-cells = <0>;

        wifi@1 {
            compatible = "xradio,xr819";
            reg = <1>;
            interrupt-parent = <&pio>;
            interrupts = <10 IRQ_TYPE_EDGE_RISING>;
            local-mac-address = [02 00 00 00 00 01];
        };
    };
```

## Documentation/devicetree/bindings/nvmem/microchip,sama7g5-otpc.yaml
```yaml
# SPDX-License-Identifier: (GPL-2.0 OR BSD-2-Clause)
%YAML 1.2
---
$id: http://devicetree.org/schemas/nvmem/microchip,sama7g5-otpc.yaml#
$schema: http://devicetree.org/meta-schemas/core.yaml#

title: Microchip SAMA7G5 OTP Controller (OTPC)

maintainers:
  - Claudiu Beznea <claudiu.beznea@microchip.com>

description: |
  OTP controller drives a NVMEM memory where system specific data
  (e.g. calibration data for analog cells, hardware configuration
  settings, chip identifiers) or user specific data could be stored.

allOf:
  - $ref: nvmem.yaml#
  - $ref: nvmem-deprecated-cells.yaml#

properties:
  compatible:
    items:
      - const: microchip,sama7g5-otpc
      - const: syscon

  reg:
    maxItems: 1

  clocks:
    items:
      - description: main rc oscillator
      - description: otpc peripheral clock

required:
  - compatible
  - reg
  - clocks

unevaluatedProperties: false

examples:
  - |
    #include <dt-bindings/clock/at91.h>
    #include <dt-bindings/clock/microchip,sama7g5-pmc.h>
    #include <dt-bindings/nvmem/microchip,sama7g5-otpc.h>

    otpc: efuse@e8c00000 {
        compatible = "microchip,sama7g5-otpc", "syscon";
        reg = <0xe8c00000 0xec>;
        #address-cells = <1>;
        #size-cells = <1>;
        clocks = <&pmc PMC_TYPE_CORE SAMA7G5_PMC_MAIN_RC>, <&pmc PMC_TYPE_PERIPHERAL 67>;

        temperature_calib: calib@1 {
            reg = <OTP_PKT(1) 76>;
        };
    };

...
```

## Documentation/devicetree/bindings/phy/metanoia,usb2-phy.yaml
```yaml
# SPDX-License-Identifier: GPL-2.0-only OR BSD-2-Clause
%YAML 1.2
---
$id: http://devicetree.org/schemas/phy/metanoia,usb2-phy.yaml#
$schema: http://devicetree.org/meta-schemas/core.yaml#

title: Metanoia USB2 PHY

description: |
  The Metanoia MT2824 USB2 PHY is controlled solely through a reset line.

maintainers:
  - Jun Chang <jun.chang@metanoia-comm.com>

properties:
  compatible:
    const: metanoia,mt2824-usb2-phy

  resets:
    maxItems: 1

  reset-names:
    const: usb2-phy

  "#phy-cells":
    const: 0

required:
  - compatible
  - resets
  - reset-names
  - "#phy-cells"

additionalProperties: false

examples:
  - |
    usb2phy: usb2-phy-reset {
        compatible = "metanoia,mt2824-usb2-phy";
        #phy-cells = <0>;
        resets = <&rst 18>;
        reset-names = "usb2-phy";
    };
```

## Documentation/devicetree/bindings/phy/rockchip,rk3568-edp-phy.yaml
```yaml
# SPDX-License-Identifier: (GPL-2.0-only OR BSD-2-Clause)
%YAML 1.2
---
$id: http://devicetree.org/schemas/phy/rockchip,rk3568-edp-phy.yaml#
$schema: http://devicetree.org/meta-schemas/core.yaml#

title: Rockchip eDP Transmitter PHY with NaNeng IP block

maintainers:
  - Damon Ding <damon.ding@rock-chips.com>
  - Heiko Stuebner <heiko@sntech.de>

description:
  On the RK3568 SoC the eDP PHY is controlled through the eDP PHY GRF
  registers, therefore the PHY node is expected to be a child of the
  eDP PHY GRF syscon node.

properties:
  compatible:
    const: rockchip,rk3568-edp-phy

  reg:
    maxItems: 1
    description: PHY registers within the eDP PHY GRF.

  clocks:
    maxItems: 1

  clock-names:
    const: refclk

  "#phy-cells":
    const: 0

required:
  - compatible
  - reg
  - clocks
  - clock-names
  - "#phy-cells"

additionalProperties: false

examples:
  - |
    #include <dt-bindings/clock/rk3568-cru.h>

    soc {
      #address-cells = <2>;
      #size-cells = <2>;

      edp_phy_grf: syscon@fdcb0000 {
        compatible = "rockchip,rk3568-edp-phy-grf", "syscon", "simple-mfd";
        reg = <0x0 0xfdcb0000 0x0 0x8000>;
        clocks = <&cru PCLK_EDPPHY_GRF>;
        ranges = <0x0 0x0 0xfdcb0000 0x100>;
        #address-cells = <1>;
        #size-cells = <1>;

        edp_phy: phy@0 {
          compatible = "rockchip,rk3568-edp-phy";
          reg = <0x0 0x100>;
          clocks = <&pmucru XIN_OSC0_EDPPHY_G>;
          clock-names = "refclk";
          #phy-cells = <0>;
        };
      };
    };
```
