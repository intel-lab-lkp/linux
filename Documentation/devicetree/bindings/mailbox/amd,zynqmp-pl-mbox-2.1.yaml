## Documentation/devicetree/bindings/power/supply/siliconmitus,sm5714-fuelgauge.yaml
```yaml
# SPDX-License-Identifier: GPL-2.0-only OR BSD-2-Clause
%YAML 1.2
---
$id: http://devicetree.org/schemas/power/supply/siliconmitus,sm5714-fuelgauge.yaml#
$schema: http://devicetree.org/meta-schemas/core.yaml#

title: Silicon Mitus SM5714 fuel gauge

maintainers:
  - Asdlerto Korry <korryasdlerto@gmail.com>

description:
  The SM5714 is a power management chip for mobile phones with a charger,
  a USB Type-C port controller, a MUIC and a fuel gauge, each on its own
  I2C address. This binding describes the fuel gauge, which reports the
  battery state of charge, voltage and current.

allOf:
  - $ref: power-supply.yaml#

properties:
  compatible:
    const: siliconmitus,sm5714-fuelgauge

  reg:
    maxItems: 1

  io-channels:
    maxItems: 1
    description:
      ADC channel that reports the temperature of the battery thermistor.
      The temperature measured by the fuel gauge itself rises with the
      charge current, so the battery temperature is taken from this
      channel when it is present.

required:
  - compatible
  - reg

unevaluatedProperties: false

examples:
  - |
    i2c {
      #address-cells = <1>;
      #size-cells = <0>;

      fuel-gauge@71 {
        compatible = "siliconmitus,sm5714-fuelgauge";
        reg = <0x71>;
        io-channels = <&pmk8350_vadc 0x14b>;
      };
    };
```

## Documentation/devicetree/bindings/regulator/qcom,usb-vbus-regulator.yaml
```yaml
# SPDX-License-Identifier: GPL-2.0
%YAML 1.2
---
$id: http://devicetree.org/schemas/regulator/qcom,usb-vbus-regulator.yaml#
$schema: http://devicetree.org/meta-schemas/core.yaml#

title: The Qualcomm PMIC VBUS output regulator driver

maintainers:
  - Wesley Cheng <quic_wcheng@quicinc.com>

description: |
  This regulator driver controls the VBUS output by the Qualcomm PMIC.  This
  regulator will be enabled in situations where the device is required to
  provide power to the connected peripheral.

  The pm8150b and pmi8998 variant uses an OTG current-limit selector.

  The pm4125 variant uses a different register layout with a 2-bit VBOOST
  voltage selector.

properties:
  compatible:
    oneOf:
      - enum:
          - qcom,pm8150b-vbus-reg
          - qcom,pm4125-vbus-reg
          - qcom,pmi8998-vbus-reg
      - items:
          - enum:
              - qcom,pm6150-vbus-reg
              - qcom,pm7250b-vbus-reg
              - qcom,pmi632-vbus-reg
          - const: qcom,pm8150b-vbus-reg
      - items:
          - enum:
              - qcom,pm660-vbus-reg
          - const: qcom,pmi8998-vbus-reg

  reg:
    maxItems: 1
    description: VBUS output base address

allOf:
  - $ref: regulator.yaml#
  - if:
      properties:
        compatible:
          contains:
            enum:
              - qcom,pm8150b-vbus-reg
              - qcom,pm6150-vbus-reg
              - qcom,pm7250b-vbus-reg
              - qcom,pmi632-vbus-reg
    then:
      properties:
        regulator-min-microamp:
          multipleOf: 500000
          minimum: 500000
          maximum: 3000000

        regulator-max-microamp:
          multipleOf: 500000
          minimum: 500000
          maximum: 3000000

      required:
        - regulator-min-microamp
        - regulator-max-microamp

  - if:
      properties:
        compatible:
          contains:
            enum:
              - qcom,pm660-vbus-reg
              - qcom,pmi8998-vbus-reg
    then:
      properties:
        regulator-min-microamp:
          multipleOf: 250000
          minimum: 250000
          maximum: 2000000

        regulator-max-microamp:
          multipleOf: 250000
          minimum: 250000
          maximum: 2000000

      required:
        - regulator-min-microamp
        - regulator-max-microamp

  - if:
      properties:
        compatible:
          contains:
            const: qcom,pm4125-vbus-reg
    then:
      properties:
        regulator-min-microvolt:
          multipleOf: 250000
          minimum: 4250000
          maximum: 5000000

        regulator-max-microvolt:
          multipleOf: 250000
          minimum: 4250000
          maximum: 5000000

      required:
        - regulator-min-microvolt
        - regulator-max-microvolt

required:
  - compatible
  - reg

unevaluatedProperties: false

examples:
  - |
     pmic {
        #address-cells = <1>;
        #size-cells = <0>;

        usb-vbus-regulator@1100 {
            compatible = "qcom,pm8150b-vbus-reg";
            reg = <0x1100>;
            regulator-min-microamp = <500000>;
            regulator-max-microamp = <3000000>;
        };
     };
  - |
     pmic {
        #address-cells = <1>;
        #size-cells = <0>;

        usb-vbus-regulator@1100 {
            compatible = "qcom,pm4125-vbus-reg";
            reg = <0x1100>;
            regulator-min-microvolt = <4250000>;
            regulator-max-microvolt = <5000000>;
        };
     };
...
```

## Documentation/devicetree/bindings/reset/metanoia,reset.yaml
```yaml
# SPDX-License-Identifier: (GPL-2.0-only OR BSD-2-Clause)
%YAML 1.2
---
$id: http://devicetree.org/schemas/reset/metanoia,reset.yaml#
$schema: http://devicetree.org/meta-schemas/core.yaml#

title: Metanoia Reset Controller

maintainers:
  - Jun Chang <jun.chang@metanoia-comm.com>

description:
  Metanoia reset controllers provide warm-reset and system reset controls
  via memory-mapped registers.

properties:
  compatible:
    enum:
      - metanoia,mt2824-reset

  reg:
    maxItems: 1

  "#reset-cells":
    const: 1

required:
  - compatible
  - reg
  - "#reset-cells"

additionalProperties: false

examples:
  - |
    rst: rst-controller@1000000c {
        compatible = "metanoia,mt2824-reset";
        reg = <0x1000000c 0x4>;
        #reset-cells = <1>;
    };
```

## Documentation/devicetree/bindings/riscv/metanoia.yaml
```yaml
# SPDX-License-Identifier: (GPL-2.0-only OR BSD-2-Clause)
%YAML 1.2
---
$id: http://devicetree.org/schemas/riscv/metanoia.yaml#
$schema: http://devicetree.org/meta-schemas/core.yaml#

title: Metanoia SoC-based boards

maintainers:
  - Jun Chang <jun.chang@metanoia-comm.com>

description:
  Metanoia SoC-based boards

properties:
  $nodename:
    const: '/'
  compatible:
    oneOf:
      - items:
          - enum:
              - metanoia,mt5824-evb
          - const: metanoia,mt2824

additionalProperties: true
```

## Documentation/devicetree/bindings/riscv/mips.yaml
```yaml
# SPDX-License-Identifier: (GPL-2.0-only OR BSD-2-Clause)
%YAML 1.2
---
$id: http://devicetree.org/schemas/riscv/mips.yaml#
$schema: http://devicetree.org/meta-schemas/core.yaml#

title: MIPS SoC-based boards

maintainers:
  - Djordje Todorovic <djordje.todorovic@htecgroup.com>
  - Aleksa Paunovic <aleksa.paunovic@htecgroup.com>

description:
  MIPS SoC-based boards

properties:
  $nodename:
    const: '/'
  compatible:
    oneOf:
      - description: |
          Boston FPGA development board with a MIPS P8700 bitfile

          The Boston board carries a Xilinx XC7V2000T FPGA and fixed
          peripherals: a Xilinx AXI PCIe root port, an Intel EG20T PCH,
          a UART and an ASCII LCD.
        items:
          - const: mips,p8700-boston-rtl-5057225-202410011144
          - const: mips,p8700-boston

additionalProperties: true

...
```

## Documentation/devicetree/bindings/serial/wkmic,wk2124.yaml
```yaml
# SPDX-License-Identifier: (GPL-2.0-only OR BSD-2-Clause)
%YAML 1.2
---
$id: http://devicetree.org/schemas/serial/wkmic,wk2124.yaml#
$schema: http://devicetree.org/meta-schemas/core.yaml#

title: WKmic WK2xxx SPI to UART bridge

maintainers:
  - Zi Jie Zhao <zjzhao@edatec.cn>

description:
  The WK2xxx family (WK2124, WK2132, WK2168, WK2202 and WK2204) are SPI to
  UART bridge ICs from WKmic (Chengdu Weikai Microelectronics). Each IC
  exposes two or four full-duplex UART channels with 256-byte RX/TX FIFOs
  through a single SPI slave interface and one interrupt line, and is
  clocked from a single external reference clock. Each channel is
  described by a "serial@N" child node that carries its own serial and
  RS-485 properties.

properties:
  compatible:
    enum:
      - wkmic,wk2124
      - wkmic,wk2132
      - wkmic,wk2168
      - wkmic,wk2202
      - wkmic,wk2204

  reg:
    maxItems: 1

  interrupts:
    description:
      When missing, the device driver uses polling instead.
    maxItems: 1

  clocks:
    maxItems: 1

  "#address-cells":
    const: 1

  "#size-cells":
    const: 0

patternProperties:
  "^serial@[0-3]$":
    type: object
    description: A single UART channel of the chip.
    allOf:
      - $ref: /schemas/serial/serial.yaml#
      - $ref: /schemas/serial/rs485.yaml#
    properties:
      reg:
        description: UART channel number on the chip.
        maximum: 3
    required:
      - reg
    unevaluatedProperties: false

required:
  - compatible
  - reg
  - clocks
  - "#address-cells"
  - "#size-cells"

allOf:
  - $ref: /schemas/spi/spi-peripheral-props.yaml#

  - if:
      properties:
        compatible:
          contains:
            enum:
              - wkmic,wk2132
              - wkmic,wk2202
    then:
      patternProperties:
        "^serial@[23]$": false

unevaluatedProperties: false

examples:
  - |
    #include <dt-bindings/interrupt-controller/irq.h>

    xtal: clock-11059200 {
        compatible = "fixed-clock";
        clock-frequency = <11059200>;
        #clock-cells = <0>;
    };

    spi {
        #address-cells = <1>;
        #size-cells = <0>;

        serial@0 {
            compatible = "wkmic,wk2132";
            reg = <0>;
            spi-max-frequency = <10000000>;
            clocks = <&xtal>;
            interrupt-parent = <&gpio>;
            interrupts = <24 IRQ_TYPE_LEVEL_LOW>;
            #address-cells = <1>;
            #size-cells = <0>;

            serial@0 {
                reg = <0>;
            };

            serial@1 {
                reg = <1>;
                rs485-rts-active-low;
                linux,rs485-enabled-at-boot-time;
            };
        };
    };
```

## Documentation/devicetree/bindings/soc/renesas/casio,fx-9750giii.yaml
```yaml
# SPDX-License-Identifier: (GPL-2.0-only OR BSD-2-Clause)
%YAML 1.2
---
$id: http://devicetree.org/schemas/soc/renesas/casio,fx-9750giii.yaml#
$schema: http://devicetree.org/meta-schemas/core.yaml#

title: Casio fx-9750GIII Graphing Calculator

maintainers:
  - Artem Novak <artem122novak@gmail.com>

description:
  The Casio fx-9750GIII graphing calculator is based on
  the Renesas SH7305 processor.

select:
  properties:
    compatible:
      contains:
        const: casio,fx-9750giii
  required:
    - compatible

properties:
  compatible:
    items:
      - const: casio,fx-9750giii
      - const: renesas,sh7305

required:
  - compatible

additionalProperties: true
```
