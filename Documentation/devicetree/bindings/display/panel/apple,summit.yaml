## Documentation/devicetree/bindings/display/panel/samsung,s6e3ha8.yaml
```yaml
# SPDX-License-Identifier: GPL-2.0-only OR BSD-2-Clause
%YAML 1.2
---
$id: http://devicetree.org/schemas/display/panel/samsung,s6e3ha8.yaml#
$schema: http://devicetree.org/meta-schemas/core.yaml#

title: Samsung s6e3ha8 AMOLED DSI panel

description: |
  The s6e3ha8 is a display driver IC used in 1440x2960 AMOLED panels from
  Samsung Mobile Displays (SMD).

  Known panels:
    - AMB577PX01, 5.77", Samsung Galaxy S9 (samsung,s6e3ha8-amb577px01)
    - AMB630QY01, 6.3", Google Pixel 3 XL (samsung,s6e3ha8-amb630qy01)

maintainers:
  - Dzmitry Sankouski <dsankouski@gmail.com>

allOf:
  - $ref: panel-common.yaml#
  - if:
      properties:
        compatible:
          contains:
            enum:
              - samsung,s6e3ha8
              - samsung,s6e3ha8-amb577px01
    then:
      required:
        - vddr-supply
  - if:
      properties:
        compatible:
          contains:
            const: samsung,s6e3ha8-amb630qy01
    then:
      required:
        - vddpos-supply
        - vddneg-supply

properties:
  compatible:
    oneOf:
      - enum:
          - samsung,s6e3ha8-amb577px01
          - samsung,s6e3ha8-amb630qy01
      - const: samsung,s6e3ha8
        deprecated: true

  reg:
    maxItems: 1

  vdd3-supply:
    description: VDD regulator

  vci-supply:
    description: VCI regulator

  vddr-supply:
    description: VDDR regulator

  vddpos-supply:
    description: positive boost supply regulator (ELVDD)

  vddneg-supply:
    description: negative boost supply regulator (ELVSS)

required:
  - compatible
  - reset-gpios
  - vdd3-supply
  - vci-supply

unevaluatedProperties: false

examples:
  - |
    #include <dt-bindings/gpio/gpio.h>

    dsi {
        #address-cells = <1>;
        #size-cells = <0>;

        panel@0 {
            compatible = "samsung,s6e3ha8-amb577px01";
            reg = <0>;
            vci-supply = <&s2dos05_ldo4>;
            vddr-supply = <&s2dos05_buck1>;
            vdd3-supply = <&s2dos05_ldo1>;
            te-gpios = <&tlmm 10 GPIO_ACTIVE_HIGH>;
            reset-gpios = <&tlmm 6 GPIO_ACTIVE_LOW>;
            pinctrl-0 = <&sde_dsi_active &sde_te_active_sleep>;
            pinctrl-1 = <&sde_dsi_suspend &sde_te_active_sleep>;
            pinctrl-names = "default", "sleep";

            port {
                panel_in: endpoint {
                    remote-endpoint = <&mdss_dsi0_out>;
                };
            };
        };
    };

...
```

## Documentation/devicetree/bindings/display/panel/samsung,s6e8aa5x01.yaml
```yaml
# SPDX-License-Identifier: (GPL-2.0-only OR BSD-2-Clause)
%YAML 1.2
---
$id: http://devicetree.org/schemas/display/panel/samsung,s6e8aa0.yaml#
$schema: http://devicetree.org/meta-schemas/core.yaml#

title: Samsung S6E8AA5X01 display panel controller

maintainers:
  - Kaustabh Chakraborty <kauschluss@disroot.org>

allOf:
  - $ref: panel-common.yaml#

properties:
  compatible:
    const: samsung,s6e8aa5x01

  reg:
    maxItems: 1

  vdd-supply:
    maxItems: 1
    description: core voltage supply

  vci-supply:
    maxItems: 1
    description: voltage supply for analog circuits

  reset-gpios: true
  width-mm: true
  height-mm: true
  panel-timing: true

required:
  - compatible
  - reg
  - width-mm
  - height-mm
  - panel-timing

additionalProperties: false

examples:
  - |
    #include <dt-bindings/gpio/gpio.h>

    dsi {
        #address-cells = <1>;
        #size-cells = <0>;

        panel@0 {
            compatible = "samsung,s6e8aa5x01";
            reg = <0>;

            vdd-supply = <&panel_vdd_reg>;
            vci-supply = <&panel_vci_reg>;

            reset-gpios = <&gpd3 4 GPIO_ACTIVE_HIGH>;

            width-mm = <62>;
            height-mm = <128>;

            panel-timing {
                clock-frequency = <73094400>;

                hactive = <720>;
                hsync-len = <2>;
                hfront-porch = <62>;
                hback-porch = <26>;

                vactive = <1480>;
                vsync-len = <2>;
                vfront-porch = <12>;
                vback-porch = <10>;
            };
        };
    };

...
```

## Documentation/devicetree/bindings/display/panel/samsung,souxp00-a.yaml
```yaml
# SPDX-License-Identifier: (GPL-2.0-only OR BSD-2-Clause)
%YAML 1.2
---
$id: http://devicetree.org/schemas/display/panel/samsung,souxp00-a.yaml#
$schema: http://devicetree.org/meta-schemas/core.yaml#

title: Samsung SOUXP00-A DDI for 1644x3840@60Hz 6.5" OLED DSI panels

maintainers:
  - Marijn Suijten <marijn.suijten@somainline.org>

description: |
  Samsung SOUXP00-A Display-Driver-IC found in the Sony Xperia 1 (kumano
  griffin, amb650wh01 panel) and Sony Xperia 1 II (edo pdx203, amb650wh07 panel)
  smartphones.  It is always programmed with Display Stream Compression 1.1
  enabled.

  The assembly features a Samsung touchscreen compatible with
  samsung,s6sy761.

allOf:
  - $ref: panel-common.yaml#

properties:
  compatible:
    enum:
      - samsung,souxp00-a-amb650wh01
      - samsung,souxp00-a-amb650wh07

  port: true

  reg:
    maxItems: 1
    description: DSI virtual channel

  reset-gpios: true

  vci-supply:
    description: DriverIC Operation supply (3.0V)

  vddio-supply:
    description: I/O voltage supply (1.8V)

required:
  - compatible
  - port
  - reg
  - reset-gpios
  - vci-supply
  - vddio-supply

additionalProperties: false

examples:
  - |
    #include <dt-bindings/gpio/gpio.h>

    dsi {
        #address-cells = <1>;
        #size-cells = <0>;
        panel@0 {
            compatible = "samsung,souxp00-a-amb650wh01";
            reg = <0>;

            reset-gpios = <&tlmm 6 GPIO_ACTIVE_LOW>;

            vci-supply = <&vreg_l17a_3p0>;
            vddio-supply = <&vreg_l14a_1p8>;

            port {
                endpoint {
                    remote-endpoint = <&dsi0_out>;
                };
            };
        };
    };

...
```

## Documentation/devicetree/bindings/display/panel/tianma,ta066vvhm03.yaml
```yaml
# SPDX-License-Identifier: GPL-2.0-only OR BSD-2-Clause
%YAML 1.2
---
$id: http://devicetree.org/schemas/display/panel/tianma,ta066vvhm03.yaml#
$schema: http://devicetree.org/meta-schemas/core.yaml#

title: Tianma TA066VVHM03 AMOLED DSI Panel

maintainers:
  - Alexander Koskovich <akoskovich@pm.me>

allOf:
  - $ref: panel-common.yaml#

properties:
  compatible:
    const: tianma,ta066vvhm03

  reg:
    maxItems: 1
    description: DSI virtual channel

  vddio-supply: true
  vci-supply: true
  vdd-supply: true
  port: true
  enable-gpios: true
  reset-gpios: true

required:
  - compatible
  - reg
  - vddio-supply
  - vci-supply
  - vdd-supply
  - reset-gpios
  - port

additionalProperties: false

examples:
  - |
    #include <dt-bindings/gpio/gpio.h>

    dsi {
        #address-cells = <1>;
        #size-cells = <0>;

        panel@0 {
            compatible = "tianma,ta066vvhm03";
            reg = <0>;

            enable-gpios = <&tlmm 12 GPIO_ACTIVE_HIGH>;
            reset-gpios = <&tlmm 75 GPIO_ACTIVE_LOW>;

            vci-supply = <&vreg_l10a>;
            vdd-supply = <&vreg_l3c>;
            vddio-supply = <&vreg_l14a>;

            port {
                panel_in: endpoint {
                    remote-endpoint = <&mdss_dsi0_out>;
                };
            };
        };
    };
...
```

## Documentation/devicetree/bindings/display/panel/tianma,tl121bvms07-00.yaml
```yaml
# SPDX-License-Identifier: (GPL-2.0-only OR BSD-2-Clause)
%YAML 1.2
---
$id: http://devicetree.org/schemas/display/panel/tianma,tl121bvms07-00.yaml#
$schema: http://devicetree.org/meta-schemas/core.yaml#

title: Tianma TL121BVMS07-00 12.1" MIPI-DSI TFT LCD Panel

maintainers:
  - Langyan Ye <yelangyan@huaqin.corp-partner.google.com>

description: |
  The Tianma TL121BVMS07-00 is a 12.1-inch MIPI-DSI TFT LCD panel.
  It requires multiple regulators (AVDD, AVEE, and 1.8V logic)
  and an enable GPIO. Optional properties such as backlight and
  rotation are inherited from panel-common.yaml.

allOf:
  - $ref: panel-common.yaml#

properties:
  compatible:
    const: tianma,tl121bvms07-00

  reg:
    description: DSI virtual channel number
    minimum: 0
    maximum: 3

  enable-gpios:
    maxItems: 1
    description: GPIO specifier for the enable pin

  avdd-supply:
    description: phandle of the regulator that provides positive voltage

  avee-supply:
    description: phandle of the regulator that provides negative voltage

  pp1800-supply:
    description: core voltage supply

  backlight:
    $ref: /schemas/types.yaml#/definitions/phandle
    description: Phandle to the backlight device.

  port:
    $ref: /schemas/graph.yaml#/properties/port
    description: Input port of the panel, connected to the DSI host.

required:
  - compatible
  - reg
  - enable-gpios
  - avdd-supply
  - avee-supply
  - pp1800-supply
  - port

additionalProperties: false

examples:
  - |
    dsi0 {
      #address-cells = <1>;
      #size-cells = <0>;

      mipi_panel: panel@0 {
        compatible = "tianma,tl121bvms07-00";
        reg = <0>;
        enable-gpios = <&pio 25 0>;
        avdd-supply = <&en_pp5800_mipi_disp>;
        avee-supply = <&en_pp5800_mipi_disp>;
        pp1800-supply = <&mt6359_vcn18_ldo_reg>;
        backlight = <&backlight>;

        port {
          panel_in: endpoint {
            remote-endpoint = <&dsi_out>;
          };
        };
      };
    };

...
```

## Documentation/devicetree/bindings/display/panel/tsd,tst070wsbe-196c.yaml
```yaml
# SPDX-License-Identifier: (GPL-2.0-only OR BSD-2-Clause)
%YAML 1.2
---
$id: http://devicetree.org/schemas/display/panel/tsd,tst070wsbe-196c.yaml#
$schema: http://devicetree.org/meta-schemas/core.yaml#

title: TSD TST070WSBE-196C 7" 1024x600 MIPI-DSI TFT LCD panel

maintainers:
  - William Bright <william.bright@imd-tec.com>

description: |
  The TSD TST070WSBE-196C is a 7" 1024x600 TFT LCD panel module with an
  EK79007AD controller, connected via a 4-lane MIPI-DSI video interface.

allOf:
  - $ref: panel-common.yaml

properties:
  compatible:
    const: tsd,tst070wsbe-196c

  reg:
    maxItems: 1
    description: DSI virtual channel

  backlight: true
  reset-gpios: true
  power-supply: true
  port: true

required:
  - compatible
  - reg
  - reset-gpios
  - power-supply
  - port

additionalProperties: false

examples:
  - |
    #include <dt-bindings/gpio/gpio.h>

    dsi {
        #address-cells = <1>;
        #size-cells = <0>;

        panel@0 {
            compatible = "tsd,tst070wsbe-196c";
            reg = <0>;

            reset-gpios = <&tlmm 133 GPIO_ACTIVE_LOW>;
            power-supply = <&display_panel_pwr_en>;
            backlight = <&backlight>;

            port {
                panel_in: endpoint {
                    remote-endpoint = <&dsi_out>;
                };
            };
        };
    };
...
```

## Documentation/devicetree/bindings/display/panel/waveshare,dpi.yaml
```yaml
# SPDX-License-Identifier: GPL-2.0
%YAML 1.2
---
$id: http://devicetree.org/schemas/display/panel/waveshare,dpi.yaml#
$schema: http://devicetree.org/meta-schemas/core.yaml#

title: Waveshare Touch Display

maintainers:
  - Marek Vasut <marek.vasut+renesas@mailbox.org>

allOf:
  - $ref: panel-dpi.yaml#

properties:
  compatible:
    items:
      - enum:
          - waveshare,13.3inch-panel
          - waveshare,7.0inch-c-panel
      - {} # panel-dpi, but not listed here to avoid false select

  height-mm: true
  label: true
  panel-timing: true
  port: true
  power-supply: true
  width-mm: true

additionalProperties: false

...
```
