## Documentation/devicetree/bindings/display/panel/novatek,nt51021.yaml
```yaml
# SPDX-License-Identifier: GPL-2.0-only OR BSD-2-Clause
%YAML 1.2
---
$id: http://devicetree.org/schemas/display/panel/novatek,nt51021.yaml#
$schema: http://devicetree.org/meta-schemas/core.yaml#

title: Novatek NT51021 based 1200x1920 DSI display panels

maintainers:
  - Ryan Brue <ryanbrue.dev@gmail.com>

description:
  The Novatek NT51021 is a DSI panel controller driving 1200x1920 WUXGA
  panels over four lanes in video mode. The controller carries no readable
  panel identity, so each panel module it is fitted to needs its own
  compatible naming the module.

allOf:
  - $ref: panel-common.yaml#

properties:
  compatible:
    items:
      - const: amazon,suez-boe-nt51021
      - const: novatek,nt51021

  reg:
    maxItems: 1

  power-supply: true
  reset-gpios: true
  backlight: true
  port: true

required:
  - compatible
  - reg
  - power-supply
  - reset-gpios
  - port

unevaluatedProperties: false

examples:
  - |
    #include <dt-bindings/gpio/gpio.h>

    dsi {
        #address-cells = <1>;
        #size-cells = <0>;

        panel@0 {
            compatible = "amazon,suez-boe-nt51021", "novatek,nt51021";
            reg = <0>;
            backlight = <&backlight_lcd>;
            power-supply = <&vgp6>;
            reset-gpios = <&pio 105 GPIO_ACTIVE_LOW>;

            port {
                endpoint {
                    remote-endpoint = <&dsi_out>;
                };
            };
        };
    };
```

## Documentation/devicetree/bindings/display/panel/panel-mipi.yaml
```yaml
# SPDX-License-Identifier: (GPL-2.0-only OR BSD-2-Clause)
%YAML 1.2
---
$id: http://devicetree.org/schemas/display/panel/panel-mipi.yaml#
$schema: http://devicetree.org/meta-schemas/core.yaml#

title: Generic MIPI-DSI/DPI Panels Requiring Initialization

maintainers:
  - Hironori KIKUCHI <kikuchan98@gmail.com>

description: This is a binding for generic MIPI-DSI/DPI panels that require
  initialization with a simple command sequence before use.

properties:
  compatible:
    oneOf:
      - items:
          - enum:
              # Unknown 3.35" 720x480 24-bit IPS LCD panel
              # used in Anbernic RG 34XX
              - anbernic,rg34xx-panel
              # Unknown 4.00" 640x480 24-bit IPS LCD panel (YLM-LBV0400001X-V1)
              # used in Anbernic RG40XX series
              - anbernic,rg40xx-panel
              # Unknown 3.95" 720x720 24-bit IPS LCD panel (YLM-LBN0395004H-V1)
              # used in Anbernic RG CubeXX
              - anbernic,rgcubexx-panel
          - const: panel-mipi-dpi-spi
      - items:
          - enum:
              # HOTHMI TFT-H028B23VGIST7G40-V1 2.80" 480x640 TFT LCD panel
              - hothmi,tft-h028b23vgist7g40-v1
          - const: panel-mipi-dsi

  reg:
    description: DSI / SPI channel used by that screen
    maxItems: 1

  power-supply: true

  io-supply:
    description: I/O system regulator.
      No need to set if this is the same as polwer-supply.

  dc-gpios:
    maxItems: 1
    description: Controller data/command selection (D/CX) in 4-line SPI mode.
      If not set, the controller is in 3-line SPI mode.
      Disallowed for DSI.

  port: true
  reset-gpios: true

  backlight: true

required:
  - compatible
  - reg

allOf:
  - $ref: panel-common.yaml#
  - if:
      properties:
        compatible:
          contains:
            enum:
              - panel-mipi-dpi-spi
    then:
      # SPI mode
      $ref: /schemas/spi/spi-peripheral-props.yaml#

  - if:
      properties:
        compatible:
          contains:
            enum:
              - panel-mipi-dsi
    then:
      # DSI mode
      properties:
        dc-gpios: false

unevaluatedProperties: false

examples:
  - |
    dsi {
        #address-cells = <1>;
        #size-cells = <0>;

        panel@0 {
            compatible = "hothmi,tft-h028b23vgist7g40-v1", "panel-mipi-dsi";
            reg = <0>;

            port {
                mipi_in_panel: endpoint {
                    remote-endpoint = <&mipi_out_panel>;
                };
            };
        };
    };
  - |
    #include <dt-bindings/gpio/gpio.h>

    spi {
        #address-cells = <1>;
        #size-cells = <0>;

        panel@0 {
            compatible = "anbernic,rg40xx-panel", "panel-mipi-dpi-spi";
            reg = <0>;

            spi-max-frequency = <40000000>;

            dc-gpios = <&gpio 24 GPIO_ACTIVE_HIGH>;
            reset-gpios = <&gpio 25 GPIO_ACTIVE_LOW>;

            backlight = <&backlight>;
        };
    };
```

## Documentation/devicetree/bindings/display/panel/raio,ra8875.yaml
```yaml
# SPDX-License-Identifier: (GPL-2.0-only OR BSD-2-Clause)
%YAML 1.2
---
$id: http://devicetree.org/schemas/display/panel/raio,ra8875.yaml#
$schema: http://devicetree.org/meta-schemas/core.yaml#

title: RAiO RA8875 Display Controller

maintainers:
  - Adam Azuddin <azuddinadam@gmail.com>

description:
  The RA8875 is a TFT LCD controller for panels up to 800x480 pixels.
  It can be connected to the controller via 8080/6800 parallel interface,
  SPI or I2C. This binding describes the SPI-connected device.

allOf:
  - $ref: panel-common.yaml#
  - $ref: /schemas/spi/spi-peripheral-props.yaml#

properties:
  compatible:
    const: raio,ra8875

  reg:
    maxItems: 1

  spi-max-frequency:
    maximum: 25000000

  vdd-supply:
    description:
      3.3 V supply for the IO pins, the oscillator IO pins, the ADC pins
      and the internal LDO. The 1.8 V core rail is generated internally.

  reset-gpios:
    description:
      GPIO connected to the active-low RST# pin. Optional, since the board
      may instead use an RC reset circuit.
    maxItems: 1

required:
  - compatible
  - reg
  - display-timings
  - vdd-supply

unevaluatedProperties: false

examples:
  - |
    spi {
        #address-cells = <1>;
        #size-cells = <0>;

        panel: display@0 {
            compatible = "raio,ra8875";
            reg = <0>;
            spi-max-frequency = <16000000>;
            vdd-supply = <&vcc_3v3>;
            reset-gpios = <&gpio 25 GPIO_ACTIVE_LOW>;

            display-timings {
                native-mode = <&timing0>;
                timing0: timing0 {
                    clock-frequency = <25000000>;
                    hactive = <800>;
                    vactive = <480>;
                    hfront-porch = <40>;
                    hsync-len = <40>;
                    hback-porch = <40>;
                    vfront-porch = <10>;
                    vsync-len = <10>;
                    vback-porch = <20>;
                };
            };
        };
    };
```

## Documentation/devicetree/bindings/display/panel/raydium,rm69380.yaml
```yaml
# SPDX-License-Identifier: GPL-2.0-only OR BSD-2-Clause
%YAML 1.2
---
$id: http://devicetree.org/schemas/display/panel/raydium,rm69380.yaml#
$schema: http://devicetree.org/meta-schemas/core.yaml#

title: Raydium RM6380-based DSI display panels

maintainers:
  - David Wronek <david@mainlining.org>

description:
  The Raydium RM69380 is a generic DSI Panel IC used to control
  OLED panels.

properties:
  compatible:
    items:
      - const: lenovo,j716f-edo-rm69380
      - const: raydium,rm69380

  avdd-supply:
    description: Analog voltage rail

  vddio-supply:
    description: I/O voltage rail

  reset-gpios:
    maxItems: 1

  reg: true

required:
  - compatible
  - reg
  - avdd-supply
  - vddio-supply
  - reset-gpios

allOf:
  - $ref: panel-common-dual.yaml#
  - if:
      properties:
        compatible:
          contains:
            enum:
              - lenovo,j716f-edo-rm69380
    then:
      properties:
        port: false
        ports:
          required:
            - port@1

unevaluatedProperties: false

examples:
  - |
    #include <dt-bindings/gpio/gpio.h>

    dsi {
        #address-cells = <1>;
        #size-cells = <0>;

        panel@0 {
            compatible = "lenovo,j716f-edo-rm69380", "raydium,rm69380";
            reg = <0>;

            avdd-supply = <&panel_avdd_regulator>;
            vddio-supply = <&vreg_l14a>;
            reset-gpios = <&tlmm 75 GPIO_ACTIVE_LOW>;

            ports {
                #address-cells = <1>;
                #size-cells = <0>;

                port@0 {
                    reg = <0>;
                    panel_in_0: endpoint {
                        remote-endpoint = <&mdss_dsi0_out>;
                    };
                };

                port@1 {
                    reg = <1>;
                    panel_in_1: endpoint {
                        remote-endpoint = <&mdss_dsi1_out>;
                    };
                };
            };
        };
    };

...
```

## Documentation/devicetree/bindings/display/panel/samsung,ams662zs01.yaml
```yaml
# SPDX-License-Identifier: (GPL-2.0-only OR BSD-2-Clause)
%YAML 1.2
---
$id: http://devicetree.org/schemas/display/panel/samsung,ams662zs01.yaml#
$schema: http://devicetree.org/meta-schemas/core.yaml#

title: Samsung AMS662ZS01 DSI Display Panel

maintainers:
  - Vsevolod Nevorotov <sevanevorotov29@gmail.com>

allOf:
  - $ref: panel-common.yaml#

properties:
  compatible:
    const: samsung,ams662zs01

  reg:
    maxItems: 1

  reset-gpios:
    maxItems: 1

  vout-gpios:
    maxItems: 1
    description: Panel VOUT enable GPIO line

  vddio-supply:
    description: 1.8V I/O power supply

  vdd-supply:
    description: 3.0V core power supply

  port: true

required:
  - compatible
  - reg
  - reset-gpios
  - vddio-supply
  - vdd-supply
  - port

additionalProperties: false

examples:
  - |
    #include <dt-bindings/gpio/gpio.h>

    dsi {
        #address-cells = <1>;
        #size-cells = <0>;

        panel@0 {
            compatible = "samsung,ams662zs01";
            reg = <0>;

            reset-gpios = <&tlmm 24 GPIO_ACTIVE_LOW>;
            vout-gpios = <&tlmm 25 GPIO_ACTIVE_HIGH>;

            vddio-supply = <&vreg_l12c_1p8>;
            vdd-supply = <&vreg_l13c_3p0>;

            pinctrl-names = "default", "sleep";
            pinctrl-0 = <&mdp_vsync_active>;
            pinctrl-1 = <&mdp_vsync_active>;

            port {
                panel_in: endpoint {
                    remote-endpoint = <&mdss_dsi0_out>;
                };
            };
        };
    };
```

## Documentation/devicetree/bindings/display/panel/samsung,ana6707.yaml
```yaml
# SPDX-License-Identifier: (GPL-2.0-only OR BSD-2-Clause)
%YAML 1.2
---
$id: http://devicetree.org/schemas/display/panel/samsung,ana6707.yaml#
$schema: http://devicetree.org/meta-schemas/core.yaml#

title: Samsung ANA6707 DDI for 1644x3840@120Hz 6.5" OLED DSI panels

maintainers:
  - Marijn Suijten <marijn.suijten@somainline.org>

description: |
  Samsung ANA6707 Display-Driver-IC found in the Sony Xperia 1 III, Sony Xperia
  1 IV and Sony Xperia 1 V smartphones, paired with the amb650yl01 panel.  It
  is always programmed with Display Stream Compression 1.1 enabled, and requires
  two DSI interfaces.

  The assembly features a Samsung touchscreen compatible with
  samsung,s6sy761.

allOf:
  - $ref: panel-common.yaml#

properties:
  compatible:
    const: samsung,ana6707-amb650yl01

  port: true

  reg:
    maxItems: 1
    description: DSI virtual channel

  reset-gpios: true

  vci-supply:
    description: DriverIC Operation supply (3.0V)

  vddio-supply:
    description: I/O voltage supply (1.8V)

required:
  - compatible
  - port
  - reg
  - reset-gpios
  - vci-supply
  - vddio-supply

additionalProperties: false

examples:
  - |
    #include <dt-bindings/gpio/gpio.h>

    dsi0 {
        #address-cells = <1>;
        #size-cells = <0>;
        panel@0 {
            compatible = "samsung,ana6707-amb650yl01";
            reg = <0>;

            reset-gpios = <&tlmm 24 GPIO_ACTIVE_LOW>;

            vci-supply = <&pm8350c_l13>;
            vddio-supply = <&pm8350c_l12>;

            ports {
                #address-cells = <1>;
                #size-cells = <0>;

                port@0 {
                    reg = <0>;

                    panel_in_0: endpoint {
                        remote-endpoint = <&mdss_dsi0_out>;
                    };
                };
                port@1 {
                    reg = <1>;

                    panel_in_1: endpoint {
                        remote-endpoint = <&mdss_dsi1_out>;
                    };
                };
            };
        };
    };

...
```

## Documentation/devicetree/bindings/display/panel/samsung,s6e3fc2x01.yaml
```yaml
# SPDX-License-Identifier: GPL-2.0-only OR BSD-2-Clause
%YAML 1.2
---
$id: http://devicetree.org/schemas/display/panel/samsung,s6e3fc2x01.yaml#
$schema: http://devicetree.org/meta-schemas/core.yaml#

title: Samsung S6E3FC2X01 AMOLED DDIC

description: The S6E3FC2X01 is display driver IC with connected panel.

maintainers:
  - David Heidelberg <david@ixit.cz>

allOf:
  - $ref: panel-common.yaml#

properties:
  compatible:
    const: samsung,s6e3fc2x01-ams641rw

  reg:
    maxItems: 1

  reset-gpios: true

  port: true

  vddio-supply:
    description: VDD regulator

  vci-supply:
    description: VCI regulator

  poc-supply:
    description: POC regulator

required:
  - compatible
  - reset-gpios
  - vddio-supply
  - vci-supply
  - poc-supply

unevaluatedProperties: false

examples:
  - |
    #include <dt-bindings/gpio/gpio.h>

    dsi {
        #address-cells = <1>;
        #size-cells = <0>;

        panel@0 {
            compatible = "samsung,s6e3fc2x01-ams641rw";
            reg = <0>;

            vddio-supply = <&vreg_l14a_1p88>;
            vci-supply = <&s2dos05_buck1>;
            poc-supply = <&s2dos05_ldo1>;

            te-gpios = <&tlmm 10 GPIO_ACTIVE_HIGH>;
            reset-gpios = <&tlmm 6 GPIO_ACTIVE_HIGH>;

            pinctrl-names = "default", "sleep";
            pinctrl-0 = <&sde_dsi_active &sde_te_active_sleep>;
            pinctrl-1 = <&sde_dsi_suspend &sde_te_active_sleep>;

            port {
                panel_in: endpoint {
                    remote-endpoint = <&mdss_dsi0_out>;
                };
            };
        };
    };

...
```
