## Documentation/devicetree/bindings/display/panel/apple,summit.yaml
```yaml
# SPDX-License-Identifier: (GPL-2.0-only OR BSD-2-Clause)
%YAML 1.2
---
$id: http://devicetree.org/schemas/display/panel/apple,summit.yaml#
$schema: http://devicetree.org/meta-schemas/core.yaml#

title: Apple "Summit" display panel.

maintainers:
  - asahi@lists.linux.dev
  - Sasha Finkelstein <fnkl.kernel@gmail.com>

allOf:
  - $ref: panel-common.yaml#
  - $ref: /schemas/leds/backlight/common.yaml#

properties:
  compatible:
    items:
      - enum:
          - apple,j293-summit
          - apple,j493-summit
      - const: apple,summit

  reg:
    maxItems: 1

  max-brightness: true

  port: true

required:
  - compatible
  - reg
  - max-brightness
  - port

additionalProperties: false

examples:
  - |
    dsi {
    	#address-cells = <1>;
    	#size-cells = <0>;

    	panel@0 {
    		compatible = "apple,j293-summit", "apple,summit";
    		reg = <0>;
    		max-brightness = <255>;

    		port {
    			dfr_panel_in: endpoint {
    				remote-endpoint = <&dfr_bridge_out>;
    			};
    		};
    	};
    };
...
```

## Documentation/devicetree/bindings/display/panel/boe,th101mb31ig002-28a.yaml
```yaml
# SPDX-License-Identifier: (GPL-2.0-only OR BSD-2-Clause)
%YAML 1.2
---
$id: http://devicetree.org/schemas/display/panel/boe,th101mb31ig002-28a.yaml#
$schema: http://devicetree.org/meta-schemas/core.yaml#

title: BOE TH101MB31IG002-28A Pine64 Pinetab2 DSI Display Panel

maintainers:
  - Manuel Traut <manut@mecka.net>

allOf:
  - $ref: panel-common.yaml#

properties:
  compatible:
    enum:
        # BOE TH101MB31IG002-28A 10.1" WXGA TFT LCD panel
      - boe,th101mb31ig002-28a

  reg:
    description: the virtual channel number of a DSI peripheral

  backlight:
    description: phandle of the backlight device attached to the panel

  enable-gpios:
    description: a GPIO spec for the enable pin

  power-supply:
    description: core voltage supply


  ports: true
  rotation: true

required:
  - compatible
  - reg
  - enable-gpios
  - power-supply

additionalProperties: false

examples:
  - |
    dsi {
        #address-cells = <1>;
        #size-cells = <0>;
        panel@0 {
            compatible = "boe,th101mb31ig002-28a";
            reg = <0>;
            backlight = <&backlight_lcd0>;
            enable-gpios = <&pio 45 0>;
            rotation = <90>;
            power-supply = <&vcc_3v3>;
            ports {
                #address-cells = <1>;
                #size-cells = <0>;
                port@0 {
                    reg = <0>;
                    #address-cells = <1>;
                    #size-cells = <0>;
                    panel_in_dsi: endpoint@0 {
                        reg = <0>;
                        remote-endpoint = <&dsi0_out_con>;
                    };
                };
            };
        };
    };

...
```

## Documentation/devicetree/bindings/display/panel/ilitek,ili79600a.yaml
```yaml
# SPDX-License-Identifier: GPL-2.0-only OR BSD-2-Clause
%YAML 1.2
---
$id: http://devicetree.org/schemas/display/panel/ilitek,ili79600a.yaml#
$schema: http://devicetree.org/meta-schemas/core.yaml#

title: Ilitek ILI79600A based MIPI-DSI panels

maintainers:
  - Dave Stevenson <dave.stevenson@raspberrypi.com>
  - Marek Vasut <marek.vasut+renesas@mailbox.org>

allOf:
  - $ref: panel-common.yaml#

properties:
  compatible:
    items:
      - enum:
          - raspberrypi,dsi-10inch
      - const: ilitek,ili79600a

  reg:
    maxItems: 1
    description: DSI virtual channel used by the panel

  enable-gpios:
    maxItems: 1
    description: GPIO specifier for the enable pin

  avdd-supply:
    description: Positive analog voltage supply (AVDD)

  avee-supply:
    description: Negative analog voltage supply (AVEE)

  pp1800-supply:
    description: 1.8V logic voltage supply

  pp3300-supply:
    description: 3.3V logic voltage supply

  backlight: true

required:
  - compatible
  - reg

additionalProperties: false

examples:
  - |
    #include <dt-bindings/gpio/gpio.h>

    dsi {
        #address-cells = <1>;
        #size-cells = <0>;

        panel@0 {
            compatible = "raspberrypi,dsi-10inch", "ilitek,ili79600a";
            reg = <0>;
            avdd-supply = <&reg_display>;
            backlight = <&pwm_bl>;
        };
    };
```

## Documentation/devicetree/bindings/display/panel/jdi,fhd-nt35596s.yaml
```yaml
# SPDX-License-Identifier: (GPL-2.0-only OR BSD-2-Clause)
%YAML 1.2
---
$id: http://devicetree.org/schemas/display/panel/jdi,fhd-nt35596s.yaml#
$schema: http://devicetree.org/meta-schemas/core.yaml#

title: JDI FHD NT35596S MIPI-DSI Panel

maintainers:
  - Molly Sophia <mollysophia379@gmail.com>

allOf:
  - $ref: panel-common.yaml#

properties:
  compatible:
    const: jdi,fhd-nt35596s

  reg:
    maxItems: 1

  backlight: true
  reset-gpios: true

  vddio-supply:
    description: I/O voltage rail

  vddneg-supply:
    description: Negative source voltage rail

  vddpos-supply:
    description: Positive source voltage rail

  port: true

required:
  - compatible
  - reg
  - reset-gpios
  - vddio-supply
  - vddneg-supply
  - vddpos-supply
  - port

additionalProperties: false

examples:
  - |
    #include <dt-bindings/gpio/gpio.h>

    dsi {
        #address-cells = <1>;
        #size-cells = <0>;

        panel@0 {
            compatible = "jdi,fhd-nt35596s";
            reg = <0>;

            reset-gpios = <&tlmm 6 GPIO_ACTIVE_LOW>;
            vddio-supply = <&vreg_l14a_1p8>;
            backlight = <&pmi8998_wled>;
            vddpos-supply = <&lab>;
            vddneg-supply = <&ibb>;

            port {
                panel_in: endpoint {
                    remote-endpoint = <&mdss_dsi0_out>;
                };
            };
        };
    };

...
```

## Documentation/devicetree/bindings/display/panel/leadtek,ltk028qv25byl.yaml
```yaml
# SPDX-License-Identifier: (GPL-2.0-only OR BSD-2-Clause)
%YAML 1.2
---
$id: http://devicetree.org/schemas/display/panel/leadtek,ltk028qv25byl.yaml#
$schema: http://devicetree.org/meta-schemas/core.yaml#

title: Leadtek LTK028QV25BYL 2.8in 240x320 DSI panel

maintainers:
  - Herve Codina <herve.codina@bootlin.com>

allOf:
  - $ref: panel-common.yaml#

properties:
  compatible:
    const: leadtek,ltk028qv25byl

  reg:
    maxItems: 1

  backlight: true
  port: true
  reset-gpios: true

  iovcc-supply:
    description: regulator that supplies the IOVCC voltage

  vci-supply:
    description: regulator that supplies the VCI voltage

required:
  - compatible
  - reg
  - backlight
  - iovcc-supply
  - vci-supply

additionalProperties: false

examples:
  - |
    dsi {
        #address-cells = <1>;
        #size-cells = <0>;
        panel@0 {
            compatible = "leadtek,ltk028qv25byl";
            reg = <0>;
            backlight = <&backlight>;
            iovcc-supply = <&vcc_1v8>;
            vci-supply = <&vcc3v3_lcd>;
        };
    };

...
```

## Documentation/devicetree/bindings/display/panel/lg,sw43408.yaml
```yaml
# SPDX-License-Identifier: (GPL-2.0-only OR BSD-2-Clause)
%YAML 1.2
---
$id: http://devicetree.org/schemas/display/panel/lg,sw43408.yaml#
$schema: http://devicetree.org/meta-schemas/core.yaml#

title: LG SW43408 1080x2160 DSI panel

maintainers:
  - Caleb Connolly <caleb.connolly@linaro.org>

description: |
  This panel is used on the Pixel 3, it is a 60hz OLED panel which
  required DSC (Display Stream Compression) and has rounded corners.

allOf:
  - $ref: panel-common.yaml#

properties:
  compatible:
    items:
      - const: lg,sw43408

  reg: true
  port: true
  vddi-supply: true
  vpnl-supply: true
  reset-gpios: true

additionalProperties: false

required:
  - compatible
  - vddi-supply
  - vpnl-supply
  - reset-gpios
...
```

## Documentation/devicetree/bindings/display/panel/lg,sw49410.yaml
```yaml
# SPDX-License-Identifier: (GPL-2.0-only OR BSD-2-Clause)
%YAML 1.2
---
$id: http://devicetree.org/schemas/display/panel/lg,sw49410.yaml#
$schema: http://devicetree.org/meta-schemas/core.yaml#

title: LG SW49410 MIPI-DSI panels

maintainers:
  - Paul Sajna <hello@paulsajna.com>

description:
  LG SW49410 6.1" 1440x3120  panel found in LG G7 ThinQ smartphone.

allOf:
  - $ref: panel-common.yaml#

properties:
  compatible:
    items:
      - const: lg,sw49410

  reg:
    maxItems: 1

  backlight:
    description: Backlight device reference

  reset-gpios:
    description: Reset pin reference

required:
  - compatible
  - reg
  - reset-gpios
  - port

unevaluatedProperties: false

examples:
  - |
    #include <dt-bindings/gpio/gpio.h>

    dsi {
        #address-cells = <1>;
        #size-cells = <0>;

        display_panel: panel@0 {
            reg = <0>;
            compatible = "lg,sw49410";

            backlight = <&pmi8998_wled>;
            reset-gpios = <&tlmm 6 GPIO_ACTIVE_LOW>;

            pinctrl-names = "default", "sleep";
            pinctrl-0 = <&sde_dsi_active &sde_te_active>;
            pinctrl-1 = <&sde_dsi_sleep &sde_te_sleep>;

            port {
                panel_in: endpoint {
                    remote-endpoint = <&mdss_dsi0_out>;
                };
            };
        };
    };
...
```

## Documentation/devicetree/bindings/display/panel/lgd,lh599qh3-edb1.yaml
```yaml
# SPDX-License-Identifier: (GPL-2.0-only OR BSD-2-Clause)
%YAML 1.2
---
$id: http://devicetree.org/schemas/display/panel/lgd,lh599qh3-edb1.yaml#
$schema: http://devicetree.org/meta-schemas/core.yaml#

title: LG Display LH599QH3-EDB1 1440x2880 6.0" OLED DSI command-mode panel

maintainers:
  - Marijn Suijten <marijn.suijten@somainline.org>

description: |
  LG Display LH599QH3-EDB1 6.0" 1440x2880 (9:18 aspect ratio) 60Hz panel, found
  in the Sony Xperia XZ3 smartphone.  It is always programmed with Display
  Stream Compression 1.1 enabled.

  The assembly features an Atmel maXTouch digitizer, described separately as
  atmel,maxtouch.

allOf:
  - $ref: panel-common.yaml#

properties:
  compatible:
    const: lgd,lh599qh3-edb1-um1

  port: true

  reg:
    maxItems: 1
    description: DSI virtual channel

  reset-gpios: true

  avdd-supply:
    description: Analog voltage supply (3.0V)

  vddio-supply:
    description: I/O voltage supply (1.8V)

required:
  - compatible
  - port
  - reg
  - reset-gpios
  - avdd-supply
  - vddio-supply

additionalProperties: false

examples:
  - |
    #include <dt-bindings/gpio/gpio.h>

    dsi {
        #address-cells = <1>;
        #size-cells = <0>;
        panel@0 {
            compatible = "lgd,lh599qh3-edb1-um1";
            reg = <0>;

            avdd-supply = <&vreg_l28a_2p8>;
            vddio-supply = <&vreg_l14a_1p8>;

            reset-gpios = <&tlmm 6 GPIO_ACTIVE_HIGH>;

            port {
                panel_in: endpoint {
                    remote-endpoint = <&dsi0_out>;
                };
            };
        };
    };

...
```

## Documentation/devicetree/bindings/display/panel/lxd,m9189a.yaml
```yaml
# SPDX-License-Identifier: (GPL-2.0-only OR BSD-2-Clause)
%YAML 1.2
---
$id: http://devicetree.org/schemas/display/panel/lxd,m9189a.yaml#
$schema: http://devicetree.org/meta-schemas/core.yaml#

title: LXD M9189A DSI Display Panel

maintainers:
  - Rouven Czerwinski <r.czerwinski@pengutronix.de>

properties:
  compatible:
    const: lxd,m9189a

  reg:
    maxItems: 1

  standby-gpios:
    description: GPIO used for the standby pin
    maxItems: 1

  reset-gpios:
    description: GPIO used for the reset pin
    maxItems: 1

  vdd-supply:
    description: Power regulator

  backlight:
    description: Backlight used by the panel
    $ref: /schemas/types.yaml#/definitions/phandle

  port: true

required:
  - compatible
  - reg
  - standby-gpios
  - reset-gpios
  - vdd-supply
  - port

additionalProperties: false

examples:
  - |
    #include <dt-bindings/gpio/gpio.h>

    dsi {
      #address-cells = <1>;
      #size-cells = <0>;

      panel@0 {
        compatible = "lxd,m9189a";
        reg = <0>;
        backlight = <&backlight>;
        reset-gpios = <&gpio3 25 GPIO_ACTIVE_LOW>;
        standby-gpios = <&gpio5 22 GPIO_ACTIVE_LOW>;
        vdd-supply = <&reg_display_3v3>;

        port {
          mipi_panel_in: endpoint {
            remote-endpoint = <&mipi_dsi_out>;
          };
        };
      };
    };
```

## Documentation/devicetree/bindings/display/panel/novatek,nt35532.yaml
```yaml
# SPDX-License-Identifier: (GPL-2.0-only OR BSD-2-Clause)
%YAML 1.2
---
$id: http://devicetree.org/schemas/display/panel/novatek,nt35532.yaml#
$schema: http://devicetree.org/meta-schemas/core.yaml#

title: Novatek NT35532-based DSI display panels

maintainers:
  - Cristian Cozzolino <cristian_ci@protonmail.com>

allOf:
  - $ref: panel-common.yaml#

properties:
  compatible:
    const: novatek,nt35532

  reg:
    maxItems: 1

  backlight: true
  reset-gpios: true

  vsn-supply:
    description: negative voltage supply for analog circuits
  vsp-supply:
    description: positive voltage supply for analog circuits

  port: true

required:
  - compatible
  - reg
  - reset-gpios
  - vsn-supply
  - vsp-supply
  - port

additionalProperties: false

examples:
  - |
    #include <dt-bindings/gpio/gpio.h>

    dsi {
        #address-cells = <1>;
        #size-cells = <0>;

        panel@0 {
            compatible = "novatek,nt35532";
            reg = <0>;

            backlight = <&pmi8950_wled>;
            reset-gpios = <&tlmm 61 GPIO_ACTIVE_LOW>;
            vsn-supply = <&ibb>;
            vsp-supply = <&lab>;

            port {
                panel_in: endpoint {
                    remote-endpoint = <&dsi0_out>;
                };
            };
        };
    };
...
```

## Documentation/devicetree/bindings/display/panel/novatek,nt37703.yaml
```yaml
# SPDX-License-Identifier: GPL-2.0-only OR BSD-2-Clause
%YAML 1.2
---
$id: http://devicetree.org/schemas/display/panel/novatek,nt37703.yaml#
$schema: http://devicetree.org/meta-schemas/core.yaml#

title: Novatek NT37703 display driver IC based panels

maintainers:
  - Esteban Urrutia <esteuwu@proton.me>

properties:
  compatible:
    items:
      - enum:
          - motorola,bronco-tianma-v2-nt37703
      - const: novatek,nt37703

  reg:
    maxItems: 1

  avdd-supply:
    description: Analog power supply for panel

  elvdd-supply:
    description: Positive electroluminiscent (EL) power supply for panel

  elvss-supply:
    description: Negative electroluminiscent (EL) power supply for panel

  vci-supply:
    description: Analog power supply for DDIC

  vdd-supply:
    description: Digital power supply for DDIC

  vddi-supply:
    description: Digital I/O power supply for DDIC

  reset-gpios:
    maxItems: 1

required:
  - compatible
  - reg
  - reset-gpios

allOf:
  - $ref: panel-common.yaml#

unevaluatedProperties: false

examples:
  - |
    #include <dt-bindings/gpio/gpio.h>

    dsi {
        #address-cells = <1>;
        #size-cells = <0>;

        panel@0 {
            compatible = "motorola,bronco-tianma-v2-nt37703", "novatek,nt37703";
            reg = <0>;

            vci-supply = <&vreg_l13c_3p0>;
            vdd-supply = <&vreg_l1d_1p25>;
            vddi-supply = <&vreg_l12c_1p8>;
            reset-gpios = <&tlmm 0 GPIO_ACTIVE_LOW>;

            port {
                panel_in: endpoint {
                        remote-endpoint = <&dsi0_out>;
                };
            };
        };
    };

...
```
