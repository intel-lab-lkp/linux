## Documentation/devicetree/bindings/dma/andestech,atcdmac300.yaml
```yaml
# SPDX-License-Identifier: (GPL-2.0-only OR BSD-2-Clause)
%YAML 1.2
---
$id: http://devicetree.org/schemas/dma/andestech,atcdmac300.yaml#
$schema: http://devicetree.org/meta-schemas/core.yaml#

title: Andes ATCDMAC300 DMA Controller

maintainers:
  - CL Wang <cl634@andestech.com>

allOf:
  - $ref: dma-controller.yaml#

properties:
  compatible:
    const: andestech,atcdmac300

  reg:
    maxItems: 1

  interrupts:
    maxItems: 1

  "#dma-cells":
    const: 1

required:
  - compatible
  - reg
  - interrupts
  - "#dma-cells"

unevaluatedProperties: false

examples:
  - |
    #include <dt-bindings/interrupt-controller/irq.h>

    soc {
        #address-cells = <2>;
        #size-cells = <2>;

        dma-controller@f0c00000 {
            compatible = "andestech,atcdmac300";
            reg = <0x0 0xf0c00000 0x0 0x1000>;
            interrupts = <10 IRQ_TYPE_LEVEL_HIGH>;
            #dma-cells = <1>;
        };
    };
...
```

## Documentation/devicetree/bindings/dma/arm,dma-350.yaml
```yaml
# SPDX-License-Identifier: (GPL-2.0-only OR BSD-2-Clause)
%YAML 1.2
---
$id: http://devicetree.org/schemas/dma/arm,dma-350.yaml#
$schema: http://devicetree.org/meta-schemas/core.yaml#

title: Arm CoreLink DMA-350 Controller

maintainers:
  - Robin Murphy <robin.murphy@arm.com>

allOf:
  - $ref: dma-controller.yaml#
  - if:
      properties:
        compatible:
          contains:
            const: cix,sky1-dma350
    then:
      required:
        - clocks

properties:
  compatible:
    oneOf:
      - const: arm,dma-350
      - items:
          - const: cix,sky1-dma350
          - const: arm,dma-350

  reg:
    items:
      - description: Base and size of the full register map

  interrupts:
    minItems: 1
    items:
      - description: Channel 0 interrupt
      - description: Channel 1 interrupt
      - description: Channel 2 interrupt
      - description: Channel 3 interrupt
      - description: Channel 4 interrupt
      - description: Channel 5 interrupt
      - description: Channel 6 interrupt
      - description: Channel 7 interrupt

  "#dma-cells":
    const: 1
    description: The cell is the trigger input number

  clocks:
    maxItems: 1

  resets:
    maxItems: 1

  memory-region:
    maxItems: 1
    description:
      Reserved memory region used for DMA allocations when the controller
      cannot reach all of system memory.

required:
  - compatible
  - reg
  - interrupts

unevaluatedProperties: false
```

## Documentation/devicetree/bindings/dma/cix,sky1-dma350.yaml
```yaml
# SPDX-License-Identifier: (GPL-2.0-only OR BSD-2-Clause)
%YAML 1.2
---
$id: http://devicetree.org/schemas/dma/cix,sky1-dma350.yaml#
$schema: http://devicetree.org/meta-schemas/core.yaml#

title: CIX Sky1 DMA-350 Integration

maintainers:
  - CIX Kernel Team <cix-kernel-upstream@cixtech.com>

description:
  The CIX Sky1 DMA-350 integration driver owns SoC resources around an
  Arm DMA-350 controller, such as clocks, resets, interrupt routing, and
  optional reserved memory. Reserved memory is described on this parent node
  and assigned by the integration driver to the child DMA-350 device. The child
  node describes the generic DMA-350 IP.

properties:
  $nodename:
    pattern: "^dma@[0-9a-f]+$"

  compatible:
    const: cix,sky1-dma350

  "#address-cells":
    const: 2

  "#size-cells":
    const: 2

  ranges: true

  dma-ranges: true

  clocks:
    maxItems: 1

  resets:
    maxItems: 1

  power-domains:
    maxItems: 1

  cix,irq-router:
    $ref: /schemas/types.yaml#/definitions/phandle
    description:
      Syscon phandle for the Sky1 subsystem register block that routes
      DMA-350 channel interrupts to the AP interrupt controller.

  memory-region:
    maxItems: 1
    description:
      Reserved memory pool assigned by the CIX Sky1 DMA-350 integration driver
      to the child Arm DMA-350 device.

patternProperties:
  '^dma-controller@[0-9a-f]+$':
    $ref: arm,dma-350.yaml#

required:
  - compatible
  - "#address-cells"
  - "#size-cells"
  - ranges
  - dma-ranges

additionalProperties: false

examples:
  - |
    #include <dt-bindings/interrupt-controller/arm-gic.h>

    / {
        #address-cells = <2>;
        #size-cells = <2>;
        interrupt-parent = <&gic>;

        gic: interrupt-controller {
            #address-cells = <0>;
            interrupt-controller;
            #interrupt-cells = <4>;
        };

        dma@7010000 {
            compatible = "cix,sky1-dma350";
            #address-cells = <2>;
            #size-cells = <2>;
            ranges = <0x0 0x0 0x0 0x07010000 0x0 0x10000>;
            dma-ranges = <0x0 0x20000000 0x0 0x07010000 0x0 0x00100000>;
            clocks = <&clk 9>;
            resets = <&rst 15>;
            cix,irq-router = <&audss_cru>;

            dma-controller@0 {
                compatible = "arm,dma-350";
                reg = <0x0 0x0 0x0 0x10000>;
                interrupts = <GIC_SPI 230 IRQ_TYPE_LEVEL_HIGH 0>;
                #dma-cells = <1>;
            };
        };
    };
```

## Documentation/devicetree/bindings/dma/fsl,elo-dma.yaml
```yaml
# SPDX-License-Identifier: (GPL-2.0-only OR BSD-2-Clause)
%YAML 1.2
---
$id: http://devicetree.org/schemas/dma/fsl,elo-dma.yaml#
$schema: http://devicetree.org/meta-schemas/core.yaml#

title: Freescale Elo DMA Controller

maintainers:
  - J. Neuschäfer <j.ne@posteo.net>

description: |
  This is a little-endian 4-channel DMA controller, used in Freescale mpc83xx
  series chips such as mpc8315, mpc8349, mpc8379 etc.

  Note on DMA channel compatible properties: The compatible property must say
  "fsl,elo-dma-channel" or "fsl,eloplus-dma-channel" to be used by the Elo DMA
  driver (fsldma).  Any DMA channel used by fsldma cannot be used by another
  DMA driver, such as the SSI sound drivers for the MPC8610.  Therefore, any
  DMA channel that should be used for another driver should not use
  "fsl,elo-dma-channel" or "fsl,eloplus-dma-channel".  For the SSI drivers, for
  example, the compatible property should be "fsl,ssi-dma-channel".  See
  ssi.txt for more information.

properties:
  compatible:
    items:
      - enum:
          - fsl,mpc8313-dma
          - fsl,mpc8315-dma
          - fsl,mpc8323-dma
          - fsl,mpc8347-dma
          - fsl,mpc8349-dma
          - fsl,mpc8360-dma
          - fsl,mpc8377-dma
          - fsl,mpc8378-dma
          - fsl,mpc8379-dma
      - const: fsl,elo-dma

  reg:
    maxItems: 1
    description:
      DMA General Status Register, i.e. DGSR which contains status for
      all the 4 DMA channels.

  ranges: true

  cell-index:
    $ref: /schemas/types.yaml#/definitions/uint32
    description: Controller index. 0 for controller @ 0x8100.

  interrupts:
    maxItems: 1

patternProperties:
  "^dma-channel@.*$":
    type: object

    properties:
      compatible:
        items:
          - enum:
              - fsl,mpc8315-dma-channel
              - fsl,mpc8323-dma-channel
              - fsl,mpc8347-dma-channel
              - fsl,mpc8349-dma-channel
              - fsl,mpc8360-dma-channel
              - fsl,mpc8377-dma-channel
              - fsl,mpc8378-dma-channel
              - fsl,mpc8379-dma-channel
          - const: fsl,elo-dma-channel

      reg:
        maxItems: 1

      cell-index:
        description: DMA channel index starts at 0.

      interrupts: true

required:
  - compatible
  - reg
  - interrupts

additionalProperties: true

examples:
  - |
    dma@82a8 {
        #address-cells = <1>;
        #size-cells = <1>;
        compatible = "fsl,mpc8349-dma", "fsl,elo-dma";
        reg = <0x82a8 4>;
        ranges = <0 0x8100 0x1a4>;
        interrupt-parent = <&ipic>;
        interrupts = <71 8>;
        cell-index = <0>;
        dma-channel@0 {
            compatible = "fsl,mpc8349-dma-channel", "fsl,elo-dma-channel";
            cell-index = <0>;
            reg = <0 0x80>;
            interrupt-parent = <&ipic>;
            interrupts = <71 8>;
        };
        dma-channel@80 {
            compatible = "fsl,mpc8349-dma-channel", "fsl,elo-dma-channel";
            cell-index = <1>;
            reg = <0x80 0x80>;
            interrupt-parent = <&ipic>;
            interrupts = <71 8>;
        };
        dma-channel@100 {
            compatible = "fsl,mpc8349-dma-channel", "fsl,elo-dma-channel";
            cell-index = <2>;
            reg = <0x100 0x80>;
            interrupt-parent = <&ipic>;
            interrupts = <71 8>;
        };
        dma-channel@180 {
            compatible = "fsl,mpc8349-dma-channel", "fsl,elo-dma-channel";
            cell-index = <3>;
            reg = <0x180 0x80>;
            interrupt-parent = <&ipic>;
            interrupts = <71 8>;
        };
    };

...
```

## Documentation/devicetree/bindings/dma/fsl,elo3-dma.yaml
```yaml
# SPDX-License-Identifier: (GPL-2.0-only OR BSD-2-Clause)
%YAML 1.2
---
$id: http://devicetree.org/schemas/dma/fsl,elo3-dma.yaml#
$schema: http://devicetree.org/meta-schemas/core.yaml#

title: Freescale Elo3 DMA Controller

maintainers:
  - J. Neuschäfer <j.ne@posteo.net>

description: |
  DMA controller which has same function as EloPlus except that Elo3 has 8
  channels while EloPlus has only 4, it is used in Freescale Txxx and Bxxx
  series chips, such as t1040, t4240, b4860.

  Note on DMA channel compatible properties: The compatible property must say
  "fsl,elo-dma-channel" or "fsl,eloplus-dma-channel" to be used by the Elo DMA
  driver (fsldma).  Any DMA channel used by fsldma cannot be used by another
  DMA driver, such as the SSI sound drivers for the MPC8610.  Therefore, any DMA
  channel that should be used for another driver should not use
  "fsl,elo-dma-channel" or "fsl,eloplus-dma-channel".  For the SSI drivers, for
  example, the compatible property should be "fsl,ssi-dma-channel".  See ssi.txt
  for more information.

properties:
  compatible:
    const: fsl,elo3-dma

  reg:
    maxItems: 2
    description: |
      contains two entries for DMA General Status Registers, i.e. DGSR0 which
      includes status for channel 1~4, and DGSR1 for channel 5~8

  interrupts:
    maxItems: 1

patternProperties:
  "^dma-channel@.*$":
    type: object

    properties:
      compatible:
        const: fsl,eloplus-dma-channel

      reg:
        maxItems: 1

      interrupts: true

examples:
  - |
    dma@100300 {
        #address-cells = <1>;
        #size-cells = <1>;
        compatible = "fsl,elo3-dma";
        reg = <0x100300 0x4>,
              <0x100600 0x4>;
        ranges = <0x0 0x100100 0x500>;
        dma-channel@0 {
            compatible = "fsl,eloplus-dma-channel";
            reg = <0x0 0x80>;
            interrupts = <28 2 0 0>;
        };
        dma-channel@80 {
            compatible = "fsl,eloplus-dma-channel";
            reg = <0x80 0x80>;
            interrupts = <29 2 0 0>;
        };
        dma-channel@100 {
            compatible = "fsl,eloplus-dma-channel";
            reg = <0x100 0x80>;
            interrupts = <30 2 0 0>;
        };
        dma-channel@180 {
            compatible = "fsl,eloplus-dma-channel";
            reg = <0x180 0x80>;
            interrupts = <31 2 0 0>;
        };
        dma-channel@300 {
            compatible = "fsl,eloplus-dma-channel";
            reg = <0x300 0x80>;
            interrupts = <76 2 0 0>;
        };
        dma-channel@380 {
            compatible = "fsl,eloplus-dma-channel";
            reg = <0x380 0x80>;
            interrupts = <77 2 0 0>;
        };
        dma-channel@400 {
            compatible = "fsl,eloplus-dma-channel";
            reg = <0x400 0x80>;
            interrupts = <78 2 0 0>;
        };
        dma-channel@480 {
            compatible = "fsl,eloplus-dma-channel";
            reg = <0x480 0x80>;
            interrupts = <79 2 0 0>;
        };
    };

additionalProperties: true

...
```

## Documentation/devicetree/bindings/dma/fsl,eloplus-dma.yaml
```yaml
# SPDX-License-Identifier: (GPL-2.0-only OR BSD-2-Clause)
%YAML 1.2
---
$id: http://devicetree.org/schemas/dma/fsl,eloplus-dma.yaml#
$schema: http://devicetree.org/meta-schemas/core.yaml#

title: Freescale EloPlus DMA Controller

maintainers:
  - J. Neuschäfer <j.ne@posteo.net>

description: |
  This is a 4-channel DMA controller with extended addresses and chaining,
  mainly used in Freescale mpc85xx/86xx, Pxxx and BSC series chips, such as
  mpc8540, mpc8641 p4080, bsc9131 etc.

  Note on DMA channel compatible properties: The compatible property must say
  "fsl,elo-dma-channel" or "fsl,eloplus-dma-channel" to be used by the Elo DMA
  driver (fsldma).  Any DMA channel used by fsldma cannot be used by another
  DMA driver, such as the SSI sound drivers for the MPC8610.  Therefore, any DMA
  channel that should be used for another driver should not use
  "fsl,elo-dma-channel" or "fsl,eloplus-dma-channel".  For the SSI drivers, for
  example, the compatible property should be "fsl,ssi-dma-channel".  See ssi.txt
  for more information.

properties:
  compatible:
    oneOf:
      - items:
          - enum:
              - fsl,mpc8540-dma
              - fsl,mpc8541-dma
              - fsl,mpc8548-dma
              - fsl,mpc8555-dma
              - fsl,mpc8560-dma
              - fsl,mpc8572-dma
              - fsl,mpc8641-dma
          - const: fsl,eloplus-dma
      - const: fsl,eloplus-dma

  reg:
    maxItems: 1
    description:
      DMA General Status Register, i.e. DGSR which contains
      status for all the 4 DMA channels

  cell-index:
    $ref: /schemas/types.yaml#/definitions/uint32
    description: |
      controller index.  0 for controller @ 0x21000, 1 for controller @ 0xc000

  interrupts:
    maxItems: 1

patternProperties:
  "^dma-channel@.*$":
    type: object

    properties:
      compatible:
        items:
          - enum:
              - fsl,mpc8540-dma-channel
              - fsl,mpc8541-dma-channel
              - fsl,mpc8548-dma-channel
              - fsl,mpc8555-dma-channel
              - fsl,mpc8560-dma-channel
              - fsl,mpc8572-dma-channel
          - const: fsl,eloplus-dma-channel

      reg:
        maxItems: 1

      cell-index:
        description: DMA channel index starts at 0.

      interrupts: true

examples:
  - |
    dma@21300 {
        #address-cells = <1>;
        #size-cells = <1>;
        compatible = "fsl,mpc8540-dma", "fsl,eloplus-dma";
        reg = <0x21300 4>;
        ranges = <0 0x21100 0x200>;
        cell-index = <0>;
        dma-channel@0 {
            compatible = "fsl,mpc8540-dma-channel", "fsl,eloplus-dma-channel";
            reg = <0 0x80>;
            cell-index = <0>;
            interrupt-parent = <&mpic>;
            interrupts = <20 2>;
        };
        dma-channel@80 {
            compatible = "fsl,mpc8540-dma-channel", "fsl,eloplus-dma-channel";
            reg = <0x80 0x80>;
            cell-index = <1>;
            interrupt-parent = <&mpic>;
            interrupts = <21 2>;
        };
        dma-channel@100 {
            compatible = "fsl,mpc8540-dma-channel", "fsl,eloplus-dma-channel";
            reg = <0x100 0x80>;
            cell-index = <2>;
            interrupt-parent = <&mpic>;
            interrupts = <22 2>;
        };
        dma-channel@180 {
            compatible = "fsl,mpc8540-dma-channel", "fsl,eloplus-dma-channel";
            reg = <0x180 0x80>;
            cell-index = <3>;
            interrupt-parent = <&mpic>;
            interrupts = <23 2>;
        };
    };

additionalProperties: true

...
```
