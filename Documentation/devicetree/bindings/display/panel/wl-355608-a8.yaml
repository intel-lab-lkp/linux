## Documentation/devicetree/bindings/dma/hisi,ascend-sdma.yaml
```yaml
# SPDX-License-Identifier: (GPL-2.0-only OR BSD-2-Clause)
%YAML 1.2
---
$id: http://devicetree.org/schemas/dma/hisi,ascend-sdma.yaml#
$schema: http://devicetree.org/meta-schemas/core.yaml#

title: HISI Ascend System DMA (SDMA) controller

description: |
  The Ascend SDMA controller is used for transferring data
  in system memory. It utilizes IOMMU SVA feature and accepts
  virtual address from user process.

maintainers:
  - Guo Mengqi <guomengqi3@huawei.com>

allOf:
  - $ref: dma-controller.yaml#

properties:
  compatible:
    enum:
      - hisi,ascend310-sdma
      - hisi,ascend910-sdma

  reg:
    maxItems: 1

  '#dma-cells':
    const: 1
    description:
      Clients specify a single cell with channel number.

  hisi,ascend-sdma-channel-map:
    description: |
      bitmap, each bit stands for a channel that is allowed to
      use by this system. Maximum 64 bits.
    $ref: /schemas/types.yaml#/definitions/uint64

  iommus:
    maxItems: 1

  pasid-num-bits:
    description: |
      sdma utilizes iommu sva feature to transfer user space data.
      It acts as a basic dma controller if not bound to user space.
    const: 0x10

  dma-coherent: true

  dma-can-stall: true

required:
  - compatible
  - reg
  - hisi,ascend-sdma-channel-map
  - '#dma-cells'
  - iommus

additionalProperties: false

examples:
  - |
    dma-controller@880e0000 {
        compatible = "hisilicon,ascend310-sdma";
        reg = <0x880e0000 0x10000>;
        hisi,ascend-sdma-channel-map = <0x00000000 0x0000ff00>;
        iommus = <&smmu 0x7f46>;
        pasid-num-bits = <0x10>;
        dma-coherent;
        dma-can-stall;
        #dma-cells = <1>;
    };

...
```

## Documentation/devicetree/bindings/dma/hisilicon,ascend-sdma.yaml
```yaml
# SPDX-License-Identifier: (GPL-2.0-only OR BSD-2-Clause)
%YAML 1.2
---
$id: http://devicetree.org/schemas/dma/hisilicon,ascend-sdma.yaml#
$schema: http://devicetree.org/meta-schemas/core.yaml#

title: HiSilicon Ascend System DMA (SDMA) controller

description: |
  The Ascend SDMA controller is used for transferring data
  in system memory.

maintainers:
  - Guo Mengqi <guomengqi3@huawei.com>

allOf:
  - $ref: dma-controller.yaml#

properties:
  compatible:
    enum:
      - hisilicon,ascend310-sdma
      - hisilicon,ascend910-sdma

  reg:
    maxItems: 1

  '#dma-cells':
    const: 1
    description:
      Clients specify a single cell with channel number.

  dma-channel-mask:
    minItems: 1
    maxItems: 2

  iommus:
    maxItems: 1

  pasid-num-bits:
    description: |
      This tells smmu that this device supports iommu-sva feature.
      This determines the maximum number of digits in the pasid.
    maximum: 0x10

  dma-coherent: true

  dma-can-stall: true

required:
  - compatible
  - reg
  - dma-channel-mask
  - '#dma-cells'
  - iommus
  - pasid-num-bits
  - dma-can-stall

additionalProperties: false

examples:
  - |
    dma-controller@880e0000 {
        compatible = "hisilicon,ascend310-sdma";
        reg = <0x880e0000 0x10000>;
        dma-channel-mask = <0xff00>;
        iommus = <&smmu 0x7f46>;
        pasid-num-bits = <0x10>;
        dma-coherent;
        dma-can-stall;
        #dma-cells = <1>;
    };

...
```

## Documentation/devicetree/bindings/dma/img,pistachio-mdc-dma.yaml
```yaml
# SPDX-License-Identifier: (GPL-2.0-only OR BSD-2-Clause)
%YAML 1.2
---
$id: http://devicetree.org/schemas/dma/img,pistachio-mdc-dma.yaml#
$schema: http://devicetree.org/meta-schemas/core.yaml#

title: IMG Multi-threaded DMA Controller (MDC)

maintainers:
  - Rahul Bedarkar <rahulbedarkar89@gmail.com>
  - linux-mips@vger.kernel.org

allOf:
  - $ref: /schemas/dma/dma-controller.yaml#

properties:
  compatible:
    const: img,pistachio-mdc-dma

  reg:
    maxItems: 1

  interrupts:
    minItems: 1
    maxItems: 32

  clocks:
    maxItems: 1

  clock-names:
    items:
      - const: sys

  img,cr-periph:
    $ref: /schemas/types.yaml#/definitions/phandle
    description:
      Phandle to peripheral control syscon node with DMA request to channel
      mapping registers.

  img,max-burst-multiplier:
    $ref: /schemas/types.yaml#/definitions/uint32
    minimum: 1
    description:
      Maximum supported burst size multiplier. The maximum burst size is this
      value multiplied by the hardware-reported bus width.

  "#dma-cells":
    const: 3
    description: |
      DMA specifier cells:
        1: peripheral's DMA request line
        2: channel bitmap: bit N set indicates channel N is usable
        3: thread ID to be used by the channel

  dma-channels:
    minimum: 1
    maximum: 32
    description: Defaults to HW-reported value if not specified.

required:
  - compatible
  - reg
  - interrupts
  - clocks
  - clock-names
  - img,cr-periph
  - img,max-burst-multiplier
  - "#dma-cells"

unevaluatedProperties: false

examples:
  - |
    #include <dt-bindings/interrupt-controller/mips-gic.h>
    #include <dt-bindings/interrupt-controller/irq.h>

    dma-controller@18143000 {
      compatible = "img,pistachio-mdc-dma";
      reg = <0x18143000 0x1000>;
      interrupts = <GIC_SHARED 27 IRQ_TYPE_LEVEL_HIGH>,
                   <GIC_SHARED 28 IRQ_TYPE_LEVEL_HIGH>;
      clocks = <&system_clk>;
      clock-names = "sys";

      img,max-burst-multiplier = <16>;
      img,cr-periph = <&cr_periph>;

      #dma-cells = <3>;
    };
```

## Documentation/devicetree/bindings/dma/img-mdc-dma.yaml
```yaml
# SPDX-License-Identifier: (GPL-2.0-only OR BSD-2-Clause)
%YAML 1.2
---
$id: http://devicetree.org/schemas/dma/img-mdc-dma.yaml#
$schema: http://devicetree.org/meta-schemas/core.yaml#

title: IMG Multi-threaded DMA Controller (MDC)

maintainers:
  - Vinod Koul <vkoul@kernel.org>

allOf:
  - $ref: /schemas/dma/dma-controller.yaml#

properties:
  compatible:
    description: Must be "img,pistachio-mdc-dma".
    const: img,pistachio-mdc-dma

  reg:
    description:
      Must contain the base address and length of the MDC registers.
    minItems: 1

  interrupts:
    description:
      Must contain all the per-channel DMA interrupts.

  clocks:
    description: |
      Must contain an entry for each entry in clock-names.
      See clock/clock.yaml for details.

  clock-names:
    description: |
      Must include the following entries:
        - sys: MDC system interface clock.
    minItems: 1
    contains: { const: sys }

  img,cr-periph:
    $ref: /schemas/types.yaml#/definitions/phandle
    description: |
      Must contain a phandle to the peripheral control syscon node
      which contains the DMA request to channel mapping registers.

  img,max-burst-multiplier:
    description: |
      Must be the maximum supported burst size multiplier.
      The maximum burst size is this value multiplied by the
      hardware-reported bus width.
    $ref: /schemas/types.yaml#/definitions/uint32

  "#dma-cells":
    description: |
      Must be 3:
        - The first cell is the peripheral's DMA request line.
        - The second cell is a bitmap specifying to which channels the DMA request
          line may be mapped (i.e. bit N set indicates channel N is usable).
        - The third cell is the thread ID to be used by the channel.
    const: 3

  dma-channels:
    description: |
      Number of supported DMA channels, up to 32. If not specified
      the number reported by the hardware is used.
    $ref: /schemas/types.yaml#/definitions/uint32
    maximum: 32

required:
  - compatible
  - reg
  - interrupts
  - clocks
  - clock-names
  - "img,cr-periph"
  - "img,max-burst-multiplier"
  - "#dma-cells"

unevaluatedProperties: false

examples:
  - |
    #include <dt-bindings/interrupt-controller/mips-gic.h>
    #include <dt-bindings/interrupt-controller/irq.h>
    mdc: dma-controller@18143000 {
      compatible = "img,pistachio-mdc-dma";
      reg = <0x18143000 0x1000>;
      interrupts = <GIC_SHARED 27 IRQ_TYPE_LEVEL_HIGH>,
            <GIC_SHARED 28 IRQ_TYPE_LEVEL_HIGH>;
      clocks = <&system_clk>;
      clock-names = "sys";

      img,max-burst-multiplier = <16>;
      img,cr-periph = <&cr_periph>;

      #dma-cells = <3>;
    };
```
