## Documentation/devicetree/bindings/display/panel/wl-355608-a8.yaml
```yaml
# SPDX-License-Identifier: (GPL-2.0-only OR BSD-2-Clause)
%YAML 1.2
---
$id: http://devicetree.org/schemas/display/panel/wl-355608-a8.yaml#
$schema: http://devicetree.org/meta-schemas/core.yaml#

title: WL-355608-A8 3.5" (640x480 pixels) 24-bit IPS LCD panel

maintainers:
  - Ryan Walklin <ryan@testtoast.com>

allOf:
  - $ref: panel-common.yaml#
  - $ref: /schemas/spi/spi-peripheral-props.yaml#

properties:
  compatible:
    const: wl-355608-a8

  reg:
    maxItems: 1

  spi-3wire: true

required:
  - compatible
  - reg
  - port
  - power-supply
  - reset-gpios

unevaluatedProperties: false

examples:
  - |
    #include <dt-bindings/gpio/gpio.h>

    spi_lcd: spi {
        compatible = "spi-gpio";
        #address-cells = <1>;
        #size-cells = <0>;

        sck-gpios = <&pio 8 9 GPIO_ACTIVE_HIGH>; // PI9
        mosi-gpios = <&pio 8 10 GPIO_ACTIVE_HIGH>; // PI10
        cs-gpios = <&pio 8 8 GPIO_ACTIVE_HIGH>; // PI8
        num-chipselects = <1>;

        panel: panel@0 {
            compatible = "wl_355608_a8";
            reg = <0>;

            spi-3wire;
            spi-max-frequency = <3125000>;

            reset-gpios = <&pio 8 14 GPIO_ACTIVE_LOW>; // PI14

            backlight = <&backlight>;
            power-supply = <&reg_lcd>;
            pinctrl-0 = <&lcd0_rgb888_pins>;
            pinctrl-names = "default";

            port {
            	panel_in_rgb: endpoint {
                    remote-endpoint = <&tcon_lcd0_out_lcd>;
                };
            };
        };
    };
```

## Documentation/devicetree/bindings/display/sharp,ls027b7dh01.yaml
```yaml
# SPDX-License-Identifier: (GPL-2.0 OR BSD-2-Clause)
%YAML 1.2
---
$id: http://devicetree.org/schemas/display/sharp,ls027b7dh01.yaml#
$schema: http://devicetree.org/meta-schemas/core.yaml#

title: Sharp LS027B7DH01 Memory LCD Display

maintainers:
  - Mehdi Djait <mehdi.djait@bootlin.com>

description:
  The Sharp LS027B7DH01 is a 2.7" 400x240 monochrome display connected over a
  SPI bus. The display requires an alternating signal to prevent the buildup of
  a DC bias that will stop any update. Two modes can be used for the generation
  of this signal Software by writing to the display or Hardware by supplying the
  External COM inversion signal.

allOf:
  - $ref: panel/panel-common.yaml#
  - $ref: /schemas/spi/spi-peripheral-props.yaml#

properties:
  compatible:
    const: sharp,ls027b7dh01

  reg:
    maxItems: 1

  spi-cs-high: true

  spi-lsb-first: true

  spi-max-frequency:
    maximum: 2000000

  enable-gpios:
    maxItems: 1

  pwms:
    maxItems: 1
    description: External COM inversion signal

required:
  - compatible
  - reg
  - spi-lsb-first
  - enable-gpios

additionalProperties: false

examples:
  - |
    #include <dt-bindings/gpio/gpio.h>

    spi {
            #address-cells = <1>;
            #size-cells = <0>;

            display@0{
                    compatible = "sharp,ls027b7dh01";
                    reg = <0>;
                    spi-cs-high;
                    spi-lsb-first;
                    spi-max-frequency = <2000000>;
                    enable-gpios = <&gpiof 3 GPIO_ACTIVE_HIGH>;
                    pwms = <&pwm 1 1000000000 0>;
            };
    };

...
```

## Documentation/devicetree/bindings/display/sharp,sharp-memory.yaml
```yaml
# SPDX-License-Identifier: (GPL-2.0-only OR BSD-2-Clause)
%YAML 1.2
---
$id: http://devicetree.org/schemas/display/sharp,sharp-memory.yaml#
$schema: http://devicetree.org/meta-schemas/core.yaml#

title: Sharp Memory LCD panels

maintainers:
  - Alex Lanzano <lanzano.alex@gmail.com>

description:
  This binding is for the Sharp Memory LCD monochrome displays.

properties:
  compatible:
    enum:
      - sharp,ls010b7dh04
      - sharp,ls011b7dh03
      - sharp,ls012b7dd01
      - sharp,ls013b7dh03
      - sharp,ls013b7dh05
      - sharp,ls018b7dh02
      - sharp,ls027b7dh01
      - sharp,ls027b7dh01a
      - sharp,ls032b7dd02
      - sharp,ls044q7dh01

  reg:
    maxItems: 1

  spi-cs-high: true

  spi-max-frequency:
    maximum: 2000000

  vcom-mode:
    $ref: /schemas/types.yaml#/definitions/uint32
    description: |
      VCOM is a signal that prevents DC bias from being built up in
      the panel resulting in pixels being forever stuck in one state.
      vcom-mode can be set to one of three modes

      SHARP_MEMORY_SOFTWARE_VCOM - This method uses a kthread to periodically send a
      "maintain display" message to the display, toggling the vcom
      bit on and off with each message

      SHARP_MEMORY_EXTERNAL_VCOM - This method relies on an external clock to generate
      the signal on the EXTCOMM pin

      SHARP_MEMORY_PWM_VCOM - This method uses a pwm device to generate the signal
      on the EXTCOMM pin

    enum: [ 0, 1, 2 ]

  enable-gpios:
    maxItems: 1
    description: Enables display

  pwms:
    maxItems: 1
    description: External VCOM signal

required:
  - compatible
  - reg
  - spi-cs-high
  - vcom-mode

if:
  properties:
    vcom-mode:
      # SHARP_MEMORY_PWM_VCOM
      enum: [2]
then:
  required:
    - pwms

additionalProperties: false

examples:
  - |
    #include <dt-bindings/display/sharp-memory.h>

    spi {
            #address-cells = <1>;
            #size-cells = <0>;

            display@0{
                    compatible = "sharp,ls013b7dh03";
                    reg = <0>;
                    spi-cs-high;
                    spi-max-frequency = <1000000>;
                    vcom-mode = <SHARP_MEMORY_SOFTWARE_VCOM>;
            };
    };
...
```

## Documentation/devicetree/bindings/display/sitronix,st7571-i2c.yaml
```yaml
# SPDX-License-Identifier: (GPL-2.0-only OR BSD-2-Clause)
%YAML 1.2
---
$id: http://devicetree.org/schemas/display/sitronix,st7571-i2c.yaml#
$schema: http://devicetree.org/meta-schemas/core.yaml#

title: Sitronix ST7571 Display Panels

maintainers:
  - Marcus Folkesson <marcus.folkesson@gmail.com>

properties:
  compatible:
    const: sitronix,st7571-i2c

  reg:
    description: I2C address of the LCD controller
    maxItems: 1

  sitronix,panel-width-mm:
    description: physical panel width [mm]

  sitronix,panel-height-mm:
    description: physical panel height [mm]

  sitronix,panel-nlines:
    description: Number of lines in the panel
    $ref: /schemas/types.yaml#/definitions/uint32
    minimum: 1
    maximum: 128
    default: 128

  sitronix,panel-start-line:
    description: Start line of the panel
    $ref: /schemas/types.yaml#/definitions/uint32
    minimum: 0
    maximum: 127
    default: 0

  reset-gpios:
    description: GPIO connected to the RST_N signal.
    maxItems: 1

required:
  - compatible
  - reg
  - reset-gpios
  - sitronix,panel-width-mm
  - sitronix,panel-height-mm

additionalProperties: false

examples:
  - |
    #include <dt-bindings/gpio/gpio.h>
    #
    i2c {
        #address-cells = <1>;
        #size-cells = <0>;

        display@3f {
          compatible = "sitronix,st7571-i2c";
          reg = <0x3f>;

          reset-gpios = <&gpio0 3 GPIO_ACTIVE_HIGH>;
          sitronix,panel-width-mm = <37>;
          sitronix,panel-height-mm = <27>;
          sitronix,panel-nlines = <96>;
          sitronix,panel-start-line = <0>;
        };
    };
```

## Documentation/devicetree/bindings/display/sitronix,st7571.yaml
```yaml
# SPDX-License-Identifier: (GPL-2.0-only OR BSD-2-Clause)
%YAML 1.2
---
$id: http://devicetree.org/schemas/display/sitronix,st7571.yaml#
$schema: http://devicetree.org/meta-schemas/core.yaml#

title: Sitronix ST7571 Display Panels

maintainers:
  - Marcus Folkesson <marcus.folkesson@gmail.com>

description:
  This binding is for display panels using a Sitronix ST7571 controller in I2C
  mode.

allOf:
  - $ref: panel/panel-common.yaml#

properties:
  compatible:
    const: sitronix,st7571

  reg: true
  reset-gpios: true
  width-mm: true
  height-mm: true

  panel-timing:
    $ref: panel/panel-timing.yaml#
    description: |
      The panel-timing node specifies the display resolution and timing
      parameters. The hactive and vactive properties are mandatory.
      The vback-porch property specifies the start line of the display.
      The other properties should be set to zero.

required:
  - compatible
  - reg
  - reset-gpios
  - width-mm
  - height-mm
  - panel-timing

additionalProperties: false

examples:
  - |
    #include <dt-bindings/gpio/gpio.h>
    
    i2c {
        #address-cells = <1>;
        #size-cells = <0>;

        display@3f {
          compatible = "sitronix,st7571";
          reg = <0x3f>;
          reset-gpios = <&gpio0 3 GPIO_ACTIVE_LOW>;
          width-mm = <37>;
          height-mm = <27>;

            panel-timing {
                hactive = <128>;
                vactive = <96>;
                hback-porch = <0>;
                vback-porch = <0>;
                clock-frequency = <0>;
                hfront-porch = <0>;
                hsync-len = <0>;
                vfront-porch = <0>;
                vsync-len = <0>;
            };
        };
    };
```

## Documentation/devicetree/bindings/display/sitronix,st7735s.yaml
```yaml
# SPDX-License-Identifier: GPL-2.0-only OR BSD-2-Clause
%YAML 1.2
---
$id: http://devicetree.org/schemas/display/sitronix,st7735s.yaml#
$schema: http://devicetree.org/meta-schemas/core.yaml#

title: Sitronix ST7735S Display Panels

maintainers:
  - Stefan x Nilsson <stefan.x.nilsson@axis.com>

description:
  This binding is for display panels using a Sitronix ST7735S
  controller in SPI mode.

allOf:
  - $ref: panel/panel-common.yaml#
  - $ref: /schemas/spi/spi-peripheral-props.yaml#

properties:
  compatible:
    oneOf:
      - description:
          Winstar WF0096ATYAA3DNN0 0.96" 80x160 Color TFT
        items:
          - enum:
              - winstar,wf0096atyaa3dnn0
          - const: sitronix,st7735s

  dc-gpios:
    maxItems: 1
    description: Display data/command selection (D/CX)

  backlight: true
  reg: true
  spi-max-frequency: true
  reset-gpios: true
  rotation: true

required:
  - compatible
  - reg
  - dc-gpios

additionalProperties: true

examples:
  - |
    #include <dt-bindings/gpio/gpio.h>

    backlight: backlight {
            compatible = "gpio-backlight";
            gpios = <&gpio 44 GPIO_ACTIVE_HIGH>;
    };

    regdisplay: regulatordisplay {
            compatible = "regulator-fixed";
            regulator-name = "display";
            regulator-min-microvolt = <3300000>;
            regulator-max-microvolt = <3300000>;
            regulator-enable-ramp-delay = <100000>;
            enable-active-high;
    };

    spi {
            #address-cells = <1>;
            #size-cells = <0>;

            display@0 {
                    compatible = "winstar,wf0096atyaa3dnn0","sitronix,st7735s";
                    reg = <0>;
                    spi-max-frequency = <12000000>;
                    dc-gpios = <&gpio 43 GPIO_ACTIVE_HIGH>;
                    reset-gpios = <&gpio 23 GPIO_ACTIVE_HIGH>;
                    backlight = <&backlight>;
                    power-supply = <&regdsiplay>;
                    rotation = <270>;
            };
    };

...
```

## Documentation/devicetree/bindings/display/sitronix,st7920.yaml
```yaml
# SPDX-License-Identifier: (GPL-2.0-only OR BSD-2-Clause)
%YAML 1.2
---
$id: http://devicetree.org/schemas/display/sitronix,st7920.yaml#
$schema: http://devicetree.org/meta-schemas/core.yaml#

title: Sitronix ST7920 LCD Display Controllers

maintainers:
  - Iker Pedrosa <ikerpedrosam@gmail.com>

description: |
  The Sitronix ST7920 is a controller for monochrome dot-matrix graphical LCDs,
  most commonly used for 128x64 pixel displays.
  This binding supports connecting the display via a standard SPI bus.

properties:
  compatible:
    const: sitronix,st7920

  reg:
    description: The chip-select number for the device on the SPI bus.
    maxItems: 1

  spi-max-frequency:
    description: Maximum SPI clock frequency in Hz.
    maximum: 600000

  spi-cs-high:
    type: boolean
    description: Indicates the chip select is active high.

required:
  - compatible
  - reg
  - spi-max-frequency

additionalProperties: false

examples:
  - |
    // Example: ST7920 connected to an SPI bus
    #include <dt-bindings/gpio/gpio.h>

    spi0 {
        #address-cells = <1>;
        #size-cells = <0>;

        display@0 {
            compatible = "sitronix,st7920";
            reg = <0>; // Chip select 0
            spi-max-frequency = <600000>;
            spi-cs-high;
        };
    };
```

## Documentation/devicetree/bindings/display/sm501fb.txt
```
* SM SM501

The SM SM501 is a LCD controller, with proper hardware, it can also
drive DVI monitors.

Required properties:
- compatible : should be "smi,sm501".
- reg : contain two entries:
    - First entry: System Configuration register
    - Second entry: IO space (Display Controller register)
- interrupts : SMI interrupt to the cpu should be described here.

Optional properties:
- mode : select a video mode:
    <xres>x<yres>[-<bpp>][@<refresh>]
- edid : verbatim EDID data block describing attached display.
  Data from the detailed timing descriptor will be used to
  program the display controller.
- little-endian: available on big endian systems, to
  set different foreign endian.
- big-endian: available on little endian systems, to
  set different foreign endian.
- route: Framebuffer output route
  "own": CRT=>CRT, Panel=>Panel
  "crt-panel": Panel=>CRT, Panel=>Panel
- swap-fb-endian: swap framebuffer byteorder
- crt: CRT output control
- panel: Panel output control
- smi,devices: select peripheral functions.
  available usb-host, usb-gadget, ssp0, ssp,1 uart0, uart1, accel,
            ac97, i2s, gpio and all.
- smi,mclk: SM501 mclk frequency.
- smi,m1xclk: SM501 m1xclk frequency.
- smi,misc-timing: SM501 Miscellaneous Timing reg value.
- smi,misc-control: SM501 Miscellaneous Control reg value.
- smi,gpio-low: SM501 GPIO31-0 Control reg value.
- smi,gpio-high: SM501 GPIO63-32 Control reg value.
- smi,num-i2c: I2C channel number.
- smi,gpio-i2c: I2C assigned GPIO.

Example for MPC5200:
	display@1,0 {
		compatible = "smi,sm501";
		reg = <1 0x00000000 0x00800000
		       1 0x03e00000 0x00200000>;
		interrupts = <1 1 3>;
		mode = "640x480-32@60";
		edid = [edid-data];
	};
```
