## Documentation/devicetree/bindings/display/solomon,ssd132x.yaml
```yaml
# SPDX-License-Identifier: (GPL-2.0-only OR BSD-2-Clause)
%YAML 1.2
---
$id: http://devicetree.org/schemas/display/solomon,ssd132x.yaml#
$schema: http://devicetree.org/meta-schemas/core.yaml#

title: Solomon SSD132x OLED Controllers

maintainers:
  - Javier Martinez Canillas <javierm@redhat.com>

properties:
  compatible:
    oneOf:
      - enum:
          - solomon,ssd1322
          - solomon,ssd1325
          - solomon,ssd1327

  reg:
    maxItems: 1

  reset-gpios:
    maxItems: 1

  # Only required for SPI
  dc-gpios:
    description:
      GPIO connected to the controller's D/C# (Data/Command) pin,
      that is needed for 4-wire SPI to tell the controller if the
      data sent is for a command register or the display data RAM
    maxItems: 1

  solomon,height:
    $ref: /schemas/types.yaml#/definitions/uint32
    description:
      Height in pixel of the screen driven by the controller.
      The default value is controller-dependent.

  solomon,width:
    $ref: /schemas/types.yaml#/definitions/uint32
    description:
      Width in pixel of the screen driven by the controller.
      The default value is controller-dependent.

required:
  - compatible
  - reg

allOf:
  - $ref: /schemas/spi/spi-peripheral-props.yaml#

  - if:
      properties:
        compatible:
          contains:
            const: solomon,ssd1322
    then:
      properties:
        width:
          default: 480
        height:
          default: 128

  - if:
      properties:
        compatible:
          contains:
            const: solomon,ssd1325
    then:
      properties:
        width:
          default: 128
        height:
          default: 80

  - if:
      properties:
        compatible:
          contains:
            const: solomon,ssd1327
    then:
      properties:
        width:
          default: 128
        height:
          default: 128

unevaluatedProperties: false

examples:
  - |
    i2c {
            #address-cells = <1>;
            #size-cells = <0>;

            ssd1327_i2c: oled@3c {
                    compatible = "solomon,ssd1327";
                    reg = <0x3c>;
                    reset-gpios = <&gpio2 7>;
            };

    };
  - |
    spi {
            #address-cells = <1>;
            #size-cells = <0>;

            ssd1327_spi: oled@0 {
                    compatible = "solomon,ssd1327";
                    reg = <0x0>;
                    reset-gpios = <&gpio2 7>;
                    dc-gpios = <&gpio2 8>;
                    spi-max-frequency = <10000000>;
            };
    };
```

## Documentation/devicetree/bindings/display/solomon,ssd1351.yaml
```yaml
# SPDX-License-Identifier: (GPL-2.0-only OR BSD-2-Clause)
%YAML 1.2
---
$id: http://devicetree.org/schemas/display/solomon,ssd1351.yaml#
$schema: http://devicetree.org/meta-schemas/core.yaml#

title: Solomon SSD1351 OLED Display Controller

maintainers:
  - Amit Barzilai <amit.barzilai22@gmail.com>

allOf:
  - $ref: solomon,ssd-common.yaml#

properties:
  compatible:
    enum:
      - solomon,ssd1351

  solomon,width:
    default: 128

  solomon,height:
    default: 128

  rotation: true

required:
  - compatible
  - reg

unevaluatedProperties: false

examples:
  - |
    spi {
        #address-cells = <1>;
        #size-cells = <0>;

        oled@0 {
            compatible = "solomon,ssd1351";
            reg = <0x0>;
            reset-gpios = <&gpio2 7>;
            dc-gpios = <&gpio2 8>;
            spi-max-frequency = <10000000>;
        };
    };
```

## Documentation/devicetree/bindings/display/tegra/nvidia,tegra-8bit-cpu.yaml
```yaml
# SPDX-License-Identifier: (GPL-2.0-only OR BSD-2-Clause)
%YAML 1.2
---
$id: http://devicetree.org/schemas/display/tegra/nvidia,tegra-8bit-cpu.yaml#
$schema: http://devicetree.org/meta-schemas/core.yaml#

title: Nvidia Tegra DC based MIPI DBI Type B bridge

maintainers:
  - Svyatoslav Ryhel <clamor95@gmail.com>

description: The display controller in Tegra20/30 SoCs features an
  8-bit SPI interface that closely resembles the MIPI DBI Type B
  protocol and is referred to as '8-bit CPU'. Each display controller
  provides two such interfaces, which can be used to send MIPI DCS
  commands to initialize and control the panel while image data is
  transmitted via 16/18/24-line RGB.

properties:
  compatible:
    const: nvidia,tegra-8bit-cpu

  dc-gpios:
    description: Data/command selection pin.
    maxItems: 1

  rw-gpios:
    description: Read/write pin.
    maxItems: 1

  cs-gpios:
    description: Chip select pin.
    maxItems: 1

  data-gpios:
    description: Specifies a set of 8 gpio pins used to transfer data.
    minItems: 8
    maxItems: 8

  nvidia,init-sequence:
    $ref: /schemas/types.yaml#/definitions/uint32-array
    description: Device specific set of values used in DC DISP_SPI_INIT_SEQ
      registers.
    minItems: 4
    maxItems: 4

  panel:
    type: object
    description: Node of supported panel driven by the bridge.

  ports:
    $ref: /schemas/graph.yaml#/properties/ports

    properties:
      port@0:
        $ref: /schemas/graph.yaml#/$defs/port-base
        unevaluatedProperties: false
        description: Video port for RGB input.

        properties:
          endpoint:
            $ref: /schemas/graph.yaml#/$defs/endpoint-base
            unevaluatedProperties: false

            properties:
              bus-width:
                enum: [ 16, 18, 24 ]

      port@1:
        $ref: /schemas/graph.yaml#/properties/port
        description: Video port for DBI output (panel or connector).

    required:
      - port@0
      - port@1

required:
  - compatible
  - ports

unevaluatedProperties: false

examples:
  - |
    #include <dt-bindings/gpio/gpio.h>

    dbi-bridge {
        compatible = "nvidia,tegra-8bit-cpu";

        dc-gpios = <&gpio 110 GPIO_ACTIVE_HIGH>;
        rw-gpios = <&gpio 11 GPIO_ACTIVE_HIGH>;
        cs-gpios = <&gpio 108 GPIO_ACTIVE_HIGH>;

        data-gpios = <&gpio 32 GPIO_ACTIVE_HIGH>, <&gpio 33 GPIO_ACTIVE_HIGH>,
                     <&gpio 34 GPIO_ACTIVE_HIGH>, <&gpio 35 GPIO_ACTIVE_HIGH>,
                     <&gpio 36 GPIO_ACTIVE_HIGH>, <&gpio 37 GPIO_ACTIVE_HIGH>,
                     <&gpio 38 GPIO_ACTIVE_HIGH>, <&gpio 39 GPIO_ACTIVE_HIGH>;

        nvidia,init-sequence = <0x0000002c 0x0 0x0 0x00005000>;

        panel {
            compatible = "hit,tx10d07vm0baa";

            reset-gpios = <&gpio 175 GPIO_ACTIVE_LOW>;

            avci-supply = <&vcc_2v8_lcd>;
            iovcc-supply = <&iovcc_1v8_lcd>;

            backlight = <&backlight>;

            port {
                panel_input: endpoint {
                    remote-endpoint = <&bridge_output>;
                };
            };
        };

        ports {
            #address-cells = <1>;
            #size-cells = <0>;

            port@0 {
                reg = <0>;

                bridge_input: endpoint {
                    remote-endpoint = <&dpi_output>;
                };
            };

            port@1 {
                reg = <1>;

                bridge_output: endpoint {
                    remote-endpoint = <&panel_input>;
                };
            };
        };
    };
```

## Documentation/devicetree/bindings/display/tegra/nvidia,tegra30-csi.yaml
```yaml
# SPDX-License-Identifier: (GPL-2.0-only OR BSD-2-Clause)
%YAML 1.2
---
$id: http://devicetree.org/schemas/display/tegra/nvidia,tegra30-csi.yaml#
$schema: http://devicetree.org/meta-schemas/core.yaml#

title: NVIDIA Tegra30 CSI controller

maintainers:
  - Svyatoslav Ryhel <clamor95@gmail.com>

properties:
  compatible:
    enum:
      - nvidia,tegra30-csi

  reg:
    maxItems: 1

  clocks:
    items:
      - description: module clock
      - description: PAD A clock
      - description: PAD B clock

  clock-names:
    items:
      - const: csi
      - const: csia-pad
      - const: csib-pad

  avdd-dsi-csi-supply:
    description: DSI/CSI power supply. Must supply 1.2 V.

  power-domains:
    maxItems: 1

  "#nvidia,mipi-calibrate-cells":
    description: The number of cells in a MIPI calibration specifier.
      Should be 1. The single cell specifies an id of the pads that
      need to be calibrated for a given device.
    $ref: /schemas/types.yaml#/definitions/uint32
    const: 1

  "#address-cells":
    const: 1

  "#size-cells":
    const: 0

patternProperties:
  "^channel@[0-1]$":
    type: object
    description: channel 0 represents CSI-A and 1 represents CSI-B
    additionalProperties: false

    properties:
      reg:
        maxItems: 1

      nvidia,mipi-calibrate:
        description: Should contain a phandle and a specifier specifying
          which pads are used by this DSI output and need to be
          calibrated. 0 is for CSI-A, 1 is for CSI-B, 2 is for DSI-A and
          3 is for DSI-B
        $ref: /schemas/types.yaml#/definitions/phandle-array

      "#address-cells":
        const: 1

      "#size-cells":
        const: 0

      port@0:
        $ref: /schemas/graph.yaml#/$defs/port-base
        unevaluatedProperties: false
        description: port receiving the video stream from the sensor

        properties:
          endpoint:
            $ref: /schemas/media/video-interfaces.yaml#
            unevaluatedProperties: false

            properties:
              data-lanes: true

            required:
              - data-lanes

        required:
          - endpoint

      port@1:
        $ref: /schemas/graph.yaml#/properties/port
        description: port sending the video stream to the VI

    required:
      - reg
      - "#address-cells"
      - "#size-cells"
      - port@0
      - port@1

additionalProperties: false

required:
  - compatible
  - reg
  - clocks
  - clock-names
  - power-domains
  - "#address-cells"
  - "#size-cells"

# see nvidia,tegra20-vi.yaml for an example
```

## Documentation/devicetree/bindings/display/ti/ti,tpd12s015.yaml
```yaml
# SPDX-License-Identifier: (GPL-2.0-only OR BSD-2-Clause)
%YAML 1.2
---
$id: http://devicetree.org/schemas/display/ti/ti,tpd12s015.yaml#
$schema: http://devicetree.org/meta-schemas/core.yaml#

title: TI TPD12S015 HDMI level shifter and ESD protection chip

maintainers:
  - Tomi Valkeinen <tomi.valkeinen@ideasonboard.com>

description: |
  The TPD12S015 is an HDMI companion chip that combines a level shifter and
  ESD protection circuitry. It sits between an HDMI transmitter and the HDMI
  connector, and provides control over the level shifter enable and the
  hot-plug detect signals.

properties:
  compatible:
    oneOf:
      - const: ti,tpd12s015
      - items:
          - const: ti,tpd12s016
          - const: ti,tpd12s015

  gpios:
    description:
      The CT CP HPD, LS OE and HPD GPIOs, in that order. The first GPIO
      controls the level shifter, the second enables the level shifter
      outputs and the third reads the hot-plug detect line. Boards that
      also route the DDC lines through the chip use five entries, with
      the SCL and SDA GPIOs appended.
    minItems: 3
    maxItems: 5

  ports:
    $ref: /schemas/graph.yaml#/properties/ports

    properties:
      port@0:
        $ref: /schemas/graph.yaml#/$defs/port-base
        unevaluatedProperties: false
        description: HDMI input from the transmitter.

      port@1:
        $ref: /schemas/graph.yaml#/$defs/port-base
        unevaluatedProperties: false
        description: HDMI output to the connector.

    required:
      - port@0
      - port@1

required:
  - compatible
  - ports

additionalProperties: false

examples:
  - |
    #include <dt-bindings/gpio/gpio.h>

    encoder1 {
        compatible = "ti,tpd12s015";

        gpios = <&gpio2 28 GPIO_ACTIVE_HIGH>,    /* 60, CT CP HPD */
                <&gpio2 9 GPIO_ACTIVE_HIGH>,    /* 41, LS OE */
                <&gpio2 31 GPIO_ACTIVE_HIGH>;    /* 63, HPD */

        ports {
            #address-cells = <1>;
            #size-cells = <0>;

            port@0 {
                reg = <0>;

                tpd12s015_in: endpoint {
                    remote-endpoint = <&hdmi_out>;
                };
            };

            port@1 {
                reg = <1>;

                tpd12s015_out: endpoint {
                    remote-endpoint = <&hdmi_connector_in>;
                };
            };
        };
    };

...
```

## Documentation/devicetree/bindings/display/via,vt8500-fb.yaml
```yaml
# SPDX-License-Identifier: GPL-2.0-only OR BSD-2-Clause
%YAML 1.2
---
$id: http://devicetree.org/schemas/display/via,vt8500-fb.yaml#
$schema: http://devicetree.org/meta-schemas/core.yaml#

title: VIA VT8500 Framebuffer Controller

maintainers:
  - Kalyani Patra <kalyanipatra2003@gmail.com>

description:
  Framebuffer controller present on VIA VT8500 SoCs.

properties:
  compatible:
    const: via,vt8500-fb

  reg:
    maxItems: 1

  interrupts:
    maxItems: 1

  bits-per-pixel:
    description: Framebuffer bit depth
    enum: [16, 32]

  display-timings:
    $ref: /schemas/display/panel/display-timings.yaml#

required:
  - compatible
  - reg
  - interrupts
  - bits-per-pixel
  - display-timings

additionalProperties: false

examples:
  - |
    fb@d8050800 {
        compatible = "via,vt8500-fb";
        reg = <0xd800e400 0x400>;
        interrupts = <12>;
        bits-per-pixel = <16>;

        display-timings {
            native-mode = <&timing0>;
            timing0: timing0 {
                clock-frequency = <0>;
                hactive = <800>;
                vactive = <480>;
                hfront-porch = <40>;
                hback-porch = <88>;
                hsync-len = <0>;
                vback-porch = <32>;
                vfront-porch = <11>;
                vsync-len = <1>;
            };
        };
    };
```

## Documentation/devicetree/bindings/dma/andestech,ae350-dma.yaml
```yaml
# SPDX-License-Identifier: (GPL-2.0-only OR BSD-2-Clause)
%YAML 1.2
---
$id: http://devicetree.org/schemas/dma/andestech,ae350-dma.yaml#
$schema: http://devicetree.org/meta-schemas/core.yaml#

title: Andes ATCDMAC300 DMA Controller

maintainers:
  - CL Wang <cl634@andestech.com>

allOf:
  - $ref: dma-controller.yaml#

properties:
  compatible:
    oneOf:
      - items:
          - enum:
              - andestech,qilai-dma
          - const: andestech,ae350-dma
      - const: andestech,ae350-dma

  reg:
    minItems: 1
    maxItems: 2
    description:
      First entry is the DMA controller register range (required).
      Second entry is the cache control in IOCP controller (optional).

  reg-names:
    minItems: 1
    items:
      - const: dma
      - const: iocp

  interrupts:
    maxItems: 1

  "#dma-cells":
    const: 1

required:
  - compatible
  - reg
  - interrupts
  - "#dma-cells"

additionalProperties: false

examples:
  - |
    #include <dt-bindings/interrupt-controller/irq.h>

    soc {
        #address-cells = <2>;
        #size-cells = <2>;

        dma-controller@f0c00000 {
            compatible = "andestech,ae350-dma";
            reg = <0x0 0xf0c00000 0x0 0x1000>,
                  <0x0 0xe8000000 0x0 0x10>;
            reg-names = "dma", "iocp";
            interrupts = <10 IRQ_TYPE_LEVEL_HIGH>;
            #dma-cells = <1>;
        };
    };
...
```
