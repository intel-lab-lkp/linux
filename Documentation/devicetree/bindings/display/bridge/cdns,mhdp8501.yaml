## Documentation/devicetree/bindings/display/fsl,lcdif.yaml
```yaml
# SPDX-License-Identifier: (GPL-2.0-only OR BSD-2-Clause)
%YAML 1.2
---
$id: http://devicetree.org/schemas/display/fsl,lcdif.yaml#
$schema: http://devicetree.org/meta-schemas/core.yaml#

title: Freescale/NXP i.MX LCD Interface (LCDIF)

maintainers:
  - Marek Vasut <marex@denx.de>
  - Stefan Agner <stefan@agner.ch>

description: |
  (e)LCDIF display controller found in the Freescale/NXP i.MX SoCs.

properties:
  compatible:
    oneOf:
      - enum:
          - fsl,imx23-lcdif
          - fsl,imx28-lcdif
          - fsl,imx6sx-lcdif
          - fsl,imx8mp-lcdif
          - fsl,imx93-lcdif
      - items:
          - enum:
              - fsl,imx6sl-lcdif
              - fsl,imx6sll-lcdif
              - fsl,imx6ul-lcdif
              - fsl,imx7d-lcdif
              - fsl,imx8mm-lcdif
              - fsl,imx8mn-lcdif
              - fsl,imx8mq-lcdif
          - const: fsl,imx6sx-lcdif

  reg:
    maxItems: 1

  clocks:
    items:
      - description: Pixel clock
      - description: Bus clock
      - description: Display AXI clock
    minItems: 1

  clock-names:
    items:
      - const: pix
      - const: axi
      - const: disp_axi
    minItems: 1

  display:
    $ref: /schemas/types.yaml#/definitions/phandle
    description: The phandle for display timing information

  dmas:
    items:
      - description: DMA specifier for the RX DMA channel.

  dma-names:
    items:
      - const: rx

  interrupts:
    items:
      - description: LCDIF DMA interrupt
      - description: LCDIF Error interrupt
    minItems: 1

  lcd-supply:
    description: Regulator for LCD supply voltage.

  power-domains:
    maxItems: 1

  port:
    $ref: /schemas/graph.yaml#/properties/port
    description: The LCDIF output port

required:
  - compatible
  - reg
  - clocks
  - interrupts

patternProperties:
  'display([0-9])':
    description: Node with display timing parameters

additionalProperties: false

allOf:
  - if:
      properties:
        compatible:
          contains:
            const: fsl,imx6sx-lcdif
    then:
      properties:
        clocks:
          minItems: 2
          maxItems: 3
        clock-names:
          minItems: 2
          maxItems: 3
      required:
        - clock-names
  - if:
      properties:
        compatible:
          contains:
            enum:
              - fsl,imx8mp-lcdif
              - fsl,imx93-lcdif
    then:
      properties:
        clocks:
          minItems: 3
          maxItems: 3
        clock-names:
          minItems: 3
          maxItems: 3
      required:
        - clock-names
  - if:
      not:
        properties:
          compatible:
            contains:
              enum:
                - fsl,imx6sx-lcdif
                - fsl,imx8mp-lcdif
                - fsl,imx93-lcdif
    then:
      properties:
        clocks:
          maxItems: 1
        clock-names:
          maxItems: 1
  - if:
      properties:
        compatible:
          const: fsl,imx6sx-lcdif
    then:
      required:
        - power-domains
  - if:
      properties:
        compatible:
          contains:
            enum:
              - fsl,imx6sl-lcdif
              - fsl,imx8mm-lcdif
              - fsl,imx8mn-lcdif
              - fsl,imx8mp-lcdif
              - fsl,imx93-lcdif
    then:
      required:
        - power-domains
  - if:
      properties:
        compatible:
          contains:
            enum:
              - fsl,imx23-lcdif
    then:
      properties:
        interrupts:
          minItems: 2
          maxItems: 2
    else:
      properties:
        interrupts:
          maxItems: 1

  - if:
      not:
        properties:
          compatible:
            contains:
              enum:
                - fsl,imx28-lcdif
    then:
      properties:
        dmas: false
        dma-names: false

examples:
  - |
    #include <dt-bindings/clock/imx6sx-clock.h>
    #include <dt-bindings/interrupt-controller/arm-gic.h>

    display-controller@2220000 {
        compatible = "fsl,imx6sx-lcdif";
        reg = <0x02220000 0x4000>;
        interrupts = <GIC_SPI 5 IRQ_TYPE_LEVEL_HIGH>;
        clocks = <&clks IMX6SX_CLK_LCDIF1_PIX>,
                 <&clks IMX6SX_CLK_LCDIF_APB>,
                 <&clks IMX6SX_CLK_DISPLAY_AXI>;
        clock-names = "pix", "axi", "disp_axi";
        power-domains = <&pd_disp>;

        port {
            endpoint {
                remote-endpoint = <&panel_in>;
            };
        };
    };
  - |
    lcdif: lcdif@80030000 {
        compatible = "fsl,imx28-lcdif";
        reg = <0x80030000 0x2000>;
        interrupts = <38>;
        clocks = <&clks 55>;
        dmas = <&dma_apbh 13>;
        dma-names = "rx";
        pinctrl-names = "default";
        pinctrl-0 = <&lcdif_24bit_pins_a>, <&lcdif_sync_pins_bttc>,
                 <&lcdif_reset_pins_bttc>;
        lcd-supply = <&reg_3v3>;
        display = <&display0>;
        status = "okay";

        display0: display0 {
                bits-per-pixel = <32>;
                bus-width = <24>;
                display-timings {
                        native-mode = <&timing0>;
                        timing0: timing0 {
                                clock-frequency = <6500000>;
                                hactive = <320>;
                                vactive = <240>;
                                hfront-porch = <20>;
                                hback-porch = <38>;
                                hsync-len = <30>;
                                vfront-porch = <4>;
                                vback-porch = <14>;
                                vsync-len = <4>;
                                hsync-active = <0>;
                                vsync-active = <0>;
                                de-active = <0>;
                                pixelclk-active = <1>;
                        };
                };
        };
    };
...
```

## Documentation/devicetree/bindings/display/imx/fsl,imx8mp-hdmi-pai.yaml
```yaml
# SPDX-License-Identifier: (GPL-2.0-only OR BSD-2-Clause)
%YAML 1.2
---
$id: http://devicetree.org/schemas/display/imx/fsl,imx8mp-hdmi-pai.yaml#
$schema: http://devicetree.org/meta-schemas/core.yaml#

title: Freescale i.MX8MP HDMI Parallel Audio Interface

maintainers:
  - Shengjiu Wang <shengjiu.wang@nxp.com>

description:
  The HDMI TX Parallel Audio Interface (HTX_PAI) is a digital module that acts as the
  bridge between the Audio Subsystem to the HDMI TX Controller.

properties:
  compatible:
    const: fsl,imx8mp-hdmi-pai

  reg:
    maxItems: 1

  interrupts:
    maxItems: 1

  power-domains:
    maxItems: 1

  port:
    $ref: /schemas/graph.yaml#/properties/port
    description: Output to the HDMI TX controller.
    unevaluatedProperties: false

required:
  - compatible
  - reg
  - interrupts
  - power-domains
  - port

additionalProperties: false

examples:
  - |
    #include <dt-bindings/interrupt-controller/irq.h>
    #include <dt-bindings/power/imx8mp-power.h>

    hdmi@32fc4800 {
        compatible = "fsl,imx8mp-hdmi-pai";
        reg = <0x32fc4800 0x800>;
        interrupt-parent = <&irqsteer_hdmi>;
        interrupts = <14>;
        power-domains = <&hdmi_blk_ctrl IMX8MP_HDMIBLK_PD_PAI>;

        port {

            pai_to_hdmi_tx: endpoint {
                remote-endpoint = <&hdmi_tx_from_pai>;
            };
        };
    };
```

## Documentation/devicetree/bindings/display/imx/fsl,imx8qxp-dc-gammacor.yaml
```yaml
# SPDX-License-Identifier: (GPL-2.0-only OR BSD-2-Clause)
%YAML 1.2
---
$id: http://devicetree.org/schemas/display/imx/fsl,imx8qxp-dc-gammacor.yaml#
$schema: http://devicetree.org/meta-schemas/core.yaml#

title: Freescale i.MX8qxp Display Controller Gamma Correction Unit

description: |
  The unit supports non-linear color transformation.

  Each Gamma Correction Unit device should have an alias in the aliases node,
  in the form of dc<x>-gammacor<y>, where <x> is an integer specifying the
  Display Controller instance and <y> is an integer specifying the Gamma
  Correction Unit device instance.

maintainers:
  - Liu Ying <victor.liu@nxp.com>

properties:
  compatible:
    const: fsl,imx8qxp-dc-gammacor

  reg:
    maxItems: 1

required:
  - compatible
  - reg

additionalProperties: false

examples:
  - |
    gammacor@5618c000 {
        compatible = "fsl,imx8qxp-dc-gammacor";
        reg = <0x5618c000 0x20>;
    };
```

## Documentation/devicetree/bindings/display/imx/fsl,imx95-dc-domainblend.yaml
```yaml
# SPDX-License-Identifier: (GPL-2.0-only OR BSD-2-Clause)
%YAML 1.2
---
$id: http://devicetree.org/schemas/display/imx/fsl,imx95-dc-domainblend.yaml#
$schema: http://devicetree.org/meta-schemas/core.yaml#

title: Freescale i.MX95 Display Controller Domain Blend Unit

description: Combines two input frames to a single output frame.

maintainers:
  - Marek Vasut <marek.vasut@mailbox.org>

properties:
  compatible:
    const: fsl,imx95-dc-domainblend

  reg:
    maxItems: 1

required:
  - compatible
  - reg

additionalProperties: false

examples:
  - |
    domainblend@4b6a0000 {
        compatible = "fsl,imx95-dc-domainblend";
        reg = <0x4b6a0000 0x10>;
    };
```

## Documentation/devicetree/bindings/display/imx/nxp,imx94-dcif.yaml
```yaml
# SPDX-License-Identifier: (GPL-2.0 OR BSD-2-Clause)
# Copyright 2025 NXP
%YAML 1.2
---
$id: http://devicetree.org/schemas/display/imx/nxp,imx94-dcif.yaml#
$schema: http://devicetree.org/meta-schemas/core.yaml#

title: i.MX94 Display Control Interface (DCIF)

maintainers:
  - Laurentiu Palcu <laurentiu.palcu@oss.nxp.com>

description:
  The Display Control Interface(DCIF) is a system master that fetches graphics
  stored in memory and displays them on a TFT LCD panel or connects to a
  display interface depending on the chip configuration.

properties:
  compatible:
    const: nxp,imx94-dcif

  reg:
    maxItems: 1

  interrupts:
    items:
      - description: CPU domain 0 (controlled by common registers group).
      - description: CPU domain 1 (controlled by background layer registers group).
      - description: CPU domain 2 (controlled by foreground layer registers group).

  interrupt-names:
    items:
      - const: common
      - const: bg_layer
      - const: fg_layer

  clocks:
    maxItems: 3

  clock-names:
    items:
      - const: apb
      - const: axi
      - const: pix

  power-domains:
    maxItems: 1

  port:
    $ref: /schemas/graph.yaml#/$defs/port-base
    unevaluatedProperties: false
    description: Display Pixel Interface(DPI) output port

    properties:
      endpoint:
        $ref: /schemas/media/video-interfaces.yaml#
        unevaluatedProperties: false

required:
  - compatible
  - reg
  - interrupts
  - clocks
  - power-domains
  - port

additionalProperties: false

examples:
  - |
    #include <dt-bindings/interrupt-controller/arm-gic.h>

    display-controller@4b120000 {
        compatible = "nxp,imx94-dcif";
        reg = <0x4b120000 0x300000>;
        interrupts = <GIC_SPI 377 IRQ_TYPE_LEVEL_HIGH>,
                     <GIC_SPI 378 IRQ_TYPE_LEVEL_HIGH>,
                     <GIC_SPI 379 IRQ_TYPE_LEVEL_HIGH>;
        interrupt-names = "common", "bg_layer", "fg_layer";
        clocks = <&scmi_clk 69>, <&scmi_clk 70>, <&dispmix_csr 0>;
        clock-names = "apb", "axi", "pix";
        assigned-clocks = <&dispmix_csr 0>;
        assigned-clock-parents = <&ldb_pll_pixel>;
        power-domains = <&scmi_devpd 11>;
        port {
            dcif_out: endpoint {
                remote-endpoint = <&ldb_in>;
            };
        };
    };
```

## Documentation/devicetree/bindings/display/linux,boot-logo-clut224.yaml
```yaml
# SPDX-License-Identifier: (GPL-2.0-only OR BSD-2-Clause)
%YAML 1.2
---
$id: http://devicetree.org/schemas/display/linux,boot-logo-clut224.yaml#
$schema: http://devicetree.org/meta-schemas/core.yaml#

title: Boot logo supplied by the device tree

maintainers:
  - Max Pedraza <maximpedraza@gmail.com>

description: |
  Embedded systems commonly need a product specific boot logo. Today that
  means pointing CONFIG_LOGO_LINUX_CLUT224_FILE at a different image, which
  bakes it into the kernel image: changing the logo means building and
  deploying a new kernel.

  This node lets the boot logo be described by the device tree instead, so that
  a single kernel image can serve several products, or several revisions of the
  same product, that only differ in branding.

  Since a logo is configuration rather than a description of the hardware, the
  node lives under /chosen, next to the other things firmware hands to the
  operating system. Open Firmware, which the device tree descends from, carried
  a boot logo in the same spirit as the oem-logo variable under /options.

  The image is stored in the same paletted format the in-kernel CLUT224 logos
  use: a palette of at most 224 RGB entries plus one palette index per pixel.

properties:
  compatible:
    const: linux,boot-logo-clut224

  width:
    $ref: /schemas/types.yaml#/definitions/uint32
    description: Logo width in pixels.
    minimum: 1
    maximum: 65535

  height:
    $ref: /schemas/types.yaml#/definitions/uint32
    description: Logo height in pixels.
    minimum: 1
    maximum: 65535

  clut:
    $ref: /schemas/types.yaml#/definitions/uint8-array
    description:
      Colour lookup table, as consecutive red, green and blue bytes per entry.
      The number of entries is derived from the property length and must not
      exceed 224.
    minItems: 3
    maxItems: 672

  data:
    $ref: /schemas/types.yaml#/definitions/uint8-array
    description:
      One byte per pixel, left to right and top to bottom, each byte being an
      index into the colour lookup table. The property length must be equal to
      width multiplied by height.

  logo-position:
    $ref: /schemas/types.yaml#/definitions/uint32-array
    description:
      X and Y coordinates, in pixels, of the top left corner of the logo.
      Defaults to the top left corner of the screen.
    items:
      - description: X coordinate
      - description: Y coordinate

  logo-offset:
    $ref: /schemas/types.yaml#/definitions/int32-array
    description:
      X and Y displacement, in pixels, applied after the logo has been placed.
      Mostly useful together with logo-centered.
    items:
      - description: X displacement
      - description: Y displacement

  logo-centered:
    type: boolean
    description:
      Centre the logo on the screen, overriding logo-position.

  logo-rotation:
    $ref: /schemas/types.yaml#/definitions/string
    description: Rotation applied to the logo before it is drawn.
    enum: [none, cw, ccw, ud]
    default: none

required:
  - compatible
  - width
  - height
  - clut
  - data

# The image either lives in the device tree or in a reserved memory region,
# never both.
oneOf:
  - required:
      - width
      - height
      - clut
      - data
  - required:
      - memory-region

additionalProperties: false

examples:
  - |
    // A 4x2 logo using three colours, centred on the screen.
    / {
        #address-cells = <1>;
        #size-cells = <1>;

        chosen {
            logo {
                compatible = "linux,boot-logo-clut224";
                width = <4>;
                height = <2>;
                clut = /bits/ 8 <0xff 0x00 0x00
                                 0x00 0xff 0x00
                                 0x00 0x00 0xff>;
                data = /bits/ 8 <0x00 0x01 0x01 0x00
                                 0x02 0x00 0x00 0x02>;
                logo-centered;
            };
        };
    };
```
