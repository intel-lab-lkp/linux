## Documentation/devicetree/bindings/display/bridge/microchip,sam9x75-mipi-dsi.yaml
```yaml
# SPDX-License-Identifier: (GPL-2.0-only OR BSD-2-Clause)
%YAML 1.2
---
$id: http://devicetree.org/schemas/display/bridge/microchip,sam9x75-mipi-dsi.yaml#
$schema: http://devicetree.org/meta-schemas/core.yaml#

title: Microchip SAM9X75 MIPI DSI Controller

maintainers:
  - Manikandan Muralidharan <manikandan.m@microchip.com>

description:
  Microchip specific extensions or wrapper to the Synopsys Designware MIPI DSI.
  The MIPI Display Serial Interface (DSI) Host Controller implements all
  protocol functions defined in the MIPI DSI Specification.The DSI Host
  provides an interface between the LCD Controller (LCDC) and the MIPI D-PHY,
  allowing communication with a DSI-compliant display.

allOf:
  - $ref: /schemas/display/dsi-controller.yaml#

properties:
  compatible:
    const: microchip,sam9x75-mipi-dsi

  reg:
    maxItems: 1

  clocks:
    items:
      - description:
          Peripheral Bus Clock between LCDC and MIPI DPHY
      - description:
          MIPI DPHY Interface reference clock for PLL block

  clock-names:
    items:
      - const: pclk
      - const: refclk

  ports:
    $ref: /schemas/graph.yaml#/properties/ports

    properties:
      port@0:
        $ref: /schemas/graph.yaml#/$defs/port-base
        unevaluatedProperties: false
        description:
          DSI Input port node, connected to the LCDC RGB output port.

        properties:
          endpoint:
            $ref: /schemas/media/video-interfaces.yaml#
            unevaluatedProperties: false

      port@1:
        $ref: /schemas/graph.yaml#/$defs/port-base
        unevaluatedProperties: false
        description:
          DSI Output port node, connected to a panel or a bridge input port.

        properties:
          endpoint:
            $ref: /schemas/media/video-interfaces.yaml#
            unevaluatedProperties: false

required:
  - compatible
  - reg
  - clocks
  - clock-names
  - ports

unevaluatedProperties: false

examples:
  - |
     #include <dt-bindings/clock/at91.h>
     #include <dt-bindings/gpio/gpio.h>

     dsi@f8054000 {
       compatible = "microchip,sam9x75-mipi-dsi";
       reg = <0xf8054000 0x200>;
       clocks = <&pmc PMC_TYPE_PERIPHERAL 54>, <&pmc PMC_TYPE_GCK 55>;
       clock-names = "pclk", "refclk";

       #address-cells = <1>;
       #size-cells = <0>;

       ports {
         #address-cells = <1>;
         #size-cells = <0>;

         port@0 {
           reg = <0>;
           dsi_in: endpoint {
             remote-endpoint = <&hlcdc_panel_output>;
           };
         };

         port@1 {
           reg = <1>;
           dsi_out: endpoint {
             remote-endpoint = <&mipi_in_panel>;
           };
         };
       };
     };
...
```

## Documentation/devicetree/bindings/display/bridge/simple-bridge.yaml
```yaml
# SPDX-License-Identifier: (GPL-2.0-only OR BSD-2-Clause)
%YAML 1.2
---
$id: http://devicetree.org/schemas/display/bridge/simple-bridge.yaml#
$schema: http://devicetree.org/meta-schemas/core.yaml#

title: Transparent non-programmable DRM bridges

maintainers:
  - Laurent Pinchart <laurent.pinchart+renesas@ideasonboard.com>
  - Maxime Ripard <mripard@kernel.org>

description: |
  This binding supports transparent non-programmable bridges that don't require
  any configuration, with a single input and a single output.

properties:
  compatible:
    oneOf:
      - items:
          - enum:
              - ti,ths8134a
              - ti,ths8134b
          - const: ti,ths8134
      - items:
          - const: corpro,gm7123
          - const: adi,adv7123
      - enum:
          - adi,adv7123
          - dpi-color-encoder
          - dumb-vga-dac
          - ti,opa362
          - ti,ths8134
          - ti,ths8135

  ports:
    $ref: /schemas/graph.yaml#/properties/ports

    properties:
      port@0:
        $ref: /schemas/graph.yaml#/$defs/port-base
        unevaluatedProperties: false
        description: The bridge input

        properties:
          endpoint:
            $ref: /schemas/media/video-interfaces.yaml#
            unevaluatedProperties: false

            properties:
              dpi-color-coding: true

      port@1:
        $ref: /schemas/graph.yaml#/$defs/port-base
        unevaluatedProperties: false
        description: The bridge output

        properties:
          endpoint:
            $ref: /schemas/media/video-interfaces.yaml#
            unevaluatedProperties: false

            properties:
              dpi-color-coding: true

    required:
      - port@0
      - port@1

  enable-gpios:
    maxItems: 1
    description: GPIO controlling bridge enable

  vdd-supply:
    description: Power supply for the bridge

required:
  - compatible
  - ports

additionalProperties: false

allOf:
  - $ref: /schemas/display/dpi-color-coding.yaml#
  - if:
      properties:
        compatible:
          contains:
            const: dpi-color-encoder
    then:
      properties:
        ports:
          properties:
            port@0:
              properties:
                endpoint:
                  required:
                    - dpi-color-coding

            port@1:
              properties:
                endpoint:
                  required:
                    - dpi-color-coding
    else:
      properties:
        ports:
          properties:
            port@0:
              properties:
                endpoint:
                  properties:
                    dpi-color-coding: false

            port@1:
              properties:
                endpoint:
                  properties:
                    dpi-color-coding: false

examples:
  - |
    bridge {
        compatible = "ti,ths8134a", "ti,ths8134";

        ports {
            #address-cells = <1>;
            #size-cells = <0>;

            port@0 {
                reg = <0>;

                vga_bridge_in: endpoint {
                    remote-endpoint = <&tcon0_out_vga>;
                };
            };

            port@1 {
                reg = <1>;

                vga_bridge_out: endpoint {
                    remote-endpoint = <&vga_con_in>;
                };
            };
        };
    };

  - |
    bridge {
        compatible = "dpi-color-enoder";

        ports {
            #address-cells = <1>;
            #size-cells = <0>;

            port@0 {
                reg = <0>;

                dpi_in: endpoint {
                    remote-endpoint = <&dc_out>;
                    dpi-color-coding = "18bit-configuration1";
                };
            };

            port@1 {
                reg = <1>;

                dpi_out: endpoint {
                    remote-endpoint = <&panel_in>;
                    dpi-color-coding = "24bit";
                };
            };
        };
    };

...
```

## Documentation/devicetree/bindings/display/bridge/starfive,jh7110-inno-hdmi-controller.yaml
```yaml
# SPDX-License-Identifier: (GPL-2.0-only OR BSD-2-Clause)
%YAML 1.2
---
$id: http://devicetree.org/schemas/display/bridge/starfive,jh7110-inno-hdmi-controller.yaml#
$schema: http://devicetree.org/meta-schemas/core.yaml#

title: StarFive JH7110 Innosilicon HDMI Controller

maintainers:
  - Michal Wilczynski <m.wilczynski@samsung.com>

description:
  The controller portion of the StarFive JH7110 INNO HDMI IP.

properties:
  compatible:
    const: starfive,jh7110-inno-hdmi-controller

  interrupts:
    maxItems: 1

  clocks:
    items:
      - description: The HDMI controller main clock
      - description: Audio master clock
      - description: Audio bit clock, from the I2S transmitter
      - description: The pixel clock, generated by the PHY

  clock-names:
    items:
      - const: pclk
      - const: mclk
      - const: bclk
      - const: pixel

  resets:
    maxItems: 1

  phys:
    maxItems: 1

  starfive,vout-syscon:
    $ref: /schemas/types.yaml#/definitions/phandle
    description:
      Phandle to the dom_vout_syscon system controller, which holds the mux
      selecting the DC8200 output that drives the HDMI transmitter.

  ports:
    $ref: /schemas/graph.yaml#/properties/ports

    properties:
      port@0:
        $ref: /schemas/graph.yaml#/properties/port
        description:
          Input from the DC8200. The remote port number selects the DC8200
          panel and the remote endpoint number the interface on that panel,
          0 for DPI and 1 for DP.

      port@1:
        $ref: /schemas/graph.yaml#/properties/port
        description: Output to the HDMI connector.

    required:
      - port@0
      - port@1

required:
  - compatible
  - interrupts
  - clocks
  - clock-names
  - resets
  - phys
  - starfive,vout-syscon
  - ports

additionalProperties: false

examples:
  # Shown as a child of the HDMI subsystem node; see
  # Documentation/devicetree/bindings/mfd/starfive,jh7110-hdmi-subsystem.yaml
  # for the full node.
  - |
    #include <dt-bindings/clock/starfive,jh7110-crg.h>
    #include <dt-bindings/reset/starfive,jh7110-crg.h>

    controller {
        compatible = "starfive,jh7110-inno-hdmi-controller";
        clocks = <&voutcrg JH7110_VOUTCLK_HDMI_TX_SYS>,
                 <&voutcrg JH7110_VOUTCLK_HDMI_TX_MCLK>,
                 <&voutcrg JH7110_VOUTCLK_HDMI_TX_BCLK>,
                 <&hdmi_phy>;
        clock-names = "pclk", "mclk", "bclk", "pixel";
        interrupts = <99>;
        phys = <&hdmi_phy>;
        resets = <&voutcrg JH7110_VOUTRST_HDMI_TX_HDMI>;
        starfive,vout-syscon = <&vout_syscon>;

        ports {
            #address-cells = <1>;
            #size-cells = <0>;

            port@0 {
                reg = <0>;

                endpoint {
                    remote-endpoint = <&dpu_out_dpi0>;
                };
            };

            port@1 {
                reg = <1>;

                endpoint {
                    remote-endpoint = <&hdmi_con_in>;
                };
            };
        };
    };

...
```

## Documentation/devicetree/bindings/display/bridge/thine,thc63lvd827.yaml
```yaml
# SPDX-License-Identifier: (GPL-2.0-only OR BSD-2-Clause)
%YAML 1.2
---
$id: http://devicetree.org/schemas/display/bridge/thine,thc63lvd827.yaml#
$schema: http://devicetree.org/meta-schemas/core.yaml#

title: THine THC63LVD827 DPI to LVDS encoder

maintainers:
  - Francesco Dolcini <francesco.dolcini@toradex.com>

description: >
  The THC63LVD827 converts a 24-bit parallel RGB interface plus HSYNC,
  VSYNC and data-enable to single-link or dual-link LVDS.

  The LVDS output data mapping is configured using the MAP and 6B/8B inputs,
  that can be controlled by GPIOs.

  The LVDS output link mode (single/dual) is configured using the MODE input.

  The parallel interface pixel clock sample polarity is configurable with the
  R/F input strap option.

properties:
  compatible:
    const: thine,thc63lvd827

  map-gpios:
    maxItems: 1
    description:
      GPIO connected to the MAP input. A high level selects Mapping Mode 1
      and a low level selects Mapping Mode 2.

  mode-gpios:
    maxItems: 1
    description:
      GPIO connected to the MODE input. A high level selects single-link
      LVDS output and a low level selects dual-link LVDS output.

  b6b8-gpios:
    maxItems: 1
    description:
      GPIO connected to the 6B/8B input. A high level selects 6-bit (21-bit)
      mode and a low level selects 8-bit (27-bit) mode.

  powerdown-gpios:
    maxItems: 1
    description:
      GPIO connected to the active-low /PDWN input. A high level selects
      normal operation and a low level power down the chip.

  vcc-supply:
    description: Power supply for the digital circuitry (1.8V).

  pllvcc-supply:
    description: Power supply for the PLL circuitry (1.8V).

  lvdsvcc-supply:
    description: Power supply for the LVDS outputs (1.8V).

  iovcc-supply:
    description: Power supply for the IO inputs circuitry (1.8V, 2.5V or 3.3V).

  ports:
    $ref: /schemas/graph.yaml#/properties/ports

    properties:
      port@0:
        $ref: /schemas/graph.yaml#/$defs/port-base
        unevaluatedProperties: false
        description: Parallel RGB input

        properties:
          endpoint:
            $ref: /schemas/media/video-interfaces.yaml
            unevaluatedProperties: false

            properties:
              pclk-sample:
                description:
                  Sample data on falling (0) or rising (1) edges of the pixel
                  clock signal.
                enum: [ 0, 1 ]
                default: 0

      port@1:
        $ref: /schemas/graph.yaml#/properties/port
        description: LVDS output 1st link, used in single- and dual-link mode.

      port@2:
        $ref: /schemas/graph.yaml#/properties/port
        description: Optional LVDS output 2nd link, for dual-link mode.

    required:
      - port@0
      - port@1

required:
  - compatible
  - ports

additionalProperties: false

examples:
  - |
    #include <dt-bindings/gpio/gpio.h>

    lvds-encoder {
        compatible = "thine,thc63lvd827";

        map-gpios = <&gpio4 10 GPIO_ACTIVE_HIGH>;
        mode-gpios = <&gpio4 11 GPIO_ACTIVE_HIGH>;
        powerdown-gpios = <&gpio4 12 GPIO_ACTIVE_LOW>;

        ports {
            #address-cells = <1>;
            #size-cells = <0>;

            port@0 {
                reg = <0>;

                endpoint {
                    pclk-sample = <1>;
                    remote-endpoint = <&dpi_out>;
                };
            };

            port@1 {
                reg = <1>;

                endpoint {
                    remote-endpoint = <&lvds_display_in>;
                };
            };
        };
    };

...
```
