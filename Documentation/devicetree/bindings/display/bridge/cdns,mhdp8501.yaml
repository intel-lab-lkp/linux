## Documentation/devicetree/bindings/display/mayqueen,pixpaper.yaml
```yaml
# SPDX-License-Identifier: (GPL-2.0 OR BSD-2-Clause)
%YAML 1.2
---
$id: http://devicetree.org/schemas/display/mayqueen,pixpaper.yaml#
$schema: http://devicetree.org/meta-schemas/core.yaml#

title: Mayqueen Pixpaper e-ink display panels

maintainers:
  - LiangCheng Wang <zaq14760@gmail.com>

description:
  Mayqueen Pixpaper e-ink display panels are controlled via an SPI interface
  and require GPIO pins for reset, busy, and data/command control. Different
  panel models use model-specific command sequences selected via their
  compatible strings.

allOf:
  - $ref: /schemas/spi/spi-peripheral-props.yaml#

properties:
  compatible:
    enum:
      - mayqueen,pixpaper
      - mayqueen,pixpaper-426m

  reg:
    maxItems: 1

  spi-max-frequency:
    maximum: 1000000
    default: 1000000

  reset-gpios:
    maxItems: 1

  busy-gpios:
    maxItems: 1

  dc-gpios:
    maxItems: 1

required:
  - compatible
  - reg
  - reset-gpios
  - busy-gpios
  - dc-gpios

unevaluatedProperties: false

examples:
  - |
    #include <dt-bindings/gpio/gpio.h>
    spi {
        #address-cells = <1>;
        #size-cells = <0>;
        display@0 {
            compatible = "mayqueen,pixpaper";
            reg = <0>;
            spi-max-frequency = <1000000>;
            reset-gpios = <&gpio1 17 GPIO_ACTIVE_HIGH>;
            busy-gpios = <&gpio1 18 GPIO_ACTIVE_HIGH>;
            dc-gpios = <&gpio1 19 GPIO_ACTIVE_HIGH>;
        };
    };
```

## Documentation/devicetree/bindings/display/mediatek/mediatek,disp-tdshp.yaml
```yaml
# SPDX-License-Identifier: (GPL-2.0-only OR BSD-2-Clause)
%YAML 1.2
---
$id: http://devicetree.org/schemas/display/mediatek/mediatek,disp-tdshp.yaml#
$schema: http://devicetree.org/meta-schemas/core.yaml#

title: MediaTek display 2D sharpness processor

maintainers:
  - Chun-Kuang Hu <chunkuang.hu@kernel.org>
  - Philipp Zabel <p.zabel@pengutronix.de>

description: |
  MediaTek display 2D sharpness processor, namely TDSHP, provides a
  operation used to adjust sharpness in display system.

properties:
  compatible:
    enum:
      - mediatek,mt8196-disp-tdshp

  reg:
    maxItems: 1

  clocks:
    maxItems: 1

required:
  - compatible
  - reg
  - clocks

additionalProperties: false

examples:
  - |
    soc {
        #address-cells = <2>;
        #size-cells = <2>;

        disp-tdshp@321e0000 {
            compatible = "mediatek,mt8196-disp-tdshp";
            reg = <0 0x321e0000 0 0x1000>;
            clocks = <&dispsys_config_clk 107>;
        };
    };
```

## Documentation/devicetree/bindings/display/mediatek/mediatek,outproc.yaml
```yaml
# SPDX-License-Identifier: (GPL-2.0-only OR BSD-2-Clause)
%YAML 1.2
---
$id: http://devicetree.org/schemas/display/mediatek/mediatek,outproc.yaml#
$schema: http://devicetree.org/meta-schemas/core.yaml#

title: MediaTek display overlap output processor

maintainers:
  - Chun-Kuang Hu <chunkuang.hu@kernel.org>
  - Philipp Zabel <p.zabel@pengutronix.de>

description:
  MediaTek display overlap output processor, namely OVL_OUTPROC or OUTPROC,
  handles the post-stage of pixel processing in the overlapping procedure.
  OVL_OUTPROC manages pixels for gamma correction and ensures that pixel
  values are within the correct range.

properties:
  compatible:
    const: mediatek,mt8196-outproc

  reg:
    maxItems: 1

  clocks:
    maxItems: 1

  interrupts:
    maxItems: 1

required:
  - compatible
  - reg
  - clocks

additionalProperties: false

examples:
  - |
    #include <dt-bindings/interrupt-controller/arm-gic.h>
    #include <dt-bindings/interrupt-controller/irq.h>

    soc {
        #address-cells = <2>;
        #size-cells = <2>;

        outproc0: outproc@32970000 {
            compatible = "mediatek,mt8196-outproc";
            reg = <0 0x32970000 0 0x1000>;
            clocks = <&ovlsys_config_clk 49>;
            interrupts = <GIC_SPI 450 IRQ_TYPE_LEVEL_HIGH 0>;
        };
    };
```

## Documentation/devicetree/bindings/display/nxp,pcd8544.yaml
```yaml
# SPDX-License-Identifier: (GPL-2.0-only OR BSD-2-Clause)
%YAML 1.2
---
$id: http://devicetree.org/schemas/display/nxp,pcd8544.yaml#
$schema: http://devicetree.org/meta-schemas/core.yaml#

title: Philips Semiconductors PCD8544 LCD Display Controller

maintainers:
  - Viktar Simanenka <viteosen@gmail.com>

description: |
  Philips Semiconductors PCD8544 LCD Display Controller with SPI control bus.
  Designed to drive a graphic display of 48 rows and 84 columns,
  such as Nokia 5110/3310 LCDs.

allOf:
  - $ref: /schemas/spi/spi-peripheral-props.yaml#

properties:
  compatible:
    enum:
      - nxp,pcd8544

  dc-gpios:
    maxItems: 1
    description: Data/Command selection pin (D/CX).

  reset-gpios:
    maxItems: 1
    description: Display Reset pin (RST).

  backlight:
    $ref: /schemas/types.yaml#/definitions/phandle
    description: |
      Phandle of the backlight device. The display may have an LED pin that
      controls the backlight through GPIO or PWM.

  nxp,inverted:
    type: boolean
    description: Display color inversion.

  nxp,voltage-op:
    $ref: /schemas/types.yaml#/definitions/uint32
    minimum: 0
    maximum: 127
    description: |
      Liquid crystall voltage operation coefficient. Determines the LCD
      controlling voltage on display segments. Should be adjusted according
      to the ambient temperature. Adjusts the contrast of the display.

  nxp,temperature-coeff:
    $ref: /schemas/types.yaml#/definitions/uint32
    minimum: 0
    maximum: 3
    description: |
      Display temperature compensation coefficient. Increases LCD controlling
      voltage at lower temperatures to maintain optimum contrast.

  nxp,bias:
    $ref: /schemas/types.yaml#/definitions/uint32
    minimum: 0
    maximum: 7
    description: |
      Display bias system coefficient. Should only be changed if an external
      oscillator is used for the display.

required:
  - compatible
  - reg
  - dc-gpios
  - reset-gpios

unevaluatedProperties: false

examples:
  - |
    #include <dt-bindings/gpio/gpio.h>

    spi {
        #address-cells = <1>;
        #size-cells = <0>;

        display@0 {
            compatible = "nxp,pcd8544";
            reg = <0>;
            spi-max-frequency = <8000000>;

            dc-gpios = <&pio 0 3 GPIO_ACTIVE_HIGH>; /* DC=PA3 */
            reset-gpios = <&pio 0 1 GPIO_ACTIVE_HIGH>; /* RESET=PA1 */
            backlight = <&backlight>;

            nxp,inverted;
            nxp,voltage-op = <0>;
            nxp,bias = <4>;
            nxp,temperature-coeff = <0>;
        };
    };

...
```

## Documentation/devicetree/bindings/display/panel/anbernic,rg35xx-plus-rev6-panel.yaml
```yaml
# SPDX-License-Identifier: (GPL-2.0-only OR BSD-2-Clause)
%YAML 1.2
---
$id: http://devicetree.org/schemas/display/panel/anbernic,rg35xx-plus-rev6-panel.yaml#
$schema: http://devicetree.org/meta-schemas/core.yaml#

title: Anbernic RG35XX series (YLM-LBV0345001H-V2) 3.45" 640x480 24-bit IPS LCD panel

maintainers:
  - Hironori KIKUCHI <kikuchan98@gmail.com>

allOf:
  - $ref: panel-common.yaml#
  - $ref: /schemas/spi/spi-peripheral-props.yaml#

properties:
  compatible:
    const: anbernic,rg35xx-plus-rev6-panel

  reg:
    maxItems: 1

  spi-3wire: true

required:
  - compatible
  - reg
  - port
  - power-supply
  - reset-gpios

unevaluatedProperties: false

examples:
  - |
    #include <dt-bindings/gpio/gpio.h>

    spi {
        #address-cells = <1>;
        #size-cells = <0>;

        panel@0 {
            compatible = "anbernic,rg35xx-plus-rev6-panel";
            reg = <0>;

            spi-3wire;
            spi-max-frequency = <3125000>;

            reset-gpios = <&pio 8 14 GPIO_ACTIVE_LOW>; // PI14

            backlight = <&backlight>;
            power-supply = <&reg_lcd>;

            port {
                endpoint {
                    remote-endpoint = <&tcon_lcd0_out_lcd>;
                };
            };
        };
    };
```

## Documentation/devicetree/bindings/display/panel/anbernic,rg40xx-panel.yaml
```yaml
# SPDX-License-Identifier: (GPL-2.0-only OR BSD-2-Clause)
%YAML 1.2
---
$id: http://devicetree.org/schemas/display/panel/anbernic,rg40xx-panel.yaml#
$schema: http://devicetree.org/meta-schemas/core.yaml#

title: Anbernic RG40XX series (YLM-LBV0400001X-V1) 4.00" 640x480 24-bit IPS LCD panel

maintainers:
  - Hironori KIKUCHI <kikuchan98@gmail.com>

allOf:
  - $ref: panel-common.yaml#
  - $ref: /schemas/spi/spi-peripheral-props.yaml#

properties:
  compatible:
    const: anbernic,rg40xx-panel

  reg:
    maxItems: 1

  spi-3wire: true

required:
  - compatible
  - reg
  - port
  - power-supply
  - reset-gpios

unevaluatedProperties: false

examples:
  - |
    #include <dt-bindings/gpio/gpio.h>

    spi {
        #address-cells = <1>;
        #size-cells = <0>;

        panel@0 {
            compatible = "anbernic,rg40xx-panel";
            reg = <0>;

            spi-3wire;
            spi-max-frequency = <3125000>;

            reset-gpios = <&pio 8 14 GPIO_ACTIVE_LOW>; // PI14

            backlight = <&backlight>;
            power-supply = <&reg_lcd>;

            port {
                endpoint {
                    remote-endpoint = <&tcon_lcd0_out_lcd>;
                };
            };
        };
    };
```

## Documentation/devicetree/bindings/display/panel/anbernic,rgcubexx-panel.yaml
```yaml
# SPDX-License-Identifier: (GPL-2.0-only OR BSD-2-Clause)
%YAML 1.2
---
$id: http://devicetree.org/schemas/display/panel/anbernic,rgcubexx-panel.yaml#
$schema: http://devicetree.org/meta-schemas/core.yaml#

title: Anbernic RG CubeXX (YLM-LBN0395004H-V1) 3.95" 720x720 24-bit IPS LCD panel

maintainers:
  - Hironori KIKUCHI <kikuchan98@gmail.com>

allOf:
  - $ref: panel-common.yaml#
  - $ref: /schemas/spi/spi-peripheral-props.yaml#

properties:
  compatible:
    const: anbernic,rgcubexx-panel

  reg:
    maxItems: 1

  spi-3wire: true

required:
  - compatible
  - reg
  - port
  - power-supply
  - reset-gpios

unevaluatedProperties: false

examples:
  - |
    #include <dt-bindings/gpio/gpio.h>

    spi {
        #address-cells = <1>;
        #size-cells = <0>;

        panel@0 {
            compatible = "anbernic,rgcubexx-panel";
            reg = <0>;

            spi-3wire;
            spi-max-frequency = <3125000>;

            reset-gpios = <&pio 8 14 GPIO_ACTIVE_LOW>; // PI14

            backlight = <&backlight>;
            power-supply = <&reg_lcd>;

            port {
                endpoint {
                    remote-endpoint = <&tcon_lcd0_out_lcd>;
                };
            };
        };
    };
```

## Documentation/devicetree/bindings/display/panel/anbernic,ylm-lbv0345001h-v2.yaml
```yaml
# SPDX-License-Identifier: (GPL-2.0-only OR BSD-2-Clause)
%YAML 1.2
---
$id: http://devicetree.org/schemas/display/panel/anbernic,ylm-lbv0345001h-v2.yaml#
$schema: http://devicetree.org/meta-schemas/core.yaml#

title: Anbernic RG35XX series (YLM-LBV0345001H-V2) 3.45" 640x480 24-bit IPS LCD panel

maintainers:
  - Hironori KIKUCHI <kikuchan98@gmail.com>

allOf:
  - $ref: panel-common.yaml#
  - $ref: /schemas/spi/spi-peripheral-props.yaml#

properties:
  compatible:
    oneOf:
      - const: anbernic,ylm-lbv0345001h-v2
      - items:
          - enum:
              - anbernic,rg35xx-2024-panel
              - anbernic,rg35xx-h-panel
              - anbernic,rg35xx-sp-panel
              - anbernic,rg35xx-plus-panel
          - const: anbernic,ylm-lbv0345001h-v2

  reg:
    maxItems: 1

  spi-3wire: true

required:
  - compatible
  - reg
  - port
  - power-supply
  - reset-gpios

unevaluatedProperties: false

examples:
  - |
    #include <dt-bindings/gpio/gpio.h>

    spi {
        #address-cells = <1>;
        #size-cells = <0>;

        panel@0 {
            compatible = "anbernic,ylm-lbv0345001h-v2";
            reg = <0>;

            spi-3wire;
            spi-max-frequency = <3125000>;

            reset-gpios = <&pio 8 14 GPIO_ACTIVE_LOW>; // PI14

            backlight = <&backlight>;
            power-supply = <&reg_lcd>;

            port {
                endpoint {
                    remote-endpoint = <&tcon_lcd0_out_lcd>;
                };
            };
        };
    };
```
