## Documentation/devicetree/bindings/display/bridge/ti,tmds181.yaml
```yaml
# SPDX-License-Identifier: (GPL-2.0-only OR BSD-2-Clause)
%YAML 1.2
---
$id: http://devicetree.org/schemas/display/bridge/ti,tmds181.yaml#
$schema: http://devicetree.org/meta-schemas/core.yaml#

title: TMDS181 and SN65DP159 HDMI retimer/redriver chips

maintainers:
  - Mike Looijmans <mike.looijmans@topic.nl>

description: |
  Texas Instruments TMDS181 and SN65DP159 retimer and redriver chips.
  https://www.ti.com/product/TMDS181
  https://www.ti.com/product/SN65DP159
  When I2C control is enabled, various pin strapping options like equalizer and
  slew-rate are unavailable. These can be configured through I2C using the
  properties defined here.
  A common application for these chips is to convert AC coupled serdes outputs
  from an FPGA or SoC into HDMI compliant signals.

properties:
  compatible:
    oneOf:
      - const: ti,tmds181
      - items:
          - const: ti,sn65dp159
          - const: ti,tmds181

  reg:
    enum:
      - 0x5b
      - 0x5c
      - 0x5d
      - 0x5e

  reset-gpios:
    maxItems: 1
    description: GPIO specifier for OE pin which acts as active low reset.

  vdd-supply:
    description: Core power supply, 1.1V

  vcc-supply:
    description: IO power supply, 3.3V

  ports:
    $ref: /schemas/graph.yaml#/properties/ports

    properties:
      port@0:
        $ref: /schemas/graph.yaml#/$defs/port-base
        unevaluatedProperties: false
        description: Video port for HDMI (ish) input

        properties:
          endpoint:
            $ref: /schemas/media/video-interfaces.yaml#
            unevaluatedProperties: false

      port@1:
        $ref: /schemas/graph.yaml#/$defs/port-base
        unevaluatedProperties: false
        description: Video port for HDMI output (panel or bridge)

        properties:
          endpoint:
            $ref: /schemas/media/video-interfaces.yaml#
            unevaluatedProperties: false

    required:
      - port@0
      - port@1

  ti,retimer-mode:
    enum:
      - source
      - sink
    description:
      Force chip to operate in "source" or "sink" mode.

  ti,retimer-threshold-hz:
    minimum: 25000000
    maximum: 600000000
    default: 200000000
    description:
      Cross-over point. Up until this pixel clock frequency the chip remains in
      the low-power redriver mode. Above the threshold the chip should operate
      in retimer mode.

  slew-rate:
    $ref: /schemas/types.yaml#/definitions/uint32
    minimum: 0
    maximum: 3
    default: 3
    description: Set slew rate, 0 is slowest, 3 is fastest.

  ti,equalizer:
    enum:
      - adaptive
      - disabled
      - fixed
    default: adaptive
    description: Configure the equalizer

if:
  properties:
    compatible:
      contains:
        const: ti,sn65dp159

then:
  properties:
    ti,retimer-mode:
      default: source

else:
  properties:
    ti,retimer-mode:
      default: sink
    slew-rate: false

required:
  - compatible
  - reg
  - ports

additionalProperties: false

examples:
  - |
    #include <dt-bindings/gpio/gpio.h>

    i2c {
        #address-cells = <1>;
        #size-cells = <0>;

        bridge@5b {
            compatible = "ti,sn65dp159", "ti,tmds181";
            reg = <0x5b>;
            vdd-supply = <&vcc_1v1_reg>;
            vcc-supply = <&vcc_3v3_reg>;
            reset-gpios = <&gpio2 1 GPIO_ACTIVE_LOW>;
            slew-rate = <2>;
            ti,retimer-threshold-hz = <350000000>;
            ti,retimer-mode = "source";
            ti,equalizer = "disabled";

            ports {
                #address-cells = <1>;
                #size-cells = <0>;

                port@0 {
                    reg = <0>;

                    endpoint {
                        remote-endpoint = <&encoder_out>;
                    };
                };

                port@1 {
                    reg = <1>;

                    endpoint {
                        remote-endpoint = <&hdmi_connector_in>;
                    };
                };
            };
        };
    };
```

## Documentation/devicetree/bindings/display/chipwealth,ch1115.yaml
```yaml
# SPDX-License-Identifier: (GPL-2.0-only OR BSD-2-Clause)
%YAML 1.2
---
$id: http://devicetree.org/schemas/display/chipwealth,ch1115.yaml#
$schema: http://devicetree.org/meta-schemas/core.yaml#

title: Chipwealth CH1115 Display Controller

maintainers:
  - Nicolás Antinori <nico.antinori.7@gmail.com>

description:
  Chipwealth CH1115 is a controller for monochrome dot matrix OLED
  panels.

  https://datasheet4u.com/download/1576606/CH1115.html

allOf:
  - $ref: panel/panel-common.yaml#

properties:
  compatible:
    const: chipwealth,ch1115

  reg:
    maxItems: 1

  chipwealth,inverted:
    type: boolean
    description:
      Display pixels are inverted, i.e. 0 is white and 1 is black.

  chipwealth,offset:
    $ref: /schemas/types.yaml#/definitions/uint32
    minimum: 0
    maximum: 63
    default: 0
    description:
      Display start line offset. Specifies the vertical alignment and row shift
      along the Y-coordinate.

  width-mm: true
  height-mm: true
  flip-horizontal: true
  flip-vertical: true
  panel-timing: true

required:
  - compatible
  - reg
  - width-mm
  - height-mm
  - panel-timing

additionalProperties: false

examples:
  - |
    i2c {
        #address-cells = <1>;
        #size-cells = <0>;

        display@3c {
            compatible = "chipwealth,ch1115";
            reg = <0x3c>;
            width-mm = <12>;
            height-mm = <8>;
            chipwealth,offset = <8>;
            panel-timing {
                clock-frequency = <0>;
                hactive = <88>;
                vactive = <48>;
                hfront-porch = <0>;
                hback-porch = <0>;
                hsync-len = <0>;
                vsync-len = <0>;
                vfront-porch = <0>;
                vback-porch = <0>;
            };
        };
    };
```

## Documentation/devicetree/bindings/display/dpi-color-coding.yaml
```yaml
# SPDX-License-Identifier: (GPL-2.0-only OR BSD-2-Clause)
%YAML 1.2
---
$id: http://devicetree.org/schemas/display/dpi-color-coding.yaml#
$schema: http://devicetree.org/meta-schemas/core.yaml#

title: MIPI DPI Interface Color Coding

maintainers:
  - Liu Ying <victor.liu@nxp.com>

description:
  MIPI Alliance Standard for Display Pixel Interface(DPI-2) Version 2.00(15
  September 2005) specifies color codings at the DPI interface.

properties:
  dpi-color-coding:
    enum:
      - 16bit-configuration1
      - 16bit-configuration2
      - 16bit-configuration3
      - 18bit-configuration1
      - 18bit-configuration2
      - 24bit
    description: |
      This table specifies the mapping of data bits, as components of primary
      pixel color values red(R), green(G) and blue(B), to signal lines at the
      interface.

      +--------+--------------------------+-----------------+--------+
      | Signal |          16-bit          |      18-bit     |        |
      |        +--------+--------+--------+--------+--------+ 24-bit |
      | Line   |  cfg1  |  cfg2  |  cfg3  |  cfg1  |  cfg2  |        |
      +========+========+========+========+========+========+========+
      |   D23  | unused | unused | unused | unused | unused |   R7   |
      +--------+--------+--------+--------+--------+--------+--------+
      |   D22  | unused | unused | unused | unused | unused |   R6   |
      +--------+--------+--------+--------+--------+--------+--------+
      |   D21  | unused | unused |   R4   | unused |   R5   |   R5   |
      +--------+--------+--------+--------+--------+--------+--------+
      |   D20  | unused |   R4   |   R3   | unused |   R4   |   R4   |
      +--------+--------+--------+--------+--------+--------+--------+
      |   D19  | unused |   R3   |   R2   | unused |   R3   |   R3   |
      +--------+--------+--------+--------+--------+--------+--------+
      |   D18  | unused |   R2   |   R1   | unused |   R2   |   R2   |
      +--------+--------+--------+--------+--------+--------+--------+
      |   D17  | unused |   R1   |   R0   |   R5   |   R1   |   R1   |
      +--------+--------+--------+--------+--------+--------+--------+
      |   D16  | unused |   R0   | unused |   R4   |   R0   |   R0   |
      +--------+--------+--------+--------+--------+--------+--------+
      |   D15  |   R4   | unused | unused |   R3   | unused |   G7   |
      +--------+--------+--------+--------+--------+--------+--------+
      |   D14  |   R3   | unused | unused |   R2   | unused |   G6   |
      +--------+--------+--------+--------+--------+--------+--------+
      |   D13  |   R2   |   G5   |   G5   |   R1   |   G5   |   G5   |
      +--------+--------+--------+--------+--------+--------+--------+
      |   D12  |   R1   |   G4   |   G4   |   R0   |   G4   |   G4   |
      +--------+--------+--------+--------+--------+--------+--------+
      |   D11  |   R0   |   G3   |   G3   |   G5   |   G3   |   G3   |
      +--------+--------+--------+--------+--------+--------+--------+
      |   D10  |   G5   |   G2   |   G2   |   G4   |   G2   |   G2   |
      +--------+--------+--------+--------+--------+--------+--------+
      |   D9   |   G4   |   G1   |   G1   |   G3   |   G1   |   G1   |
      +--------+--------+--------+--------+--------+--------+--------+
      |   D8   |   G3   |   G0   |   G0   |   G2   |   G0   |   G0   |
      +--------+--------+--------+--------+--------+--------+--------+
      |   D7   |   G2   | unused | unused |   G1   | unused |   B7   |
      +--------+--------+--------+--------+--------+--------+--------+
      |   D6   |   G1   | unused | unused |   G0   | unused |   B6   |
      +--------+--------+--------+--------+--------+--------+--------+
      |   D5   |   G0   | unused |   B4   |   B5   |   B5   |   B5   |
      +--------+--------+--------+--------+--------+--------+--------+
      |   D4   |   B4   |   B4   |   B3   |   B4   |   B4   |   B4   |
      +--------+--------+--------+--------+--------+--------+--------+
      |   D3   |   B3   |   B3   |   B2   |   B3   |   B3   |   B3   |
      +--------+--------+--------+--------+--------+--------+--------+
      |   D2   |   B2   |   B2   |   B1   |   B2   |   B2   |   B2   |
      +--------+--------+--------+--------+--------+--------+--------+
      |   D1   |   B1   |   B1   |   B0   |   B1   |   B1   |   B1   |
      +--------+--------+--------+--------+--------+--------+--------+
      |   D0   |   B0   |   B0   | unused |   B0   |   B0   |   B0   |
      +--------+--------+--------+--------+--------+--------+--------+

      There are three mappings for 16-bit pixels to data signals, two mappings
      for 18-bit pixels to data signals, and one mapping for 24-bit pixels to
      data signals.

additionalProperties: true

...
```
