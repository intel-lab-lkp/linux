## Documentation/devicetree/bindings/display/bridge/cdns,mhdp8501.yaml
```yaml
# SPDX-License-Identifier: (GPL-2.0 OR BSD-2-Clause)
%YAML 1.2
---
$id: http://devicetree.org/schemas/display/bridge/cdns,mhdp8501.yaml#
$schema: http://devicetree.org/meta-schemas/core.yaml#

title: Cadence MHDP8501 DP/HDMI bridge

maintainers:
  - Sandor Yu <Sandor.yu@nxp.com>

description:
  Cadence MHDP8501 DisplayPort/HDMI interface.

properties:
  compatible:
    enum:
      - fsl,imx8mq-mhdp8501

  reg:
    maxItems: 1

  clocks:
    maxItems: 1
    description: MHDP8501 DP/HDMI APB clock.

  phys:
    maxItems: 1
    description:
      phandle to the DP/HDMI PHY

  interrupts:
    items:
      - description: Hotplug cable plugin.
      - description: Hotplug cable plugout.

  interrupt-names:
    items:
      - const: plug_in
      - const: plug_out

  cdns,bridge-type:
    $ref: /schemas/types.yaml#/definitions/uint32
    enum: [0, 1]
    description: |
      Type of bridge output:
        0: DisplayPort
        1: HDMI

  ports:
    $ref: /schemas/graph.yaml#/properties/ports

    properties:
      port@0:
        $ref: /schemas/graph.yaml#/properties/port
        description:
          Input port from display controller output.

      port@1:
        $ref: /schemas/graph.yaml#/$defs/port-base
        unevaluatedProperties: false
        description:
          Output port to DisplayPort or HDMI connector.

        properties:
          endpoint:
            $ref: /schemas/media/video-interfaces.yaml#
            unevaluatedProperties: false

            properties:
              data-lanes:
                description: Lane reordering for HDMI or DisplayPort interface.
                minItems: 4
                maxItems: 4

            required:
              - data-lanes

    required:
      - port@0
      - port@1

required:
  - compatible
  - reg
  - clocks
  - interrupts
  - interrupt-names
  - phys
  - ports
  - cdns,bridge-type

additionalProperties: false

examples:
  - |
    #include <dt-bindings/clock/imx8mq-clock.h>
    #include <dt-bindings/interrupt-controller/arm-gic.h>

    mhdp: display-bridge@32c00000 {
        compatible = "fsl,imx8mq-mhdp8501";
        reg = <0x32c00000 0x100000>;
        interrupts = <GIC_SPI 16 IRQ_TYPE_LEVEL_HIGH>,
                     <GIC_SPI 25 IRQ_TYPE_LEVEL_HIGH>;
        interrupt-names = "plug_in", "plug_out";
        clocks = <&clk IMX8MQ_CLK_DISP_APB_ROOT>;
        phys = <&mdhp_phy>;
        cdns,bridge-type = <0>;

        ports {
            #address-cells = <1>;
            #size-cells = <0>;

            port@0 {
                reg = <0>;

                mhdp_in: endpoint {
                    remote-endpoint = <&dcss_out>;
                };
            };

            port@1 {
                reg = <1>;

                mhdp_out: endpoint {
                    remote-endpoint = <&dp_connector>;
                    data-lanes = <2 1 0 3>;
                };
            };
        };
    };
```

## Documentation/devicetree/bindings/display/bridge/ite,it6162.yaml
```yaml
# SPDX-License-Identifier: (GPL-2.0-only OR BSD-2-Clause)
%YAML 1.2
---
$id: http://devicetree.org/schemas/display/bridge/ite,it6162.yaml#
$schema: http://devicetree.org/meta-schemas/core.yaml#

title: ITE IT6162 MIPI DSI to HDMI 2.0 Bridge

maintainers:
  - Hermes Wu <Hermes.Wu@ite.com.tw>

description: |
  The ITE IT6162 is a high-performance, low-power HDMI bridge that converts
  2 MIPI DSI signals to 1 HDMI 2.0 output. It supports dual MIPI D-PHY 2.0
  links up to 10 Gbps each (20 Gbps total), compatible with DSI-2 v2.0.

  The HDMI transmitter supports resolutions up to 4Kx2K@60Hz and is compliant
  with HDMI 2.0 specifications.

  For audio, it supports up to 8-channel LPCM via I2S (multi-line or TDM mode),
  with optional S/PDIF or DSD (for SACD). Audio sampling rates up to 192 kHz
  are supported.

allOf:
  - $ref: /schemas/sound/dai-common.yaml#

properties:
  compatible:
    const: ite,it6162

  reg:
    maxItems: 1

  interrupts:
    maxItems: 1

  reset-gpios:
    maxItems: 1

  ivdd-supply:
    description: Core voltage supply

  ovdd-supply:
    description: I/O voltage supply

  ovdd1833-supply:
    description: Flexible I/O voltage supply (1.8V domain)

  "#sound-dai-cells":
    const: 0

  ite,support-hdcp:
    description: >
      Boolean property indicating that HDCP (High-bandwidth Digital Content
      Protection) is supported and enabled on this board/hardware instance.

      When present, the driver may initialize and enable HDCP functionality
      (typically HDCP 1.4 or higher depending on chip/firmware). If absent,
      HDCP support is considered disabled or not implemented/wired.

      Presence enables support; the property value is ignored (use as flag:
      `ite,support-hdcp;`).
    type: boolean

  ports:
    $ref: /schemas/graph.yaml#/properties/ports

    properties:
      port@0:
        $ref: /schemas/graph.yaml#/$defs/port-base
        unevaluatedProperties: false
        description: Input port for MIPI DSI-0 (first DSI lane pair; optional)

        properties:
          endpoint:
            $ref: /schemas/media/video-interfaces.yaml#
            unevaluatedProperties: false
            properties:
              data-lanes:
                minItems: 1
                maxItems: 4
              lane-polarities:
                $ref: /schemas/types.yaml#/definitions/uint32-array
                minItems: 1
                maxItems: 5
                items:
                  enum: [0, 1]
                description: >
                  Array of lane polarities starting with clock lane, followed by
                  data lanes in the order given in data-lanes.
                  0 = normal (active high), 1 = inverted (active low).
                  If omitted, all lanes are assumed normal (0).
              clock-noncontinuous:
                type: boolean
                description: >
                  If present, allows MIPI DSI non-continuous clock mode
                  (clock lane can be stopped between transmissions for power saving).
            required:
              - data-lanes

      port@1:
        $ref: /schemas/graph.yaml#/$defs/port-base
        unevaluatedProperties: false
        description: Input port for MIPI DSI-1 (second DSI lane pair; required)

        properties:
          endpoint:
            $ref: /schemas/media/video-interfaces.yaml#
            unevaluatedProperties: false
            properties:
              data-lanes:
                minItems: 1
                maxItems: 4
              lane-polarities:
                $ref: /schemas/types.yaml#/definitions/uint32-array
                minItems: 1
                maxItems: 5
                items:
                  enum: [0, 1]
                description: >
                  Array of lane polarities starting with clock lane, followed by
                  data lanes in the order given in data-lanes.
                  0 = normal (active high), 1 = inverted (active low).
                  If omitted, all lanes are assumed normal (0).
              clock-noncontinuous:
                type: boolean
                description: >
                  If present, allows MIPI DSI non-continuous clock mode
                  (clock lane can be stopped between transmissions for power saving).
            required:
              - data-lanes

      port@2:
        $ref: /schemas/graph.yaml#/properties/port
        description: Audio input port (I2S; optional)

      port@3:
        $ref: /schemas/graph.yaml#/properties/port
        description: HDMI output port (optional)

    required:
      - port@1   # Only DSI-1 port is mandatory per your request

required:
  - compatible
  - reg
  - interrupts
  - ports

unevaluatedProperties: false

examples:
  - |
    #include <dt-bindings/gpio/gpio.h>
    #include <dt-bindings/interrupt-controller/irq.h>

    i2c {
        #address-cells = <1>;
        #size-cells = <0>;

        bridge@58 {
            compatible = "ite,it6162";
            reg = <0x58>;

            #sound-dai-cells = <0>;

            interrupt-parent = <&pio>;
            interrupts = <128 IRQ_TYPE_LEVEL_LOW>;

            pinctrl-names = "default";
            pinctrl-0 = <&it6162_pins>;

            reset-gpios = <&pio 127 GPIO_ACTIVE_LOW>;

            ivdd-supply = <&pp1000_hdmi_x>;
            ovdd-supply = <&pp3300_vio28_x>;
            ovdd1833-supply = <&pp1800_vcamio_x>;

            ite,support-hdcp;   // HDCP enabled on this board

            ports {
                #address-cells = <1>;
                #size-cells = <0>;

                port@0 {
                    reg = <0>;
                    it6162_dsi0: endpoint {
                        data-lanes = < 1 2 3 4>;
                        remote-endpoint = <&dsi_0_out>;
                    };
                };

                port@1 {
                    reg = <1>;
                    it6162_dsi1: endpoint {
                        data-lanes = < 1 2 3 4>;
                        remote-endpoint = <&dsi_1_out>;
                    };
                };

                port@2 {
                    reg = <2>;
                    it6162_audio_in: endpoint {
                        remote-endpoint = <&i2s0_out>;
                    };
                };

                port@3 {
                    reg = <3>;
                    it6162_hdmi_out: endpoint {
                        remote-endpoint = <&hdmi_connector_in>;
                    };
                };
            };
        };
    };
```

## Documentation/devicetree/bindings/display/bridge/lontium,lt7911exc.yaml
```yaml
# SPDX-License-Identifier: GPL-2.0-only OR BSD-2-Clause
%YAML 1.2
---
$id: http://devicetree.org/schemas/display/bridge/lontium,lt7911exc.yaml#
$schema: http://devicetree.org/meta-schemas/core.yaml#

title: Lontium LT7911EXC eDP to MIPI DSI Bridge

maintainers:
  - Sunyun Yang <syyang@lontium.com>

properties:
  compatible:
    enum:
      - lontium,lt7911exc

  reg:
    maxItems: 1

  reset-gpios:
    maxItems: 1
    description: GPIO connected to RST_ pin.

  vdd-supply:
    description: Regulator for 1.2V MIPI phy power.

  vcc-supply:
    description: Regulator for 3.3V IO power.

  ports:
    $ref: /schemas/graph.yaml#/properties/ports

    properties:
      port@0:
        $ref: /schemas/graph.yaml#/properties/port
        description: Video port for eDP input.

      port@1:
        $ref: /schemas/graph.yaml#/properties/port
        description: Video port for MIPI DSI output.

    required:
      - port@0
      - port@1

required:
  - compatible
  - reg
  - reset-gpios
  - vdd-supply
  - vcc-supply
  - ports

additionalProperties: false

examples:
  - |
    #include <dt-bindings/gpio/gpio.h>
    i2c {
        #address-cells = <1>;
        #size-cells = <0>;

        mipi-bridge@41 {
            compatible = "lontium,lt7911exc";
            reg = <0x41>;
            reset-gpios = <&gpy8 8 GPIO_ACTIVE_LOW>;
            vdd-supply = <&lt7911exc_1v2>;
            vcc-supply = <&lt7911exc_3v3>;

            ports {
                #address-cells = <1>;
                #size-cells = <0>;

                port@0 {
                    reg = <0>;
                    bridge_in: endpoint {
                        remote-endpoint = <&edp_out>;
                    };
                };

                port@1 {
                    reg = <1>;
                    bridge_out: endpoint {
                        remote-endpoint = <&panel_in>;
                    };
                };
            };
        };
    };
```

## Documentation/devicetree/bindings/display/bridge/lontium,lt9611c.yaml
```yaml
# SPDX-License-Identifier: (GPL-2.0-only OR BSD-2-Clause)
%YAML 1.2
---
$id: http://devicetree.org/schemas/display/bridge/lontium,lt9611.yaml#
$schema: http://devicetree.org/meta-schemas/core.yaml#

title: Lontium LT9611C 2 Port MIPI to HDMI Bridge

maintainers:
  - Rob Herring <robh@kernel.org>

description: |
  The LT9611C are bridge devices which convert DSI to HDMI

properties:
  compatible:
    enum:
      - lontium,lt9611c
      - lontium,lt9611uxd

  reg:
    maxItems: 1

  "#sound-dai-cells":
    const: 0

  interrupts:
    maxItems: 1

  reset-gpios:
    maxItems: 1
    description: GPIO connected to active high RESET pin.

  vdd-supply:
    description: Regulator for 1.2V MIPI phy power.

  vcc-supply:
    description: Regulator for 3.3V IO power.

  ports:
    $ref: /schemas/graph.yaml#/properties/ports

    properties:
      port@0:
        $ref: /schemas/graph.yaml#/properties/port
        description:
          Primary MIPI port-1 for MIPI input

      port@1:
        $ref: /schemas/graph.yaml#/properties/port
        description:
          Additional MIPI port-2 for MIPI input, used in combination
          with primary MIPI port-1 to drive higher resolution displays

      port@2:
        $ref: /schemas/graph.yaml#/properties/port
        description:
          HDMI port for HDMI output

    required:
      - port@0
      - port@2

required:
  - compatible
  - reg
  - interrupts
  - vdd-supply
  - vcc-supply
  - ports

additionalProperties: false

examples:
  - |
    #include <dt-bindings/gpio/gpio.h>
    #include <dt-bindings/interrupt-controller/irq.h>

    i2c10 {
      #address-cells = <1>;
      #size-cells = <0>;

      hdmi-bridge@41 {
        compatible = "lontium,lt9611c";
        reg = <0x41>;
        #sound-dai-cells = <0>;
        interrupts-extended = <&pio 128 GPIO_ACTIVE_HIGH>;
        reset-gpios = <&pio 127 GPIO_ACTIVE_HIGH>;
        vdd-supply = <&lt9611_1v2>;
        vcc-supply = <&lt9611_3v3>;
        dsi-lanes = <4>;
        status = "okay";

        ports {
          #address-cells = <1>;
          #size-cells = <0>;

          port@0 {
            reg = <0>;
            lt9611_a: endpoint {
              remote-endpoint = <&dsi0_out>;
            };
          };

          port@1 {
            reg = <1>;
            lt9611_b: endpoint {
              remote-endpoint = <&dsi1_out>;
            };
          };

          port@2 {
            reg = <2>;
            lt9611_out: endpoint {
              remote-endpoint = <&hdmi_con>;
            };
          };
        };
      };
    };

...
```
