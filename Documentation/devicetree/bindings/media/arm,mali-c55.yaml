## Documentation/devicetree/bindings/media/i2c/onnn,ar0233.yaml
```yaml
# SPDX-License-Identifier: (GPL-2.0-only OR BSD-2-Clause)
%YAML 1.2
---
$id: http://devicetree.org/schemas/media/i2c/onnn,ar0233.yaml#
$schema: http://devicetree.org/meta-schemas/core.yaml#

title: ON Semiconductor AR0233 MIPI CSI-2 sensor

maintainers:
  - Alexander Shiyan <eagle.alexander923@gmail.com>

description:
  The AR0233 is a 1/2.5" CMOS digital image sensor with MIPI CSI-2 and
  I2C-compatible control interface.

properties:
  compatible:
    const: onnn,ar0233

  reg:
    maxItems: 1

  clocks:
    maxItems: 1

  clock-names:
    const: extclk

  vaa-supply:
    description:
      Supply for the VAA analog voltage (2.8V).

  vaapix-supply:
    description:
      Supply for the VAA_PIX pixel voltage (2.8V).

  vddio-supply:
    description:
      Supply for the VDD_IO I/O digital voltage (1.8V/2.8V).

  vddphy-supply:
    description:
      Supply for the VDD_PHY digital voltage (1.2V).

  vdd-supply:
    description:
      Supply for the VDD core digital voltage (1.2V).

  reset-gpios:
    description: Reset GPIO, active low.
    maxItems: 1

  port:
    $ref: /schemas/graph.yaml#/$defs/port-base
    unevaluatedProperties: false
    description:
      Video output port.

    properties:
      endpoint:
        $ref: /schemas/media/video-interfaces.yaml#
        unevaluatedProperties: false

        properties:
          bus-type:
            const: 4

          data-lanes:
            anyOf:
              - items:
                  - const: 1
              - items:
                  - const: 1
                  - const: 2
              - items:
                  - const: 1
                  - const: 2
                  - const: 3
                  - const: 4

          link-frequencies: true

        required:
          - data-lanes
          - link-frequencies

required:
  - compatible
  - reg
  - clocks
  - clock-names
  - port

unevaluatedProperties: false

examples:
  - |
    #include <dt-bindings/gpio/gpio.h>
    #include <dt-bindings/media/video-interfaces.h>

    i2c {
        #address-cells = <1>;
        #size-cells = <0>;

        camera@10 {
            compatible = "onnn,ar0233";
            reg = <0x10>;

            clocks = <&clk27m>;
            clock-names = "extclk";

            reset-gpios = <&ser0 0 GPIO_ACTIVE_LOW>;

            port {
                ar0233_out: endpoint {
                    data-lanes = <1 2>;
                    link-frequencies = /bits/ 64 <375000000>;
                    remote-endpoint = <&ub953_csi_in>;
                };
            };
        };
    };
```

## Documentation/devicetree/bindings/media/i2c/onnn,ar0234.yaml
```yaml
# SPDX-License-Identifier: (GPL-2.0-only OR BSD-2-Clause)
%YAML 1.2
---
$id: http://devicetree.org/schemas/media/i2c/onnn,ar0234.yaml#
$schema: http://devicetree.org/meta-schemas/core.yaml#

title: ON Semiconductor AR0234 1/2.6-inch CMOS Digital Image Sensor

maintainers:
  - Alexander Shiyan <eagle.alexander923@gmail.com>

description:
  The AR0234 is a 1/2.6-inch CMOS digital image sensor with a pixel
  array of 1940x1220 pixels, capable of 1920x1200 resolution at up
  to 120 fps. It supports MIPI CSI-2 output with 2 or 4 data lanes,
  color raw Bayer (8/10-bit) or monochrome output.

properties:
  compatible:
    oneOf:
      - const: onnn,ar0234cs
      - items:
          - enum: ["onnn,ar0234cssc", "onnn,ar0234cssm"]
          - const: onnn,ar0234cs

  reg:
    description: I2C device address
    maxItems: 1

  clocks:
    description: Reference clock (external clock) input
    maxItems: 1

  reset-gpios:
    description: Reset pin, usually active low (if needed)
    maxItems: 1

  vaa-supply:
    description: Analog (2.8V) supply regulator

  vdd-supply:
    description: Digital Core (1.2V) supply regulator

  vddio-supply:
    description: I/O (1.8V-2.8V) supply regulator

  orientation: true
  rotation: true

  port:
    $ref: /schemas/graph.yaml#/$defs/port-base
    description: CSI-2 transmitter port
    additionalProperties: false
    properties:
      endpoint:
        $ref: /schemas/media/video-interfaces.yaml#
        unevaluatedProperties: false
        properties:
          data-lanes:
            description: Number of MIPI CSI-2 data lanes
            oneOf:
              - items:
                  enum: [1, 2]
                minItems: 2
                maxItems: 2
              - items:
                  enum: [1, 2, 3, 4]
                minItems: 4
                maxItems: 4

          link-frequencies:
            description:
              Allowed MIPI link frequencies in Hz. Two frequencies must
              be provided, one for 8-bit mode and another for 10-bit mode.
              Each frequency shall be within the sensor valid operating
              range.
            minItems: 2
            maxItems: 2
            items:
              minimum: 360000000
              maximum: 450000000

        required:
          - data-lanes
          - link-frequencies

    required:
      - endpoint

required:
  - compatible
  - reg
  - clocks
  - port

additionalProperties: false

examples:
  - |
    #include <dt-bindings/gpio/gpio.h>

    i2c {
        #address-cells = <1>;
        #size-cells = <0>;

        camera@18 {
            compatible = "onnn,ar0234cssc", "onnn,ar0234cs";
            reg = <0x18>;
            pinctrl-names = "default";
            pinctrl-0 = <&pinctrl_cam>;
            clocks = <&clk27m>;
            vaa-supply = <&reg_cam_vaa>;
            vdd-supply = <&reg_cam_vdd>;
            vddio-supply = <&reg_cam_vddio>;
            reset-gpios = <&gpio3 4 GPIO_ACTIVE_LOW>;

            port {
                ar0234_out: endpoint {
                    data-lanes = <1 2 3 4>;
                    link-frequencies = /bits/ 64 <360000000 450000000>;
                    remote-endpoint = <&ar0234_in>;
                };
            };
        };
    };
...
```

## Documentation/devicetree/bindings/media/i2c/ovti,og01a1b.yaml
```yaml
# SPDX-License-Identifier: (GPL-2.0-only OR BSD-2-Clause)
# Copyright (c) 2023-2024 Linaro Ltd.
%YAML 1.2
---
$id: http://devicetree.org/schemas/media/i2c/ovti,og01a1b.yaml#
$schema: http://devicetree.org/meta-schemas/core.yaml#

title: OmniVision OG01A1B Image Sensor

maintainers:
  - Vladimir Zapolskiy <vladimir.zapolskiy@linaro.org>

description: |-
  The OmniVision OG01A1B is black and white CMOS 1.3 Megapixel (1280x1024)
  image sensor controlled over an I2C-compatible SCCB bus.
  The sensor transmits images on a MIPI CSI-2 output interface with one or
  two data lanes.

allOf:
  - $ref: /schemas/media/video-interface-devices.yaml#

properties:
  compatible:
    const: ovti,og01a1b

  reg:
    maxItems: 1

  clocks:
    description: External clock connected to the sensor system clock.
    maxItems: 1

  clock-frequency:
    description: Frequency of the external clock to the sensor in Hz.

  reset-gpios:
    description: Active low signal GPIO to control sensor.
    maxItems: 1

  strobe-gpios:
    description: GPIO connected to the sensor strobe pad.
    maxItems: 1

  avdd-supply:
    description: Analogue circuit voltage supply.

  dovdd-supply:
    description: I/O circuit voltage supply.

  dvdd-supply:
    description: Digital circuit voltage supply.

  port:
    $ref: /schemas/graph.yaml#/$defs/port-base
    additionalProperties: false
    description:
      Output port node, single endpoint describing the CSI-2 transmitter.

    properties:
      endpoint:
        $ref: /schemas/media/video-interfaces.yaml#
        unevaluatedProperties: false

        properties:
          data-lanes:
            minItems: 1
            maxItems: 2

          link-frequencies: true

        required:
          - data-lanes

required:
  - compatible
  - reg
  - clocks
  - port

unevaluatedProperties: false

examples:
  - |
    #include <dt-bindings/gpio/gpio.h>

    i2c {
        #address-cells = <1>;
        #size-cells = <0>;

        sensor@60 {
            compatible = "ovti,og01a1b";
            reg = <0x60>;
            clocks = <&clk 0>;
            reset-gpios = <&gpio 117 GPIO_ACTIVE_LOW>;
            avdd-supply = <&vreg_3v3>;
            dovdd-supply = <&vreg_1p8>;
            dvdd-supply = <&vreg_1p2>;

            port {
                og01a1b_ep: endpoint {
                    remote-endpoint = <&csiphy_ep>;
                    data-lanes = <1 2>;
                    link-frequencies = /bits/ 64 <500000000>;
                };
            };
        };
    };
...
```

## Documentation/devicetree/bindings/media/i2c/ovti,og0va1b.yaml
```yaml
# SPDX-License-Identifier: (GPL-2.0-only OR BSD-2-Clause)
# Copyright (c) Qualcomm Technologies, Inc. and/or its subsidiaries.
%YAML 1.2
---
$id: http://devicetree.org/schemas/media/i2c/ovti,og0va1b.yaml#
$schema: http://devicetree.org/meta-schemas/core.yaml#

title: OmniVision OG0VA1B Image Sensor

maintainers:
  - Wenmeng Liu <wenmeng.liu@oss.qualcomm.com>

description:
  The OmniVision OG0VA1B is a 1/10-inch black and white CMOS VGA (640x480)
  image sensor. It is controlled over an I2C-compatible SCCB bus and transmits
  images on a 1-lane MIPI CSI-2 output interface.

allOf:
  - $ref: /schemas/media/video-interface-devices.yaml#

properties:
  compatible:
    const: ovti,og0va1b

  reg:
    maxItems: 1

  clocks:
    maxItems: 1

  reset-gpios:
    description: Active low GPIO connected to XSHUTDN pad of the sensor.
    maxItems: 1

  avdd-supply:
    description: Analogue circuit voltage supply.

  dovdd-supply:
    description: I/O circuit voltage supply.

  dvdd-supply:
    description: Digital circuit voltage supply.

  port:
    $ref: /schemas/graph.yaml#/$defs/port-base
    additionalProperties: false
    description:
      Output port node, single endpoint describing the CSI-2 transmitter.

    properties:
      endpoint:
        $ref: /schemas/media/video-interfaces.yaml#
        unevaluatedProperties: false

        properties:
          data-lanes:
            description: OG0VA1B supports a single MIPI CSI-2 data lane only.
            items:
              - const: 1

          link-frequencies: true

        required:
          - data-lanes
          - link-frequencies

    required:
      - endpoint

required:
  - compatible
  - reg
  - clocks
  - port

unevaluatedProperties: false

examples:
  - |
    #include <dt-bindings/gpio/gpio.h>

    i2c {
        #address-cells = <1>;
        #size-cells = <0>;

        sensor@36 {
            compatible = "ovti,og0va1b";
            reg = <0x36>;
            clocks = <&clk 0>;
            reset-gpios = <&gpio 42 GPIO_ACTIVE_LOW>;
            avdd-supply = <&vreg_2v8>;
            dovdd-supply = <&vreg_1v8>;
            dvdd-supply = <&vreg_1v2>;

            port {
                og0va1b_ep: endpoint {
                    remote-endpoint = <&csiphy_ep>;
                    data-lanes = <1>;
                    link-frequencies = /bits/ 64 <480000000>;
                };
            };
        };
    };
...
```

## Documentation/devicetree/bindings/media/i2c/ovti,ov08x40.yaml
```yaml
# SPDX-License-Identifier: (GPL-2.0 OR BSD-2-Clause)
# Copyright (c) 2024 Linaro Ltd.
%YAML 1.2
---
$id: http://devicetree.org/schemas/media/i2c/ovti,ov08x40.yaml#
$schema: http://devicetree.org/meta-schemas/core.yaml#

title: Omnivision OV08X40 CMOS Sensor

maintainers:
  - Bryan O'Donoghue <bryan.odonoghue@linaro.org>

description: |-
  The Omnivision OV08X40 is a 9.2 megapixel, CMOS image sensor which supports.
  - Automatic black level calibration (ABLC)
  - Programmable controls for frame rate, mirror and flip, binning, cropping
    and windowing
  - Output formats 10-bit 4C RGB RAW, 10-bit Bayer RAW
  - 4-lane MIPI D-PHY TX @ 1 Gbps per lane
  - 2-lane MPIP D-PHY TX @ 2 Gbps per lane
  - Dynamic defect pixel cancellation
  - Standard SCCB command interface

properties:
  compatible:
    const: ovti,ov08x40

  reg:
    maxItems: 1

  clocks:
    maxItems: 1

  clock-names:
    description:
      Input clock for the sensor.
    items:
      - const: xvclk

  clock-frequency:
    description:
      Frequency of the xvclk clock in Hertz.

  avdd-supply:
    description: Analogue circuit voltage supply.

  dovdd-supply:
    description: I/O circuit voltage supply.

  dvdd-supply:
    description: Digital circuit voltage supply.

  reset-gpios:
    description: Active low GPIO connected to XSHUTDOWN pad of the sensor.

  port:
    $ref: /schemas/graph.yaml#/$defs/port-base
    additionalProperties: false

    properties:
      endpoint:
        $ref: /schemas/media/video-interfaces.yaml#
        unevaluatedProperties: false

        properties:
          data-lanes:
            oneOf:
              - items:
                  - const: 1
                  - const: 2
              - items:
                  - const: 1
                  - const: 2
                  - const: 3
                  - const: 4

          link-frequencies: true

        required:
          - data-lanes
          - link-frequencies

required:
  - compatible
  - reg
  - clocks
  - clock-names
  - clock-frequency
  - dovdd-supply
  - avdd-supply
  - dvdd-supply
  - reset-gpios
  - port

additionalProperties: false

examples:
  - |
    #include <dt-bindings/gpio/gpio.h>

    i2c {
        #address-cells = <1>;
        #size-cells = <0>;

        ov08x40: camera@36 {
            compatible = "ovti,ov08x40";
            reg = <0x36>;

            reset-gpios = <&tlmm 111 GPIO_ACTIVE_LOW>;
            pinctrl-names = "default";
            pinctrl-0 = <&cam_rgb_defaultt>;

            clocks = <&ov08x40_clk>;
            clock-names = "xvclk";
            clock-frequency = <19200000>;

            avdd-supply = <&vreg_l7b_2p8>;
            dvdd-supply = <&vreg_l7b_1p8>;
            dovdd-supply = <&vreg_l3m_1p8>;

            port {
                ov08x40_ep: endpoint {
                    remote-endpoint = <&csiphy4_ep>;
                    data-lanes = <1 2 3 4>;
                    link-frequencies = /bits/ 64 <400000000>;
                };
            };
        };
    };
...
```
