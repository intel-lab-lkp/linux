## Documentation/devicetree/bindings/media/i2c/maxim,max96714.yaml
```yaml
# SPDX-License-Identifier: (GPL-2.0-only OR BSD-2-Clause)
# Copyright (C) 2024 Collabora Ltd.
%YAML 1.2
---
$id: http://devicetree.org/schemas/media/i2c/maxim,max96714.yaml#
$schema: http://devicetree.org/meta-schemas/core.yaml#

title: Maxim MAX96714 GMSL2 to CSI-2 Deserializer

maintainers:
  - Julien Massot <julien.massot@collabora.com>
  - Cosmin Tanislav <cosmin.tanislav@analog.com>

description:
  The MAX96714 deserializer converts GMSL2 serial inputs into MIPI CSI-2 D-PHY
  formatted output. The device allows the GMSL2 link to simultaneously transmit
  bidirectional control-channel data while forward video transmissions are in
  progress. The MAX96714 can connect to one remotely located serializer using
  industry-standard coax or STP interconnects. The device cans operate in pixel
  or tunnel mode. In pixel mode the MAX96714 can select individual video stream,
  while the tunnel mode forward all the MIPI data received by the serializer.

  The GMSL2 serial link operates at a fixed rate of 3Gbps or 6Gbps in the
  forward direction and 187.5Mbps in the reverse direction.

  MAX96714F only supports a fixed rate of 3Gbps in the forward direction.
  MAX9296A only supports pixel mode, and has two GMSL2 links.
  MAX96716A supports both tunnel and pixel mode, and has two GMSL2 links.
  MAX96792A supports both tunnel and pixel mode, and has two GMSL3 links.

properties:
  compatible:
    oneOf:
      - const: maxim,max9296a
      - const: maxim,max96714f
      - const: maxim,max96716a
      - const: maxim,max96792a
      - items:
          - enum:
              - maxim,max96714
          - const: maxim,max96714f

  reg:
    maxItems: 1

  powerdown-gpios:
    maxItems: 1
    description:
      Specifier for the GPIO connected to the PWDNB pin.

required:
  - compatible
  - reg

additionalProperties: false
allOf:
  - if:
      properties:
        compatible:
          contains:
            enum:
              - maxim,max96714
              - maxim,max96714f
    then:
      required:
        - ports

      properties:
        port0-poc-supply:
          description: Regulator providing Power over Coax for the GMSL port

        i2c-gate:
          $ref: /schemas/i2c/i2c-gate.yaml
          unevaluatedProperties: false

        ports:
          $ref: /schemas/graph.yaml#/properties/ports

          properties:
            port@0:
              $ref: /schemas/graph.yaml#/properties/port
              unevaluatedProperties: false
              description: GMSL Input
              properties:
                endpoint:
                  $ref: /schemas/media/video-interfaces.yaml#
                  unevaluatedProperties: false
                  description:
                    Endpoint for GMSL2-Link port.

            port@1:
              $ref: /schemas/graph.yaml#/$defs/port-base
              unevaluatedProperties: false
              description: CSI-2 Output port

              properties:
                endpoint:
                  $ref: /schemas/media/video-interfaces.yaml#
                  unevaluatedProperties: false

                  properties:
                    data-lanes:
                      minItems: 1
                      maxItems: 4

                    lane-polarities:
                      minItems: 1
                      maxItems: 5

                    link-frequencies:
                      maxItems: 1

                  required:
                    - data-lanes

          required:
            - port@1

  - if:
      properties:
        compatible:
          contains:
            enum:
              - maxim,max9296a
              - maxim,max96792a
    then:
      allOf:
        - $ref: /schemas/i2c/i2c-atr.yaml#

      properties:
        i2c-alias-pool:
          maxItems: 2

        i2c-atr:
          patternProperties:
            '^i2c@[0-1]$':
              $ref: /schemas/i2c/i2c-controller.yaml#
              properties:
                reg:
                  items:
                    min: 0
                    max: 1

  - if:
      properties:
        compatible:
          contains:
            const: maxim,max96716a
    then:
      properties:
        i2c-mux:
          $ref: /schemas/i2c/i2c-mux.yaml#
          patternProperties:
            '^i2c@[0-1]$':
              $ref: /schemas/i2c/i2c-controller.yaml#
              properties:
                reg:
                  items:
                    min: 0
                    max: 1

  - if:
      properties:
        compatible:
          contains:
            enum:
              - maxim,max9296a
              - maxim,max96716a
              - maxim,max96792a
    then:
      properties:
        port0-poc-supply:
          description: Regulator providing Power over Coax for GMSL port 0

        port1-poc-supply:
          description: Regulator providing Power over Coax for GMSL port 1

        ports:
          $ref: /schemas/graph.yaml#/properties/ports

          patternProperties:
            port@[0-1]:
              $ref: /schemas/graph.yaml#/properties/port
              unevaluatedProperties: false
              description: GMSL Input
              properties:
                endpoint:
                  $ref: /schemas/media/video-interfaces.yaml#
                  unevaluatedProperties: false
                  description:
                    Endpoint for GMSL2-Link port.

            port@[2-3]:
              $ref: /schemas/graph.yaml#/$defs/port-base
              unevaluatedProperties: false
              description: CSI-2 Output port

              properties:
                endpoint:
                  $ref: /schemas/media/video-interfaces.yaml#
                  unevaluatedProperties: false

                  properties:
                    data-lanes:
                      minItems: 1
                      maxItems: 4

                    lane-polarities:
                      minItems: 1
                      maxItems: 5

                    link-frequencies:
                      maxItems: 1

                  required:
                    - data-lanes

          anyOf:
            - required:
                - port@2
            - required:
                - port@3

examples:
  - |
    #include <dt-bindings/gpio/gpio.h>
    #include <dt-bindings/media/video-interfaces.h>

    i2c {
        #address-cells = <1>;
        #size-cells = <0>;

        deserializer@28 {
            compatible = "maxim,max96714f";
            reg = <0x28>;
            powerdown-gpios = <&main_gpio0 37 GPIO_ACTIVE_LOW>;

            ports {
                #address-cells = <1>;
                #size-cells = <0>;
                port@0 {
                    reg = <0>;
                    max96714_gmsl_in: endpoint {
                        remote-endpoint = <&max96917f_gmsl_out>;
                    };
                };

                port@1 {
                    reg = <1>;
                    max96714_csi_out: endpoint {
                        data-lanes = <1 2 3 4>;
                        link-frequencies = /bits/ 64 <400000000>;
                        remote-endpoint = <&csi_in>;
                    };
                };
            };

            i2c-gate {
                #address-cells = <1>;
                #size-cells = <0>;

                serializer@40 {
                    compatible = "maxim,max96717f";
                    reg = <0x40>;
                    gpio-controller;
                    #gpio-cells = <2>;
                    #clock-cells = <0>;

                    ports {
                        #address-cells = <1>;
                        #size-cells = <0>;

                        port@0 {
                            reg = <0>;
                            max96717f_csi_in: endpoint {
                                data-lanes = <1 2>;
                                lane-polarities = <1 0 1>;
                                remote-endpoint = <&sensor_out>;
                            };
                        };

                        port@1 {
                            reg = <1>;
                            max96917f_gmsl_out: endpoint {
                                remote-endpoint = <&max96714_gmsl_in>;
                            };
                        };
                    };
                };
            };
        };
    };
...
```

## Documentation/devicetree/bindings/media/i2c/maxim,max96714f.yaml
```yaml
# SPDX-License-Identifier: (GPL-2.0-only OR BSD-2-Clause)
# Copyright (C) 2023 Collabora Ltd.
%YAML 1.2
---
$id: http://devicetree.org/schemas/media/i2c/maxim,max96714f.yaml#
$schema: http://devicetree.org/meta-schemas/core.yaml#

title: GMSL2 to CSI-2 Deserializer

maintainers:
  - Julien Massot <julien.massot@collabora.com>

description: |
  The MAX96714F deserializer converts GMSL2 serial inputs into MIPI
  CSI-2 D-PHY or C-PHY formatted output. The device allows the GMSL2 link to
  simultaneously transmit bidirectional control-channel data while forward
  video transmissions are in progress. The MAX96714F can connect to one
  remotely located serializer using industry-standard coax or STP
  interconnects. The device cans operate in pixel or tunnel mode. In pixel mode
  the MAX96714F can select individual video stream, while the tunnel mode forward all
  the MIPI data received by the serializer.

  The GMSL2 serial link operates at a fixed rate of 3Gbps in the
  forward direction and 187.5Mbps in the reverse direction.

properties:
  compatible:
    const: maxim,max96714f

  reg:
    description: I2C device address
    maxItems: 1

  enable-gpios: true

  ports:
    $ref: /schemas/graph.yaml#/properties/ports

    properties:
      port@0:
        $ref: /schemas/graph.yaml#/properties/port
        unevaluatedProperties: false
        description: GMSL Input
        properties:
          endpoint:
            $ref: /schemas/media/video-interfaces.yaml#
            unevaluatedProperties: false
            description:
              Endpoint for GMSL2-Link port.

      port@1:
        $ref: /schemas/graph.yaml#/$defs/port-base
        unevaluatedProperties: false
        description: CSI-2 Output

        properties:
          endpoint:
            $ref: /schemas/media/video-interfaces.yaml#
            unevaluatedProperties: false

            properties:
              data-lanes: true
              bus-type:
                enum:
                  - 4 # MEDIA_BUS_TYPE_CSI2_DPHY

            required:
              - data-lanes
              - bus-type

    required:
      - port@1

  i2c-gate:
    $ref: /schemas/i2c/i2c-controller.yaml
    unevaluatedProperties: false
    description: |
      The MAX96714 will pass through and forward the I2C requests from the
      incoming I2C bus over the GMSL2 link. Therefore it supports an i2c-gate
      subnode to configure a serializer.

  port0-poc-supply:
    description: Regulator providing Power over Coax for a particular port

required:
  - compatible
  - reg
  - ports

additionalProperties: false

examples:
  - |
    #include <dt-bindings/gpio/gpio.h>
    #include <dt-bindings/media/video-interfaces.h>

    main_i2c2 {
            #address-cells = <1>;
            #size-cells = <0>;

            gmsl-deserializer@28 {
                    compatible = "maxim,max96714f";
                    reg = <0x28>;
                    enable-gpios = <&main_gpio0 37 GPIO_ACTIVE_HIGH>;

                    ports {
                            #address-cells = <1>;
                            #size-cells = <0>;
                            port@0 {
                                    reg = <0>;
                                    max96714_gmsl_in: endpoint {
                                            remote-endpoint = <&max96917f_gmsl_out>;
                                    };
                           };

                            port@1 {
                                    reg = <1>;
                                    max96714_csi_out: endpoint {
                                            bus-type = <MEDIA_BUS_TYPE_CSI2_DPHY>;
                                            clock-lanes = <0>;
                                            data-lanes = <1 2 3 4>;
                                            link-frequencies = /bits/ 64 <400000000>;
                                            remote-endpoint = <&csi_in>;
                                    };
                            };
                    };

                    i2c-gate {
                            #address-cells = <1>;
                            #size-cells = <0>;

                            gmsl-serializer@40 {
                                   compatible = "maxim,max96717f";
                                   reg = <0x40>;
                                   gpio-controller;
                                   #gpio-cells = <2>;
                                   #clock-cells = <0>;

                                   ports {
                                            #address-cells = <1>;
                                            #size-cells = <0>;

                                            port@0 {
                                                    reg = <0>;
                                                    max96717f_csi_in: endpoint {
                                                            data-lanes = <1 2>;
                                                            lane-polarities = <1 0 1>;
                                                            remote-endpoint = <&vd5661_csi>;
                                                    };
                                            };

                                            port@1 {
                                                    reg = <1>;
                                                    max96917f_gmsl_out: endpoint {
                                                            remote-endpoint = <&max96714_gmsl_in>;
                                                    };
                                            };
                                   };
                            };
                    };
            };
    };
...
```
