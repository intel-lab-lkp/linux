## Documentation/devicetree/bindings/media/arm,mali-c55.yaml
```yaml
# SPDX-License-Identifier: (GPL-2.0-only OR BSD-2-Clause)
%YAML 1.2
---
$id: http://devicetree.org/schemas/media/arm,mali-c55.yaml#
$schema: http://devicetree.org/meta-schemas/core.yaml#

title: ARM Mali-C55 Image Signal Processor

maintainers:
  - Daniel Scally <dan.scally@ideasonboard.com>
  - Jacopo Mondi <jacopo.mondi@ideasonboard.com>

properties:
  compatible:
    const: arm,mali-c55

  reg:
    maxItems: 1

  interrupts:
    minItems: 1
    items:
      - description: Combined ISP core interrupt
      - description: Full-resolution DMA writer line-tick interrupt
      - description: Full-resolution UV DMA writer line-tick interrupt

  clocks:
    items:
      - description: ISP Video Clock
      - description: ISP AXI clock
      - description: ISP AHB-lite clock

  clock-names:
    items:
      - const: vclk
      - const: aclk
      - const: hclk

  power-domains:
    maxItems: 1

  resets:
    items:
      - description: vclk domain reset
      - description: aclk domain reset
      - description: hclk domain reset

  reset-names:
    items:
      - const: vresetn
      - const: aresetn
      - const: hresetn

  port:
    $ref: /schemas/graph.yaml#/properties/port
    description: Input parallel video bus

    properties:
      endpoint:
        $ref: /schemas/graph.yaml#/properties/endpoint

required:
  - compatible
  - reg
  - interrupts
  - clocks
  - clock-names
  - resets
  - reset-names
  - port

additionalProperties: false

examples:
  - |
    #include <dt-bindings/interrupt-controller/arm-gic.h>

    isp@400000 {
      compatible = "arm,mali-c55";
      reg = <0x400000 0x200000>;
      clocks = <&clk 0>, <&clk 1>, <&clk 2>;
      clock-names = "vclk", "aclk", "hclk";
      power-domains = <&power>;
      resets = <&resets 0>, <&resets 1>, <&resets 2>;
      reset-names = "vresetn", "aresetn", "hresetn";
      /* Example interrupt numbers. */
      interrupts = <GIC_SPI 100 IRQ_TYPE_LEVEL_HIGH>,
                   <GIC_SPI 101 IRQ_TYPE_EDGE_RISING>,
                   <GIC_SPI 102 IRQ_TYPE_EDGE_RISING>;

      port {
        isp_in: endpoint {
            remote-endpoint = <&csi2_rx_out>;
        };
      };
    };
...
```

## Documentation/devicetree/bindings/media/axiado,ax3000-video.yaml
```yaml
# SPDX-License-Identifier: (GPL-2.0-only OR BSD-2-Clause)
%YAML 1.2
---
$id: http://devicetree.org/schemas/media/axiado,ax3000-video.yaml#
$schema: http://devicetree.org/meta-schemas/core.yaml#

title: Axiado AX3000 Video Controller

maintainers:
  - Shubhangini G <shubhangini@axiado.com>
  - Tzu-Hao Wei <twei@axiado.com>
  - Prasad Bolisetty <pbolisetty@axiado.com>

description:
  Axiado AX3000 video capture controller. Reads frames written by the
  display engine into a shared reserved memory region and exposes them
  as a V4L2 capture device.

properties:
  compatible:
    oneOf:
      - const: axiado,ax3000-video
      - items:
          - const: axiado,ax3005-video
          - const: axiado,ax3000-video

  memory-region:
    minItems: 1
    items:
      - description: video frame buffer, shared with the display engine
      - description: optional control mailbox, shared with the host

required:
  - compatible
  - memory-region

additionalProperties: false

examples:
  - |
    video {
        compatible = "axiado,ax3000-video";
        memory-region = <&pci_ep_disp>, <&pci_ep_ctrl>;
    };
```

## Documentation/devicetree/bindings/media/camera-module.yaml
```yaml
# SPDX-License-Identifier: (GPL-2.0-only OR BSD-2-Clause)
# Copyright (C) 2025 Intel Corporation
%YAML 1.2
---
$id: http://devicetree.org/schemas/media/camera-module.yaml#
$schema: http://devicetree.org/meta-schemas/core.yaml#

title: Camera modules

maintainers:
  - Sakari Ailus <sakari.ailus@linux.intel.com>

description: |
  Camera modules are devices that embed one or more active devices, including
  Camera Sensors, Voice Coil Motor (VCM) and possibly a flash LED as well as
  other passive devices such as lenses and Ultra-Violet (UV) filters. While the
  camera modules themselves have no OF nodes and have generally no module
  specific functions, it still does matter for the software stack as a whole
  which module the devices are a part of.

  Two properties are used for this, depending on what is known of the module:

  1. The model of the module is known. In this case the name of the module uses
  the format "vendor,model[,version]" where "vendor" is the manufacturer of the
  module and "model" the name of the model. The version part is optional. In
  such cases the property "camera-module-canonical" will be used. If the vendor
  is not known, the "gpio" vendor prefix is used.

  2. The model of the module is unknown. In this case, the module has an
  identifier only, and will be described in detail in the camera module
  database. The property "camera-module-casual" is used to denote such modules.

  Before including in this binding documentation, all modules shall also be
  documented in add-URL-here.

  All camera modules listed below shall have the name of the sensor as well as
  other devices included in the module as DT compatible string mentioned in a
  comment after the enumeration, separated by a whitespace (" ").

  Always keep the enumeration alphabetically (1) or numerically (2) sorted.

properties:
  camera-module-canonical:
    $ref: /schemas/types.yaml#/definitions/string
    enum:
      - "dell,0BF122N3" # onnn,ov01a10
  camera-module-casual:
    $ref: /schemas/types.yaml#/definitions/uint32
    enum:
      - 1 # st,vs6555

additionalProperties: true
```

## Documentation/devicetree/bindings/media/cnm,wave633c.yaml
```yaml
# SPDX-License-Identifier: (GPL-2.0 OR BSD-2-Clause)
%YAML 1.2
---
$id: http://devicetree.org/schemas/media/cnm,wave633c.yaml#
$schema: http://devicetree.org/meta-schemas/core.yaml#

title: Chips&Media Wave6 Series multi-standard codec IP.

maintainers:
  - Nas Chung <nas.chung@chipsnmedia.com>
  - Jackson Lee <jackson.lee@chipsnmedia.com>

description:
  The Chips&Media Wave6 codec IP is a multi-standard video encoder/decoder.
  On NXP i.MX SoCs, Wave6 codec IP functionality is split between
  the VPU control region and the VPU core region.
  The VPU control region manages shared resources such as firmware memory,
  while the VPU core region provides encoding and decoding
  capabilities. The VPU core cannot operate independently without
  the VPU control region.

properties:
  compatible:
    items:
      - enum:
          - nxp,imx95-vpu
      - const: cnm,wave633c

  clocks:
    items:
      - description: VPU clock
      - description: VPU associated block clock

  clock-names:
    items:
      - const: vpu
      - const: vpublk_wave

  power-domains:
    maxItems: 1
    description: Main VPU power domain

  "#address-cells": true

  "#size-cells": true

  ranges: true

patternProperties:
  "^video-core@[0-9a-f]+$":
    type: object

    properties:
      compatible:
        items:
          - enum:
              - nxp,imx95-vpu-core

      reg:
        maxItems: 1

      interrupts:
        maxItems: 1

    required:
      - compatible
      - reg
      - interrupts

    additionalProperties: false

  "^video-controller@[0-9a-f]+$":
    type: object

    properties:
      compatible:
        items:
          - enum:
              - nxp,imx95-vpu-ctrl

      reg:
        maxItems: 1

      memory-region:
        maxItems: 1

      power-domains:
        maxItems: 1
        description: Performance power domain

      '#cooling-cells':
        const: 2

      sram:
        $ref: /schemas/types.yaml#/definitions/phandle
        description: phandle of the SRAM memory region node.

    required:
      - compatible
      - reg
      - memory-region
      - power-domains

    additionalProperties: false

required:
  - compatible
  - clocks
  - power-domains

additionalProperties: false

examples:
  - |
    #include <dt-bindings/interrupt-controller/arm-gic.h>
    #include <dt-bindings/clock/nxp,imx95-clock.h>

    soc {
      #address-cells = <2>;
      #size-cells = <2>;

      vpu: video-codec {
        compatible = "nxp,imx95-vpu", "cnm,wave633c";
        clocks = <&scmi_clk 115>,
                 <&vpu_blk_ctrl IMX95_CLK_VPUBLK_WAVE>;
        clock-names = "vpu", "vpublk_wave";
        power-domains = <&scmi_devpd 21>;
        #address-cells = <2>;
        #size-cells = <2>;
        ranges;

        vpucore0: video-core@4c480000 {
          compatible = "nxp,imx95-vpu-core";
          reg = <0x0 0x4c480000 0x0 0x10000>;
          interrupts = <GIC_SPI 299 IRQ_TYPE_LEVEL_HIGH>;
        };

        vpucore1: video-core@4c490000 {
          compatible = "nxp,imx95-vpu-core";
          reg = <0x0 0x4c490000 0x0 0x10000>;
          interrupts = <GIC_SPI 300 IRQ_TYPE_LEVEL_HIGH>;
        };

        vpucore2: video-core@4c4a0000 {
          compatible = "nxp,imx95-vpu-core";
          reg = <0x0 0x4c4a0000 0x0 0x10000>;
          interrupts = <GIC_SPI 301 IRQ_TYPE_LEVEL_HIGH>;
        };

        vpucore3: video-core@4c4b0000 {
          compatible = "nxp,imx95-vpu-core";
          reg = <0x0 0x4c4b0000 0x0 0x10000>;
          interrupts = <GIC_SPI 302 IRQ_TYPE_LEVEL_HIGH>;
        };

        vpuctrl: video-controller@4c4c0000 {
          compatible = "nxp,imx95-vpu-ctrl";
          reg = <0x0 0x4c4c0000 0x0 0x10000>;
          memory-region = <&vpu_boot>;
          power-domains = <&scmi_perf 10>;
          #cooling-cells = <2>;
          sram = <&sram1>;
        };
      };
    };
```

## Documentation/devicetree/bindings/media/fsl,imx6q-mlb150.yaml
```yaml
# SPDX-License-Identifier: (GPL-2.0-only OR BSD-2-Clause)
%YAML 1.2
---
$id: http://devicetree.org/schemas/media/fsl,imx6q-mlb150.yaml#
$schema: http://devicetree.org/meta-schemas/core.yaml#

title: Freescale i.MX6Q MediaLB DIM2 Controller

maintainers:
  - Andrey Shvetsov <andrey.shvetsov@k2l.de>

description: |
  MediaLB DIM2 module found in Freescale i.MX6Q SoCs.

properties:
  compatible:
    const: fsl,imx6q-mlb150

  reg:
    maxItems: 1

  interrupts:
    items:
      - description: MediaLB Interrupt
      - description: AHB0 Interrupt

  clocks:
    minItems: 1
    maxItems: 2

  clock-names:
    items:
      - const: mlb
      - const: pll8_mlb

  microchip,clock-speed:
    $ref: /schemas/types.yaml#/definitions/string
    enum:
      - 256fs
      - 512fs
      - 1024fs
      - 2048fs
      - 3072fs
      - 4096fs
      - 6144fs
      - 8192fs
    description: DIM2 clock speed.

required:
  - compatible
  - reg
  - interrupts
  - clocks
  - clock-names
  - microchip,clock-speed

additionalProperties: false

examples:
  - |
    #include <dt-bindings/interrupt-controller/arm-gic.h>

    mlb@218e000 {
        compatible = "fsl,imx6q-mlb150";
        reg = <0x0218e000 0x4000>;
        interrupts = <0 150 IRQ_TYPE_LEVEL_HIGH>,
                     <0 151 IRQ_TYPE_LEVEL_HIGH>;
        clocks = <&clks 1>, <&clks 2>;
        clock-names = "mlb", "pll8_mlb";
        microchip,clock-speed = "2048fs";
    };
```

## Documentation/devicetree/bindings/media/google,chv3-fb.yaml
```yaml
# SPDX-License-Identifier: (GPL-2.0 OR BSD-2-Clause)
%YAML 1.2
---
$id: http://devicetree.org/schemas/media/google,chv3-fb.yaml#
$schema: http://devicetree.org/meta-schemas/core.yaml#

title: Google Chameleon v3 video framebuffer

maintainers:
  - Paweł Anikiel <panikiel@google.com>

properties:
  compatible:
    const: google,chv3-fb

  reg:
    items:
      - description: core registers
      - description: irq registers

  interrupts:
    maxItems: 1

  google,legacy-format:
    type: boolean
    description: The incoming video stream is in 32-bit padded mode.

  port:
    $ref: /schemas/graph.yaml#/properties/port
    description:
      Connection to the video receiver - optional. If this isn't present,
      the video interface still works on its own, but EDID control is
      unavailable and DV timing information only reports the active
      video width/height.

required:
  - compatible
  - reg
  - interrupts

additionalProperties: false

examples:
  - |
    #include <dt-bindings/interrupt-controller/arm-gic.h>

    video@c0060500 {
        compatible = "google,chv3-fb";
        reg = <0xc0060500 0x100>,
              <0xc0060f20 0x10>;
        interrupts = <GIC_SPI 19 IRQ_TYPE_LEVEL_HIGH>;
        google,legacy-format;
    };

  - |
    video@c0060600 {
        compatible = "google,chv3-fb";
        reg = <0xc0060600 0x100>,
              <0xc0060f30 0x10>;
        interrupts = <GIC_SPI 22 IRQ_TYPE_LEVEL_HIGH>;

        port {
            fb_mst0_0: endpoint {
                remote-endpoint = <&dprx_mst_0>;
            };
        };
    };
```

## Documentation/devicetree/bindings/media/hisilicon,hix5hd2-ir.yaml
```yaml
# SPDX-License-Identifier: (GPL-2.0-only OR BSD-2-Clause)
%YAML 1.2
---
$id: http://devicetree.org/schemas/media/hisilicon,hix5hd2-ir.yaml#
$schema: http://devicetree.org/meta-schemas/core.yaml#

title: HiSilicon Hix5hd2 Infrared Receiver

maintainers:
  - Shawn Guo <shawn.guo@linaro.org>

allOf:
  - $ref: rc.yaml#

properties:
  compatible:
    enum:
      - hisilicon,hix5hd2-ir
      - hisilicon,hi3796cv300-ir

  reg:
    maxItems: 1

  interrupts:
    maxItems: 1

  clocks:
    maxItems: 1

  hisilicon,power-syscon:
    $ref: /schemas/types.yaml#/definitions/phandle
    description: phandle of syscon used to control power.
    deprecated: true

required:
  - compatible
  - reg
  - interrupts
  - clocks

unevaluatedProperties: false

examples:
  - |
    #include <dt-bindings/interrupt-controller/arm-gic.h>

    ir@f8001000 {
        compatible = "hisilicon,hix5hd2-ir";
        reg = <0xf8001000 0x1000>;
        interrupts = <0 47 4>;
        clocks = <&clock 0>;
        linux,rc-map-name = "rc-tivo";
    };
```

## Documentation/devicetree/bindings/media/hix5hd2-ir.yaml
```yaml
# SPDX-License-Identifier: (GPL-2.0-only OR BSD-2-Clause)
%YAML 1.2
---
$id: http://devicetree.org/schemas/media/hix5hd2-ir.yaml#
$schema: http://devicetree.org/meta-schemas/core.yaml#

title: HiSilicon Hix5hd2 infrared remote controller

maintainers:
  - Pranav Kharche <pranavkharche7@gmail.com>

allOf:
  - $ref: rc.yaml#

description: |
  This binding describes the infrared remote controller found in
  HiSilicon SoCs such as hix5hd2 and hi3796cv300.

properties:
  compatible:
    enum:
      - hisilicon,hix5hd2-ir
      - hisilicon,hi3796cv300-ir

  reg:
    maxItems: 1

  interrupts:
    maxItems: 1

  clocks:
    maxItems: 1

required:
  - compatible
  - reg
  - interrupts
  - clocks

unevaluatedProperties: false

examples:
  - |
    #include <dt-bindings/interrupt-controller/arm-gic.h>
    #include <dt-bindings/interrupt-controller/irq.h>

    ir: ir@f8001000 {
        compatible = "hisilicon,hix5hd2-ir";
        reg = <0xf8001000 0x1000>;
        interrupts = <GIC_SPI 47 IRQ_TYPE_LEVEL_HIGH>;
        clocks = <&clock 0>;
        linux,rc-map-name = "rc-tivo";
    };
```
