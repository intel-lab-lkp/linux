## Documentation/devicetree/bindings/media/i2c/ovti,ov13b10.yaml
```yaml
# SPDX-License-Identifier: (GPL-2.0-only OR BSD-2-Clause)
%YAML 1.2
---
$id: http://devicetree.org/schemas/media/i2c/ovti,ov13b10.yaml#
$schema: http://devicetree.org/meta-schemas/core.yaml#

title: Omnivision ov13b10 image sensor

maintainers:
  - Arec Kao <arec.kao@intel.com>

allOf:
  - $ref: /schemas/media/video-interface-devices.yaml#

properties:
  compatible:
    const: ovti,ov13b10

  reg:
    maxItems: 1

  clocks:
    description: System clock.
    maxItems: 1

  reset-gpios:
    description: GPIO connected to the XSHUTDOWN pin. Active low.
    maxItems: 1

  avdd-supply:
    description: Analog circuit voltage supply.

  dvdd-supply:
    description: Digital circuit voltage supply.

  dovdd-supply:
    description: Digital I/O circuit voltage supply.

  port:
    $ref: /schemas/graph.yaml#/$defs/port-base
    additionalProperties: false

    properties:
      endpoint:
        $ref: /schemas/media/video-interfaces.yaml#
        additionalProperties: false

        properties:
          data-lanes:
            minItems: 1
            maxItems: 4
            items:
              enum: [1, 2, 3, 4]

          link-frequencies: true
          remote-endpoint: true

        required:
          - data-lanes
          - link-frequencies
          - remote-endpoint

required:
  - compatible
  - reg
  - clocks
  - port

unevaluatedProperties: false

examples:
  - |
    #include <dt-bindings/gpio/gpio.h>

    i2c {
        #address-cells = <1>;
        #size-cells = <0>;

        ov13b10: camera@36 {
            compatible = "ovti,ov13b10";
            reg = <0x36>;

            clocks = <&sensor_xclk>;
            reset-gpios = <&gpio 117 GPIO_ACTIVE_LOW>;

            avdd-supply = <&ov13b10_avdd>;
            dvdd-supply = <&ov13b10_dvdd>;
            dovdd-supply = <&ov13b10_dovdd>;

            port {
                ov13b10_ep: endpoint {
                    data-lanes = <1 2 3 4>;
                    link-frequencies = /bits/ 64 <560000000>;
                    remote-endpoint = <&csiphy_ep>;
                };
            };
        };
    };
...
```

## Documentation/devicetree/bindings/media/i2c/ovti,ov2659.yaml
```yaml
# SPDX-License-Identifier: (GPL-2.0-only OR BSD-2-Clause)
%YAML 1.2
---
$id: http://devicetree.org/schemas/media/i2c/ovti,ov2659.yaml#
$schema: http://devicetree.org/meta-schemas/core.yaml#

title: OmniVision OV2659 1/5-Inch 2Mp SOC Camera

maintainers:
  - Frank Li <Frank.Li@kernel.org>

description:
  The Omnivision OV2659 is a 1/5-inch SOC camera, with an active array size of
  1632H x 1212V. It is programmable through a SCCB. The OV2659 sensor supports
  multiple resolutions output, such as UXGA, SVGA, 720p. It also can support
  YUV422, RGB565/555 or raw RGB output formats.

properties:
  compatible:
    const: ovti,ov2659

  reg:
    maxItems: 1

  clocks:
    maxItems: 1

  clock-names:
    items:
      - const: xvclk

  powerdown-gpios:
    description:
      Reference to the GPIO connected to the pwdn pin, if any.
      Active high with internal pull down resistor.
    maxItems: 1

  reset-gpios:
    description:
      Reference to the GPIO connected to the resetb pin, if any.
      Active low with internal pull up resistor.
    maxItems: 1

  port:
    $ref: /schemas/graph.yaml#/$defs/port-base
    unevaluatedProperties: false

    properties:
      endpoint:
        $ref: /schemas/media/video-interfaces.yaml#
        unevaluatedProperties: false

        properties:
          link-frequencies:
            description: Target pixel clock frequency.
            maxItems: 1

        required:
          - link-frequencies

required:
  - compatible
  - reg
  - clocks
  - clock-names
  - port

additionalProperties: false

examples:
  - |
    #include <dt-bindings/gpio/gpio.h>

    i2c {
        #address-cells = <1>;
        #size-cells = <0>;

        camera@30 {
            compatible = "ovti,ov2659";
            reg = <0x30>;

            clocks = <&clk_ov2659 0>;
            clock-names = "xvclk";

            powerdown-gpios = <&gpio6 14 GPIO_ACTIVE_HIGH>;
            reset-gpios = <&gpio6 15 GPIO_ACTIVE_LOW>;

            port {
                endpoint {
                    remote-endpoint = <&vpfe_ep>;
                    link-frequencies = /bits/ 64 <70000000>;
                };
            };
        };
    };
```

## Documentation/devicetree/bindings/media/i2c/ovti,ov2732.yaml
```yaml
# SPDX-License-Identifier: (GPL-2.0 OR BSD-2-Clause)
%YAML 1.2
---
$id: http://devicetree.org/schemas/media/i2c/ovti,ov2732.yaml#
$schema: http://devicetree.org/meta-schemas/core.yaml#

title: OmniVision OV2732 Image Sensor

maintainers:
  - Walter Werner SCHNEIDER <contact@schnwalter.eu>

description:
  The OmniVision OV2732 is a 2MP (1920x1080) color CMOS image sensor controlled
  through an I2C-compatible SCCB bus.

properties:
  compatible:
    const: ovti,ov2732

  reg:
    maxItems: 1

  clocks:
    items:
      - description: XVCLK clock

  clock-names:
    const: xvclk

  avdd-supply:
    description: Analog Domain Power Supply

  dovdd-supply:
    description: I/O Domain Power Supply

  dvdd-supply:
    description: Digital Domain Power Supply

  pwdn-gpios:
    maxItems: 1
    description: Reference to the GPIO connected to the pwdn pin. Active high.

  reset-gpios:
    maxItems: 1
    description: Reference to the GPIO connected to the reset pin. Active high.

  port:
    description: MIPI CSI-2 transmitter port
    $ref: /schemas/graph.yaml#/$defs/port-base
    additionalProperties: false

    properties:
      endpoint:
        $ref: /schemas/media/video-interfaces.yaml#
        unevaluatedProperties: false

        properties:
          data-lanes:
            items:
              - const: 1
              - const: 2
          link-frequencies: true
          remote-endpoint: true

        required:
          - data-lanes
          - link-frequencies
          - remote-endpoint

required:
  - compatible
  - reg
  - clocks
  - clock-names
  - avdd-supply
  - dovdd-supply
  - dvdd-supply
  - port

additionalProperties: false

examples:
  - |
    #include <dt-bindings/gpio/gpio.h>

    i2c {
        #address-cells = <1>;
        #size-cells = <0>;

        ov2732: camera@36 {
            compatible = "ovti,ov2732";
            reg = <0x36>;
            clocks = <&ov2732_clk>;
            clock-names = "xvclk";

            avdd-supply = <&ov2732_avdd>;
            dovdd-supply = <&ov2732_dovdd>;
            dvdd-supply = <&ov2732_dvdd>;

            pwdn-gpios = <&gpio0 13 GPIO_ACTIVE_LOW>;
            reset-gpios = <&gpio0 8 GPIO_ACTIVE_LOW>;

            port {
                camera_out: endpoint {
                  data-lanes = <1 2>;
                  link-frequencies = /bits/ 64 <360000000>;
                  remote-endpoint = <&mipi_in_camera>;
                };
            };
        };
    };
```

## Documentation/devicetree/bindings/media/i2c/ovti,ov2735.yaml
```yaml
# SPDX-License-Identifier: (GPL-2.0 OR BSD-2-Clause)
%YAML 1.2
---
$id: http://devicetree.org/schemas/media/i2c/ovti,ov2735.yaml#
$schema: http://devicetree.org/meta-schemas/core.yaml#

title: OmniVision OV2735 Image Sensor

maintainers:
  - Himanshu Bhavani <himanshu.bhavani@siliconsignals.io>

description: |
  The OmniVision OV2735 is a 2MP (1920x1080) color CMOS image sensor controlled
  through an I2C-compatible SCCB bus. it outputs RAW10 format and uses a 1/2.7"
  optical format.

properties:
  compatible:
    const: ovti,ov2735

  reg:
    maxItems: 1

  clocks:
    items:
      - description: XVCLK clock

  clock-names:
    items:
      - const: xvclk

  AVDD-supply:
    description: Analog Domain Power Supply

  DOVDD-supply:
    description: I/O Domain Power Supply

  DVDD-supply:
    description: Digital Domain Power Supply

  reset-gpios:
    maxItems: 1
    description: Reset Pin GPIO Control (active low)

  pwdn-gpios:
    maxItems: 1
    description: Powerdown Pin GPIO Control (active low)

  port:
    description: MIPI CSI-2 transmitter port
    $ref: /schemas/graph.yaml#/$defs/port-base
    additionalProperties: false

    properties:
      endpoint:
        $ref: /schemas/media/video-interfaces.yaml#
        unevaluatedProperties: false

        properties:
          data-lanes:
            items:
              - const: 1
              - const: 2

        required:
          - data-lanes

required:
  - compatible
  - reg
  - clocks
  - port

additionalProperties: false

examples:
  - |
    #include <dt-bindings/clock/rk3399-cru.h>
    #include <dt-bindings/gpio/gpio.h>

    i2c {
        #address-cells = <1>;
        #size-cells = <0>;

        camera-sensor@3c {
            compatible = "ovti,ov2735";
            reg = <0x3c>;
            clocks = <&ov2735_clk>;

            assigned-clocks = <&ov2735_clk>;
            assigned-clock-parents = <&ov2735_clk_parent>;
            assigned-clock-rates = <24000000>;

            reset-gpios = <&gpio1 6 GPIO_ACTIVE_LOW>;
            pwdn-gpios = <&gpio2 11 GPIO_ACTIVE_LOW>;

            port {
                cam_out: endpoint {
                    remote-endpoint = <&mipi_in_cam>;
                    data-lanes = <1 2>;
                };
            };
        };
    };
```

## Documentation/devicetree/bindings/media/i2c/ovti,ov32c4.yaml
```yaml
# SPDX-License-Identifier: (GPL-2.0 OR BSD-2-Clause)
%YAML 1.2
---
$id: http://devicetree.org/schemas/media/i2c/ovti,ov32c4.yaml#
$schema: http://devicetree.org/meta-schemas/core.yaml#

title: OmniVision OV32C4 Image Sensor

maintainers:
  - Robert Bozik <robertbozik@gmail.com>

description:
  The OmniVision OV32C4 is a 32 megapixel RGBC (red, green, blue and clear)
  CMOS image sensor in a 4-cell arrangement, with on-chip 4-cell fusion and
  binning. It has a 6528x4896 active pixel array, a 4-lane MIPI CSI-2 D-PHY
  transmitter and the standard SCCB command interface.

allOf:
  - $ref: /schemas/media/video-interface-devices.yaml#

properties:
  compatible:
    const: ovti,ov32c4

  reg:
    maxItems: 1

  clocks:
    maxItems: 1
    description: Input clock (XVCLK).

  avdd-supply: true

  dovdd-supply: true

  dvdd-supply: true

  reset-gpios:
    maxItems: 1
    description: Active low GPIO connected to the XSHUTDOWN pad of the sensor.

  port:
    $ref: /schemas/graph.yaml#/$defs/port-base
    additionalProperties: false

    properties:
      endpoint:
        $ref: /schemas/media/video-interfaces.yaml#
        additionalProperties: false

        properties:
          data-lanes:
            items:
              - const: 1
              - const: 2
              - const: 3
              - const: 4
          link-frequencies: true
          remote-endpoint: true

        required:
          - data-lanes
          - link-frequencies
          - remote-endpoint

required:
  - compatible
  - reg
  - clocks
  - port

unevaluatedProperties: false

examples:
  - |
    #include <dt-bindings/gpio/gpio.h>

    i2c {
        #address-cells = <1>;
        #size-cells = <0>;

        camera@36 {
            compatible = "ovti,ov32c4";
            reg = <0x36>;

            clocks = <&ov32c4_clk>;
            assigned-clocks = <&ov32c4_clk>;
            assigned-clock-rates = <19200000>;

            avdd-supply = <&vreg_2p8>;
            dovdd-supply = <&vreg_1p8>;
            dvdd-supply = <&vreg_1p1>;

            reset-gpios = <&tlmm 111 GPIO_ACTIVE_LOW>;

            port {
                ov32c4_ep: endpoint {
                    remote-endpoint = <&csiphy0_ep>;
                    data-lanes = <1 2 3 4>;
                    link-frequencies = /bits/ 64 <400000000>;
                };
            };
        };
    };
...
```
