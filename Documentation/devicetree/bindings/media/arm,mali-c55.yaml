## Documentation/devicetree/bindings/media/i2c/ams,mira016.yaml
```yaml
# SPDX-License-Identifier: (GPL-2.0 OR BSD-2-Clause)
%YAML 1.2
---
$id: http://devicetree.org/schemas/media/i2c/ams,mira016.yaml#
$schema: http://devicetree.org/meta-schemas/core.yaml#

title: AMS 0.16 MP NIR enhanced global shutter image sensor

maintainers:
  - Jacopo Mondi <jacopo.mondi@ideasonboard.com>
  - Philippe Baetens <philippebaetens@gmail.com>

description:
  Mira016 is a 0.16 MP NIR enhanced global shutter image sensor designed for 2D
  and 3D consumer and industrial machine vision applications. The sensor is
  compliant to the MIPI CSI-2 v1.3 protocol interface and the D-PHY v1.2
  physical layer specifications to transmit the image data to the host
  processor. It uses one data lane and one clock lane operating up to 1.5 Gbps.

allOf:
  - $ref: /schemas/media/video-interface-devices.yaml#

properties:
  compatible:
    const: ams,mira016

  reg:
    maxItems: 1

  clocks:
    maxItems: 1

  vdd28-supply:
    description:
      I/O voltage supply, 2.8 volts

  vdd11-supply:
    description:
      I/O voltage supply, 1.1 volts

  reset-gpios:
    description: Sensor reset (RST_N) GPIO
    maxItems: 1

  port:
    $ref: /schemas/graph.yaml#/$defs/port-base
    additionalProperties: false
    description:
      Video output port

    properties:
      endpoint:
        $ref: /schemas/media/video-interfaces.yaml#
        unevaluatedProperties: false

        properties:
          data-lanes:
            items:
              - const: 1

        required:
          - data-lanes
          - link-frequencies

required:
  - compatible
  - reg
  - clocks
  - vdd28-supply
  - vdd11-supply
  - port

unevaluatedProperties: false

examples:
  - |
    i2c {
        #address-cells = <1>;
        #size-cells = <0>;

        mira016: camera-sensor@36 {
            compatible = "ams,mira016";
            reg = <0x36>;
            clocks = <&cam1_clk>;
            vdd28-supply = <&cam1_reg>;
            vdd11-supply = <&cam_dummy_reg>;
            port {
                mira016_ep: endpoint {
                    data-lanes = <1>;
                    link-frequencies = /bits/ 64 <750000000>;
                };
            };
        };
    };
...
```

## Documentation/devicetree/bindings/media/i2c/dongwoon,dw9719.yaml
```yaml
# SPDX-License-Identifier: (GPL-2.0-only OR BSD-2-Clause)
%YAML 1.2
---
$id: http://devicetree.org/schemas/media/i2c/dongwoon,dw9719.yaml#
$schema: http://devicetree.org/meta-schemas/core.yaml#

title: Dongwoon Anatech DW9719 Voice Coil Motor (VCM) Controller

maintainers:
  - devicetree@vger.kernel.org

description:
  The Dongwoon DW9719 is a 10-bit digital-to-analog (DAC) converter. The DAC
  is controlled via a 2-wire (I2C-compatible) serial interface.

properties:
  compatible:
    enum:
      - dongwoon,dw9719
      - dongwoon,dw9761

  reg:
    maxItems: 1

  vdd-supply:
    description: Regulator providing power to the "VDD" pin.

required:
  - compatible
  - reg

additionalProperties: false

examples:
  - |
    i2c {
        #address-cells = <1>;
        #size-cells = <0>;

        camera-lens@c {
            compatible = "dongwoon,dw9761";
            reg = <0x0c>;
            vdd-supply = <&pm8916_l10>;
        };
    };
```

## Documentation/devicetree/bindings/media/i2c/galaxycore,gc08a3.yaml
```yaml
# SPDX-License-Identifier: (GPL-2.0-only OR BSD-2-Clause)
%YAML 1.2
---
$id: http://devicetree.org/schemas/media/i2c/galaxycore,gc08a3.yaml#
$schema: http://devicetree.org/meta-schemas/core.yaml#

title: GalaxyCore gc08a3 1/4" 8M Pixel MIPI CSI-2 sensor

maintainers:
  - Zhi Mao <zhi.mao@mediatek.com>

description: |-
  The gc08a3 is a raw image sensor with an MIPI CSI-2 image data
  interface and CCI (I2C compatible) control bus. The output format
  is raw Bayer.

properties:
  compatible:
    const: GalaxyCore,gc08a3

  reg:
    maxItems: 1

  clocks:
    items:
      - description: Reference to the mclk clock.

  assigned-clocks:
    maxItems: 1

  assigned-clock-rates:
    maxItems: 1

  enable-gpios:
    description: Reference to the GPIO connected to the RESETB pin. Active low.
    maxItems: 1

  vddio-supply:
    description: Definition of the regulator used for the VDDIO power supply.

  vdda-supply:
    description: Definition of the regulator used for the VDDA power supply.

  vddd-supply:
    description: Definition of the regulator used for the VDDD power supply.

  port:
    $ref: /schemas/graph.yaml#/$defs/port-base
    unevaluatedProperties: false

    properties:
      endpoint:
        $ref: /schemas/media/video-interfaces.yaml#
        unevaluatedProperties: false

        properties:
          data-lanes:
            oneOf:
              - items:
                  - const: 1
                  - const: 2
                  - const: 3
                  - const: 4
              - items:
                  - const: 1
                  - const: 2

          link-frequencies: true

        required:
          - data-lanes
          - link-frequencies

required:
  - compatible
  - reg
  - clocks
  - assigned-clocks
  - assigned-clock-rates
  - vddio-supply
  - vdda-supply
  - vddd-supply
  - port

additionalProperties: false

examples:
  - |
    #include <dt-bindings/gpio/gpio.h>

    i2c {
        #address-cells = <1>;
        #size-cells = <0>;

        sensor0@2 {
            status = "okay";
            compatible = "GalaxyCore,gc08a3";
            reg = <0x31>;

            clocks = <&topckgen CLK_TOP_CAMTG>,
                <&topckgen CLK_TOP_UNIVPLL_192M_D8>;
            clock-names = "xvclk", "freq_mux";
            clock-frequency = <24000000>;

            assigned-clocks = <&topckgen CLK_TOP_CAMTG>,
                    <&topckgen CLK_TOP_UNIVPLL_192M_D8>;
            assigned-clock-parents = <&topckgen CLK_TOP_UNIVPLL_192M_D8>;
            assigned-clock-rates = <0>, <24000000>;

            enable-gpios = <&pio 19 GPIO_ACTIVE_HIGH>;

            pinctrl-names = "default";
            pinctrl-0 = <&camera_pins_cam0>;

            avdd-supply = <&mt6359_vfe28_ldo_reg>;

            port {
                sensor0_out_2: endpoint {
                    data-lanes = <1 2 3 4>;
                    link-frequencies = /bits/ 64 <336000000 207000000>;
                    remote-endpoint = <&seninf_csi_port_0_in_2>;
                };
            };
        };

    };

...
```

## Documentation/devicetree/bindings/media/i2c/giantec,gt97xx.yaml
```yaml
# SPDX-License-Identifier: (GPL-2.0 OR BSD-2-Clause)
# Copyright (c) 2020 MediaTek Inc.
%YAML 1.2
---
$id: http://devicetree.org/schemas/media/i2c/giantec,gt97xx.yaml#
$schema: http://devicetree.org/meta-schemas/core.yaml#

title: Giantec Semiconductor, Crop. GT97xx Voice Coil Motor (VCM)

maintainers:
  - Zhi Mao <zhi.mao@mediatek.com>

description: |-
  The Giantec GT97xx is a 10-bit DAC with current sink capability.
  The DAC is controlled via I2C bus that operates at clock rates up to 1MHz.
  This chip integrates Advanced Actuator Control (AAC) technology
  and is intended for driving voice coil lens in camera modules.

properties:
  compatible:
    enum:
      - giantec,gt9768 # for GT9768 VCM
      - giantec,gt9769 # for GT9769 VCM

  reg:
    maxItems: 1

  vin-supply: true

  vdd-supply: true

  giantec,aac-mode:
    description:
      Indication of AAC mode select.
    $ref: /schemas/types.yaml#/definitions/uint32
    enum:
      - 1    #  AAC2 mode(operation time# 0.48 x Tvib)
      - 2    #  AAC3 mode(operation time# 0.70 x Tvib)
      - 3    #  AAC4 mode(operation time# 0.75 x Tvib)
      - 5    #  AAC8 mode(operation time# 1.13 x Tvib)
    default: 2

  giantec,aac-timing:
    description:
      Number of AAC Timing count that controlled by one 6-bit period of
      vibration register AACT[5:0], the unit of which is 100 us.
    $ref: /schemas/types.yaml#/definitions/uint32
    default: 0x20
    minimum: 0x00
    maximum: 0x3f

  giantec,clock-presc:
    description:
      Indication of VCM internal clock dividing rate select, as one multiple
      factor to calculate VCM ring periodic time Tvib.
    $ref: /schemas/types.yaml#/definitions/uint32
    enum:
      - 0    #  Dividing Rate -  2
      - 1    #  Dividing Rate -  1
      - 2    #  Dividing Rate -  1/2
      - 3    #  Dividing Rate -  1/4
      - 4    #  Dividing Rate -  8
      - 5    #  Dividing Rate -  4
    default: 1

required:
  - compatible
  - reg
  - vin-supply
  - vdd-supply

additionalProperties: false

examples:
  - |

    i2c {
        #address-cells = <1>;
        #size-cells = <0>;

        vcm@c {
            compatible = "giantec,gt9768";
            reg = <0x0c>;

            vin-supply = <&gt97xx_vin>;
            vdd-supply = <&gt97xx_vdd>;
            giantec,aac-timing = <0x20>;
        };
    };

...
```

## Documentation/devicetree/bindings/media/i2c/ite,it6625.yaml
```yaml
# SPDX-License-Identifier: (GPL-2.0-only OR BSD-2-Clause)
%YAML 1.2
---
$id: http://devicetree.org/schemas/media/i2c/ite,it6625.yaml#
$schema: http://devicetree.org/meta-schemas/core.yaml#

title: ITE IT6625/IT6626 HDMI to dual MIPI CSI-2 bridge

maintainers:
  - Hermes Wu <Hermes.wu@ite.com.tw>

description: |-
  The ITE IT6625 and IT6626 are HDMI to MIPI CSI-2 bridge devices.
  IT6625 supports an HDMI 2.0 input and converts it to one or two D-PHY CSI
  outputs, while IT6626 supports an HDMI 2.1 input and converts it to one or
  two C/D-PHY CSI outputs. The bridges are programmable through I2C and
  expose one HDMI input port and two selectable CSI-2 output ports. The
  bridge can operate in split mode or clone mode.

properties:
  compatible:
    enum:
      - ite,it6625
      - ite,it6626

  reg:
    maxItems: 1

  reset-gpios:
    description:
      GPIO connected to the active-low reset line.
    maxItems: 1

  ports:
    $ref: /schemas/graph.yaml#/properties/ports
    properties:
      port@0:
        $ref: /schemas/graph.yaml#/$defs/port-base
        unevaluatedProperties: false
        description: CSI-2 output port MIPI0

        properties:
          endpoint:
            $ref: /schemas/media/video-interfaces.yaml#
            unevaluatedProperties: false

            properties:
              data-lanes:
                minItems: 1
                maxItems: 4

              bus-type:
                enum:
                  - 1 # MEDIA_BUS_TYPE_CSI2_CPHY
                  - 4 # MEDIA_BUS_TYPE_CSI2_DPHY

              clock-noncontinuous: true
              link-frequencies: true

            required:
              - data-lanes

      port@1:
        $ref: /schemas/graph.yaml#/$defs/port-base
        unevaluatedProperties: false
        description: CSI-2 output port MIPI1

        properties:
          endpoint:
            $ref: /schemas/media/video-interfaces.yaml#
            unevaluatedProperties: false

            properties:
              data-lanes:
                minItems: 1
                maxItems: 4

              bus-type:
                enum:
                  - 1 # MEDIA_BUS_TYPE_CSI2_CPHY
                  - 4 # MEDIA_BUS_TYPE_CSI2_DPHY

              clock-noncontinuous: true
              link-frequencies: true

            required:
              - data-lanes

      port@2:
        $ref: /schemas/graph.yaml#/$defs/port-base
        unevaluatedProperties: false
        description: HDMI connector input port

        properties:
          endpoint:
            $ref: /schemas/graph.yaml#/$defs/endpoint-base
            unevaluatedProperties: false

    required:
      - port@0
required:
  - compatible
  - reg
  - ports

allOf:
  - if:
      properties:
        compatible:
          contains:
            const: ite,it6625
    then:
      properties:
        ports:
          properties:
            port@0:
              properties:
                endpoint:
                  properties:
                    bus-type:
                      const: 4
            port@1:
              properties:
                endpoint:
                  properties:
                    bus-type:
                      const: 4

additionalProperties: false

examples:
  - |
    #include <dt-bindings/gpio/gpio.h>

    i2c {
      #address-cells = <1>;
      #size-cells = <0>;

      hdmi-bridge@4c {
        compatible = "ite,it6625";
        reg = <0x4c>;

        reset-gpios = <&gpio 2 GPIO_ACTIVE_LOW>;

        ports {
          #address-cells = <1>;
          #size-cells = <0>;

          port@0 {
            reg = <0>;
            csi_out0: endpoint {
              remote-endpoint = <&csi2_rx0>;
              bus-type = <4>; /* MEDIA_BUS_TYPE_CSI2_DPHY */
              data-lanes = <1 2 3 4>;
            };
          };
        };
      };
    };
```
