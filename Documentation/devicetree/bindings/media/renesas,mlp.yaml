## Documentation/devicetree/bindings/media/rockchip,rk3588-vpu720.yaml
```yaml
# SPDX-License-Identifier: (GPL-2.0 OR BSD-2-Clause)
%YAML 1.2
---
$id: http://devicetree.org/schemas/media/rockchip,rk3588-vpu720.yaml#
$schema: http://devicetree.org/meta-schemas/core.yaml#

title: Rockchip VPU720 JPEG Decoder

maintainers:
  - Lucas Sinn <lucas.sinn@wolfvision.net>

description:
  The VPU720 is Rockchip's in-house JPEG/MJPEG hardware decoder found on the
  RK3588.  It is driven by the Hantro V4L2 driver.  A dedicated Link List
  Processor (LLP) register block, located at offset 0x300 within the same
  register window, allows the hardware to decode a chain of frames
  autonomously ("link mode").

properties:
  compatible:
    const: rockchip,rk3588-vpu720

  reg:
    maxItems: 1
    description:
      The decoder register window.  It covers both the task (function)
      registers at offset 0x000 and the LLP (link table) registers at
      offset 0x300.

  interrupts:
    maxItems: 1

  interrupt-names:
    const: vdpu

  clocks:
    items:
      - description: AXI clock
      - description: AHB clock

  clock-names:
    items:
      - const: aclk
      - const: hclk

  resets:
    items:
      - description: AXI reset line
      - description: AHB reset line

  reset-names:
    items:
      - const: axi
      - const: ahb

  power-domains:
    maxItems: 1

  iommus:
    maxItems: 1

required:
  - compatible
  - reg
  - interrupts
  - interrupt-names
  - clocks
  - clock-names
  - resets
  - reset-names
  - power-domains

additionalProperties: false

examples:
  - |
    #include <dt-bindings/clock/rockchip,rk3588-cru.h>
    #include <dt-bindings/interrupt-controller/arm-gic.h>
    #include <dt-bindings/power/rk3588-power.h>
    #include <dt-bindings/reset/rockchip,rk3588-cru.h>

    video-codec@fdb90000 {
        compatible = "rockchip,rk3588-vpu720";
        reg = <0xfdb90000 0x400>;
        interrupts = <GIC_SPI 129 IRQ_TYPE_LEVEL_HIGH 0>;
        interrupt-names = "vdpu";
        clocks = <&cru ACLK_JPEG_DECODER>, <&cru HCLK_JPEG_DECODER>;
        clock-names = "aclk", "hclk";
        resets = <&cru SRST_A_JPEG_DECODER>, <&cru SRST_H_JPEG_DECODER>;
        reset-names = "axi", "ahb";
        iommus = <&jpegd_mmu>;
        power-domains = <&power RK3588_PD_VDPU>;
    };
```

## Documentation/devicetree/bindings/media/rockchip,vdec2.yaml
```yaml
# SPDX-License-Identifier: (GPL-2.0 OR BSD-2-Clause)
%YAML 1.2
---
$id: http://devicetree.org/schemas/media/rockchip,vdec2.yaml#
$schema: http://devicetree.org/meta-schemas/core.yaml#

title: Rockchip Video Decoder 2 (VDec2)

maintainers:
  - Heiko Stuebner <heiko@sntech.de>

description: |-
  The Rockchip rk3588 has a stateless Video Decoder that can decodes H.264,
  HEVC, VP9 and AVS2 streams.

properties:
  compatible:
    const: rockchip,rk3588-vdec2

  reg:
    maxItems: 1

  interrupts:
    maxItems: 1

  clocks:
    items:
      - description: The Video decoder AXI interface clock
      - description: The Video decoder AHB interface clock
      - description: The Video decoder core clock
      - description: The Video decoder CABAC clock
      - description: The Video decoder HEVC CABAC clock

  clock-names:
    items:
      - const: axi
      - const: ahb
      - const: core
      - const: cabac
      - const: hevc_cabac

  assigned-clocks: true

  assigned-clock-rates: true

  power-domains:
    maxItems: 1

required:
  - compatible
  - reg
  - interrupts
  - clocks
  - clock-names
  - power-domains

additionalProperties: false

examples:
  - |
    #include <dt-bindings/interrupt-controller/arm-gic.h>
    #include <dt-bindings/clock/rockchip,rk3588-cru.h>
    #include <dt-bindings/power/rk3588-power.h>

    vdec2: video-codec@fdc38100 {
        compatible = "rockchip,rk3588-vdec2";
        reg = <0x0 0xfdc38100 0x0 0x500>;
        interrupts = <GIC_SPI 95 IRQ_TYPE_LEVEL_HIGH 0>;
        clocks = <&cru ACLK_RKVDEC0>, <&cru HCLK_RKVDEC0>, <&cru CLK_RKVDEC0_CORE>,
                 <&cru CLK_RKVDEC0_CA>, <&cru CLK_RKVDEC0_HEVC_CA>;
        clock-names = "axi", "ahc", "core",
                      "cabac", "hevc_cabac";
        assigned-clocks = <&cru ACLK_RKVDEC0>, <&cru CLK_RKVDEC0_CORE>,
                          <&cru CLK_RKVDEC0_CA>, <&cru CLK_RKVDEC0_HEVC_CA>;
        assigned-clock-rates = <800000000>, <600000000>,
                               <600000000>, <1000000000>;
        power-domains = <&power RK3588_PD_RKVDEC0>;
    };

...
```

## Documentation/devicetree/bindings/media/ti,vip.yaml
```yaml
# SPDX-License-Identifier: (GPL-2.0-only OR BSD-2-Clause)
# Copyright (C) 2025 Texas Instruments Incorporated -  http://www.ti.com/
%YAML 1.2
---
$id: http://devicetree.org/schemas/media/ti,vip.yaml#
$schema: http://devicetree.org/meta-schemas/core.yaml#

title: Texas Instruments DRA7x VIDEO INPUT PORT (VIP).

maintainers:
  - Yemike Abhilash Chandra <y-abhilashchandra@ti.com>

description: |-
  Video Input Port (VIP) can be found on devices such as DRA7xx and
  provides the system interface and the processing capability to
  connect parallel image-sensor as well as BT.656/1120 capable encoder
  chip to DRA7x device.

  Each VIP instance supports 2 independently configurable external
  video input capture slices (Slice 0 and Slice 1) each providing
  up to two video input ports (Port A and Port B).

properties:
  compatible:
    enum:
      - ti,dra7-vip

  reg:
    items:
      - description: The VIP main register region
      - description: Video Data Parser (PARSER) register region for Slice0
      - description: Color Space Conversion (CSC) register region for Slice0
      - description: Scaler (SC) register region for Slice0
      - description: Video Data Parser (PARSER) register region for Slice1
      - description: Color Space Conversion (CSC) register region for Slice1
      - description: Scaler (SC) register region for Slice1
      - description: Video Port Direct Memory Access (VPDMA) register region

  reg-names:
    items:
      - const: vip
      - const: parser0
      - const: csc0
      - const: sc0
      - const: parser1
      - const: csc1
      - const: sc1
      - const: vpdma

  interrupts:
    items:
      - description: IRQ index 0 is used for Slice0 interrupts
      - description: IRQ index 1 is used for Slice1 interrupts

  ti,ctrl-module:
    description:
      Reference to the device control module that provides clock-edge
      inversion control for VIP ports. These controls allow the
      VIP to sample pixel data on the correct clock edge.
    $ref: /schemas/types.yaml#/definitions/phandle-array
    items:
      items:
        - description: phandle to device control module
        - description: offset to the CTRL_CORE_SMA_SW_1 register
        - description: Bit field to slice 0 port A
        - description: Bit field to slice 0 port B
        - description: Bit field to slice 1 port A
        - description: Bit field to slice 1 port B
    maxItems: 1

  ports:
    $ref: /schemas/graph.yaml#/properties/ports

    patternProperties:
      '^port@[0-3]$':
        $ref: /schemas/graph.yaml#/$defs/port-base
        unevaluatedProperties: false
        description: |
          Each VIP instance supports 2 independently configurable external video
          input capture slices (Slice 0 and Slice 1) each providing up to two video
          input ports (Port A and Port B). These ports represent the following
          port@0 -> Slice 0 Port A
          port@1 -> Slice 0 Port B
          port@2 -> Slice 1 Port A
          port@3 -> Slice 1 Port B

        properties:
          endpoint:
            $ref: /schemas/media/video-interfaces.yaml#
            unevaluatedProperties: false

            properties:
              bus-width:
                enum: [8, 16, 24]
                default: 8

              ti,vip-pixel-mux:
                type: boolean
                description:
                  In BT656/1120 mode, this will enable pixel-muxing if
                  the number of channels is either 1, 2 or 4. If this
                  property is present then pixel-muxing is enabled
                  otherwise it will use line-muxing.

              ti,vip-channels:
                $ref: /schemas/types.yaml#/definitions/uint8-array
                minItems: 1
                maxItems: 16
                description:
                  In BT656/1120 mode, list of channel ids to be captured.
                  If the property is not present then 1 channel is assumed.

              remote-endpoint: true

required:
  - compatible
  - reg
  - reg-names
  - interrupts
  - ti,ctrl-module
  - ports

additionalProperties: false

examples:
  - |
    #include <dt-bindings/interrupt-controller/arm-gic.h>
    #include <dt-bindings/interrupt-controller/irq.h>

    vip1: video@48970000 {
        compatible = "ti,dra7-vip";
        reg = <0x48970000 0x114>,
              <0x48975500 0xD8>,
              <0x48975700 0x18>,
              <0x48975800 0x80>,
              <0x48975a00 0xD8>,
              <0x48975c00 0x18>,
              <0x48975d00 0x80>,
              <0x4897d000 0x400>;
        reg-names = "vip",
                    "parser0",
                    "csc0",
                    "sc0",
                    "parser1",
                    "csc1",
                    "sc1",
                    "vpdma";
        interrupts = <GIC_SPI 351 IRQ_TYPE_LEVEL_HIGH>,
                     <GIC_SPI 392 IRQ_TYPE_LEVEL_HIGH>;
        ti,ctrl-module = <&scm_conf 0x534 0x0 0x2 0x1 0x3>;

        ports {
              #address-cells = <1>;
              #size-cells = <0>;

              vin1a: port@0 {
                    reg = <0>;

                    vin1a_ep: endpoint {
                           remote-endpoint = <&camera1>;
                           hsync-active = <1>;
                           vsync-active = <1>;
                           pclk-sample = <0>;
                           bus-width = <8>;
                    };
              };
              vin1b: port@1 {
                    reg = <1>;
              };
              vin2a: port@2 {
                    reg = <2>;
              };
              vin2b: port@3 {
                    reg = <3>;
              };
         };
    };
...
```

## Documentation/devicetree/bindings/media/toshiba,visconti5-viif.yaml
```yaml
# SPDX-License-Identifier: (GPL-2.0-only OR BSD-2-Clause)
%YAML 1.2
---
$id: http://devicetree.org/schemas/media/toshiba,visconti5-viif.yaml#
$schema: http://devicetree.org/meta-schemas/core.yaml#

title: Toshiba Visconti5 SoC Video Input Interface

maintainers:
  - Nobuhiro Iwamatsu <nobuhiro1.iwamatsu@toshiba.co.jp>

description: |-
  Toshiba Visconti5 SoC Video Input Interface (VIIF) receives MIPI CSI2 video
  stream, processes the stream with image signal processors (L1ISP, L2ISP),
  then stores pictures to main memory.

properties:
  compatible:
    const: toshiba,visconti5-viif

  reg:
    items:
      - description: Registers for capture control
      - description: Registers for CSI2 receiver control
      - description: Registers for bus interface unit control
      - description: Registers for Memory Protection Unit

  interrupts:
    items:
      - description: Sync Interrupt
      - description: Status (Error) Interrupt
      - description: CSI2 Receiver Interrupt
      - description: L1ISP Interrupt

  port:
    $ref: /schemas/graph.yaml#/$defs/port-base
    unevaluatedProperties: false
    description: CSI-2 input port, with a single endpoint connected to the CSI-2 transmitter.

    properties:
      endpoint:
        $ref: video-interfaces.yaml#
        additionalProperties: false

        required:
          - clock-noncontinuous
          - link-frequencies
          - remote-endpoint
          - data-lanes

        properties:
          data-lanes:
            description: VIIF supports 1, 2, 3 or 4 data lanes
            minItems: 1
            items:
              - const: 1
              - const: 2
              - const: 3
              - const: 4

          clock-noncontinuous: true
          link-frequencies: true
          remote-endpoint: true

required:
  - compatible
  - reg
  - interrupts
  - port

additionalProperties: false

examples:
  - |
    #include <dt-bindings/interrupt-controller/arm-gic.h>
    #include <dt-bindings/interrupt-controller/irq.h>

    soc {
        #address-cells = <2>;
        #size-cells = <2>;

        video@1c000000 {
            compatible = "toshiba,visconti5-viif";
            reg = <0 0x1c000000 0 0x6000>,
                  <0 0x1c008000 0 0x400>,
                  <0 0x1c00e000 0 0x1000>,
                  <0 0x2417a000 0 0x1000>;
            interrupts = <GIC_SPI 64 IRQ_TYPE_LEVEL_HIGH>,
                         <GIC_SPI 67 IRQ_TYPE_LEVEL_HIGH>,
                         <GIC_SPI 73 IRQ_TYPE_LEVEL_HIGH>,
                         <GIC_SPI 76 IRQ_TYPE_LEVEL_HIGH>;

            port {
                #address-cells = <1>;
                #size-cells = <0>;

                csi_in0: endpoint {
                    remote-endpoint = <&imx219_out0>;
                    data-lanes = <1 2>;
                    clock-noncontinuous;
                    link-frequencies = /bits/ 64 <456000000>;
                };
            };
        };
    };
```

## Documentation/devicetree/bindings/media/usb-camera-module.yaml
```yaml
# SPDX-License-Identifier: (GPL-2.0-only OR BSD-2-Clause)
%YAML 1.2
---
$id: http://devicetree.org/schemas/media/usb-camera-module.yaml#
$schema: http://devicetree.org/meta-schemas/core.yaml#

title: USB Camera Module

maintainers:
  - Ricardo Ribalda <ribalda@chromium.org>

description: |
  This schema allows for annotating auxiliary information for fixed camera
  modules. This information enables the system to determine if incoming frames
  require rotation, mirroring, or other transformations. It also describes the
  module's relationship with other hardware elements, such as flash LEDs or
  Voice Coil Motors (VCMs).

allOf:
  - $ref: /schemas/usb/usb-device.yaml#
  - $ref: /schemas/media/video-interface-devices.yaml#

properties:
  reg:
    maxItems: 1

required:
  - reg

additionalProperties: true

examples:
  - |
    usb@11270000 {
        reg = <0x11270000 0x1000>;
        interrupts = <0x0 0x4e 0x0>;
        #address-cells = <1>;
        #size-cells = <0>;

        device@1 {
            compatible = "usb123,4567";
            reg = <2>;
            orientation = <0>;
            rotation = <90>;
        };
    };
```

## Documentation/devicetree/bindings/media/xilinx/xlnx,axi4-os62420.yaml
```yaml
# SPDX-License-Identifier: (GPL-2.0-only OR BSD-2-Clause)
%YAML 1.2
---
$id: http://devicetree.org/schemas/media/xilinx/xlnx,axi4-os62420.yaml#
$schema: http://devicetree.org/meta-schemas/core.yaml#

title: Xilinx MediaLB DIM2 Controller

maintainers:
  - Andrey Shvetsov <andrey.shvetsov@k2l.de>

description: |
  MediaLB DIM2 module found in Xilinx FPGAs.

properties:
  compatible:
    enum:
      - xlnx,axi4-os62420_3pin-1.00.a
      - xlnx,axi4-os62420_6pin-1.00.a

  reg:
    maxItems: 1

  interrupts:
    items:
      - description: MediaLB Interrupt
      - description: AHB0 Interrupt

  microchip,clock-speed:
    $ref: /schemas/types.yaml#/definitions/string
    enum:
      - 256fs
      - 512fs
      - 1024fs
      - 2048fs
      - 3072fs
      - 4096fs
      - 6144fs
      - 8192fs
    description: DIM2 clock speed.

required:
  - compatible
  - reg
  - interrupts
  - microchip,clock-speed

additionalProperties: false

examples:
  - |
    #include <dt-bindings/interrupt-controller/arm-gic.h>

    dim2@e6050000 {
        compatible = "xlnx,axi4-os62420_3pin-1.00.a";
        reg = <0x43c00000 0x10000>;
        interrupts = <0 144 IRQ_TYPE_LEVEL_HIGH>,
                     <0 145 IRQ_TYPE_LEVEL_HIGH>;
        microchip,clock-speed = "2048fs";
    };
```
