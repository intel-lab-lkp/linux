## Documentation/devicetree/bindings/memory-controllers/nvidia,tegra114-emc.yaml
```yaml
# SPDX-License-Identifier: (GPL-2.0-only OR BSD-2-Clause)
%YAML 1.2
---
$id: http://devicetree.org/schemas/memory-controllers/nvidia,tegra114-emc.yaml#
$schema: http://devicetree.org/meta-schemas/core.yaml#

title: NVIDIA Tegra114 SoC External Memory Controller

maintainers:
  - Svyatoslav Ryhel <clamor95@gmail.com>

description:
  The EMC interfaces with the off-chip SDRAM to service the request stream sent
  from the memory controller.

properties:
  compatible:
    const: nvidia,tegra114-emc

  reg:
    maxItems: 1

  clocks:
    maxItems: 1

  clock-names:
    items:
      - const: emc

  interrupts:
    maxItems: 1

  "#interconnect-cells":
    const: 0

  nvidia,memory-controller:
    $ref: /schemas/types.yaml#/definitions/phandle
    description:
      phandle of the memory controller node

  power-domains:
    maxItems: 1
    description:
      Phandle of the SoC "core" power domain.

  operating-points-v2:
    description:
      Should contain freqs and voltages and opp-supported-hw property, which is
      a bitfield indicating SoC speedo ID mask.

patternProperties:
  "^emc-timings-[0-9]+$":
    type: object
    additionalProperties: false
    properties:
      nvidia,ram-code:
        $ref: /schemas/types.yaml#/definitions/uint32
        description:
          value of the RAM_CODE field in the PMC_STRAPPING_OPT_A register that
          this timing set is used for

    patternProperties:
      "^timing-[0-9]+$":
        type: object
        properties:
          clock-frequency:
            description:
              external memory clock rate in Hz
            minimum: 1000000
            maximum: 1000000000

          nvidia,emc-auto-cal-config:
            $ref: /schemas/types.yaml#/definitions/uint32
            description:
              value of the EMC_AUTO_CAL_CONFIG register for this set of timings

          nvidia,emc-auto-cal-config2:
            $ref: /schemas/types.yaml#/definitions/uint32
            description:
              value of the EMC_AUTO_CAL_CONFIG2 register for this set of timings

          nvidia,emc-auto-cal-config3:
            $ref: /schemas/types.yaml#/definitions/uint32
            description:
              value of the EMC_AUTO_CAL_CONFIG3 register for this set of timings

          nvidia,emc-auto-cal-interval:
            description:
              pad calibration interval in microseconds
            $ref: /schemas/types.yaml#/definitions/uint32
            minimum: 0
            maximum: 2097151

          nvidia,emc-cfg:
            $ref: /schemas/types.yaml#/definitions/uint32
            description:
              value of the EMC_CFG register for this set of timings

          nvidia,emc-ctt-term-ctrl:
            $ref: /schemas/types.yaml#/definitions/uint32
            description:
              value of the EMC_CTT_TERM_CTRL register for this set of timings

          nvidia,emc-mode-1:
            $ref: /schemas/types.yaml#/definitions/uint32
            description:
              value of the EMC_MRW register for this set of timings

          nvidia,emc-mode-2:
            $ref: /schemas/types.yaml#/definitions/uint32
            description:
              value of the EMC_MRW2 register for this set of timings

          nvidia,emc-mode-4:
            $ref: /schemas/types.yaml#/definitions/uint32
            description:
              value of the EMC_MRW4 register for this set of timings

          nvidia,emc-mode-reset:
            $ref: /schemas/types.yaml#/definitions/uint32
            description:
              reset value of the EMC_MRS register for this set of timings

          nvidia,emc-mrs-wait-cnt:
            $ref: /schemas/types.yaml#/definitions/uint32
            description:
              value of the EMR_MRS_WAIT_CNT register for this set of timings

          nvidia,emc-sel-dpd-ctrl:
            $ref: /schemas/types.yaml#/definitions/uint32
            description:
              value of the EMC_SEL_DPD_CTRL register for this set of timings

          nvidia,emc-xm2dqspadctrl2:
            $ref: /schemas/types.yaml#/definitions/uint32
            description:
              value of the EMC_XM2DQSPADCTRL2 register for this set of timings

          nvidia,emc-zcal-cnt-long:
            description:
              number of EMC clocks to wait before issuing any commands after
              clock change
            $ref: /schemas/types.yaml#/definitions/uint32
            minimum: 0
            maximum: 1023

          nvidia,emc-zcal-interval:
            $ref: /schemas/types.yaml#/definitions/uint32
            description:
              value of the EMC_ZCAL_INTERVAL register for this set of timings

          nvidia,emc-configuration:
            description:
              EMC timing characterization data. These are the registers (see
              section "20.11.2 EMC Registers" in the TRM) whose values need to
              be specified, according to the board documentation.
            $ref: /schemas/types.yaml#/definitions/uint32-array
            items:
              - description: EMC_RC
              - description: EMC_RFC
              - description: EMC_RAS
              - description: EMC_RP
              - description: EMC_R2W
              - description: EMC_W2R
              - description: EMC_R2P
              - description: EMC_W2P
              - description: EMC_RD_RCD
              - description: EMC_WR_RCD
              - description: EMC_RRD
              - description: EMC_REXT
              - description: EMC_WEXT
              - description: EMC_WDV
              - description: EMC_WDV_MASK
              - description: EMC_QUSE
              - description: EMC_IBDLY
              - description: EMC_EINPUT
              - description: EMC_EINPUT_DURATION
              - description: EMC_PUTERM_EXTRA
              - description: EMC_CDB_CNTL_1
              - description: EMC_CDB_CNTL_2
              - description: EMC_QRST
              - description: EMC_QSAFE
              - description: EMC_RDV
              - description: EMC_RDV_MASK
              - description: EMC_REFRESH
              - description: EMC_BURST_REFRESH_NUM
              - description: EMC_PRE_REFRESH_REQ_CNT
              - description: EMC_PDEX2WR
              - description: EMC_PDEX2RD
              - description: EMC_PCHG2PDEN
              - description: EMC_ACT2PDEN
              - description: EMC_AR2PDEN
              - description: EMC_RW2PDEN
              - description: EMC_TXSR
              - description: EMC_TXSRDLL
              - description: EMC_TCKE
              - description: EMC_TCKESR
              - description: EMC_TPD
              - description: EMC_TFAW
              - description: EMC_TRPAB
              - description: EMC_TCLKSTABLE
              - description: EMC_TCLKSTOP
              - description: EMC_TREFBW
              - description: EMC_QUSE_EXTRA
              - description: EMC_FBIO_CFG6
              - description: EMC_ODT_WRITE
              - description: EMC_ODT_READ
              - description: EMC_FBIO_CFG5
              - description: EMC_CFG_DIG_DLL
              - description: EMC_CFG_DIG_DLL_PERIOD
              - description: EMC_DLL_XFORM_DQS0
              - description: EMC_DLL_XFORM_DQS1
              - description: EMC_DLL_XFORM_DQS2
              - description: EMC_DLL_XFORM_DQS3
              - description: EMC_DLL_XFORM_DQS4
              - description: EMC_DLL_XFORM_DQS5
              - description: EMC_DLL_XFORM_DQS6
              - description: EMC_DLL_XFORM_DQS7
              - description: EMC_DLL_XFORM_QUSE0
              - description: EMC_DLL_XFORM_QUSE1
              - description: EMC_DLL_XFORM_QUSE2
              - description: EMC_DLL_XFORM_QUSE3
              - description: EMC_DLL_XFORM_QUSE4
              - description: EMC_DLL_XFORM_QUSE5
              - description: EMC_DLL_XFORM_QUSE6
              - description: EMC_DLL_XFORM_QUSE7
              - description: EMC_DLI_TRIM_TXDQS0
              - description: EMC_DLI_TRIM_TXDQS1
              - description: EMC_DLI_TRIM_TXDQS2
              - description: EMC_DLI_TRIM_TXDQS3
              - description: EMC_DLI_TRIM_TXDQS4
              - description: EMC_DLI_TRIM_TXDQS5
              - description: EMC_DLI_TRIM_TXDQS6
              - description: EMC_DLI_TRIM_TXDQS7
              - description: EMC_DLL_XFORM_DQ0
              - description: EMC_DLL_XFORM_DQ1
              - description: EMC_DLL_XFORM_DQ2
              - description: EMC_DLL_XFORM_DQ3
              - description: EMC_XM2CMDPADCTRL
              - description: EMC_XM2CMDPADCTRL4
              - description: EMC_XM2DQPADCTRL2
              - description: EMC_XM2CLKPADCTRL
              - description: EMC_XM2COMPPADCTRL
              - description: EMC_XM2VTTGENPADCTRL
              - description: EMC_XM2VTTGENPADCTRL2
              - description: EMC_XM2DQSPADCTRL3
              - description: EMC_XM2DQSPADCTRL4
              - description: EMC_DSR_VTTGEN_DRV
              - description: EMC_TXDSRVTTGEN
              - description: EMC_FBIO_SPARE
              - description: EMC_ZCAL_WAIT_CNT
              - description: EMC_MRS_WAIT_CNT2
              - description: EMC_CTT
              - description: EMC_CTT_DURATION
              - description: EMC_DYN_SELF_REF_CONTROL

        required:
          - clock-frequency
          - nvidia,emc-auto-cal-config
          - nvidia,emc-auto-cal-config2
          - nvidia,emc-auto-cal-config3
          - nvidia,emc-auto-cal-interval
          - nvidia,emc-cfg
          - nvidia,emc-ctt-term-ctrl
          - nvidia,emc-mode-1
          - nvidia,emc-mode-2
          - nvidia,emc-mode-4
          - nvidia,emc-mode-reset
          - nvidia,emc-mrs-wait-cnt
          - nvidia,emc-sel-dpd-ctrl
          - nvidia,emc-xm2dqspadctrl2
          - nvidia,emc-zcal-cnt-long
          - nvidia,emc-zcal-interval
          - nvidia,emc-configuration

        additionalProperties: false

required:
  - compatible
  - reg
  - interrupts
  - clocks
  - clock-names
  - nvidia,memory-controller
  - "#interconnect-cells"
  - operating-points-v2

additionalProperties: false

examples:
  - |
    #include <dt-bindings/clock/tegra114-car.h>
    #include <dt-bindings/interrupt-controller/arm-gic.h>

    external-memory-controller@7001b000 {
        compatible = "nvidia,tegra114-emc";
        reg = <0x7001b000 0x1000>;
        interrupts = <GIC_SPI 78 IRQ_TYPE_LEVEL_HIGH>;
        clocks = <&tegra_car TEGRA114_CLK_EMC>;
        clock-names = "emc";

        nvidia,memory-controller = <&mc>;
        operating-points-v2 = <&dvfs_opp_table>;
        power-domains = <&domain>;

        #interconnect-cells = <0>;

        emc-timings-0 {
            nvidia,ram-code = <0>;

            timing-0 {
                clock-frequency = <12750000>;

                nvidia,emc-auto-cal-config = <0xa0f10f0f>;
                nvidia,emc-auto-cal-config2 = <0x00000000>;
                nvidia,emc-auto-cal-config3 = <0x00000000>;
                nvidia,emc-auto-cal-interval = <0x001fffff>;
                nvidia,emc-cfg = <0x7324000e>;
                nvidia,emc-ctt-term-ctrl = <0x00000802>;
                nvidia,emc-mode-1 = <0x80100003>;
                nvidia,emc-mode-2 = <0x80200008>;
                nvidia,emc-mode-4 = <0x00000000>;
                nvidia,emc-mode-reset = <0x80001221>;
                nvidia,emc-mrs-wait-cnt = <0x000c000c>;
                nvidia,emc-sel-dpd-ctrl = <0x00040320>;
                nvidia,emc-xm2dqspadctrl2 = <0x0000a11c>;
                nvidia,emc-zcal-cnt-long = <0x00000042>;
                nvidia,emc-zcal-interval = <0x00000000>;

                nvidia,emc-configuration = <
                    0x00000000 /* EMC_RC */
                    0x00000003 /* EMC_RFC */
                    0x00000000 /* EMC_RAS */
                    0x00000000 /* EMC_RP */
                    0x00000004 /* EMC_R2W */
                    0x0000000a /* EMC_W2R */
                    0x00000003 /* EMC_R2P */
                    0x0000000b /* EMC_W2P */
                    0x00000000 /* EMC_RD_RCD */
                    0x00000000 /* EMC_WR_RCD */
                    0x00000003 /* EMC_RRD */
                    0x00000001 /* EMC_REXT */
                    0x00000000 /* EMC_WEXT */
                    0x00000005 /* EMC_WDV */
                    0x0000000f /* EMC_WDV_MASK */
                    0x00000006 /* EMC_QUSE */
                    0x00000006 /* EMC_IBDLY */
                    0x00000004 /* EMC_EINPUT */
                    0x00000004 /* EMC_EINPUT_DURATION */
                    0x00010000 /* EMC_PUTERM_EXTRA */
                    0x00000000 /* EMC_CDB_CNTL_1 */
                    0x00000000 /* EMC_CDB_CNTL_2 */
                    0x00000004 /* EMC_QRST */
                    0x00000009 /* EMC_QSAFE */
                    0x0000000d /* EMC_RDV */
                    0x0000000f /* EMC_RDV_MASK */
                    0x00000060 /* EMC_REFRESH */
                    0x00000000 /* EMC_BURST_REFRESH_NUM */
                    0x00000018 /* EMC_PRE_REFRESH_REQ_CNT */
                    0x00000002 /* EMC_PDEX2WR */
                    0x00000002 /* EMC_PDEX2RD */
                    0x00000001 /* EMC_PCHG2PDEN */
                    0x00000000 /* EMC_ACT2PDEN */
                    0x00000007 /* EMC_AR2PDEN */
                    0x0000000f /* EMC_RW2PDEN */
                    0x00000005 /* EMC_TXSR */
                    0x00000005 /* EMC_TXSRDLL */
                    0x00000004 /* EMC_TCKE */
                    0x00000004 /* EMC_TCKESR */
                    0x00000004 /* EMC_TPD */
                    0x00000004 /* EMC_TFAW */
                    0x00000000 /* EMC_TRPAB */
                    0x00000004 /* EMC_TCLKSTABLE */
                    0x00000005 /* EMC_TCLKSTOP */
                    0x00000064 /* EMC_TREFBW */
                    0x00000005 /* EMC_QUSE_EXTRA */
                    0x00000006 /* EMC_FBIO_CFG6 */
                    0x00000020 /* EMC_ODT_WRITE */
                    0x00000000 /* EMC_ODT_READ */
                    0x0000aa88 /* EMC_FBIO_CFG5 */
                    0x002c00a0 /* EMC_CFG_DIG_DLL */
                    0x00008000 /* EMC_CFG_DIG_DLL_PERIOD */
                    0x00064000 /* EMC_DLL_XFORM_DQS0 */
                    0x00064000 /* EMC_DLL_XFORM_DQS1 */
                    0x00064000 /* EMC_DLL_XFORM_DQS2 */
                    0x00064000 /* EMC_DLL_XFORM_DQS3 */
                    0x00064000 /* EMC_DLL_XFORM_DQS4 */
                    0x00064000 /* EMC_DLL_XFORM_DQS5 */
                    0x00064000 /* EMC_DLL_XFORM_DQS6 */
                    0x00064000 /* EMC_DLL_XFORM_DQS7 */
                    0x00000000 /* EMC_DLL_XFORM_QUSE0 */
                    0x00000000 /* EMC_DLL_XFORM_QUSE1 */
                    0x00000000 /* EMC_DLL_XFORM_QUSE2 */
                    0x00000000 /* EMC_DLL_XFORM_QUSE3 */
                    0x00000000 /* EMC_DLL_XFORM_QUSE4 */
                    0x00000000 /* EMC_DLL_XFORM_QUSE5 */
                    0x00000000 /* EMC_DLL_XFORM_QUSE6 */
                    0x00000000 /* EMC_DLL_XFORM_QUSE7 */
                    0x00000000 /* EMC_DLI_TRIM_TXDQS0 */
                    0x00000000 /* EMC_DLI_TRIM_TXDQS1 */
                    0x00000000 /* EMC_DLI_TRIM_TXDQS2 */
                    0x00000000 /* EMC_DLI_TRIM_TXDQS3 */
                    0x00000000 /* EMC_DLI_TRIM_TXDQS4 */
                    0x00000000 /* EMC_DLI_TRIM_TXDQS5 */
                    0x00000000 /* EMC_DLI_TRIM_TXDQS6 */
                    0x00000000 /* EMC_DLI_TRIM_TXDQS7 */
                    0x0007c000 /* EMC_DLL_XFORM_DQ0 */
                    0x0007c000 /* EMC_DLL_XFORM_DQ1 */
                    0x0007c000 /* EMC_DLL_XFORM_DQ2 */
                    0x0007c000 /* EMC_DLL_XFORM_DQ3 */
                    0x001112a0 /* EMC_XM2CMDPADCTRL */
                    0x00000000 /* EMC_XM2CMDPADCTRL4 */
                    0x00000000 /* EMC_XM2DQPADCTRL2 */
                    0x77ffc085 /* EMC_XM2CLKPADCTRL */
                    0x81f1f108 /* EMC_XM2COMPPADCTRL */
                    0x03037504 /* EMC_XM2VTTGENPADCTRL */
                    0x0000003f /* EMC_XM2VTTGENPADCTRL2 */
                    0x20820800 /* EMC_XM2DQSPADCTRL3 */
                    0x00249249 /* EMC_XM2DQSPADCTRL4 */
                    0x0000003f /* EMC_DSR_VTTGEN_DRV */
                    0x00000007 /* EMC_TXDSRVTTGEN */
                    0x02000000 /* EMC_FBIO_SPARE */
                    0x00000042 /* EMC_ZCAL_WAIT_CNT */
                    0x000c000c /* EMC_MRS_WAIT_CNT2 */
                    0x00000000 /* EMC_CTT */
                    0x00000000 /* EMC_CTT_DURATION */
                    0x800001c5 /* EMC_DYN_SELF_REF_CONTROL */
                >;
            };
        };
    };
```
