## Documentation/devicetree/bindings/memory-controllers/nvidia,tegra210-emc.yaml
```yaml
# SPDX-License-Identifier: (GPL-2.0-only OR BSD-2-Clause)
%YAML 1.2
---
$id: http://devicetree.org/schemas/memory-controllers/nvidia,tegra210-emc.yaml#
$schema: http://devicetree.org/meta-schemas/core.yaml#

title: NVIDIA Tegra210 SoC External Memory Controller

maintainers:
  - Thierry Reding <thierry.reding@gmail.com>
  - Jon Hunter <jonathanh@nvidia.com>

description: |
  The EMC interfaces with the off-chip SDRAM to service the request stream
  sent from the memory controller.

properties:
  compatible:
    oneOf:
      - const: nvidia,tegra210-emc
      - items:
          - const: nvidia,tegra210-emc
          - const: nvidia,tegra21-emc

  reg:
    maxItems: 3

  clocks:
    items:
      - description: external memory clock

  clock-names:
    items:
      - const: emc

  interrupts:
    items:
      - description: EMC general interrupt

  memory-region:
    maxItems: 1
    description:
      phandle to a reserved memory region describing the table of EMC
      frequencies trained by the firmware

  nvidia,memory-controller:
    $ref: /schemas/types.yaml#/definitions/phandle
    description:
      phandle of the memory controller node

  nvidia,use-ram-code:
    description:
      If set, timings are split per ram code and expected to be in
      subnodes per ram-code

  "#address-cells":
    const: 1

  "#size-cells":
    const: 0

patternProperties:
  "^emc-table@[0-9]+$":
    type: object
    additionalProperties: true
    properties:
      reg:
        maxItems: 1
        description:
          Ram code for this timing set

      nvidia,ram-code:
        $ref: /schemas/types.yaml#/definitions/uint32
        description:
          value of the RAM_CODE field in the PMC_STRAPPING_OPT_A register that
          this timing set is used for

      "#address-cells":
        const: 1

      "#size-cells":
        const: 0

    required:
      - reg
      - nvidia,ram-code


required:
  - compatible
  - reg
  - clocks
  - clock-names
  - nvidia,memory-controller

additionalProperties: false

examples:
  - |
    #include <dt-bindings/clock/tegra210-car.h>
    #include <dt-bindings/interrupt-controller/arm-gic.h>

    reserved-memory {
        #address-cells = <1>;
        #size-cells = <1>;
        ranges;

        emc_table: emc-table@83400000 {
            compatible = "nvidia,tegra210-emc-table";
            reg = <0x83400000 0x10000>;
        };
    };

    external-memory-controller@7001b000 {
        compatible = "nvidia,tegra210-emc";
        reg = <0x7001b000 0x1000>,
              <0x7001e000 0x1000>,
              <0x7001f000 0x1000>;
        clocks = <&tegra_car TEGRA210_CLK_EMC>;
        clock-names = "emc";
        interrupts = <GIC_SPI 78 IRQ_TYPE_LEVEL_HIGH>;
        memory-region = <&emc_table>;
        nvidia,memory-controller = <&mc>;
    };
```

## Documentation/devicetree/bindings/memory-controllers/socfpga-sdram-edac.yaml
```yaml
# SPDX-License-Identifier: (GPL-2.0 OR BSD-2-Clause)
%YAML 1.2
---
$id: http://devicetree.org/schemas/memory-controllers/socfpga-sdram-edac.yaml#
$schema: http://devicetree.org/meta-schemas/core.yaml#

title: Altera SoCFPGA SDRAM EDAC Controller

maintainers:
  - Matthew Gerlach <matthew.gerlach@altera.com>

description: |
  EDAC-compatible controller for SDRAM error detection and correction on
  Altera (Intel) SoCFPGA platforms.

properties:
  compatible:
    enum:
      - altr,sdram-edac
      - altr,sdram-edac-a10
      - altr,sdram-edac-s10

  altr,sdr-syscon:
    $ref: /schemas/types.yaml#/definitions/phandle
    description: Phandle to the SDRAM system controller (SDR) syscon node.

  interrupts:
    minItems: 1
    maxItems: 2
    description: |
      One or two interrupt specifiers for ECC error interrupt(s).
      Arria 10 SoCs use two interrupt lines.

  reg:
    maxItems: 1
    description: Memory-mapped base address and size of the SDRAM EDAC controller.

required:
  - compatible
  - altr,sdr-syscon
  - interrupts
  - reg

additionalProperties: false

examples:
  - |
    #include <dt-bindings/interrupt-controller/arm-gic.h>
    #include <dt-bindings/interrupt-controller/irq.h>

    edac@ffb90000 {
    compatible = "altr,sdram-edac-a10";
    reg = <0xffb90000 0x1000>;
    altr,sdr-syscon = <&sdr>;
    interrupts = <GIC_SPI 45 IRQ_TYPE_LEVEL_HIGH>,
                 <GIC_SPI 46 IRQ_TYPE_LEVEL_HIGH>;
    };

  - |
    #include <dt-bindings/interrupt-controller/arm-gic.h>
    #include <dt-bindings/interrupt-controller/irq.h>

    edac@f8004000 {
    compatible = "altr,sdram-edac-s10";
    reg = <0xf8004000 0x1000>;
    altr,sdr-syscon = <&sdr>;
    interrupts = <GIC_SPI 39 IRQ_TYPE_LEVEL_HIGH>;
    };

  - |
    #include <dt-bindings/interrupt-controller/arm-gic.h>
    #include <dt-bindings/interrupt-controller/irq.h>

    edac@ffc25000 {
    compatible = "altr,sdram-edac";
    reg = <0xffc25000 0x1000>;
    altr,sdr-syscon = <&sdr>;
    interrupts = <GIC_SPI 39 IRQ_TYPE_LEVEL_HIGH>;
    };
```

## Documentation/devicetree/bindings/memory-controllers/starfive,jh7110-dmc.yaml
```yaml
# SPDX-License-Identifier: (GPL-2.0-only OR BSD-2-Clause)
%YAML 1.2
---
$id: http://devicetree.org/schemas/memory-controllers/starfive,jh7110-dmc.yaml#
$schema: http://devicetree.org/meta-schemas/core.yaml#

title: StarFive JH7110 DMC

maintainers:
  - E Shattow <e@freeshell.de>

description:
  JH7110 DMC as implemented by U-Boot boot loader driver starfive_ddr.c

properties:
  compatible:
    items:
      - const: starfive,jh7110-dmc

  reg:
    minItems: 2
    maxItems: 2

  clocks:
    maxItems: 1

  clock-names:
    items:
      - const: pll1_out

  clock-frequency:
    enum: [2133, 2800]
    default: 2133

  resets:
    minItems: 3
    maxItems: 3

  reset-names:
    items:
      - const: axi
      - const: osc
      - const: apb

required:
  - compatible
  - reg
  - clocks
  - clock-names
  - clock-frequency
  - resets
  - reset-names

additionalProperties: false

examples:
  - |
    #include <dt-bindings/clock/starfive,jh7110-crg.h>
    #include <dt-bindings/reset/starfive,jh7110-crg.h>
    soc {
      #address-cells = <2>;
      #size-cells = <2>;

      memory-controller@15700000 {
        compatible = "starfive,jh7110-dmc";
        reg = <0x0 0x15700000 0x0 0x10000>,
              <0x0 0x13000000 0x0 0x10000>;
        clocks = <&syscrg JH7110_PLLCLK_PLL1_OUT>;
        clock-names = "pll1_out";
        clock-frequency = <2133>;
        resets = <&syscrg JH7110_SYSRST_DDR_AXI>,
                 <&syscrg JH7110_SYSRST_DDR_OSC>,
                 <&syscrg JH7110_SYSRST_DDR_APB>;
        reset-names = "axi", "osc", "apb";
      };
    };
```

## Documentation/devicetree/bindings/mfd/aaeon,srg-imx8p-mcu.yaml
```yaml
# SPDX-License-Identifier: (GPL-2.0-only OR BSD-2-Clause)
%YAML 1.2
---
$id: http://devicetree.org/schemas/mfd/aaeon,srg-imx8p-mcu.yaml#
$schema: http://devicetree.org/meta-schemas/core.yaml#

title: AAEON Embedded Controller

maintainers:
  - Jérémie Dautheribes <jeremie.dautheribes@bootlin.com>
  - Thomas Perrot <thomas.perrot@bootlin.com>

description:
  AAEON embeds a microcontroller on Standard RISC Gateway with ARM i.MX8M Plus
  Quad-Core boards providing GPIO control and watchdog timer.

  This MCU is connected via I2C bus.

  Its GPIO controller provides 7 GPOs and 12 GPIOs.

  Its watchdog has a fixed maximum hardware heartbeat of 25 seconds and supports
  a timeout of 240 seconds through automatic pinging.
  The timeout is not programmable and cannot be changed via device tree properties.

properties:
  compatible:
    const: aaeon,srg-imx8p-mcu

  reg:
    maxItems: 1

  gpio-controller: true

  "#gpio-cells":
    const: 2

  gpio-line-names:
    minItems: 1
    maxItems: 19

required:
  - compatible
  - reg
  - gpio-controller
  - "#gpio-cells"

additionalProperties: false

examples:
  - |
    i2c {
      #address-cells = <1>;
      #size-cells = <0>;

      embedded-controller@62 {
        compatible = "aaeon,srg-imx8p-mcu";
        reg = <0x62>;

        gpio-controller;
        #gpio-cells = <2>;
        gpio-line-names = "gpo-1", "gpo-2", "gpo-3", "gpo-4",
                  "gpo-5", "gpo-6", "gpo-7",
                  "gpio-1", "gpio-2", "gpio-3", "gpio-4",
                  "gpio-5", "gpio-6", "gpio-7", "gpio-8",
                  "gpio-9", "gpio-10", "gpio-11", "gpio-12";
      };
    };
```

## Documentation/devicetree/bindings/mfd/aaeon,srg-imx8pl-mcu.yaml
```yaml
# SPDX-License-Identifier: (GPL-2.0-only OR BSD-2-Clause)
%YAML 1.2
---
$id: http://devicetree.org/schemas/mfd/aaeon,srg-imx8pl-mcu.yaml#
$schema: http://devicetree.org/meta-schemas/core.yaml#

title: AAEON Embedded Controller

maintainers:
  - Jérémie Dautheribes <jeremie.dautheribes@bootlin.com>
  - Thomas Perrot <thomas.perrot@bootlin.com>

description: |
  AAEON embeds a microcontroller on their embedded boards providing system
  features such as GPIO control, watchdog timer, and LED management.
  The MCU is connected via I2C bus.

properties:
  compatible:
    const: aaeon,srg-imx8pl-mcu

  reg:
    maxItems: 1

  gpio:
    $ref: /schemas/gpio/aaeon,srg-imx8pl-gpio.yaml

  watchdog:
    $ref: /schemas/watchdog/aaeon,srg-imx8pl-wdt.yaml

required:
  - compatible
  - reg

additionalProperties: false

examples:
  - |
    i2c {
      #address-cells = <1>;
      #size-cells = <0>;

      aaeon_mcu: embedded-controller@62 {
        compatible = "aaeon,srg-imx8pl-mcu";
        reg = <0x62>;

        gpio {
          compatible = "aaeon,srg-imx8pl-gpio";
          gpio-controller;
          #gpio-cells = <2>;
          ngpios = <19>;
        };

        watchdog {
          compatible = "aaeon,srg-imx8pl-wdt";
        };
      };
    };
```

## Documentation/devicetree/bindings/mfd/adi,adp5585.yaml
```yaml
# SPDX-License-Identifier: GPL-2.0-only OR BSD-2-Clause
%YAML 1.2
---
$id: http://devicetree.org/schemas/mfd/adi,adp5585.yaml#
$schema: http://devicetree.org/meta-schemas/core.yaml#

title: ADI adp5585 GPIO, PWM, keypad controller

maintainers:
  - Frank Li <Frank.Li@nxp.com>

description:
  adp5585 is a multifunctional device that can provide GPIO, PWM and keypad.

properties:
  compatible:
    const: adi,adp5585

  reg:
    items:
      description: I2C device address.

  gpio:
    type: object
    properties:
      compatible:
        const: adp5585-gpio

      gpio-controller: true

      "#gpio-cells":
        const: 2

    required:
      - compatible
      - gpio-controller
      - "#gpio-cells"

    additionalProperties: false

  pwm:
    $ref: /schemas/pwm/pwm.yaml
    properties:
      compatible:
        const: adp5585-pwm

      "#pwm-cells":
        const: 3

    required:
      - compatible
      - "#pwm-cells"

    unevaluatedProperties: false

required:
  - compatible
  - reg

additionalProperties: false

examples:
  - |
    i2c {
        #address-cells = <1>;
        #size-cells = <0>;

        mfd@34 {
            compatible = "adi,adp5585";
            reg = <0x34>;

            gpio {
                compatible = "adp5585-gpio";
                gpio-controller;
                #gpio-cells = <2>;
            };

            pwm {
                compatible = "adp5585-pwm";
                #pwm-cells = <3>;
            };
        };
    };
```

## Documentation/devicetree/bindings/mfd/adi,ltc4283.yaml
```yaml
# SPDX-License-Identifier: (GPL-2.0 OR BSD-2-Clause)
%YAML 1.2
---
$id: http://devicetree.org/schemas/mfd/adi,ltc4283.yaml#
$schema: http://devicetree.org/meta-schemas/core.yaml#

title: LTC4283 I2C Negative Voltage Hot Swap Controller

maintainers:
  - Nuno Sá <nuno.sa@analog.com>

description: |
  The LTC4283 negative voltage hot swap controller drives an external N-channel
  MOSFET to allow a board to be safely inserted and removed from a live
  backplane.

  https://www.analog.com/media/en/technical-documentation/data-sheets/ltc4283.pdf

properties:
  compatible:
    enum:
      - adi,ltc4283

  reg:
    maxItems: 1

  gpio:
    $ref: /schemas/gpio/adi,ltc4283.yaml
  hwmon:
    $ref: /schemas/hwmon/adi,ltc4283.yaml

  adi,gpio-pins:
    description:
      The pins to use as GPIOs. The device has 4 ADIO and 4 PGIO
      pins than can be used as GPIOs. The ADIO pins are numbered from 0 to 3
      and the PGIO pins are numbered from 4 to 7.
    $ref: /schemas/types.yaml#/definitions/uint32-array
    minItems: 1
    maxItems: 8
    items:
      minimum: 0
      maximum: 7

dependencies:
  gpio:
    - adi,gpio-pins

required:
  - compatible
  - reg
  - hwmon

additionalProperties: false

examples:
  - |
    i2c {
        #address-cells = <1>;
        #size-cells = <0>;

        swap-controller@15 {
            compatible = "adi,ltc4283";
            reg = <0x15>;

            /* pgio1 to pgio4 as gpios */
            adi,gpio-pins = <0 1 2 3>;

            gpio {
                compatible = "adi,ltc4283-gpio";
                gpio-controller;
                #gpio-cells = <2>;
            };

            hwmon {
                compatible = "adi,ltc4283-hwmon";

                adi,rsense-nano-ohms = <500>;
                adi,current-limit-sense-microvolt = <25000>;
                adi,current-limit-foldback-factor = <10>;
                adi,cooling-delay-ms = <8190>;
                adi,fet-bad-timer-delay-ms = <512>;
            };
        };
    };
...
```
