## Documentation/devicetree/bindings/media/renesas,mlp.yaml
```yaml
# SPDX-License-Identifier: (GPL-2.0-only OR BSD-2-Clause)
%YAML 1.2
---
$id: http://devicetree.org/schemas/media/renesas,mlp.yaml#
$schema: http://devicetree.org/meta-schemas/core.yaml#

title: Renesas MediaLB DIM2 Controller

maintainers:
  - Andrey Shvetsov <andrey.shvetsov@k2l.de>

description: |
  MediaLB DIM2 module found in Renesas R-Car Gen2 and Gen3 SoCs.

properties:
  compatible:
    enum:
      - renesas,mlp
      - renesas,rcar-gen3-mlp

  reg:
    maxItems: 1

  interrupts:
    items:
      - description: MediaLB Interrupt
      - description: AHB0 Interrupt

  clocks:
    maxItems: 1

  microchip,clock-speed:
    $ref: /schemas/types.yaml#/definitions/string
    enum:
      - 256fs
      - 512fs
      - 1024fs
      - 2048fs
      - 3072fs
      - 4096fs
      - 6144fs
      - 8192fs
    description: DIM2 clock speed.

required:
  - compatible
  - reg
  - interrupts
  - clocks
  - microchip,clock-speed

additionalProperties: false

examples:
  - |
    #include <dt-bindings/interrupt-controller/arm-gic.h>

    mlp@e6050000 {
        compatible = "renesas,mlp";
        reg = <0xe6050000 0x1000>;
        interrupts = <GIC_SPI 144 IRQ_TYPE_LEVEL_HIGH>,
                     <GIC_SPI 145 IRQ_TYPE_LEVEL_HIGH>;
        clocks = <&cpg 123>;
        microchip,clock-speed = "2048fs";
    };
```

## Documentation/devicetree/bindings/media/renesas,rzv2h-ivc.yaml
```yaml
# SPDX-License-Identifier: (GPL-2.0-only OR BSD-2-Clause)
%YAML 1.2
---
$id: http://devicetree.org/schemas/media/renesas,rzv2h-ivc.yaml#
$schema: http://devicetree.org/meta-schemas/core.yaml#

title: Renesas RZ/V2H Input Video Control Block

maintainers:
  - Daniel Scally <dan.scally@ideasonboard.com>

description:
  The IVC block is a module that takes video frames from memory and feeds them
  to the Image Signal Processor for processing.

properties:
  compatible:
    const: renesas,r9a09g057-ivc

  reg:
    maxItems: 1

  interrupts:
    maxItems: 1

  clocks:
    items:
      - description: Input Video Control block register access clock
      - description: Video input data AXI bus clock
      - description: ISP system clock

  clock-names:
    items:
      - const: pclk
      - const: vin_aclk
      - const: sclk

  resets:
    items:
      - description: Input Video Control block register access reset
      - description: Video input data AXI bus reset
      - description: ISP core reset

  reset-names:
    items:
      - const: presetn
      - const: vin_aresetn
      - const: sresetn

  port:
    $ref: /schemas/graph.yaml#/properties/port
    description: Output parallel video bus

    properties:
      endpoint:
        $ref: /schemas/graph.yaml#/properties/endpoint

required:
  - compatible
  - reg
  - interrupts
  - clocks
  - clock-names
  - resets
  - reset-names
  - port

additionalProperties: false

examples:
  - |
    #include <dt-bindings/clock/renesas,r9a09g057-cpg.h>
    #include <dt-bindings/interrupt-controller/arm-gic.h>

    ivc: ivc@16040000 {
      compatible = "renesas,r9a09g057-ivc";
      reg = <0x16040000 0x230>;

      clocks = <&cpg CPG_MOD R9A09G057_ISP0_PCLK>,
      <&cpg CPG_MOD R9A09G057_ISP0_VIN_ACLK>,
      <&cpg CPG_MOD R9A09G057_ISP0_SCLK>;
      clock-names = "pclk", "vin_aclk", "sclk";

      resets = <&cpg R9A09G057_ISP_0_PRESETN>,
      <&cpg R9A09G057_ISP_0_VIN_ARESETN>,
      <&cpg R9A09G057_ISP_0_ISP_SRESETN>;
      reset-names = "presetn", "vin_aresetn", "sresetn";

      interrupts = <GIC_SPI 861 IRQ_TYPE_EDGE_RISING>;

      status = "okay";

      port {
        ivc_out: endpoint {
          remote-endpoint = <&isp_in>;
        };
      };
    };
...
```

## Documentation/devicetree/bindings/media/rockchip,jpeg-decoder.yaml
```yaml
# SPDX-License-Identifier: (GPL-2.0 OR BSD-2-Clause)
%YAML 1.2
---
$id: http://devicetree.org/schemas/media/rockchip,jpeg-decoder.yaml#
$schema: http://devicetree.org/meta-schemas/core.yaml#

title: Rockchip JPEG Decoder

maintainers:
  - Lucas Sinn <lucas.sinn@wolfvision.net>
  - Sascha Hauer <s.hauer@pengutronix.de>

description:
  Rockchip's in-house JPEG/MJPEG hardware decoder, known downstream as the
  VDPU720.  The same core is integrated into a number of Rockchip SoCs, which
  differ only in the clocks, resets and power domain they are wired to.  A
  dedicated Link List Processor (LLP) register block, located at offset 0x300
  within the same register window, allows the hardware to decode a chain of
  frames autonomously ("link mode").

properties:
  compatible:
    enum:
      - rockchip,rk3568-jpegd
      - rockchip,rk3588-jpegd

  reg:
    maxItems: 1
    description:
      The decoder register window.  It covers both the task (function)
      registers at offset 0x000 and the LLP (link table) registers at
      offset 0x300.

  interrupts:
    maxItems: 1

  clocks:
    items:
      - description: AXI clock
      - description: AHB clock

  clock-names:
    items:
      - const: axi
      - const: ahb

  resets:
    items:
      - description: AXI reset line
      - description: AHB reset line

  reset-names:
    items:
      - const: axi
      - const: ahb

  power-domains:
    maxItems: 1

  iommus:
    maxItems: 1

required:
  - compatible
  - reg
  - interrupts
  - clocks
  - clock-names
  - resets
  - reset-names
  - power-domains

additionalProperties: false

examples:
  - |
    #include <dt-bindings/clock/rockchip,rk3588-cru.h>
    #include <dt-bindings/interrupt-controller/arm-gic.h>
    #include <dt-bindings/power/rk3588-power.h>
    #include <dt-bindings/reset/rockchip,rk3588-cru.h>

    video-codec@fdb90000 {
        compatible = "rockchip,rk3588-jpegd";
        reg = <0xfdb90000 0x400>;
        interrupts = <GIC_SPI 129 IRQ_TYPE_LEVEL_HIGH 0>;
        clocks = <&cru ACLK_JPEG_DECODER>, <&cru HCLK_JPEG_DECODER>;
        clock-names = "axi", "ahb";
        resets = <&cru SRST_A_JPEG_DECODER>, <&cru SRST_H_JPEG_DECODER>;
        reset-names = "axi", "ahb";
        iommus = <&jpegd_mmu>;
        power-domains = <&power RK3588_PD_VDPU>;
    };
```

## Documentation/devicetree/bindings/media/rockchip,px30-vip.yaml
```yaml
# SPDX-License-Identifier: (GPL-2.0 OR BSD-2-Clause)
%YAML 1.2
---
$id: http://devicetree.org/schemas/media/rockchip,px30-vip.yaml#
$schema: http://devicetree.org/meta-schemas/core.yaml#

title: Rockchip CIF Camera Interface

maintainers:
  - Mehdi Djait <mehdi.djait@bootlin.com>

description:
  CIF is a camera interface present on some rockchip SoCs. It receives the data
  from Camera sensor or CCIR656 encoder and transfers it into system main memory
  by AXI bus.

properties:
  compatible:
    const: rockchip,px30-vip

  reg:
    maxItems: 1

  interrupts:
    maxItems: 1

  clocks:
    items:
      - description: ACLK
      - description: HCLK
      - description: PCLK

  clock-names:
    items:
      - const: aclk
      - const: hclk
      - const: pclk

  resets:
    items:
      - description: AXI
      - description: AHB
      - description: PCLK IN

  reset-names:
    items:
      - const: axi
      - const: ahb
      - const: pclkin

  power-domains:
    maxItems: 1

  ports:
    $ref: /schemas/graph.yaml#/properties/ports

    properties:
      port@0:
        $ref: /schemas/graph.yaml#/$defs/port-base
        unevaluatedProperties: false
        description: input port on the parallel interface

        properties:
          endpoint:
            $ref: video-interfaces.yaml#
            unevaluatedProperties: false

            properties:
              bus-type:
                enum: [5, 6]

            required:
              - bus-type

    required:
      - port@0

required:
  - compatible
  - reg
  - interrupts
  - clocks
  - ports

additionalProperties: false

examples:
  - |
    #include <dt-bindings/clock/px30-cru.h>
    #include <dt-bindings/display/sdtv-standards.h>
    #include <dt-bindings/gpio/gpio.h>
    #include <dt-bindings/interrupt-controller/arm-gic.h>
    #include <dt-bindings/media/video-interfaces.h>
    #include <dt-bindings/power/px30-power.h>

    parent {
        #address-cells = <2>;
        #size-cells = <2>;

        video-capture@ff490000 {
            compatible = "rockchip,px30-vip";
            reg = <0x0 0xff490000 0x0 0x200>;
            interrupts = <GIC_SPI 69 IRQ_TYPE_LEVEL_HIGH>;
            clocks = <&cru ACLK_CIF>, <&cru HCLK_CIF>, <&cru PCLK_CIF>;
            clock-names = "aclk", "hclk", "pclk";
            resets = <&cru SRST_CIF_A>, <&cru SRST_CIF_H>, <&cru SRST_CIF_PCLKIN>;
            reset-names = "axi", "ahb", "pclkin";
            power-domains = <&power PX30_PD_VI>;

            ports {
                #address-cells = <1>;
                #size-cells = <0>;

                port@0 {
                    reg = <0>;

                    cif_in: endpoint {
                        remote-endpoint = <&tw9900_out>;
                        bus-type = <MEDIA_BUS_TYPE_BT656>;
                    };
                };
            };
        };

        composite_connector {
            compatible = "composite-video-connector";
            label = "tv";
            sdtv-standards = <(SDTV_STD_PAL | SDTV_STD_NTSC)>;

            port {
                composite_to_tw9900: endpoint {
                    remote-endpoint = <&tw9900_to_composite>;
                };
            };
        };

        i2c {
            #address-cells = <1>;
            #size-cells = <0>;

            video-decoder@44 {
                compatible = "techwell,tw9900";
                reg = <0x44>;

                vdd-supply = <&tw9900_supply>;
                reset-gpios = <&gpio2 5 GPIO_ACTIVE_LOW>;

                ports {
                    #address-cells = <1>;
                    #size-cells = <0>;

                    port@0 {
                        #address-cells = <1>;
                        #size-cells = <0>;

                        reg = <0>;
                        tw9900_to_composite: endpoint@0 {
                            reg = <0>;
                            remote-endpoint = <&composite_to_tw9900>;
                        };
                    };

                    port@1 {
                        reg = <1>;
                        tw9900_out: endpoint {
                            remote-endpoint = <&cif_in>;
                        };
                    };
                };
            };
        };
    };
...
```

## Documentation/devicetree/bindings/media/rockchip,rk3568-mipi-csi.yaml
```yaml
# SPDX-License-Identifier: (GPL-2.0 OR BSD-2-Clause)
%YAML 1.2
---
$id: http://devicetree.org/schemas/media/rockchip,rk3568-mipi-csi.yaml#
$schema: http://devicetree.org/meta-schemas/core.yaml#

title: Rockchip RK3568 MIPI CSI-2 Host

maintainers:
  - Michael Riesch <michael.riesch@wolfvision.net>

description:
  The Rockchip RK3568 MIPI CSI-2 Host is a CSI-2 bridge with one input port
  and one output port. It receives the data with the help of an external
  MIPI PHY (C-PHY or D-PHY) and passes it to the Rockchip RK3568 Video Capture
  (VICAP) block.

properties:
  compatible:
    const: rockchip,rk3568-mipi-csi

  reg:
    maxItems: 1

  clocks:
    maxItems: 1

  phys:
    maxItems: 1
    description: MIPI C-PHY or D-PHY.

  power-domains:
    maxItems: 1

  resets:
    maxItems: 1

  ports:
    $ref: /schemas/graph.yaml#/properties/ports

    properties:
      port@0:
        $ref: /schemas/graph.yaml#/$defs/port-base
        unevaluatedProperties: false
        description: Input port node. Connect to e.g., a MIPI CSI-2 image sensor.

        properties:
          endpoint:
            $ref: video-interfaces.yaml#
            unevaluatedProperties: false

            properties:
              bus-type:
                enum: [1, 4]

            required:
              - bus-type

      port@1:
        $ref: /schemas/graph.yaml#/properties/port
        description: Internal port connected to a RK3568 VICAP port.

    required:
      - port@0
      - port@1

required:
  - compatible
  - reg
  - clocks
  - phys
  - phy-names
  - ports
  - power-domains
  - resets

additionalProperties: false

examples:
  - |
    #include <dt-bindings/clock/rk3568-cru.h>
    #include <dt-bindings/power/rk3568-power.h>

    parent {
        #address-cells = <2>;
        #size-cells = <2>;

        csi: csi@fdfb0000 {
            compatible = "rockchip,rk3568-mipi-csi";
            reg = <0x0 0xfdfb0000 0x0 0x10000>;
            clocks = <&cru PCLK_CSI2HOST1>;
            phys = <&csi_dphy>;
            power-domains = <&power RK3568_PD_VI>;
            resets = <&cru SRST_P_CSI2HOST1>;
            status = "disabled";

            ports {
                #address-cells = <1>;
                #size-cells = <0>;

                csi_in: port@0 {
                    reg = <0>;
                };

                csi_out: port@1 {
                    reg = <1>;

                    csi_output: endpoint {
                        remote-endpoint = <&vicap_mipi_input>;
                    };
                };
            };
        };
    };
```

## Documentation/devicetree/bindings/media/rockchip,rk3576-vepu.yaml
```yaml
# SPDX-License-Identifier: (GPL-2.0 OR BSD-2-Clause)
%YAML 1.2
---
$id: http://devicetree.org/schemas/media/rockchip,rk3576-vepu.yaml#
$schema: http://devicetree.org/meta-schemas/core.yaml#

title: Rockchip VEPU510 Video Encoder (RK3576)

maintainers:
  - Jiaxing Hu <gahing@gahingwoo.com>

description: |-
  RK3576 has two identical VEPU510 hardware H.264/H.265 video encoder
  cores. Each core is a standalone V4L2 mem2mem device in this binding;
  there is no shared hardware descriptor/link-list engine tying the two
  cores together (unlike the RK3576 video decoder's CCU), so each core
  node is independent and self-contained.

properties:
  compatible:
    const: rockchip,rk3576-vepu

  reg:
    maxItems: 1

  interrupts:
    maxItems: 1

  clocks:
    items:
      - description: The Video Encoder AXI interface clock
      - description: The Video Encoder AHB interface clock
      - description: The Video Encoder core clock

  clock-names:
    items:
      - const: aclk_vcodec
      - const: hclk_vcodec
      - const: clk_core

  assigned-clocks: true

  assigned-clock-rates: true

  resets:
    items:
      - description: The Video Encoder AXI interface reset
      - description: The Video Encoder AHB interface reset
      - description: The Video Encoder core reset

  reset-names:
    items:
      - const: video_a
      - const: video_h
      - const: video_core

  power-domains:
    maxItems: 1

  iommus:
    maxItems: 1

required:
  - compatible
  - reg
  - interrupts
  - clocks
  - clock-names
  - power-domains
  - iommus

additionalProperties: false

examples:
  - |
    #include <dt-bindings/interrupt-controller/arm-gic.h>
    #include <dt-bindings/clock/rockchip,rk3576-cru.h>
    #include <dt-bindings/power/rockchip,rk3576-power.h>

    vepu0: video-codec@27a00000 {
        compatible = "rockchip,rk3576-vepu";
        reg = <0x27a00000 0x6000>;
        interrupts = <GIC_SPI 310 IRQ_TYPE_LEVEL_HIGH>;
        clocks = <&cru ACLK_VEPU0>, <&cru HCLK_VEPU0>, <&cru CLK_VEPU0_CORE>;
        clock-names = "aclk_vcodec", "hclk_vcodec", "clk_core";
        assigned-clocks = <&cru ACLK_VEPU0>, <&cru CLK_VEPU0_CORE>;
        assigned-clock-rates = <400000000>, <702000000>;
        resets = <&cru SRST_A_VEPU0>, <&cru SRST_H_VEPU0>, <&cru SRST_VEPU0_CORE>;
        reset-names = "video_a", "video_h", "video_core";
        power-domains = <&power RK3576_PD_VEPU0>;
        iommus = <&vepu0_mmu>;
    };

...
```
