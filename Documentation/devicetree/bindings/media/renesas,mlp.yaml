## Documentation/devicetree/bindings/memory-controllers/altr,sdram-edac.yaml
```yaml
# SPDX-License-Identifier: (GPL-2.0 OR BSD-2-Clause)
%YAML 1.2
---
$id: http://devicetree.org/schemas/memory-controllers/altr,sdram-edac.yaml#
$schema: http://devicetree.org/meta-schemas/core.yaml#

title: Altera SoCFPGA SDRAM EDAC Controller

maintainers:
  - Matthew Gerlach <matthew.gerlach@altera.com>

description: |
  EDAC-compatible controller for SDRAM error detection and correction on
  Altera (Intel) SoCFPGA platforms.

properties:
  compatible:
    enum:
      - altr,sdram-edac
      - altr,sdram-edac-a10
      - altr,sdram-edac-s10

  reg:
    maxItems: 1

  altr,sdr-syscon:
    $ref: /schemas/types.yaml#/definitions/phandle
    description: Phandle to the SDRAM system controller (SDR) syscon node.

  interrupts:
    minItems: 1
    maxItems: 2

required:
  - compatible
  - reg
  - altr,sdr-syscon
  - interrupts

allOf:
  - if:
      properties:
        compatible:
          contains:
            enum:
              - altr,sdram-edac-a10
              - altr,sdram-edac-s10
    then:
      properties:
        interrupts:
          minItems: 2

additionalProperties: false

examples:
  - |
    #include <dt-bindings/interrupt-controller/arm-gic.h>
    #include <dt-bindings/interrupt-controller/irq.h>

    / {
        model = "Example SoC with SDRAM EDAC";
        compatible = "arm-soc";

        #address-cells = <1>;
        #size-cells = <1>;

        intc: interrupt-controller@0 {
            compatible = "arm,cortex-a9-gic";
            interrupt-controller;
            #interrupt-cells = <3>;
            reg = <0x0 0x1000>, <0x1000 0x1000>; // Dummy
        };

        sdr: syscon@f8000000 {
            compatible = "altr,sdr-ctl", "syscon";
            reg = <0xf8000000 0x1000>; // Dummy
        };

        memory-controller@f8004000 {
            compatible = "altr,sdram-edac-a10";
            reg = <0xf8004000 0x1000>;
            altr,sdr-syscon = <&sdr>;
            interrupt-parent = <&intc>;
            interrupts = <GIC_SPI 45 IRQ_TYPE_LEVEL_HIGH>,
                         <GIC_SPI 46 IRQ_TYPE_LEVEL_HIGH>;
        };

        memory-controller@f8011000 {
            compatible = "altr,sdram-edac-s10";
            reg = <0xf8011000 0x1000>;
            altr,sdr-syscon = <&sdr>;
            interrupt-parent = <&intc>;
            interrupts = <GIC_SPI 39 IRQ_TYPE_LEVEL_HIGH>,
                         <GIC_SPI 40 IRQ_TYPE_LEVEL_HIGH>;
        };

        memory-controller@ffc25000 {
            compatible = "altr,sdram-edac";
            reg = <0xffc25000 0x1000>;
            altr,sdr-syscon = <&sdr>;
            interrupt-parent = <&intc>;
            interrupts = <GIC_SPI 39 IRQ_TYPE_LEVEL_HIGH>;
        };
    };
```

## Documentation/devicetree/bindings/memory-controllers/ddr/jedec,ddr-channel.yaml
```yaml
# SPDX-License-Identifier: (GPL-2.0-only OR BSD-2-Clause)
%YAML 1.2
---
$id: http://devicetree.org/schemas/memory-controllers/ddr/jedec,ddr-channel.yaml#
$schema: http://devicetree.org/meta-schemas/core.yaml#

title: DDR channel with chip/rank topology description

description:
  A DDR channel is a logical grouping of memory chips that are connected
  to a host system. The main purpose of this node is to describe the
  overall DDR topology of the system, including the amount of individual
  DDR chips.

maintainers:
  - Clément Le Goffic <clement.legoffic@foss.st.com>

properties:
  compatible:
    enum:
      - jedec,ddr3-channel
      - jedec,ddr4-channel

  io-width:
    description:
      The number of DQ pins in the channel. If this number is different
      from (a multiple of) the io-width of the DDR chip, that means that
      multiple instances of that type of chip are wired in parallel on this
      channel (with the channel's DQ pins split up between the different
      chips, and the CA, CS, etc. pins of the different chips all shorted
      together).  This means that the total physical memory controlled by a
      channel is equal to the sum of the densities of each rank on the
      connected DDR chip, times the io-width of the channel divided by
      the io-width of the DDR chip.
    enum:
      - 8
      - 16
      - 32
      - 64
      - 128

required:
      - compatible
      - io-width

additionalProperties: false

examples:
  - |
    ddr_channel: ddr3-channel@0 {
        compatible = "jedec,ddr3-channel";
        io-width = <16>;
    };
```

## Documentation/devicetree/bindings/memory-controllers/ddr/jedec,ddr4.yaml
```yaml
# SPDX-License-Identifier: (GPL-2.0-only OR BSD-2-Clause)
%YAML 1.2
---
$id: http://devicetree.org/schemas/memory-controllers/ddr/jedec,ddr4.yaml#
$schema: http://devicetree.org/meta-schemas/core.yaml#

title: DDR3 SDRAM compliant to JEDEC JESD79-4D

maintainers:
  - Krzysztof Kozlowski <krzk@kernel.org>

allOf:
  - $ref: jedec,memory-props.yaml#

properties:
  compatible:
    items:
      - pattern: "^ddr4-[0-9a-f]{2},[0-9a-f]{4}$"
      - const: jedec,ddr4

required:
  - compatible
  - density
  - io-width

unevaluatedProperties: false

examples:
  - |
    ddr {
        compatible = "ddr4-ff,000f", "jedec,ddr4";
        density = <8192>;
        io-width = <8>;
    };
```

## Documentation/devicetree/bindings/memory-controllers/mediatek,common-dramc.yaml
```yaml
# SPDX-License-Identifier: GPL-2.0-only OR BSD-2-Clause
# Copyright (c) 2024 MediaTek Inc.
%YAML 1.2
---
$id: http://devicetree.org/schemas/memory-controllers/mediatek,common-dramc.yaml#
$schema: http://devicetree.org/meta-schemas/core.yaml#

title: MediaTek Common DRAMC (DRAM Controller)

maintainers:
  - Crystal Guo <crystal.guo@mediatek.com>

description: |
  The DRAM controller of MediaTek SoC provides an interface to
  get the current data rate of DRAM.

properties:
  compatible:
    const: mediatek,common-dramc

  reg:
    minItems: 9
    items:
      - description: DRAMC_AO_CHA_BASE
      - description: DRAMC_AO_CHB_BASE
      - description: DRAMC_AO_CHC_BASE
      - description: DRAMC_AO_CHD_BASE
      - description: DRAMC_NAO_CHA_BASE
      - description: DRAMC_NAO_CHB_BASE
      - description: DRAMC_NAO_CHC_BASE
      - description: DRAMC_NAO_CHD_BASE
      - description: DDRPHY_AO_CHA_BASE
      - description: DDRPHY_AO_CHB_BASE
      - description: DDRPHY_AO_CHC_BASE
      - description: DDRPHY_AO_CHD_BASE
      - description: DDRPHY_NAO_CHA_BASE
      - description: DDRPHY_NAO_CHB_BASE
      - description: DDRPHY_NAO_CHC_BASE
      - description: DDRPHY_NAO_CHD_BASE
      - description: SLEEP_BASE

  support-ch-cnt:
    maxItems: 1

  fmeter-version:
    maxItems: 1
    description:
      Fmeter version for calculating dram data rate

  crystal-freq:
    maxItems: 1
    description:
      Reference clock rate in MHz

  shu-of:
    maxItems: 1

  pll-id: true
  shu-lv: true
  sdmpcw: true
  posdiv: true
  fbksel: true
  dqsopen: true
  async-ca: true
  dq-ser-mode: true

required:
  - compatible
  - reg
  - support-ch-cnt
  - fmeter-version
  - crystal-freq
  - pll-id
  - shu-lv
  - shu-of
  - sdmpcw
  - posdiv
  - fbksel
  - dqsopen
  - async-ca
  - dq-ser-mode

additionalProperties: false

examples:
  - |
    soc {
        #address-cells = <2>;
        #size-cells = <2>;

        dramc: dramc@10230000 {
            compatible = "mediatek,common-dramc";
            reg = <0 0x10230000 0 0x2000>, /* DRAMC_AO_CHA_BASE */
                <0 0x10240000 0 0x2000>, /* DRAMC_AO_CHB_BASE */
                <0 0x10250000 0 0x2000>, /* DRAMC_AO_CHC_BASE */
                <0 0x10260000 0 0x2000>, /* DRAMC_AO_CHD_BASE */
                <0 0x10234000 0 0x1000>, /* DRAMC_NAO_CHA_BASE */
                <0 0x10244000 0 0x1000>, /* DRAMC_NAO_CHB_BASE */
                <0 0x10254000 0 0x1000>, /* DRAMC_NAO_CHC_BASE */
                <0 0x10264000 0 0x1000>, /* DRAMC_NAO_CHD_BASE */
                <0 0x10238000 0 0x2000>, /* DDRPHY_AO_CHA_BASE */
                <0 0x10248000 0 0x2000>, /* DDRPHY_AO_CHB_BASE */
                <0 0x10258000 0 0x2000>, /* DDRPHY_AO_CHC_BASE */
                <0 0x10268000 0 0x2000>, /* DDRPHY_AO_CHD_BASE */
                <0 0x10236000 0 0x2000>, /* DDRPHY_NAO_CHA_BASE */
                <0 0x10246000 0 0x2000>, /* DDRPHY_NAO_CHB_BASE */
                <0 0x10256000 0 0x2000>, /* DDRPHY_NAO_CHC_BASE */
                <0 0x10266000 0 0x2000>, /* DDRPHY_NAO_CHD_BASE */
                <0 0x10006000 0 0x1000>; /* SLEEP_BASE */
            support-ch-cnt = <4>;
            fmeter-version = <1>;
            crystal-freq = <26>;
            pll-id = <0x0e98 0x02000000 25>;
            shu-lv = <0x0e98 0x0000c000 14>;
            shu-of = <0x700>;
            sdmpcw = <0x0908 0x0007fff8 3>,
                <0x0928 0x0007fff8 3>;
            posdiv = <0x090c 0x00003800 11>,
                <0x092c 0x00003800 11>;
            fbksel = <0x0910 0x00000040 6>,
                <0x0910 0x00000040 6>;
            dqsopen = <0x0d94 0x04000000 26>,
                <0x0d94 0x04000000 26>;
            async-ca = <0x0d08 0x00000001 0>,
                <0x0d08 0x00000001 0>;
            dq-ser-mode = <0x0dc4 0x00000018 3>,
                <0x0dc4 0x00000018 3>;
        };
    };
```
