## Documentation/devicetree/bindings/media/i2c/ovti,ov3660.yaml
```yaml
# SPDX-License-Identifier: (GPL-2.0-only OR BSD-2-Clause)
%YAML 1.2
---
$id: http://devicetree.org/schemas/media/i2c/ovti,ov3660.yaml#
$schema: http://devicetree.org/meta-schemas/core.yaml#

title: OmniVision OV3660 Image Sensor

maintainers:
  - Nguyen Minh Tien <tien.nguyenminh@embeddedlinux.blog>

description:
  The OmniVision OV3660 is a 1/5" 3 megapixel (2048x1536) CMOS image sensor
  with an image signal processor and a parallel (DVP) output. It is
  controlled over SCCB (I2C) and has an internal 1.5 V regulator for its
  digital core.

allOf:
  - $ref: /schemas/media/video-interface-devices.yaml#

properties:
  compatible:
    const: ovti,ov3660

  reg:
    maxItems: 1

  clocks:
    description: XVCLK input clock (6 - 27 MHz)
    maxItems: 1

  avdd-supply:
    description: Analog voltage supply, 2.8 volts

  dovdd-supply:
    description: Digital I/O voltage supply, 1.8 or 2.8 volts

  dvdd-supply:
    description:
      Digital core voltage supply, 1.5 volts. Not needed when the internal
      regulator is used.

  powerdown-gpios:
    maxItems: 1
    description: Reference to the GPIO connected to the PWDN pin, if any.

  reset-gpios:
    maxItems: 1
    description: Reference to the GPIO connected to the RESETB pin, if any.

  port:
    description: Parallel output port
    $ref: /schemas/graph.yaml#/$defs/port-base
    additionalProperties: false

    properties:
      endpoint:
        $ref: /schemas/media/video-interfaces.yaml#
        unevaluatedProperties: false

        properties:
          bus-width:
            enum: [8, 10]

          data-shift:
            enum: [0, 2]

          pclk-sample:
            enum: [0, 1]

        required:
          - bus-width
          - hsync-active
          - vsync-active
          - pclk-sample
          - link-frequencies

    required:
      - endpoint

required:
  - compatible
  - reg
  - clocks
  - avdd-supply
  - dovdd-supply
  - port

unevaluatedProperties: false

examples:
  - |
    #include <dt-bindings/gpio/gpio.h>

    i2c {
        #address-cells = <1>;
        #size-cells = <0>;

        camera@3c {
            compatible = "ovti,ov3660";
            reg = <0x3c>;
            clocks = <&camera_clk>;
            avdd-supply = <&reg_2v8>;
            dovdd-supply = <&reg_2v8>;
            powerdown-gpios = <&gpio 5 GPIO_ACTIVE_HIGH>;
            reset-gpios = <&gpio 6 GPIO_ACTIVE_LOW>;

            port {
                endpoint {
                    remote-endpoint = <&parallel_from_ov3660>;
                    bus-width = <8>;
                    data-shift = <2>; /* D[9:2] */
                    hsync-active = <1>;
                    vsync-active = <0>;
                    pclk-sample = <1>;
                    link-frequencies = /bits/ 64 <54000000 108000000>;
                };
            };
        };
    };
...
```

## Documentation/devicetree/bindings/media/i2c/pinefeat,cef168.yaml
```yaml
# SPDX-License-Identifier: (GPL-2.0-only OR BSD-2-Clause)
# Copyright (c) 2025 Pinefeat LLP
%YAML 1.2
---
$id: http://devicetree.org/schemas/media/i2c/pinefeat,cef168.yaml#
$schema: http://devicetree.org/meta-schemas/core.yaml#

title: Pinefeat cef168 lens driver

maintainers:
  - Aliaksandr Smirnou <support@pinefeat.co.uk>

description: |
  Pinefeat produces an adapter designed to interface between
  Canon EF & EF-S lenses and non-Canon camera bodies, incorporating
  features for electronic focus and aperture adjustment. The cef168
  circuit board, included with the adapter, provides a software
  programming interface that allows control of lens focus and
  aperture positions.

properties:
  compatible:
    enum:
      - pinefeat,cef168

  reg:
    maxItems: 1

required:
  - compatible
  - reg

additionalProperties: false

examples:
  - |
    i2c {
        #address-cells = <1>;
        #size-cells = <0>;

        camera-lens@d {
            compatible = "pinefeat,cef168";
            reg = <0x0d>;
        };
    };

...
```

## Documentation/devicetree/bindings/media/i2c/samsung,s5k3t2.yaml
```yaml
# SPDX-License-Identifier: (GPL-2.0-only OR BSD-2-Clause)
%YAML 1.2
---
$id: http://devicetree.org/schemas/media/i2c/samsung,s5k3t2.yaml#
$schema: http://devicetree.org/meta-schemas/core.yaml#

title: Samsung S5K3T2 Image Sensor

description:
  Samsung S5K3T2 (ISOCELL 3T2) image sensor is a 20MP image sensor.
  The sensor is controlled over a serial camera control bus protocol,
  the widest supported output image frame size is 5184x3880 at 15 frames
  per second, data output format is RAW10 transferred over 4-lane
  MIPI D-PHY interface.

maintainers:
  - Armandas Kvietkus <armandas.kvietkus@proton.me>

allOf:
  - $ref: /schemas/media/video-interface-devices.yaml#

properties:
  compatible:
    const: samsung,s5k3t2

  reg:
    maxItems: 1

  clocks:
    description: MCLK supply clock.
    maxItems: 1

  reset-gpios:
    description: Active low GPIO connected to RESET pad of the sensor.
    maxItems: 1

  vdda-supply:
    description: Analogue voltage supply, 2.8 volts.

  vddd-supply:
    description: Digital core voltage supply, 1.05 volts.

  vddio-supply:
    description: Digital I/O voltage supply, 1.8 volts.

  port:
    $ref: /schemas/graph.yaml#/$defs/port-base
    additionalProperties: false

    properties:
      endpoint:
        $ref: /schemas/media/video-interfaces.yaml#
        unevaluatedProperties: false

        properties:
          data-lanes:
            items:
              - const: 1
              - const: 2
              - const: 3
              - const: 4

        required:
          - link-frequencies

required:
  - compatible
  - reg
  - port

unevaluatedProperties: false

examples:
  - |
      #include <dt-bindings/gpio/gpio.h>

      i2c {
          #address-cells = <1>;
          #size-cells = <0>;

          camera@10 {
              compatible = "samsung,s5k3t2";
              reg = <0x10>;
              clocks = <&camera_mclk 0>;
              assigned-clocks = <&camera_mclk 0>;
              assigned-clock-rates = <19200000>;
              reset-gpios = <&gpio1 10 GPIO_ACTIVE_LOW>;
              vdda-supply = <&vreg_2p8>;
              vddd-supply = <&vreg_1p05>;
              vddio-supply = <&vreg_1p8>;

              port {
                  endpoint {
                      data-lanes = <1 2 3 4>;
                      link-frequencies = /bits/ 64 <448000000>;
                      remote-endpoint = <&mipi_csi2_ep>;
                  };
              };
          };
      };
...
```

## Documentation/devicetree/bindings/media/i2c/sony,imx585.yaml
```yaml
# SPDX-License-Identifier: (GPL-2.0-only OR BSD-2-Clause)
%YAML 1.2
---
$id: http://devicetree.org/schemas/media/i2c/sony,imx585.yaml#
$schema: http://devicetree.org/meta-schemas/core.yaml#

title: Sony IMX585 CMOS image sensor

maintainers:
  - Will Whang <will@willwhang.com>

description:
  IMX585 sensor is a Sony CMOS sensor with 4K and FHD outputs.
  The driver supports both imx585-aaqj1 and imx585-aamj1.

properties:
  compatible:
    enum:
      - sony,imx585-aamj1
      - sony,imx585-aaqj1

  reg:
    maxItems: 1

  clocks:
    description: Clock frequency 74.25MHz, 37.125MHz, 72MHz, 27MHz, 24MHz
    maxItems: 1

  vana-supply:
    description: Analog power supply (3.3V)

  vddl-supply:
    description: Interface power supply (1.8V)

  vdig-supply:
    description: Digital power supply (1.1V)

  reset-gpios:
    description: Sensor reset (XCLR) GPIO
    maxItems: 1

  sony,sync-mode:
    description: |
      Select the sensor synchronisation mode.
        - internal-leader  (sensor drives XVS/XHS) [default]
        - internal-follower (internal clock, external XVS input)
        - external         (sensor follows external XVS/XHS)
    enum:
      - internal-leader
      - internal-follower
      - external
    default: internal-leader

  port:
    $ref: /schemas/graph.yaml#/$defs/port-base
    additionalProperties: false

    properties:
      endpoint:
        $ref: /schemas/media/video-interfaces.yaml#
        unevaluatedProperties: false

        properties:
          data-lanes:
            oneOf:
              - items:
                  - const: 1
                  - const: 2
              - items:
                  - const: 1
                  - const: 2
                  - const: 3
                  - const: 4

        required:
          - data-lanes
          - link-frequencies

required:
  - compatible
  - reg
  - clocks
  - port

unevaluatedProperties: false

examples:
  - |
    i2c {
        #address-cells = <1>;
        #size-cells = <0>;

        imx585@1a {
            compatible = "sony,imx585-aaqj1";
            reg = <0x1a>;
            clocks = <&imx585_clk>;

            assigned-clocks = <&imx585_clk>;
            assigned-clock-rates = <24000000>;

            vana-supply = <&camera_vadd_3v3>;
            vdig-supply = <&camera_vdd1_1v8>;
            vddl-supply = <&camera_vdd2_1v1>;

            port {
                imx585: endpoint {
                    remote-endpoint = <&cam>;
                    data-lanes = <1 2 3 4>;
                    link-frequencies = /bits/ 64 <720000000>;
                };
            };
        };
    };
...
```

## Documentation/devicetree/bindings/media/i2c/sony,imx681.yaml
```yaml
# SPDX-License-Identifier: (GPL-2.0 OR BSD-2-Clause)
%YAML 1.2
---
$id: http://devicetree.org/schemas/media/i2c/sony,imx681.yaml#
$schema: http://devicetree.org/meta-schemas/core.yaml#

title: Sony IMX681 CMOS Image Sensor

maintainers:
  - Andre Gilerson <andre.gilerson@gmail.com>
  - Sergey Lebedev <lsa.uz@pm.me>

description:
  The Sony IMX681 is a CMOS active pixel image sensor with a square pixel
  array, used as the user-facing camera on several Microsoft Surface devices.
  It operates from analog 2.8 V, digital 1.05 V and interface 1.8 V supplies,
  is programmable over I2C, and outputs 10-bit Bayer data over a two-lane
  MIPI CSI-2 D-PHY interface.

allOf:
  - $ref: /schemas/media/video-interface-devices.yaml#

properties:
  compatible:
    const: sony,imx681

  reg:
    maxItems: 1

  clocks:
    description: Input clock (19.2 MHz)
    maxItems: 1

  avdd-supply:
    description: Analog power supply (2.8 V)

  dvdd-supply:
    description: Digital power supply (1.05 V)

  dovdd-supply:
    description: Interface power supply (1.8 V)

  reset-gpios:
    description: Sensor reset (XCLR) GPIO, active low
    maxItems: 1

  port:
    $ref: /schemas/graph.yaml#/$defs/port-base
    unevaluatedProperties: false

    properties:
      endpoint:
        $ref: /schemas/media/video-interfaces.yaml#
        unevaluatedProperties: false

        properties:
          data-lanes:
            items:
              - const: 1
              - const: 2

        required:
          - data-lanes
          - link-frequencies

    required:
      - endpoint

required:
  - compatible
  - reg
  - clocks
  - avdd-supply
  - dvdd-supply
  - dovdd-supply
  - port

unevaluatedProperties: false

examples:
  - |
    #include <dt-bindings/gpio/gpio.h>

    i2c {
        #address-cells = <1>;
        #size-cells = <0>;

        camera-sensor@10 {
            compatible = "sony,imx681";
            reg = <0x10>;
            clocks = <&clock_cam>;
            avdd-supply = <&vcc2v8_cam>;
            dvdd-supply = <&vcc1v05_cam>;
            dovdd-supply = <&vcc1v8_cam>;
            reset-gpios = <&gpio 4 GPIO_ACTIVE_LOW>;
            orientation = <0>;
            rotation = <0>;

            port {
                imx681_ep: endpoint {
                    data-lanes = <1 2>;
                    link-frequencies = /bits/ 64 <969600000>;
                    remote-endpoint = <&csi_in>;
                };
            };
        };
    };
...
```

## Documentation/devicetree/bindings/media/i2c/sony,imx908.yaml
```yaml
# SPDX-License-Identifier: (GPL-2.0-only OR BSD-2-Clause)
# Copyright 2026 Sony Semiconductor Solutions
%YAML 1.2
---
$id: http://devicetree.org/schemas/media/i2c/sony,imx908.yaml#
$schema: http://devicetree.org/meta-schemas/core.yaml#

title: Sony IMX908 CMOS Image Sensor

maintainers:
  - Lachlan Michael <Lachlan.Michael@sony.com>

description:
  Sony IMX908 diagonal 6.42 mm (Type 1/2.8) CMOS active pixel type
  solid-state image sensor with a square pixel array and 8.39 M
  (3856x2176) pixels, supporting MIPI CSI-2 output with
  RAW10 and RAW12 formats, configured as either 2 or 4 data lanes.
  The I2C address is fixed to 0x1A as per sensor data sheet.

properties:
  compatible:
    const: sony,imx908

  reg:
    maxItems: 1

  clocks:
    description: Input clock (24 MHz, 27 MHz, 37.125 MHz, 72 MHz or 74.25 MHz)
    maxItems: 1

  dvdd-supply:
    description: Digital supply voltage (1.1V)

  ovdd-supply:
    description: Interface supply voltage (1.8V)

  avdd-supply:
    description: Analog supply voltage (3.3V)

  reset-gpios:
    description: Sensor reset (XCLR) GPIO. Active low.
    maxItems: 1

  port:
    $ref: /schemas/graph.yaml#/$defs/port-base
    unevaluatedProperties: false

    properties:
      endpoint:
        $ref: /schemas/media/video-interfaces.yaml#
        unevaluatedProperties: false

        properties:
          data-lanes:
            oneOf:
              - items:
                  - const: 1
                  - const: 2
              - items:
                  - const: 1
                  - const: 2
                  - const: 3
                  - const: 4

        required:
          - data-lanes
          - link-frequencies

required:
  - compatible
  - reg
  - clocks
  - dvdd-supply
  - ovdd-supply
  - avdd-supply
  - port

additionalProperties: false

examples:
  - |
    #include <dt-bindings/gpio/gpio.h>
    i2c {
        #address-cells = <1>;
        #size-cells = <0>;

         camera@1a {
            compatible = "sony,imx908";
            reg = <0x1a>;
            clocks = <&cdce913_cam0 0>;
            dvdd-supply = <&cam_dvdd_1r1v>;
            ovdd-supply = <&cam_ovdd_1r8v>;
            avdd-supply = <&cam_avdd_3r3v>;
            reset-gpios = <&tca6416_cam0 5 GPIO_ACTIVE_LOW>;

            port {
                imx908_out: endpoint {
                    data-lanes = <1 2 3 4>;
                    link-frequencies = /bits/ 64 <720000000>;
                    remote-endpoint = <&csi0_in>;
                };
            };
        };
    };
```
