## Documentation/devicetree/bindings/media/mediatek-jpeg-decoder.yaml
```yaml
# SPDX-License-Identifier: (GPL-2.0 OR BSD-2-Clause)
%YAML 1.2
---
$id: http://devicetree.org/schemas/media/mediatek-jpeg-decoder.yaml#
$schema: http://devicetree.org/meta-schemas/core.yaml#

title: MediaTek JPEG Decoder

maintainers:
  - Xia Jiang <xia.jiang@mediatek.com>

description: |-
  Mediatek JPEG Decoder is the JPEG decode hardware present in Mediatek SoCs

properties:
  compatible:
    oneOf:
      - items:
          - enum:
              - mediatek,mt2701-jpgdec
              - mediatek,mt8173-jpgdec
      - items:
          - enum:
              - mediatek,mt7623-jpgdec
              - mediatek,mt8188-jpgdec
          - const: mediatek,mt2701-jpgdec
      - const: mediatek,mt8189-jpgdec

  reg:
    maxItems: 1

  interrupts:
    maxItems: 1

  clocks:
    minItems: 1
    maxItems: 2

  clock-names:
    minItems: 1
    maxItems: 2
    oneOf:
      - items:
          - const: jpgdec
      - items:
          - const: jpgdec-smi
          - const: jpgdec

  mediatek,larb:
    $ref: /schemas/types.yaml#/definitions/phandle
    description: a phandle to the smi_larb node.

  power-domains:
    maxItems: 1

  iommus:
    minItems: 2
    maxItems: 32
    description: |
      Points to the respective IOMMU block with master port as argument, see
      Documentation/devicetree/bindings/iommu/mediatek,iommu.yaml for details.
      Ports are according to the HW.

required:
  - compatible
  - reg
  - interrupts
  - clocks
  - clock-names
  - power-domains
  - iommus

allOf:
  - if:
      properties:
        compatible:
          contains:
            const: mediatek,mt8189-jpgdec
    then:
      properties:
        clocks:
          maxItems: 1
        clock-names:
          maxItems: 1
    else:
      properties:
        clocks:
          minItems: 2
        clock-names:
          minItems: 2

additionalProperties: false

examples:
  - |
    #include <dt-bindings/clock/mt2701-clk.h>
    #include <dt-bindings/interrupt-controller/arm-gic.h>
    #include <dt-bindings/memory/mt2701-larb-port.h>
    #include <dt-bindings/power/mt2701-power.h>
    jpegdec: jpegdec@15004000 {
      compatible = "mediatek,mt2701-jpgdec";
      reg = <0x15004000 0x1000>;
      interrupts = <GIC_SPI 143 IRQ_TYPE_LEVEL_LOW>;
      clocks =  <&imgsys CLK_IMG_JPGDEC_SMI>,
                <&imgsys CLK_IMG_JPGDEC>;
      clock-names = "jpgdec-smi",
                    "jpgdec";
      power-domains = <&scpsys MT2701_POWER_DOMAIN_ISP>;
      iommus = <&iommu MT2701_M4U_PORT_JPGDEC_WDMA>,
               <&iommu MT2701_M4U_PORT_JPGDEC_BSDMA>;
    };
```

## Documentation/devicetree/bindings/media/microchip,dim2.yaml
```yaml
# SPDX-License-Identifier: (GPL-2.0-only OR BSD-2-Clause)
%YAML 1.2
---
$id: http://devicetree.org/schemas/media/microchip,dim2.yaml#
$schema: http://devicetree.org/meta-schemas/core.yaml#

title: Microchip MediaLB DIM2 Controller

maintainers:
  - Andrey Shvetsov <andrey.shvetsov@k2l.de>

description:
  MediaLB DIM2 module found in Freescale i.MX6Q, Renesas R-Car Gen2 and
  Gen3 SoCs, and Xilinx FPGAs.

properties:
  compatible:
    enum:
      - fsl,imx6q-mlb150
      - renesas,rcar-gen3-mlp
      - xlnx,axi4-os62420_3pin-1.00.a
      - xlnx,axi4-os62420_6pin-1.00.a

  reg:
    maxItems: 1

  interrupts:
    items:
      - description: MediaLB Interrupt
      - description: AHB0 Interrupt

  clocks:
    minItems: 1
    maxItems: 2

  clock-names:
    minItems: 1
    items:
      - const: core
      - const: pll8_mlb

  microchip,clock-frequency:
    $ref: /schemas/types.yaml#/definitions/string
    enum:
      - 256fs
      - 512fs
      - 1024fs
      - 2048fs
      - 3072fs
      - 4096fs
      - 6144fs
      - 8192fs
    description:
      DIM2 clock speed as a multiple of the frame sync frequency.

required:
  - compatible
  - reg
  - interrupts
  - microchip,clock-frequency

allOf:
  - if:
      properties:
        compatible:
          contains:
            const: fsl,imx6q-mlb150
    then:
      required:
        - clocks
        - clock-names
      properties:
        clocks:
          minItems: 2
        clock-names:
          minItems: 2

  - if:
      properties:
        compatible:
          contains:
            const: renesas,rcar-gen3-mlp
    then:
      required:
        - clocks
      properties:
        clocks:
          maxItems: 1
        clock-names: false

  - if:
      properties:
        compatible:
          contains:
            enum:
              - xlnx,axi4-os62420_3pin-1.00.a
              - xlnx,axi4-os62420_6pin-1.00.a
    then:
      properties:
        clocks: false
        clock-names: false

additionalProperties: false

examples:
  - |
    #include <dt-bindings/interrupt-controller/arm-gic.h>

    mlb@218e000 {
        compatible = "fsl,imx6q-mlb150";
        reg = <0x0218e000 0x4000>;
        interrupts = <0 150 IRQ_TYPE_LEVEL_HIGH>,
                     <0 151 IRQ_TYPE_LEVEL_HIGH>;
        clocks = <&clks 1>, <&clks 2>;
        clock-names = "core", "pll8_mlb";
        microchip,clock-frequency = "2048fs";
    };
  - |
    /* Renesas example */
    mlp@e6050000 {
        compatible = "renesas,rcar-gen3-mlp";
        reg = <0xe6050000 0x1000>;
        interrupts = <GIC_SPI 144 IRQ_TYPE_LEVEL_HIGH>,
                     <GIC_SPI 145 IRQ_TYPE_LEVEL_HIGH>;
        clocks = <&cpg 123>;
        microchip,clock-frequency = "2048fs";
    };
  - |
    /* Xilinx example */
    dim2@43c00000 {
        compatible = "xlnx,axi4-os62420_3pin-1.00.a";
        reg = <0x43c00000 0x10000>;
        interrupts = <0 144 IRQ_TYPE_LEVEL_HIGH>,
                     <0 145 IRQ_TYPE_LEVEL_HIGH>;
        microchip,clock-frequency = "2048fs";
    };
```

## Documentation/devicetree/bindings/media/nxp,imx8-jpeg.yaml
```yaml
# SPDX-License-Identifier: (GPL-2.0 OR BSD-2-Clause)
%YAML 1.2
---
$id: http://devicetree.org/schemas/media/nxp,imx8-jpeg.yaml#
$schema: http://devicetree.org/meta-schemas/core.yaml#

title: i.MX8QXP/QM JPEG decoder/encoder

maintainers:
  - Mirela Rabulea <mirela.rabulea@nxp.com>

description: |-
  The JPEG decoder/encoder present in iMX8QXP and iMX8QM SoCs is an
  ISO/IEC 10918-1 JPEG standard compliant decoder/encoder, for Baseline
  and Extended Sequential DCT modes.

properties:
  compatible:
    oneOf:
      - items:
          enum:
            - nxp,imx8qxp-jpgdec
            - nxp,imx8qxp-jpgenc
      - items:
          - const: nxp,imx8qm-jpgdec
          - const: nxp,imx8qxp-jpgdec
      - items:
          - const: nxp,imx8qm-jpgenc
          - const: nxp,imx8qxp-jpgenc

  reg:
    maxItems: 1

  interrupts:
    description:
      Interrupt number for slot
    maxItems: 1

  power-domains:
    description:
      List of phandle and PM domain specifier as documented in
      Documentation/devicetree/bindings/power/power_domain.txt
    minItems: 1               # VPUMIX
    maxItems: 2               # Wrapper and 1 slot

  nxp,slot:
    $ref: /schemas/types.yaml#/definitions/uint32
    description: Integer number of slot index used.
    minimum: 0
    maximum: 3

required:
  - compatible
  - reg
  - interrupts
  - power-domains
  - nxp,slot

additionalProperties: false

examples:
  - |
    #include <dt-bindings/interrupt-controller/arm-gic.h>
    #include <dt-bindings/firmware/imx/rsrc.h>

    jpegdec: jpegdec@58400000 {
        compatible = "nxp,imx8qxp-jpgdec";
        reg = <0x58400000 0x00050000 >;
        interrupts = <GIC_SPI 309 IRQ_TYPE_LEVEL_HIGH>;
        power-domains = <&pd IMX_SC_R_MJPEG_DEC_MP>,
                        <&pd IMX_SC_R_MJPEG_DEC_S0>;
        nxp,slot = <0>;
    };

    jpegenc: jpegenc@58450000 {
        compatible = "nxp,imx8qm-jpgenc", "nxp,imx8qxp-jpgenc";
        reg = <0x58450000 0x00050000 >;
        interrupts = <GIC_SPI 305 IRQ_TYPE_LEVEL_HIGH>;
        power-domains = <&pd IMX_SC_R_MJPEG_ENC_MP>,
                        <&pd IMX_SC_R_MJPEG_ENC_S0>;
        nxp,slot = <0>;
    };
...
```

## Documentation/devicetree/bindings/media/nxp,imx9-csi-formatter.yaml
```yaml
# SPDX-License-Identifier: (GPL-2.0-only OR BSD-2-Clause)
%YAML 1.2
---
$id: http://devicetree.org/schemas/media/nxp,imx9-csi-formatter.yaml#
$schema: http://devicetree.org/meta-schemas/core.yaml#

title: i.MX9 CSI Pixel Formatter

maintainers:
  - Guoniu Zhou <guoniu.zhou@nxp.com>

description:
  The CSI pixel formatting module uses packet info, pixel and non-pixel
  data from the CSI-2 host controller and reformat them to match Pixel
  Link(PL) definition.

properties:
  compatible:
    const: fsl,imx9-csi-formatter

  reg:
    maxItems: 1

  clocks:
    maxItems: 1

  clock-names:
    maxItems: 1

  power-domains:
    maxItems: 1

  ports:
    $ref: /schemas/graph.yaml#/properties/ports

    properties:
      port@0:
        $ref: /schemas/graph.yaml#/$defs/port-base
        unevaluatedProperties: false
        description: MIPI CSI-2 RX IDI interface

        properties:
          endpoint:
            $ref: video-interfaces.yaml#
            unevaluatedProperties: false

      port@1:
        $ref: /schemas/graph.yaml#/properties/port
        description: Pixel Link Interface

required:
  - compatible
  - reg
  - clocks
  - clock-names
  - power-domains
  - ports

additionalProperties: false

examples:
  - |
    #include <dt-bindings/clock/nxp,imx95-clock.h>

    /*
     * Power domain definitions from arch/arm64/boot/dts/freescale/imx95-power.h
     */

    #define IMX95_PD_CAMERA		3

    formatter@20 {
        compatible = "fsl,imx9-csi-formatter";
        reg = <0x20 0x100>;
        clocks = <&cameramix_csr IMX95_CLK_CAMBLK_CSI2_FOR0>;
        clock-names = "pixel";
        power-domains = <&scmi_devpd IMX95_PD_CAMERA>;

        ports {
            #address-cells = <1>;
            #size-cells = <0>;

            port@0 {
                reg = <0>;

                endpoint {
                    remote-endpoint = <&mipi_csi_0_out>;
                };
            };

            port@1 {
                reg = <1>;

                endpoint {
                    remote-endpoint = <&isi_in_2>;
                };
            };
        };
    };
```

## Documentation/devicetree/bindings/media/nxp,imx95-vpu.yaml
```yaml
# SPDX-License-Identifier: (GPL-2.0 OR BSD-2-Clause)
%YAML 1.2
---
$id: http://devicetree.org/schemas/media/nxp,imx95-vpu.yaml#
$schema: http://devicetree.org/meta-schemas/core.yaml#

title: Chips&Media Wave6 Series multi-standard codec IP on NXP i.MX SoCs

maintainers:
  - Nas Chung <nas.chung@chipsnmedia.com>
  - Jackson Lee <jackson.lee@chipsnmedia.com>

description:
  The Chips&Media Wave6 codec IP is a multi-standard video encoder/decoder.
  On NXP i.MX SoCs, the Wave6 codec IP exposes one control register region and
  four interface register regions for a shared video processing engine.
  The parent node describes the control region, which has its own MMIO range and
  manages shared resources such as firmware memory. The child nodes describe the
  interface register regions. Each interface region has its own MMIO range and
  interrupt.
  The control region and the interface regions are distinct DMA requesters.
  The control region and each interface region can be associated with separate
  IOMMU stream IDs, allowing DMA isolation between them.

properties:
  compatible:
    enum:
      - nxp,imx95-vpu

  reg:
    maxItems: 1

  clocks:
    items:
      - description: VPU core clock
      - description: VPU associated block clock

  clock-names:
    items:
      - const: core
      - const: vpublk

  power-domains:
    items:
      - description: Main VPU power domain
      - description: Performance power domain

  power-domain-names:
    items:
      - const: vpu
      - const: perf

  memory-region:
    maxItems: 1

  sram:
    $ref: /schemas/types.yaml#/definitions/phandle
    description:
      phandle to the SRAM node used to store reference data, reducing DMA
      memory bandwidth.

  iommus:
    maxItems: 1

  "#cooling-cells":
    const: 2

  "#address-cells":
    const: 2

  "#size-cells":
    const: 2

  ranges: true

patternProperties:
  "^interface@[0-9a-f]+$":
    type: object
    description:
      An interface register region within the Chips&Media Wave6 codec IP.
      Each region has its own MMIO range and interrupt and can be associated
      with a separate IOMMU stream ID for DMA isolation.
    additionalProperties: false

    properties:
      reg:
        maxItems: 1

      interrupts:
        maxItems: 1

      iommus:
        maxItems: 1

    required:
      - reg
      - interrupts

required:
  - compatible
  - reg
  - clocks
  - clock-names
  - power-domains
  - power-domain-names
  - memory-region
  - "#address-cells"
  - "#size-cells"
  - ranges

additionalProperties: false

examples:
  - |
    #include <dt-bindings/interrupt-controller/arm-gic.h>
    #include <dt-bindings/clock/nxp,imx95-clock.h>

    soc {
      #address-cells = <2>;
      #size-cells = <2>;

      video-codec@4c4c0000 {
        compatible = "nxp,imx95-vpu";
        reg = <0x0 0x4c4c0000 0x0 0x10000>;
        clocks = <&scmi_clk 115>,
                 <&vpu_blk_ctrl IMX95_CLK_VPUBLK_WAVE>;
        clock-names = "core", "vpublk";
        power-domains = <&scmi_devpd 21>,
                        <&scmi_perf 10>;
        power-domain-names = "vpu", "perf";
        memory-region = <&vpu_boot>;
        sram = <&sram1>;
        iommus = <&smmu 0x32>;
        #cooling-cells = <2>;
        #address-cells = <2>;
        #size-cells = <2>;
        ranges;

        interface@4c480000 {
          reg = <0x0 0x4c480000 0x0 0x10000>;
          interrupts = <GIC_SPI 299 IRQ_TYPE_LEVEL_HIGH>;
          iommus = <&smmu 0x33>;
        };

        interface@4c490000 {
          reg = <0x0 0x4c490000 0x0 0x10000>;
          interrupts = <GIC_SPI 300 IRQ_TYPE_LEVEL_HIGH>;
          iommus = <&smmu 0x34>;
        };

        interface@4c4a0000 {
          reg = <0x0 0x4c4a0000 0x0 0x10000>;
          interrupts = <GIC_SPI 301 IRQ_TYPE_LEVEL_HIGH>;
          iommus = <&smmu 0x35>;
        };

        interface@4c4b0000 {
          reg = <0x0 0x4c4b0000 0x0 0x10000>;
          interrupts = <GIC_SPI 302 IRQ_TYPE_LEVEL_HIGH>;
          iommus = <&smmu 0x36>;
        };
      };
    };
```

## Documentation/devicetree/bindings/media/nxp,neoisp.yaml
```yaml
# SPDX-License-Identifier: (GPL-2.0-only OR BSD-2-Clause)
%YAML 1.2
---
$id: http://devicetree.org/schemas/media/nxp,neoisp.yaml#
$schema: http://devicetree.org/meta-schemas/core.yaml#

title: NXP NEOISP Image Signal Processing Pipeline

maintainers:
  - Antoine Bouyer <antoine.bouyer@nxp.com>

description:
  The NXP NEOISP performs a set of image processing tasks on the RAW camera
  stream and provides RGB or YUV enhanced image.

properties:
  compatible:
    enum:
      - nxp,neoisp
      - nxp,imx95-a0-neoisp
      - nxp,imx95-a1-neoisp
      - nxp,imx95-b0-neoisp

  reg:
    items:
      - description: The configuration registers
      - description: ISP local memories

  interrupts:
    maxItems: 1

  clocks:
    minItems: 1

  clock-names:
    items:
      - const: camcm0

  power-domains:
    maxItems: 1

required:
  - compatible
  - reg
  - interrupts
  - clocks
  - clock-names
  - power-domains

additionalProperties: false

examples:
  - |
    #include <dt-bindings/interrupt-controller/arm-gic.h>

    isp@4ae00000 {
      compatible = "nxp,neoisp";
      reg = <0x4ae00000 0x8000>,
            <0x4afe0000 0x10000>;
      interrupts = <GIC_SPI 222 IRQ_TYPE_LEVEL_HIGH>;
      interrupt-parent = <&gic>;
      clocks = <&scmi_clk 64>; /* IMX95_CLK_CAMCM0 */
      clock-names = "camcm0";
      power-domains = <&scmi_devpd 3>; /* IMX95_PD_CAMERA */
    };
```
