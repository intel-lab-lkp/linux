## Documentation/devicetree/bindings/media/qcom,msm8953-camss.yaml
```yaml
# SPDX-License-Identifier: (GPL-2.0 OR BSD-2-Clause)

%YAML 1.2
---
$id: http://devicetree.org/schemas/media/qcom,msm8953-camss.yaml#
$schema: http://devicetree.org/meta-schemas/core.yaml#

title: Qualcomm CAMSS ISP

maintainers:
  - Barnabas Czeman <barnabas.czeman@mainlining.org>

description: |
  The CAMSS IP is a CSI decoder and ISP present on Qualcomm platforms

properties:
  compatible:
    const: qcom,msm8953-camss

  clocks:
    minItems: 30
    maxItems: 30

  clock-names:
    items:
      - const: top_ahb
      - const: ispif_ahb
      - const: micro_ahb
      - const: csiphy0_timer
      - const: csiphy1_timer
      - const: csiphy2_timer
      - const: csi0_ahb
      - const: csi0
      - const: csi0_phy
      - const: csi0_pix
      - const: csi0_rdi
      - const: csi1_ahb
      - const: csi1
      - const: csi1_phy
      - const: csi1_pix
      - const: csi1_rdi
      - const: csi2_ahb
      - const: csi2
      - const: csi2_phy
      - const: csi2_pix
      - const: csi2_rdi
      - const: ahb
      - const: vfe0
      - const: csi_vfe0
      - const: vfe0_ahb
      - const: vfe0_axi
      - const: vfe1
      - const: csi_vfe1
      - const: vfe1_ahb
      - const: vfe1_axi

  interrupts:
    minItems: 9
    maxItems: 9

  interrupt-names:
    items:
      - const: csiphy0
      - const: csiphy1
      - const: csiphy2
      - const: csid0
      - const: csid1
      - const: csid2
      - const: ispif
      - const: vfe0
      - const: vfe1

  iommus:
    maxItems: 1

  power-domains:
    items:
      - description: VFE0 GDSC - Video Front End, Global Distributed Switch Controller.
      - description: VFE1 GDSC - Video Front End, Global Distributed Switch Controller.

  ports:
    $ref: /schemas/graph.yaml#/properties/ports

    description:
      CSI input ports.

    properties:
      port@0:
        $ref: /schemas/graph.yaml#/$defs/port-base
        unevaluatedProperties: false
        description:
          Input port for receiving CSI data.

        properties:
          endpoint:
            $ref: video-interfaces.yaml#
            unevaluatedProperties: false

            properties:
              data-lanes:
                description:
                  An array of physical data lanes indexes.
                  Position of an entry determines the logical
                  lane number, while the value of an entry
                  indicates physical lane index. Lane swapping
                  is supported. Physical lane indexes;
                  0, 2, 3, 4.
                minItems: 1
                maxItems: 4

            required:
              - data-lanes

      port@1:
        $ref: /schemas/graph.yaml#/$defs/port-base
        unevaluatedProperties: false
        description:
          Input port for receiving CSI data.

        properties:
          endpoint:
            $ref: video-interfaces.yaml#
            unevaluatedProperties: false

            properties:
              data-lanes:
                minItems: 1
                maxItems: 4

            required:
              - data-lanes

      port@2:
        $ref: /schemas/graph.yaml#/$defs/port-base
        unevaluatedProperties: false
        description:
          Input port for receiving CSI data.

        properties:
          endpoint:
            $ref: video-interfaces.yaml#
            unevaluatedProperties: false

            properties:
              data-lanes:
                minItems: 1
                maxItems: 4

            required:
              - data-lanes

  reg:
    minItems: 13
    maxItems: 13

  reg-names:
    items:
      - const: csiphy0
      - const: csiphy0_clk_mux
      - const: csiphy1
      - const: csiphy1_clk_mux
      - const: csiphy2
      - const: csiphy2_clk_mux
      - const: csid0
      - const: csid1
      - const: csid2
      - const: ispif
      - const: csi_clk_mux
      - const: vfe0
      - const: vfe1

  vdda-supply:
    description:
      Definition of the regulator used as analog power supply.

required:
  - clock-names
  - clocks
  - compatible
  - interrupt-names
  - interrupts
  - iommus
  - power-domains
  - reg
  - reg-names
  - vdda-supply

additionalProperties: false

examples:
  - |
    #include <dt-bindings/interrupt-controller/arm-gic.h>
    #include <dt-bindings/clock/qcom,gcc-msm8953.h>

    camss: camss@1b00000 {

      compatible = "qcom,msm8953-camss";

      clocks = <&gcc GCC_CAMSS_TOP_AHB_CLK>,
        <&gcc GCC_CAMSS_ISPIF_AHB_CLK>,
        <&gcc GCC_CAMSS_MICRO_AHB_CLK>,
        <&gcc GCC_CAMSS_CSI0PHYTIMER_CLK>,
        <&gcc GCC_CAMSS_CSI1PHYTIMER_CLK>,
        <&gcc GCC_CAMSS_CSI2PHYTIMER_CLK>,
        <&gcc GCC_CAMSS_CSI0_AHB_CLK>,
        <&gcc GCC_CAMSS_CSI0_CLK>,
        <&gcc GCC_CAMSS_CSI0PHY_CLK>,
        <&gcc GCC_CAMSS_CSI0PIX_CLK>,
        <&gcc GCC_CAMSS_CSI0RDI_CLK>,
        <&gcc GCC_CAMSS_CSI1_AHB_CLK>,
        <&gcc GCC_CAMSS_CSI1_CLK>,
        <&gcc GCC_CAMSS_CSI1PHY_CLK>,
        <&gcc GCC_CAMSS_CSI1PIX_CLK>,
        <&gcc GCC_CAMSS_CSI1RDI_CLK>,
        <&gcc GCC_CAMSS_CSI2_AHB_CLK>,
        <&gcc GCC_CAMSS_CSI2_CLK>,
        <&gcc GCC_CAMSS_CSI2PHY_CLK>,
        <&gcc GCC_CAMSS_CSI2PIX_CLK>,
        <&gcc GCC_CAMSS_CSI2RDI_CLK>,
        <&gcc GCC_CAMSS_AHB_CLK>,
        <&gcc GCC_CAMSS_VFE0_CLK>,
        <&gcc GCC_CAMSS_CSI_VFE0_CLK>,
        <&gcc GCC_CAMSS_VFE0_AHB_CLK>,
        <&gcc GCC_CAMSS_VFE0_AXI_CLK>,
        <&gcc GCC_CAMSS_VFE1_CLK>,
        <&gcc GCC_CAMSS_CSI_VFE1_CLK>,
        <&gcc GCC_CAMSS_VFE1_AHB_CLK>,
        <&gcc GCC_CAMSS_VFE1_AXI_CLK>;

      clock-names = "top_ahb",
        "ispif_ahb",
        "micro_ahb",
        "csiphy0_timer",
        "csiphy1_timer",
        "csiphy2_timer",
        "csi0_ahb",
        "csi0",
        "csi0_phy",
        "csi0_pix",
        "csi0_rdi",
        "csi1_ahb",
        "csi1",
        "csi1_phy",
        "csi1_pix",
        "csi1_rdi",
        "csi2_ahb",
        "csi2",
        "csi2_phy",
        "csi2_pix",
        "csi2_rdi",
        "ahb",
        "vfe0",
        "csi_vfe0",
        "vfe0_ahb",
        "vfe0_axi",
        "vfe1",
        "csi_vfe1",
        "vfe1_ahb",
        "vfe1_axi";

      iommus = <&apps_iommu 0x14>;

      interrupts = <GIC_SPI 78 IRQ_TYPE_EDGE_RISING>,
        <GIC_SPI 79 IRQ_TYPE_EDGE_RISING>,
        <GIC_SPI 315 IRQ_TYPE_EDGE_RISING>,
        <GIC_SPI 51 IRQ_TYPE_EDGE_RISING>,
        <GIC_SPI 52 IRQ_TYPE_EDGE_RISING>,
        <GIC_SPI 153 IRQ_TYPE_EDGE_RISING>,
        <GIC_SPI 55 IRQ_TYPE_EDGE_RISING>,
        <GIC_SPI 57 IRQ_TYPE_EDGE_RISING>,
        <GIC_SPI 29 IRQ_TYPE_EDGE_RISING>;

      interrupt-names = "csiphy0",
        "csiphy1",
        "csiphy2",
        "csid0",
        "csid1",
        "csid2",
        "ispif",
        "vfe0",
        "vfe1";

      power-domains = <&gcc VFE0_GDSC>,
        <&gcc VFE1_GDSC>;

      reg = <0x1b34000 0x1000>,
        <0x1b00030 0x4>,
        <0x1b35000 0x1000>,
        <0x1b00038 0x4>,
        <0x1b36000 0x1000>,
        <0x1b00040 0x4>,
        <0x1b30000 0x100>,
        <0x1b30400 0x100>,
        <0x1b30800 0x100>,
        <0x1b31000 0x500>,
        <0x1b00020 0x10>,
        <0x1b10000 0x1000>,
        <0x1b14000 0x1000>;

      reg-names = "csiphy0",
        "csiphy0_clk_mux",
        "csiphy1",
        "csiphy1_clk_mux",
        "csiphy2",
        "csiphy2_clk_mux",
        "csid0",
        "csid1",
        "csid2",
        "ispif",
        "csi_clk_mux",
        "vfe0",
        "vfe1";

      vdda-supply = <&reg_2v8>;

      ports {
        #address-cells = <1>;
        #size-cells = <0>;
      };
    };
```

## Documentation/devicetree/bindings/media/qcom,msm8998-venus.yaml
```yaml
# SPDX-License-Identifier: (GPL-2.0 OR BSD-2-Clause)
%YAML 1.2
---
$id: http://devicetree.org/schemas/media/qcom,msm8998-venus.yaml#
$schema: http://devicetree.org/meta-schemas/core.yaml#

title: Qualcomm MSM8998 Venus video encode and decode accelerators

maintainers:
  - Stanimir Varbanov <stanimir.varbanov@linaro.org>

description: |
  The Venus IP is a video encode and decode accelerator present
  on Qualcomm platforms

allOf:
  - $ref: qcom,venus-common.yaml#

properties:
  compatible:
    const: qcom,msm8998-venus

  power-domains:
    maxItems: 1

  clocks:
    maxItems: 4

  clock-names:
    items:
      - const: core
      - const: iface
      - const: bus
      - const: mbus

  interconnects:
    maxItems: 2

  interconnect-names:
    items:
      - const: video-mem
      - const: cpu-cfg

  iommus:
    maxItems: 20

  video-decoder:
    type: object

    properties:
      compatible:
        const: venus-decoder

      clocks:
        maxItems: 1

      clock-names:
        items:
          - const: core

      power-domains:
        maxItems: 1

    required:
      - compatible
      - clocks
      - clock-names
      - power-domains

    additionalProperties: false

  video-encoder:
    type: object

    properties:
      compatible:
        const: venus-encoder

      clocks:
        maxItems: 1

      clock-names:
        items:
          - const: core

      power-domains:
        maxItems: 1

    required:
      - compatible
      - clocks
      - clock-names
      - power-domains

    additionalProperties: false

required:
  - compatible
  - iommus
  - video-decoder
  - video-encoder

unevaluatedProperties: false

examples:
  - |
    #include <dt-bindings/interrupt-controller/arm-gic.h>
    #include <dt-bindings/clock/qcom,mmcc-msm8998.h>

    video-codec@cc00000 {
        compatible = "qcom,msm8998-venus";
        reg = <0x0cc00000 0xff000>;
        interrupts = <GIC_SPI 287 IRQ_TYPE_LEVEL_HIGH>;
        power-domains = <&mmcc VIDEO_TOP_GDSC>;
        clocks = <&mmcc VIDEO_CORE_CLK>,
                 <&mmcc VIDEO_AHB_CLK>,
                 <&mmcc VIDEO_AXI_CLK>,
                 <&mmcc VIDEO_MAXI_CLK>;
        clock-names = "core", "iface", "bus", "mbus";
        iommus = <&mmss_smmu 0x400>,
                 <&mmss_smmu 0x401>,
                 <&mmss_smmu 0x40a>,
                 <&mmss_smmu 0x407>,
                 <&mmss_smmu 0x40e>,
                 <&mmss_smmu 0x40f>,
                 <&mmss_smmu 0x408>,
                 <&mmss_smmu 0x409>,
                 <&mmss_smmu 0x40b>,
                 <&mmss_smmu 0x40c>,
                 <&mmss_smmu 0x40d>,
                 <&mmss_smmu 0x410>,
                 <&mmss_smmu 0x421>,
                 <&mmss_smmu 0x428>,
                 <&mmss_smmu 0x429>,
                 <&mmss_smmu 0x42b>,
                 <&mmss_smmu 0x42c>,
                 <&mmss_smmu 0x42d>,
                 <&mmss_smmu 0x411>,
                 <&mmss_smmu 0x431>;
        memory-region = <&venus_mem>;

        video-decoder {
            compatible = "venus-decoder";
            clocks = <&mmcc VIDEO_SUBCORE0_CLK>;
            clock-names = "core";
            power-domains = <&mmcc VIDEO_SUBCORE0_GDSC>;
        };

        video-encoder {
            compatible = "venus-encoder";
            clocks = <&mmcc VIDEO_SUBCORE1_CLK>;
            clock-names = "core";
            power-domains = <&mmcc VIDEO_SUBCORE1_GDSC>;
        };
    };
```
