## Documentation/devicetree/bindings/media/nxp,wave633c.yaml
```yaml
# SPDX-License-Identifier: (GPL-2.0 OR BSD-2-Clause)
%YAML 1.2
---
$id: http://devicetree.org/schemas/media/nxp,wave633c.yaml#
$schema: http://devicetree.org/meta-schemas/core.yaml#

title: Chips&Media Wave6 Series multi-standard codec IP on NXP i.MX SoCs.

maintainers:
  - Nas Chung <nas.chung@chipsnmedia.com>
  - Jackson Lee <jackson.lee@chipsnmedia.com>

description:
  The Chips&Media Wave6 codec IP is a multi-standard video encoder/decoder.
  On NXP i.MX SoCs, Wave6 codec IP functionality is split between the VPU control device
  (vpu-ctrl) and the VPU device (vpu). The VPU control device manages shared resources
  such as firmware access and power domains, while the VPU device provides encoding
  and decoding capabilities. The VPU devie cannot operate independently
  without the VPU control device.

properties:
  compatible:
    items:
      - enum:
          - nxp,imx95-wave633c-ctrl
          - nxp,imx95-wave633c

  reg:
    maxItems: 1

  interrupts:
    maxItems: 1

  clocks:
    items:
      - description: VPU clock
      - description: VPU associated block clock

  clock-names:
    items:
      - const: vpu
      - const: vpublk_wave

  power-domains:
    minItems: 1
    items:
      - description: Main VPU power domain
      - description: Performance power domain

  power-domain-names:
    items:
      - const: vpumix
      - const: vpuperf

  cnm,ctrl:
    $ref: /schemas/types.yaml#/definitions/phandle
    description: phandle of the VPU control device node. Required for VPU operation.

  boot:
    $ref: /schemas/types.yaml#/definitions/phandle
    description: phandle of the boot memory region node for the VPU control device.

  sram:
    $ref: /schemas/types.yaml#/definitions/phandle
    description: phandle of the SRAM memory region node for the VPU control device.

  '#cooling-cells':
    const: 2

  support-follower:
    type: boolean
    description: Indicates whether the VPU domain power always on.

patternProperties:
  "^vpu-ctrl@[0-9a-f]+$":
    type: object
    properties:
      compatible:
        items:
          - enum:
              - nxp,imx95-wave633c-ctrl
      reg: true
      clocks: true
      clock-names: true
      power-domains:
        items:
          - description: Main VPU power domain
          - description: Performance power domain
      power-domain-names:
        items:
          - const: vpumix
          - const: vpuperf
      sram: true
      boot: true
      '#cooling-cells': true
      support-follower: true
    required:
      - compatible
      - reg
      - clocks
      - clock-names
      - power-domains
      - power-domain-names
      - sram
      - boot

    additionalProperties: false

  "^vpu@[0-9a-f]+$":
    type: object
    properties:
      compatible:
        items:
          - enum:
              - nxp,imx95-wave633c
      reg: true
      interrupts: true
      clocks: true
      clock-names: true
      power-domains:
        maxItems: 1
        description: Main VPU power domain
      cnm,ctrl: true
    required:
      - compatible
      - reg
      - interrupts
      - clocks
      - clock-names
      - power-domains
      - cnm,ctrl

    additionalProperties: false

additionalProperties: false

examples:
  - |
    #include <dt-bindings/interrupt-controller/arm-gic.h>
    #include <dt-bindings/clock/nxp,imx95-clock.h>

    soc {
      #address-cells = <2>;
      #size-cells = <2>;

      vpuctrl: vpu-ctrl@4c4c0000 {
        compatible = "nxp,imx95-wave633c-ctrl";
        reg = <0x0 0x4c4c0000 0x0 0x10000>;
        clocks = <&scmi_clk 115>,
            <&vpu_blk_ctrl IMX95_CLK_VPUBLK_WAVE>;
        clock-names = "vpu", "vpublk_wave";
        power-domains = <&scmi_devpd 21>, <&scmi_perf 10>;
        power-domain-names = "vpumix", "vpuperf";
        #cooling-cells = <2>;
        boot = <&vpu_boot>;
        sram = <&sram1>;
      };

      vpu0: vpu@4c480000 {
        compatible = "nxp,imx95-wave633c";
        reg = <0x0 0x4c480000 0x0 0x10000>;
        interrupts = <GIC_SPI 299 IRQ_TYPE_LEVEL_HIGH>;
        clocks = <&scmi_clk 115>,
                <&vpu_blk_ctrl IMX95_CLK_VPUBLK_WAVE>;
        clock-names = "vpu", "vpublk_wave";
        power-domains = <&scmi_devpd 21>;
        cnm,ctrl = <&vpuctrl>;
      };

      vpu1: vpu@4c490000 {
        compatible = "nxp,imx95-wave633c";
        reg = <0x0 0x4c490000 0x0 0x10000>;
        interrupts = <GIC_SPI 300 IRQ_TYPE_LEVEL_HIGH>;
        clocks = <&scmi_clk 115>,
                <&vpu_blk_ctrl IMX95_CLK_VPUBLK_WAVE>;
        clock-names = "vpu", "vpublk_wave";
        power-domains = <&scmi_devpd 21>;
        cnm,ctrl = <&vpuctrl>;
      };

      vpu2: vpu@4c4a0000 {
        compatible = "nxp,imx95-wave633c";
        reg = <0x0 0x4c4a0000 0x0 0x10000>;
        interrupts = <GIC_SPI 301 IRQ_TYPE_LEVEL_HIGH>;
        clocks = <&scmi_clk 115>,
                <&vpu_blk_ctrl IMX95_CLK_VPUBLK_WAVE>;
        clock-names = "vpu", "vpublk_wave";
        power-domains = <&scmi_devpd 21>;
        cnm,ctrl = <&vpuctrl>;
      };

      vpu3: vpu@4c4b0000 {
        compatible = "nxp,imx95-wave633c";
        reg = <0x0 0x4c4b0000 0x0 0x10000>;
        interrupts = <GIC_SPI 302 IRQ_TYPE_LEVEL_HIGH>;
        clocks = <&scmi_clk 115>,
                <&vpu_blk_ctrl IMX95_CLK_VPUBLK_WAVE>;
        clock-names = "vpu", "vpublk_wave";
        power-domains = <&scmi_devpd 21>;
        cnm,ctrl = <&vpuctrl>;
      };
    };
```

## Documentation/devicetree/bindings/media/qcom,jpeg-encoder.yaml
```yaml
# SPDX-License-Identifier: (GPL-2.0 OR BSD-2-Clause)
%YAML 1.2
---
$id: http://devicetree.org/schemas/media/qcom,jpeg-encoder.yaml#
$schema: http://devicetree.org/meta-schemas/core.yaml#

title: Qualcomm JPEG Encoder

maintainers:
  - Azam Sadiq Pasha Kapatrala Syed <akapatra@quicinc.com>
  - Hariram Purushothaman <hariramp@quicinc.com>

description: |
  Qualcomm JPEG Encoder is the JPEG encode hardware present in Qualcomm SoCs.

  The JPEG hardware IP version 4.2.0 is shared across SM8250, QCM6490, SM8550
  and related derivatives.  Platforms based on the SM8550 register layout and
  interrupt wiring can reuse the qcom,sm8550-jenc fallback compatible, provided
  the correct register base address and IOMMU stream IDs are supplied in the
  DTS node.

properties:
  compatible:
    oneOf:
      - items:
          - const: qcom,sm8250-jenc
      - items:
          - enum:
              - qcom,qcm6490-jenc
          - const: qcom,sm8550-jenc
      - items:
          - const: qcom,sm8550-jenc

  cell-index:
    description: Legacy JPEG HW instance index.
    $ref: /schemas/types.yaml#/definitions/uint32

  reg:
    maxItems: 1

  reg-names:
    oneOf:
      - items:
          - const: jpeg
      - items:
          - const: jpeg-regs
      - items:
          - const: jpeg_regs

  interrupts:
    maxItems: 1

  clocks:
    minItems: 6
    maxItems: 6

  clock-names:
    oneOf:
      - items:
          - const: gcc_hf_axi
          - const: gcc_sf_axi
          - const: core_ahb
          - const: cpas_ahb
          - const: camnoc_axi
          - const: jpeg
      - items:
          - const: gcc_hf_axi_clk
          - const: gcc_sf_axi_clk
          - const: core_ahb_clk
          - const: cpas_ahb_clk
          - const: camnoc_axi_clk
          - const: jpeg_clk

  power-domains:
    maxItems: 1

  iommus:
    maxItems: 2

  interconnects:
    maxItems: 4

  interconnect-names:
    items:
      - const: cam_ahb
      - const: cam_hf_0_mnoc
      - const: cam_sf_0_mnoc
      - const: cam_sf_icp_mnoc

required:
  - compatible
  - reg
  - clocks
  - interrupts
  - power-domains
  - iommus
  - interconnects
  - interconnect-names

additionalProperties: false

examples:
  - |
    jpeg-encoder@ac53000 {
        compatible = "qcom,sm8250-jenc";
        reg = <0xac53000 0x1000>;
        reg-names = "jpeg";

        interrupts = <0 474 4>;
        power-domains = <&camcc 0>;

        clock-names =
            "gcc_hf_axi",
            "gcc_sf_axi",
            "core_ahb",
            "cpas_ahb",
            "camnoc_axi",
            "jpeg";

        clocks =
            <&gcc 0>,
            <&gcc 1>,
            <&camcc 0>,
            <&camcc 1>,
            <&camcc 2>,
            <&camcc 3>;

        iommus = <&apps_smmu 0x2040 0x400>,
                 <&apps_smmu 0x2440 0x400>;

        interconnects =
            <&gem_noc 0 0 &config_noc 8 0>,
            <&mmss_noc 0 0 &mc_virt 0 0>,
            <&mmss_noc 1 0 &mc_virt 0 0>,
            <&mmss_noc 2 0 &mc_virt 0 0>;

        interconnect-names =
            "cam_ahb",
            "cam_hf_0_mnoc",
            "cam_sf_0_mnoc",
            "cam_sf_icp_mnoc";
    };
```
