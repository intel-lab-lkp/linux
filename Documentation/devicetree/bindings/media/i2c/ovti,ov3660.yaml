## Documentation/devicetree/bindings/media/i2c/st,st-vd56g3.yaml
```yaml
# SPDX-License-Identifier: (GPL-2.0 OR BSD-2-Clause)
# Copyright (c) 2024 STMicroelectronics SA.
%YAML 1.2
---
$id: http://devicetree.org/schemas/media/i2c/st,st-vd56g3.yaml#
$schema: http://devicetree.org/meta-schemas/core.yaml#

title: STMicroelectronics VD56G3 Global Shutter Image Sensor

maintainers:
  - Benjamin Mugnier <benjamin.mugnier@foss.st.com>
  - Sylvain Petinot <sylvain.petinot@foss.st.com>

description: |-
  The STMicroelectronics VD56G3 is a 1.5 M pixel global shutter image sensor
  with an active array size of 1124 x 1364 (portrait orientation). It is
  programmable through I2C, the address is fixed to 0x10. The sensor output is
  available via CSI-2, which is configured as either 1 or 2 data lanes. The
  sensor provides 8 GPIOS that can be used for external LED signal
  (synchronized with sensor integration periods)

properties:
  compatible:
    enum:
      - st,st-vd56g3
      - st,st-vd66gy
    description:
      Two variants are availables; VD56G3 is a monochrome sensor while VD66GY
      is a colour variant.

  reg:
    maxItems: 1

  clocks:
    maxItems: 1

  vcore-supply:
    description: Digital core power supply (1.15V)

  vddio-supply:
    description: Digital IO power supply (1.8V)

  vana-supply:
    description: Analog power supply (2.8V)

  reset-gpios:
    description: Sensor reset active low GPIO (XSHUTDOWN)
    maxItems: 1

  st,leds:
    description:
      Sensor's GPIOs used for external LED control. Signal being the enveloppe
      of the integration time.
    $ref: /schemas/types.yaml#/definitions/uint32-array
    minItems: 1
    maxItems: 8
    items:
      minimum: 0
      maximum: 7

  port:
    $ref: /schemas/graph.yaml#/$defs/port-base

    properties:
      endpoint:
        $ref: /schemas/media/video-interfaces.yaml#
        unevaluatedProperties: false

        properties:
          data-lanes:
            minItems: 1
            maxItems: 2
            items:
              enum: [1, 2]

          link-frequencies:
            minItems: 1
            maxItems: 1
            items:
              enum: [402000000, 750000000]

          lane-polarities:
            minItems: 1
            maxItems: 3
            description: Any lane can be inverted or not.

        required:
          - data-lanes
          - link-frequencies

required:
  - compatible
  - reg
  - clocks
  - vcore-supply
  - vddio-supply
  - vana-supply
  - reset-gpios
  - port

additionalProperties: false

examples:
  - |
    #include <dt-bindings/gpio/gpio.h>

    i2c {
        #address-cells = <1>;
        #size-cells = <0>;

        camera-sensor@10 {
            compatible = "st,st-vd56g3";
            reg = <0x10>;

            clocks = <&camera_clk_12M>;

            vcore-supply = <&camera_vcore_v1v15>;
            vddio-supply = <&camera_vddio_v1v8>;
            vana-supply = <&camera_vana_v2v8>;

            reset-gpios = <&gpio 5 GPIO_ACTIVE_LOW>;
            st,leds = <6>;

            port {
                endpoint {
                    data-lanes = <1 2>;
                    link-frequencies = /bits/ 64 <402000000>;
                    remote-endpoint = <&csiphy0_ep>;
                };
            };
        };
    };
```

## Documentation/devicetree/bindings/media/i2c/techwell,tw9900.yaml
```yaml
# SPDX-License-Identifier: (GPL-2.0-only OR BSD-2-Clause)
%YAML 1.2
---
$id: http://devicetree.org/schemas/media/i2c/techwell,tw9900.yaml#
$schema: http://devicetree.org/meta-schemas/core.yaml#

title: Techwell TW9900 NTSC/PAL video decoder

maintainers:
  - Mehdi Djait <mehdi.djait@bootlin.com>

description:
  The tw9900 is a multi-standard video decoder, supporting NTSC, PAL standards
  with auto-detection features.

properties:
  compatible:
    const: techwell,tw9900

  reg:
    maxItems: 1

  vdd-supply:
    description: VDD power supply

  reset-gpios:
    description: GPIO descriptor for the RESET input pin
    maxItems: 1

  powerdown-gpios:
    description: GPIO descriptor for the POWERDOWN input pin
    maxItems: 1

  ports:
    $ref: /schemas/graph.yaml#/properties/ports
    properties:
      port@3:
        $ref: /schemas/graph.yaml#/properties/port
        description: Video port for the decoder output.

    patternProperties:
      "^port@[0-2]$":
        $ref: /schemas/graph.yaml#/properties/port
        description: Analog video input port.

    required:
      - port@3

required:
  - compatible
  - ports
  - reg

additionalProperties: false

examples:
  - |
    #include <dt-bindings/gpio/gpio.h>
    i2c {
        #address-cells = <1>;
        #size-cells = <0>;

        video-decoder@44 {
            compatible = "techwell,tw9900";
            reg = <0x44>;

            vdd-supply = <&tw9900_supply>;
            reset-gpios = <&gpio2 5 GPIO_ACTIVE_LOW>;

            ports {
                #address-cells = <1>;
                #size-cells = <0>;

                port@3 {
                    reg = <3>;
                    endpoint {
                        remote-endpoint = <&vip_in>;
                    };
                };
            };
        };
    };
```

## Documentation/devicetree/bindings/media/i2c/vision-components,mipi-module-controller.yaml
```yaml
# SPDX-License-Identifier: (GPL-2.0 OR BSD-2-Clause)
%YAML 1.2
---
$id: http://devicetree.org/schemas/media/i2c/vision-components,mipi-module-controller.yaml#
$schema: http://devicetree.org/meta-schemas/core.yaml#

title: Vision Components MIPI Camera Module Controller

maintainers:
  - Laurent Pinchart <laurent.pinchart@ideasonboard.com>
  - Richard Leitner <richard.leitner@linux.dev>

description: |-
  The MIPI camera module controller is an FPGA-based, I2C-accessible system
  controller found on MIPI camera modules from Vision Components. It abstracts
  the camera sensor behind a unified register interface, and controls and
  sequences the on-board power supplies and clocks.

  The camera sensor abstraction is optional. The controller exposes a tunneled
  downstream I2C bus used by the attached image sensor. The controller node
  acts as the upstream device on the host bus, while child node below the
  controller represent the sensor device reachable through the tunnel.

properties:
  compatible:
    const: vision-components,mipi-module-controller

  reg:
    maxItems: 1

  '#clock-cells':
    const: 0

  clock-frequency:
    description: Frequency of the sensor clock provided by the module

  vcc-supply:
    description: Power supply of the module (3.3V)

  '#address-cells':
    const: 1

  '#size-cells':
    const: 0

required:
  - compatible
  - reg
  - '#clock-cells'
  - clock-frequency
  - vcc-supply
  - '#address-cells'
  - '#size-cells'

unevaluatedProperties: false

examples:
  - |
    i2c {
        #address-cells = <1>;
        #size-cells = <0>;

        vc_mipi_ctrl: controller@10 {
            compatible = "vision-components,mipi-module-controller";
            reg = <0x10>;
            #clock-cells = <0>;
            clock-frequency = <37125000>;
            vcc-supply = <&cam_3v3>;

            #address-cells = <1>;
            #size-cells = <0>;

            i2c@0 {
                #address-cells = <1>;
                #size-cells = <0>;

                vc_mipi_sensor: camera@60 {
                    compatible = "ovti,ov9281";
                    reg = <0x60>;

                    clocks = <&vc_mipi_ctrl>;
                    clock-names = "inck";

                    avdd-supply = <&vc_mipi_ctrl>;
                    dvdd-supply = <&vc_mipi_ctrl>;
                    dovdd-supply = <&vc_mipi_ctrl>;
                };
            };
        };
    };
...
```

## Documentation/devicetree/bindings/media/intel,dprx.yaml
```yaml
# SPDX-License-Identifier: GPL-2.0-only OR BSD-2-Clause
%YAML 1.2
---
$id: http://devicetree.org/schemas/media/intel,dprx.yaml#
$schema: http://devicetree.org/meta-schemas/core.yaml#

title: Intel DisplayPort RX IP

maintainers:
  - Paweł Anikiel <panikiel@google.com>

description: |
  The Intel Displayport RX IP is a part of the DisplayPort Intel FPGA IP
  Core. It implements a DisplayPort 1.4 receiver capable of HBR3 video
  capture and Multi-Stream Transport.

  The IP features a large number of configuration parameters, found at:
  https://www.intel.com/content/www/us/en/docs/programmable/683273/23-3-20-0-1/sink-parameters.html

  The following parameters have to be enabled:
    - Support DisplayPort sink
    - Enable GPU control
  The following parameters' values have to be set in the devicetree:
    - RX maximum link rate
    - Maximum lane count
    - Support MST
    - Max stream count (only if Support MST is enabled)

properties:
  compatible:
    const: intel,dprx-20.0.1

  reg:
    maxItems: 1

  interrupts:
    maxItems: 1

  intel,max-link-rate:
    $ref: /schemas/types.yaml#/definitions/uint32
    description: Max link rate configuration parameter

  intel,max-lane-count:
    $ref: /schemas/types.yaml#/definitions/uint32
    description: Max lane count configuration parameter

  intel,multi-stream-support:
    type: boolean
    description: Multi-Stream Transport support configuration parameter

  intel,max-stream-count:
    $ref: /schemas/types.yaml#/definitions/uint32
    description: Max stream count configuration parameter

  port:
    $ref: /schemas/graph.yaml#/properties/port
    description: SST main link

  ports:
    $ref: /schemas/graph.yaml#/properties/ports

    properties:
      port@0:
        $ref: /schemas/graph.yaml#/properties/port
        description: MST virtual channel 0 or SST main link

      port@1:
        $ref: /schemas/graph.yaml#/properties/port
        description: MST virtual channel 1

      port@2:
        $ref: /schemas/graph.yaml#/properties/port
        description: MST virtual channel 2

      port@3:
        $ref: /schemas/graph.yaml#/properties/port
        description: MST virtual channel 3

required:
  - compatible
  - reg
  - interrupts

allOf:
  - if:
      required:
        - intel,multi-stream-support
    then:
      required:
        - intel,max-stream-count
        - ports
    else:
      required:
        - port

additionalProperties: false

examples:
  - |
    #include <dt-bindings/interrupt-controller/arm-gic.h>

    dp-receiver@c0062000 {
        compatible = "intel,dprx-20.0.1";
        reg = <0xc0062000 0x800>;
        interrupt-parent = <&dprx_mst_irq>;
        interrupts = <0 IRQ_TYPE_EDGE_RISING>;
        intel,max-link-rate = <0x1e>;
        intel,max-lane-count = <4>;
        intel,multi-stream-support;
        intel,max-stream-count = <4>;

        ports {
            #address-cells = <1>;
            #size-cells = <0>;

            port@0 {
                reg = <0>;
                dprx_mst_0: endpoint {
                    remote-endpoint = <&fb_mst0_0>;
                };
            };

            port@1 {
                reg = <1>;
                dprx_mst_1: endpoint {
                    remote-endpoint = <&fb_mst1_0>;
                };
            };

            port@2 {
                reg = <2>;
                dprx_mst_2: endpoint {
                    remote-endpoint = <&fb_mst2_0>;
                };
            };

            port@3 {
                reg = <3>;
                dprx_mst_3: endpoint {
                    remote-endpoint = <&fb_mst3_0>;
                };
            };
        };
    };

  - |
    dp-receiver@c0064000 {
        compatible = "intel,dprx-20.0.1";
        reg = <0xc0064000 0x800>;
        interrupt-parent = <&dprx_sst_irq>;
        interrupts = <0 IRQ_TYPE_EDGE_RISING>;
        intel,max-link-rate = <0x1e>;
        intel,max-lane-count = <4>;

        port {
            dprx_sst_0: endpoint {
                remote-endpoint = <&fb_sst_0>;
            };
        };
    };
```

## Documentation/devicetree/bindings/media/m2m-deinterlace.yaml
```yaml
# SPDX-License-Identifier: (GPL-2.0-only OR BSD-2-Clause)
%YAML 1.2
---
$id: http://devicetree.org/schemas/media/m2m-deinterlace.yaml#
$schema: http://devicetree.org/meta-schemas/core.yaml#

title: M2M Deinterlacer

maintainers:
 - Mauro Carvalho Chehab <mchehab@kernel.org>

description: |
  A generic memory2memory device for deinterlacing video
  using dmaengine.

properties:
  compatible:
    const: m2m-deinterlace

  dma-names:
    items:
      - const: rxtx

  dmas:
    items:
      - description: mem-to-mem capable DMA channel

required:
  - compatible
  - dma-names
  - dmas

additionalProperties: false

examples:
  - |
    m2m-deinterlace {
        compatible = "m2m-deinterlace";
        dma-names = "rxtx";
        dmas = <&edma 20 0>;
    };
```

## Documentation/devicetree/bindings/media/mediatek,mt8188-aie.yaml
```yaml
# SPDX-License-Identifier: (GPL-2.0-only OR BSD-2-Clause)
%YAML 1.2
---
$id: http://devicetree.org/schemas/media/mediatek,mt8188-aie.yaml#
$schema: http://devicetree.org/meta-schemas/core.yaml#

title: The AI Engine Unit of MediaTek Camera System

maintainers:
  - Bo Kong <bo.kong@mediatek.com>

description:
  AIE(AI Engine) provides a hardware-accelerated face detection function.

properties:
  compatible:
    items:
      - const: mediatek,mt8188-aie

  reg:
    maxItems: 1

  interrupts:
    maxItems: 1

  iommus:
    description:
      List of the hardware port in respective IOMMU block for current Socs.
      Refer to bindings/iommu/mediatek,iommu.yaml.

  power-domains:
    maxItems: 1

  clocks:
    items:
      - description: clock for imgsys main ipe
      - description: clock for ipe fdvt
      - description: clock for ipe top

  clock-names:
    items:
      - const: img-ipe
      - const: ipe-fdvt
      - const: ipe-top

required:
  - compatible
  - reg
  - interrupts
  - iommus
  - power-domains
  - clocks
  - clock-names

additionalProperties: false

examples:
  - |
    #include <dt-bindings/interrupt-controller/arm-gic.h>
    #include <dt-bindings/memory/mediatek,mt8188-memory-port.h>
    #include <dt-bindings/power/mediatek,mt8188-power.h>
    #include <dt-bindings/clock/mediatek,mt8188-clk.h>
    aie@15310000 {
      compatible = "mediatek,mt8188-aie";
      reg = <0x15310000 0x1000>;
      interrupts = <GIC_SPI 787 IRQ_TYPE_LEVEL_HIGH 0>;
      iommus = <&vpp_iommu M4U_PORT_L12_FDVT_RDA_0>,
               <&vpp_iommu M4U_PORT_L12_FDVT_RDB_0>,
               <&vpp_iommu M4U_PORT_L12_FDVT_WRA_0>,
               <&vpp_iommu M4U_PORT_L12_FDVT_WRB_0>;
      power-domains = <&spm MT8188_POWER_DOMAIN_IPE>;
      clocks = <&imgsys CLK_IMGSYS_MAIN_IPE>,
               <&ipesys CLK_IPE_FDVT>,
               <&ipesys CLK_IPESYS_TOP>;
      clock-names = "img-ipe",
                    "ipe-fdvt",
                    "ipe-top";
    };
```
