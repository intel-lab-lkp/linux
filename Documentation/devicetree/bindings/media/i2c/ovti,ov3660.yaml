## Documentation/devicetree/bindings/media/qcom,sm6350-camss.yaml
```yaml
# SPDX-License-Identifier: (GPL-2.0 OR BSD-2-Clause)
%YAML 1.2
---
$id: http://devicetree.org/schemas/media/qcom,sm6350-camss.yaml#
$schema: http://devicetree.org/meta-schemas/core.yaml#

title: Qualcomm SM6350 Camera Subsystem (CAMSS)

maintainers:
  - Luca Weiss <luca.weiss@fairphone.com>

description:
  The CAMSS IP is a CSI decoder and ISP present on Qualcomm platforms.

properties:
  compatible:
    const: qcom,sm6350-camss

  reg:
    maxItems: 12

  reg-names:
    items:
      - const: csid0
      - const: csid1
      - const: csid2
      - const: csid_lite
      - const: csiphy0
      - const: csiphy1
      - const: csiphy2
      - const: csiphy3
      - const: vfe0
      - const: vfe1
      - const: vfe2
      - const: vfe_lite

  clocks:
    maxItems: 30

  clock-names:
    items:
      - const: cam_ahb_clk
      - const: cam_axi
      - const: soc_ahb
      - const: camnoc_axi
      - const: core_ahb
      - const: cpas_ahb
      - const: csiphy0
      - const: csiphy0_timer
      - const: csiphy1
      - const: csiphy1_timer
      - const: csiphy2
      - const: csiphy2_timer
      - const: csiphy3
      - const: csiphy3_timer
      - const: slow_ahb_src
      - const: vfe0_axi
      - const: vfe0
      - const: vfe0_cphy_rx
      - const: vfe0_csid
      - const: vfe1_axi
      - const: vfe1
      - const: vfe1_cphy_rx
      - const: vfe1_csid
      - const: vfe2_axi
      - const: vfe2
      - const: vfe2_cphy_rx
      - const: vfe2_csid
      - const: vfe_lite
      - const: vfe_lite_cphy_rx
      - const: vfe_lite_csid

  interrupts:
    maxItems: 12

  interrupt-names:
    items:
      - const: csid0
      - const: csid1
      - const: csid2
      - const: csid_lite
      - const: csiphy0
      - const: csiphy1
      - const: csiphy2
      - const: csiphy3
      - const: vfe0
      - const: vfe1
      - const: vfe2
      - const: vfe_lite

  interconnects:
    maxItems: 4

  interconnect-names:
    items:
      - const: cam_ahb
      - const: cam_hf_0_mnoc
      - const: cam_sf_0_mnoc
      - const: cam_sf_icp_mnoc

  iommus:
    maxItems: 4

  power-domains:
    items:
      - description: IFE0 GDSC - Image Front End, Global Distributed Switch Controller.
      - description: IFE1 GDSC - Image Front End, Global Distributed Switch Controller.
      - description: IFE2 GDSC - Image Front End, Global Distributed Switch Controller.
      - description: Titan Top GDSC - Titan ISP Block, Global Distributed Switch Controller.

  power-domain-names:
    items:
      - const: ife0
      - const: ife1
      - const: ife2
      - const: top

  vdda-0.9-supply:
    description:
      Phandle to a 0.9V regulator supply to a PHY.

  vdda-1.25-supply:
    description:
      Phandle to a 1.25V regulator supply to a PHY.

  ports:
    $ref: /schemas/graph.yaml#/properties/ports

    description:
      CSI input ports.

    patternProperties:
      "^port@[0-3]$":
        $ref: /schemas/graph.yaml#/$defs/port-base
        unevaluatedProperties: false

        description:
          Input port for receiving CSI data from a CSIPHY.

        properties:
          endpoint:
            $ref: video-interfaces.yaml#
            unevaluatedProperties: false

            properties:
              data-lanes:
                minItems: 1
                maxItems: 4

              bus-type:
                enum:
                  - 1 # MEDIA_BUS_TYPE_CSI2_CPHY
                  - 4 # MEDIA_BUS_TYPE_CSI2_DPHY

            required:
              - data-lanes

required:
  - compatible
  - reg
  - reg-names
  - clocks
  - clock-names
  - interrupts
  - interrupt-names
  - interconnects
  - interconnect-names
  - iommus
  - power-domains
  - power-domain-names
  - vdda-0.9-supply
  - vdda-1.25-supply
  - ports

additionalProperties: false

examples:
  - |
    #include <dt-bindings/clock/qcom,gcc-sm6350.h>
    #include <dt-bindings/clock/qcom,sm6350-camcc.h>
    #include <dt-bindings/interconnect/qcom,icc.h>
    #include <dt-bindings/interconnect/qcom,sm6350.h>
    #include <dt-bindings/interrupt-controller/arm-gic.h>
    #include <dt-bindings/media/video-interfaces.h>
    #include <dt-bindings/power/qcom-rpmpd.h>

    soc {
        #address-cells = <2>;
        #size-cells = <2>;

        isp@acb3000 {
            compatible = "qcom,sm6350-camss";

            reg = <0x0 0x0acb3000 0x0 0x1000>,
                  <0x0 0x0acba000 0x0 0x1000>,
                  <0x0 0x0acc1000 0x0 0x1000>,
                  <0x0 0x0acc8000 0x0 0x1000>,
                  <0x0 0x0ac65000 0x0 0x1000>,
                  <0x0 0x0ac66000 0x0 0x1000>,
                  <0x0 0x0ac67000 0x0 0x1000>,
                  <0x0 0x0ac68000 0x0 0x1000>,
                  <0x0 0x0acaf000 0x0 0x4000>,
                  <0x0 0x0acb6000 0x0 0x4000>,
                  <0x0 0x0acbd000 0x0 0x4000>,
                  <0x0 0x0acc4000 0x0 0x4000>;
            reg-names = "csid0",
                        "csid1",
                        "csid2",
                        "csid_lite",
                        "csiphy0",
                        "csiphy1",
                        "csiphy2",
                        "csiphy3",
                        "vfe0",
                        "vfe1",
                        "vfe2",
                        "vfe_lite";

            clocks = <&gcc GCC_CAMERA_AHB_CLK>,
                     <&gcc GCC_CAMERA_AXI_CLK>,
                     <&camcc CAMCC_SOC_AHB_CLK>,
                     <&camcc CAMCC_CAMNOC_AXI_CLK>,
                     <&camcc CAMCC_CORE_AHB_CLK>,
                     <&camcc CAMCC_CPAS_AHB_CLK>,
                     <&camcc CAMCC_CSIPHY0_CLK>,
                     <&camcc CAMCC_CSI0PHYTIMER_CLK>,
                     <&camcc CAMCC_CSIPHY1_CLK>,
                     <&camcc CAMCC_CSI1PHYTIMER_CLK>,
                     <&camcc CAMCC_CSIPHY2_CLK>,
                     <&camcc CAMCC_CSI2PHYTIMER_CLK>,
                     <&camcc CAMCC_CSIPHY3_CLK>,
                     <&camcc CAMCC_CSI3PHYTIMER_CLK>,
                     <&camcc CAMCC_SLOW_AHB_CLK_SRC>,
                     <&camcc CAMCC_IFE_0_AXI_CLK>,
                     <&camcc CAMCC_IFE_0_CLK>,
                     <&camcc CAMCC_IFE_0_CPHY_RX_CLK>,
                     <&camcc CAMCC_IFE_0_CSID_CLK>,
                     <&camcc CAMCC_IFE_1_AXI_CLK>,
                     <&camcc CAMCC_IFE_1_CLK>,
                     <&camcc CAMCC_IFE_1_CPHY_RX_CLK>,
                     <&camcc CAMCC_IFE_1_CSID_CLK>,
                     <&camcc CAMCC_IFE_2_AXI_CLK>,
                     <&camcc CAMCC_IFE_2_CLK>,
                     <&camcc CAMCC_IFE_2_CPHY_RX_CLK>,
                     <&camcc CAMCC_IFE_2_CSID_CLK>,
                     <&camcc CAMCC_IFE_LITE_CLK>,
                     <&camcc CAMCC_IFE_LITE_CPHY_RX_CLK>,
                     <&camcc CAMCC_IFE_LITE_CSID_CLK>;
            clock-names = "cam_ahb_clk",
                          "cam_axi",
                          "soc_ahb",
                          "camnoc_axi",
                          "core_ahb",
                          "cpas_ahb",
                          "csiphy0",
                          "csiphy0_timer",
                          "csiphy1",
                          "csiphy1_timer",
                          "csiphy2",
                          "csiphy2_timer",
                          "csiphy3",
                          "csiphy3_timer",
                          "slow_ahb_src",
                          "vfe0_axi",
                          "vfe0",
                          "vfe0_cphy_rx",
                          "vfe0_csid",
                          "vfe1_axi",
                          "vfe1",
                          "vfe1_cphy_rx",
                          "vfe1_csid",
                          "vfe2_axi",
                          "vfe2",
                          "vfe2_cphy_rx",
                          "vfe2_csid",
                          "vfe_lite",
                          "vfe_lite_cphy_rx",
                          "vfe_lite_csid";

            interrupts = <GIC_SPI 464 IRQ_TYPE_LEVEL_HIGH>,
                         <GIC_SPI 466 IRQ_TYPE_LEVEL_HIGH>,
                         <GIC_SPI 717 IRQ_TYPE_LEVEL_HIGH>,
                         <GIC_SPI 473 IRQ_TYPE_LEVEL_HIGH>,
                         <GIC_SPI 477 IRQ_TYPE_LEVEL_HIGH>,
                         <GIC_SPI 478 IRQ_TYPE_LEVEL_HIGH>,
                         <GIC_SPI 479 IRQ_TYPE_LEVEL_HIGH>,
                         <GIC_SPI 461 IRQ_TYPE_LEVEL_HIGH>,
                         <GIC_SPI 465 IRQ_TYPE_LEVEL_HIGH>,
                         <GIC_SPI 467 IRQ_TYPE_LEVEL_HIGH>,
                         <GIC_SPI 718 IRQ_TYPE_LEVEL_HIGH>,
                         <GIC_SPI 472 IRQ_TYPE_LEVEL_HIGH>;
            interrupt-names = "csid0",
                              "csid1",
                              "csid2",
                              "csid_lite",
                              "csiphy0",
                              "csiphy1",
                              "csiphy2",
                              "csiphy3",
                              "vfe0",
                              "vfe1",
                              "vfe2",
                              "vfe_lite";

            interconnects = <&gem_noc MASTER_AMPSS_M0 QCOM_ICC_TAG_ACTIVE_ONLY
                             &config_noc SLAVE_CAMERA_CFG QCOM_ICC_TAG_ACTIVE_ONLY>,
                            <&mmss_noc MASTER_CAMNOC_HF QCOM_ICC_TAG_ALWAYS
                             &clk_virt SLAVE_EBI_CH0 QCOM_ICC_TAG_ALWAYS>,
                            <&mmss_noc MASTER_CAMNOC_SF QCOM_ICC_TAG_ALWAYS
                             &clk_virt SLAVE_EBI_CH0 QCOM_ICC_TAG_ALWAYS>,
                            <&mmss_noc MASTER_CAMNOC_ICP QCOM_ICC_TAG_ALWAYS
                             &clk_virt SLAVE_EBI_CH0 QCOM_ICC_TAG_ALWAYS>;
            interconnect-names = "cam_ahb",
                                 "cam_hf_0_mnoc",
                                 "cam_sf_0_mnoc",
                                 "cam_sf_icp_mnoc";

            iommus = <&apps_smmu 0x820 0xc0>,
                     <&apps_smmu 0x840 0x0>,
                     <&apps_smmu 0x860 0xc0>,
                     <&apps_smmu 0x880 0x0>;

            power-domains = <&camcc IFE_0_GDSC>,
                            <&camcc IFE_1_GDSC>,
                            <&camcc IFE_2_GDSC>,
                            <&camcc TITAN_TOP_GDSC>;
            power-domain-names = "ife0",
                                 "ife1",
                                 "ife2",
                                 "top";

            vdda-0.9-supply = <&vreg_l18a>;
            vdda-1.25-supply = <&vreg_l22a>;

            ports {
                #address-cells = <1>;
                #size-cells = <0>;

                port@0 {
                    reg = <0>;
                    csiphy0_ep: endpoint {
                        data-lanes = <0 1 2 3>;
                        bus-type = <MEDIA_BUS_TYPE_CSI2_DPHY>;
                        remote-endpoint = <&sensor_ep>;
                    };
                };
            };
        };
    };
```

## Documentation/devicetree/bindings/media/qcom,sm8250-jpeg-enc.yaml
```yaml
# SPDX-License-Identifier: (GPL-2.0 OR BSD-2-Clause)
%YAML 1.2
---
$id: http://devicetree.org/schemas/media/qcom,sm8250-jpeg-enc.yaml#
$schema: http://devicetree.org/meta-schemas/core.yaml#

title: Qualcomm JPEG Encoder

maintainers:
  - Atanas Filipov <atanas.filipov@oss.qualcomm.com>
  - Gjorgji Rosikopulos <gjorgji.rosikopulos@oss.qualcomm.com>

description:
  Qualcomm JPEG Encoder is the JPEG encode hardware present in Qualcomm SoCs.
  The encoder is a standalone hardware IP within the camera subsystem that
  performs JPEG compression in memory-to-memory fashion.

properties:
  compatible:
    enum:
      - qcom,sm8250-jpeg-enc

  reg:
    maxItems: 1

  interrupts:
    maxItems: 1

  clocks:
    maxItems: 6

  clock-names:
    items:
      - const: hf_axi
      - const: sf_axi
      - const: core_ahb
      - const: cpas_ahb
      - const: cnoc_axi
      - const: jpeg

  power-domains:
    maxItems: 1

  interconnects:
    maxItems: 3

  interconnect-names:
    items:
      - const: cpu-cfg
      - const: hf-mnoc
      - const: sf-mnoc

  iommus:
    description:
      SMMU stream ID for the JPEG hardware. The stream ID 0x2040 is used
      for the JPEG core engine on SM8250.
    maxItems: 1

  operating-points-v2: true

  opp-table:
    type: object

required:
  - compatible
  - reg
  - clocks
  - clock-names
  - interrupts
  - power-domains
  - interconnects
  - interconnect-names
  - iommus

additionalProperties: false

examples:
  - |
    #include <dt-bindings/clock/qcom,camcc-sm8250.h>
    #include <dt-bindings/clock/qcom,gcc-sm8250.h>
    #include <dt-bindings/interconnect/qcom,icc.h>
    #include <dt-bindings/interconnect/qcom,sm8250.h>
    #include <dt-bindings/interrupt-controller/arm-gic.h>
    #include <dt-bindings/power/qcom,rpmhpd.h>

    jpeg-encoder@ac53000 {
        compatible = "qcom,sm8250-jpeg-enc";
        reg = <0x0ac53000 0x1000>;

        interrupts = <GIC_SPI 474 IRQ_TYPE_EDGE_RISING>;

        power-domains = <&camcc TITAN_TOP_GDSC>;

        clocks = <&gcc GCC_CAMERA_HF_AXI_CLK>,
                 <&gcc GCC_CAMERA_SF_AXI_CLK>,
                 <&camcc CAM_CC_CORE_AHB_CLK>,
                 <&camcc CAM_CC_CPAS_AHB_CLK>,
                 <&camcc CAM_CC_CAMNOC_AXI_CLK>,
                 <&camcc CAM_CC_JPEG_CLK>;
        clock-names = "hf_axi",
                      "sf_axi",
                      "core_ahb",
                      "cpas_ahb",
                      "cnoc_axi",
                      "jpeg";

        interconnects = <&gem_noc MASTER_AMPSS_M0 QCOM_ICC_TAG_ACTIVE_ONLY
                         &config_noc SLAVE_CAMERA_CFG QCOM_ICC_TAG_ACTIVE_ONLY>,
                        <&mmss_noc MASTER_CAMNOC_HF QCOM_ICC_TAG_ALWAYS
                         &mc_virt SLAVE_EBI_CH0 QCOM_ICC_TAG_ALWAYS>,
                        <&mmss_noc MASTER_CAMNOC_SF QCOM_ICC_TAG_ALWAYS
                         &mc_virt SLAVE_EBI_CH0 QCOM_ICC_TAG_ALWAYS>;
        interconnect-names = "cpu-cfg",
                             "hf-mnoc",
                             "sf-mnoc";

        iommus = <&apps_smmu 0x2040 0x400>;

        operating-points-v2 = <&jpeg_opp_table>;

        jpeg_opp_table: opp-table {
            compatible = "operating-points-v2";

            opp-100000000 {
                opp-hz = /bits/ 64 <400000000>,
                         /bits/ 64 <100000000>;
                required-opps = <&rpmhpd_opp_min_svs>;
            };

            opp-200000000 {
                opp-hz = /bits/ 64 <400000000>,
                         /bits/ 64 <200000000>;
                required-opps = <&rpmhpd_opp_low_svs>;
            };

            opp-400000000 {
                opp-hz = /bits/ 64 <400000000>,
                         /bits/ 64 <400000000>;
                required-opps = <&rpmhpd_opp_svs>;
            };

            opp-480000000 {
                opp-hz = /bits/ 64 <400000000>,
                         /bits/ 64 <480000000>;
                required-opps = <&rpmhpd_opp_svs_l1>;
            };

            opp-600000000 {
                opp-hz = /bits/ 64 <400000000>,
                         /bits/ 64 <600000000>;
                required-opps = <&rpmhpd_opp_nom>;
            };
        };
    };
```
