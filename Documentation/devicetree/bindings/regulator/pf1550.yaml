## Documentation/devicetree/bindings/remoteproc/microchip,ipc-sbi-remoteproc.yaml
```yaml
# SPDX-License-Identifier: (GPL-2.0-only OR BSD-2-Clause)
%YAML 1.2
---
$id: http://devicetree.org/schemas/remoteproc/microchip,ipc-sbi-remoteproc.yaml#
$schema: http://devicetree.org/meta-schemas/core.yaml#

title: Microchip IPC Remote Processor

description:
  Microchip RISC-V SoCs typically contain one or more clusters. Clusters can
  operate in Asymmetric Multi-Processing (AMP) mode, where individual cores
  or groups of cores run as independent software contexts.

  The configuration is flexible, as the set of cores or clusters that can be
  controlled as remote processors may vary, and memory regions used for
  firmware as well as mailbox assignments depend on the system design.

  Communication with remote cores or clusters is abstracted using ecalls
  to the platform's Supervisor Binary Interface (SBI) firmware, through
  which the state of remote cores or clusters are controlled. This binding
  documents that firmware interface.

maintainers:
  - Valentina Fernandez <valentina.fernandezalanis@microchip.com>

properties:
  compatible:
    const: microchip,ipc-sbi-remoteproc

  cpu:
    description:
      phandles to the CPUs comprising the remote cluster
    $ref: /schemas/types.yaml#/definitions/phandle-array

  mboxes:
    description:
      Microchip IPC mailbox specifier. Used for communication with
      a remote cluster. For HSS versions prior to v2026.04, it is also
      used for controlling the life cycle of a remote cluster. The
      specifier format is as per the bindings in
      Documentation/devicetree/bindings/mailbox/microchip,sbi-ipc.yaml
    maxItems: 1

  memory-region:
    minItems: 1
    maxItems: 5
    description:
      List of phandles to the reserved memory regions associated wih the
      remoteproc device. This is variable and describes the memories shared
      with the remote cluster (e.g. firmware, resource table, rpmsg vrings)
    items:
      anyOf:
        - description: resource table when firmware is started by the bootloader
        - description: remote cluster firmware image section
        - description: virtio device (vdev) buffer
        - description: vring0
        - description: vring1

  memory-region-names:
    minItems: 1
    maxItems: 5
    items:
      anyOf:
        - const: rsc-table
        - const: firmware
        - const: buffer
        - const: vring0
        - const: vring1

required:
  - compatible

# Remote Cluster ID is derived either from the CPU phandle or
# from the mailbox specifier prior to HSS v2026.04
anyOf:
  - required:
      - cpu
  - required:
      - mboxes

allOf:
  - if:
      properties:
        memory-region-names:
          contains:
            enum:
              - vring0
              - vring1
    then:
      properties:
        memory-region-names:
          contains:
            const: buffer

additionalProperties: false

examples:
  - |
    // Early boot mode example - firmware started by bootloader
    soc {
        #address-cells = <2>;
        #size-cells = <2>;

        remoteproc {
            compatible = "microchip,ipc-sbi-remoteproc";
            cpu = <&cpu4>;
            mboxes= <&ihc 8>;
            memory-region = <&rsctable>, <&vdev0buffer>,
                            <&vdev0vring0>, <&vdev0vring1>;
            memory-region-names = "rsc-table", "buffer",
                                  "vring0", "vring1";
        };
    };

  - |
    // Late boot mode example - firmware started by Linux (remoteproc)
    soc {
        #address-cells = <2>;
        #size-cells = <2>;

        remoteproc {
            compatible = "microchip,ipc-sbi-remoteproc";
            cpu = <&cpu4>;
            mboxes= <&ihc 8>;
            memory-region = <&cluster_firmware>, <&vdev0buffer>,
                            <&vdev0vring0>, <&vdev0vring1>;
            memory-region-names = "firmware", "buffer",
                                  "vring0", "vring1";
        };
    };
...
```

## Documentation/devicetree/bindings/remoteproc/qcom,glymur-oob-pas.yaml
```yaml
# SPDX-License-Identifier: GPL-2.0 OR BSD-2-Clause
%YAML 1.2
---
$id: http://devicetree.org/schemas/remoteproc/qcom,glymur-oob-pas.yaml#
$schema: http://devicetree.org/meta-schemas/core.yaml#

title: Qualcomm Glymur Out-of-Band Management Subsystem (OOBMSS) PAS

maintainers:
  - Anvesh Jain P <anvesh.p@oss.qualcomm.com>

description: |
  Qualcomm Glymur Out-of-Band Management Subsystem (OOBMSS) contains two
  processors running Zephyr, managed together as one remoteproc instance.
  The Out-of-Band Trusted Execution Environment (OOB-TEE) is the primary
  processor. The OOB-Non-Secure processor is an auxiliary processor that
  depends on the primary processor and cannot function independently.

  The primary processor runs the primary image, while the auxiliary
  processor runs the secondary image. Each processor has its own DTB.
  The two images and their DTBs have separate PAS identifiers for
  authentication and dedicated reserved-memory carveouts.

  OOBMSS is booted by earlier-stage firmware and uses an XO clock and the
  CX and MX power domains. Shared Memory Point-to-Point (SMP2P) provides
  boot, shutdown, handover and ping/pong signaling, as well as fatal error
  notifications. The subsystem exposes a secure GLink edge to the host,
  with doorbell interrupts provided by the Inter-Processor Communication
  Controller (IPCC).

properties:
  compatible:
    enum:
      - qcom,glymur-oobmss-pas

  reg:
    maxItems: 1

  interrupts:
    items:
      - description: Watchdog interrupt
      - description: Fatal interrupt
      - description: Ready interrupt
      - description: Handover interrupt
      - description: Stop acknowledge interrupt
      - description: Pong interrupt

  interrupt-names:
    items:
      - const: wdog
      - const: fatal
      - const: ready
      - const: handover
      - const: stop-ack
      - const: pong

  clocks:
    items:
      - description: XO clock

  clock-names:
    items:
      - const: xo

  power-domains:
    items:
      - description: CX power domain
      - description: MX power domain

  power-domain-names:
    items:
      - const: cx
      - const: mx

  memory-region:
    items:
      - description: Secure firmware carveout
      - description: Secure device tree carveout
      - description: Non-secure firmware carveout
      - description: Non-secure device tree carveout

  firmware-name:
    items:
      - description: Secure firmware
      - description: Secure device tree firmware
      - description: Non-secure firmware
      - description: Non-secure device tree firmware

  qcom,smem-states:
    minItems: 2
    description: States used by the AP to signal OOBMSS

  qcom,smem-state-names:
    minItems: 2
    description: The names of the state bits used for SMP2P output

required:
  - compatible
  - reg
  - power-domains
  - power-domain-names
  - memory-region

allOf:
  - $ref: /schemas/remoteproc/qcom,pas-common.yaml#

unevaluatedProperties: false

examples:
  - |
    #include <dt-bindings/clock/qcom,rpmh.h>
    #include <dt-bindings/interrupt-controller/arm-gic.h>
    #include <dt-bindings/interrupt-controller/irq.h>
    #include <dt-bindings/mailbox/qcom-ipcc.h>
    #include <dt-bindings/power/qcom,rpmhpd.h>
    #define IPCC_MPROC_OOB_S 56
    #define IPCC_MPROC_OOB   55

    remoteproc@1f000000 {
        compatible = "qcom,glymur-oobmss-pas";
        reg = <0x1f000000 0x30000>;

        interrupts-extended = <&intc GIC_SPI 86 IRQ_TYPE_EDGE_RISING>,
                              <&smp2p_oobmss_in 0 IRQ_TYPE_EDGE_RISING>,
                              <&smp2p_oobmss_in 1 IRQ_TYPE_EDGE_RISING>,
                              <&smp2p_oobmss_in 2 IRQ_TYPE_EDGE_RISING>,
                              <&smp2p_oobmss_in 3 IRQ_TYPE_EDGE_RISING>,
                              <&smp2p_oobmss_in 9 IRQ_TYPE_EDGE_RISING>;
        interrupt-names = "wdog", "fatal", "ready", "handover", "stop-ack", "pong";

        clocks = <&rpmhcc RPMH_CXO_CLK>;
        clock-names = "xo";
        power-domains = <&rpmhpd RPMHPD_CX>,
                        <&rpmhpd RPMHPD_MX>;
        power-domain-names = "cx", "mx";

        memory-region = <&oob_secure_mem>, <&oobdtbqc_mem>,
                        <&oob_nonsecure_mem>, <&oobdtboem_mem>;
        firmware-name = "qcom/glymur/oobmss_tee.mbn",
                        "qcom/glymur/oobmss_qc_dtb.mbn",
                        "qcom/glymur/oobmss_ns.mbn",
                        "qcom/glymur/oobmss_oem_dtb.mbn";
        qcom,smem-states = <&smp2p_oobmss_out 1>,
                           <&smp2p_oobmss_out 8>;
        qcom,smem-state-names = "stop", "ping";

        glink-edge {
            interrupts-extended = <&ipcc IPCC_MPROC_OOB_S
                                         IPCC_MPROC_SIGNAL_GLINK_QMP
                                         IRQ_TYPE_EDGE_RISING>;
            mboxes = <&ipcc IPCC_MPROC_OOB_S IPCC_MPROC_SIGNAL_GLINK_QMP>;
            label = "oobmss";
            qcom,remote-pid = <20>;
        };

    };
```

## Documentation/devicetree/bindings/remoteproc/qcom,ipq5018-wcss-sec-pil.yaml
```yaml
# SPDX-License-Identifier: (GPL-2.0-only OR BSD-2-Clause)
%YAML 1.2
---
$id: http://devicetree.org/schemas/remoteproc/qcom,ipq5018-wcss-sec-pil.yaml#
$schema: http://devicetree.org/meta-schemas/core.yaml#

title: Qualcomm WCSS Secure Peripheral Image Loader

maintainers:
  - Manikanta Mylavarapu <quic_mmanikan@quicinc.com>

description:
  Wireless Connectivity Subsystem (WCSS) Secure Peripheral Image Loader loads
  firmware and power up QDSP6 remoteproc on the Qualcomm IPQ series SoC.

properties:
  compatible:
    enum:
      - qcom,ipq5018-wcss-sec-pil
      - qcom,ipq5332-wcss-sec-pil
      - qcom,ipq9574-wcss-sec-pil

  reg:
    maxItems: 1

  firmware-name:
    maxItems: 1
    description: Firmware name for the Hexagon core

  interrupts:
    items:
      - description: Watchdog interrupt
      - description: Fatal interrupt
      - description: Ready interrupt
      - description: Handover interrupt
      - description: Stop acknowledge interrupt

  interrupt-names:
    items:
      - const: wdog
      - const: fatal
      - const: ready
      - const: handover
      - const: stop-ack

  clocks:
    minItems: 1
    items:
      - description: sleep clock
      - description: AHB interconnect clock

  clock-names:
    minItems: 1
    items:
      - const: sleep
      - const: interconnect

  mboxes:
    items:
      - description: TMECom mailbox driver

  qcom,smem-states:
    $ref: /schemas/types.yaml#/definitions/phandle-array
    description: States used by the AP to signal the remote processor
    items:
      - description: Stop Q6
      - description: Shutdown Q6

  qcom,smem-state-names:
    description:
      Names of the states used by the AP to signal the remote processor
    items:
      - const: stop
      - const: shutdown

  memory-region:
    items:
      - description: Q6 reserved region

  glink-edge:
    $ref: /schemas/remoteproc/qcom,glink-edge.yaml#
    description:
      Qualcomm G-Link subnode which represents communication edge, channels
      and devices related to the Modem.
    unevaluatedProperties: false

required:
  - compatible
  - reg
  - firmware-name
  - interrupts
  - interrupt-names
  - qcom,smem-states
  - qcom,smem-state-names
  - memory-region

allOf:
  - if:
      properties:
        compatible:
          contains:
            const: qcom,ipq5018-wcss-sec-pil
    then:
      properties:
        clocks:
          items:
            - description: sleep clock
            - description: AHB interconnect clock
        clock-names:
          items:
            - const: sleep
            - const: interconnect
      required:
        - clocks
        - clock-names

  - if:
      properties:
        compatible:
          contains:
            const: qcom,ipq5332-wcss-sec-pil
    then:
      properties:
        clocks:
          items:
            - description: sleep clock
        clock-names:
          items:
            - const: sleep
      required:
        - clocks
        - clock-names

  - if:
      properties:
        compatible:
          contains:
            enum:
              - qcom,ipq9574-wcss-sec-pil
    then:
      properties:
        clocks: false
        clock-names: false

additionalProperties: false

examples:
  - |
    #include <dt-bindings/interrupt-controller/arm-gic.h>

    q6v5_wcss: remoteproc@cd00000 {
        compatible = "qcom,ipq9574-wcss-sec-pil";
        reg = <0x0cd00000 0x10000>;
        firmware-name = "ath11k/IPQ9574/hw1.0/q6_fw.mbn";
        interrupts-extended = <&intc GIC_SPI 325 IRQ_TYPE_EDGE_RISING>,
                              <&smp2p_wcss_in 0 IRQ_TYPE_NONE>,
                              <&smp2p_wcss_in 1 IRQ_TYPE_NONE>,
                              <&smp2p_wcss_in 2 IRQ_TYPE_NONE>,
                              <&smp2p_wcss_in 3 IRQ_TYPE_NONE>;
        interrupt-names = "wdog",
                          "fatal",
                          "ready",
                          "handover",
                          "stop-ack";

        qcom,smem-states = <&smp2p_wcss_out 1>,
                           <&smp2p_wcss_out 0>;
        qcom,smem-state-names = "stop",
                                "shutdown";
        memory-region = <&q6_region>;

        glink-edge {
            interrupts = <GIC_SPI 321 IRQ_TYPE_EDGE_RISING>;
            label = "rtr";
            qcom,remote-pid = <1>;
            mboxes = <&apcs_glb 8>;
        };
    };
```
