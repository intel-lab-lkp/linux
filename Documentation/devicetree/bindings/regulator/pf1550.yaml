## Documentation/devicetree/bindings/regulator/samsung,s2mpg10-regulator.yaml
```yaml
# SPDX-License-Identifier: GPL-2.0-only OR BSD-2-Clause
%YAML 1.2
---
$id: http://devicetree.org/schemas/regulator/samsung,s2mpg10-regulator.yaml#
$schema: http://devicetree.org/meta-schemas/core.yaml#

title: Samsung S2MPG10 Power Management IC regulators

maintainers:
  - André Draszik <andre.draszik@linaro.org>

description: |
  This is part of the device tree bindings for the S2MG10 Power Management IC
  (PMIC).

  The S2MPG10 PMIC provides 10 buck and 31 LDO regulators.

  See also Documentation/devicetree/bindings/mfd/samsung,s2mps11.yaml for
  additional information and example.

definitions:
  s2mpg10-ext-control:
    properties:
      samsung,ext-control:
        description: |
          These rails can be controlled via one of several possible external
          (hardware) signals. If so, this property configures the signal the PMIC
          should monitor. For S2MPG10 rails where external control is possible other
          than ldo20m, the following values generally corresponding to the
          respective on-chip pin are valid:
            - 0 # S2MPG10_PCTRLSEL_ON - always on
            - 1 # S2MPG10_PCTRLSEL_PWREN - PWREN pin
            - 2 # S2MPG10_PCTRLSEL_PWREN_TRG - PWREN_TRG bit in MIMICKING_CTRL
            - 3 # S2MPG10_PCTRLSEL_PWREN_MIF - PWREN_MIF pin
            - 4 # S2MPG10_PCTRLSEL_PWREN_MIF_TRG - PWREN_MIF_TRG bit in MIMICKING_CTRL
            - 5 # S2MPG10_PCTRLSEL_AP_ACTIVE_N - ~AP_ACTIVE_N pin
            - 6 # S2MPG10_PCTRLSEL_AP_ACTIVE_N_TRG - ~AP_ACTIVE_N_TRG bit in MIMICKING_CTRL
            - 7 # S2MPG10_PCTRLSEL_CPUCL1_EN - CPUCL1_EN pin
            - 8 # S2MPG10_PCTRLSEL_CPUCL1_EN2 - CPUCL1_EN & PWREN pins
            - 9 # S2MPG10_PCTRLSEL_CPUCL2_EN - CPUCL2_EN pin
            - 10 # S2MPG10_PCTRLSEL_CPUCL2_EN2 - CPUCL2_E2 & PWREN pins
            - 11 # S2MPG10_PCTRLSEL_TPU_EN - TPU_EN pin
            - 12 # S2MPG10_PCTRLSEL_TPU_EN2 - TPU_EN & ~AP_ACTIVE_N pins
            - 13 # S2MPG10_PCTRLSEL_TCXO_ON - TCXO_ON pin
            - 14 # S2MPG10_PCTRLSEL_TCXO_ON2 - TCXO_ON & ~AP_ACTIVE_N pins

          For S2MPG10 ldo20m, the following values are valid
            - 0 # S2MPG10_PCTRLSEL_LDO20M_ON - always on
            - 1 # S2MPG10_PCTRLSEL_LDO20M_EN_SFR - VLDO20M_EN & LDO20M_SFR
            - 2 # S2MPG10_PCTRLSEL_LDO20M_EN - VLDO20M_EN pin
            - 3 # S2MPG10_PCTRLSEL_LDO20M_SFR - LDO20M_SFR in LDO_CTRL1 register
            - 4 # S2MPG10_PCTRLSEL_LDO20M_OFF - disable

        $ref: /schemas/types.yaml#/definitions/uint32
        minimum: 0
        maximum: 14

      samsung,ext-control-gpios:
        description: |
          For rails where external control is done via a GPIO, this optional
          property describes the GPIO line used.

        maxItems: 1

    dependentRequired:
      samsung,ext-control-gpios: [ "samsung,ext-control" ]

patternProperties:
  # 10 bucks
  "^buck([1-9]|10)m$":
    type: object
    $ref: regulator.yaml#
    unevaluatedProperties: false
    description:
      Properties for a single buck regulator.

    properties:
      regulator-ramp-delay:
        enum: [6250, 12500, 25000]
        default: 6250

    allOf:
      - $ref: "#/definitions/s2mpg10-ext-control"

  # 13 standard LDOs
  "^ldo([12]|2[1-9]|3[0-1])m$":
    type: object
    $ref: regulator.yaml#
    unevaluatedProperties: false
    description:
      Properties for single LDO regulator.

    properties:
      regulator-ramp-delay: false

  # 14 LDOs with possible external control
  "^ldo([3-9]|1[046-9]|20)m$":
    type: object
    $ref: regulator.yaml#
    unevaluatedProperties: false
    description:
      Properties for a single LDO regulator.

    properties:
      regulator-ramp-delay: false

    allOf:
      - $ref: "#/definitions/s2mpg10-ext-control"

  # 4 LDOs with ramp support and possible external control
  "^ldo1[1235]m$":
    type: object
    $ref: regulator.yaml#
    unevaluatedProperties: false
    description:
      Properties for a single LDO regulator.

    properties:
      regulator-ramp-delay:
        enum: [6250, 12500]
        default: 6250

    allOf:
      - $ref: "#/definitions/s2mpg10-ext-control"

additionalProperties: false

allOf:
  - if:
      anyOf:
        - required: [buck8m]
        - required: [buck9m]
    then:
      patternProperties:
        "^buck[8-9]m$":
          properties:
            samsung,ext-control: false

  - if:
      required:
        - ldo20m
    then:
      properties:
        ldo20m:
          properties:
            samsung,ext-control:
              maximum: 4
```

## Documentation/devicetree/bindings/regulator/samsung,s2mpg11-regulator.yaml
```yaml
# SPDX-License-Identifier: GPL-2.0-only OR BSD-2-Clause
%YAML 1.2
---
$id: http://devicetree.org/schemas/regulator/samsung,s2mpg11-regulator.yaml#
$schema: http://devicetree.org/meta-schemas/core.yaml#

title: Samsung S2MPG11 Power Management IC regulators

maintainers:
  - André Draszik <andre.draszik@linaro.org>

description: |
  This is part of the device tree bindings for the S2MG11 Power Management IC
  (PMIC).

  The S2MPG11 PMIC provides 12 buck, 1 buck-boost, and 15 LDO regulators.

  See also Documentation/devicetree/bindings/mfd/samsung,s2mps11.yaml for
  additional information and example.

definitions:
  s2mpg11-ext-control:
    properties:
      samsung,ext-control:
        description: |
          These rails can be controlled via one of several possible external
          (hardware) signals. If so, this property configures the signal the PMIC
          should monitor. The following values generally corresponding to the
          respective on-chip pin are valid:
            - 0 # S2MPG11_PCTRLSEL_ON - always on
            - 1 # S2MPG11_PCTRLSEL_PWREN - PWREN pin
            - 2 # S2MPG11_PCTRLSEL_PWREN_TRG - PWREN_TRG bit in MIMICKING_CTRL
            - 3 # S2MPG11_PCTRLSEL_PWREN_MIF - PWREN_MIF pin
            - 4 # S2MPG11_PCTRLSEL_PWREN_MIF_TRG - PWREN_MIF_TRG bit in MIMICKING_CTRL
            - 5 # S2MPG11_PCTRLSEL_AP_ACTIVE_N - ~AP_ACTIVE_N pin
            - 6 # S2MPG11_PCTRLSEL_AP_ACTIVE_N_TRG - ~AP_ACTIVE_N_TRG bit in MIMICKING_CTRL
            - 7 # S2MPG11_PCTRLSEL_G3D_EN - G3D_EN pin
            - 8 # S2MPG11_PCTRLSEL_G3D_EN2 - G3D_EN & ~AP_ACTIVE_N pins
            - 9 # S2MPG11_PCTRLSEL_AOC_VDD - AOC_VDD pin
            - 10 # S2MPG11_PCTRLSEL_AOC_RET - AOC_RET pin
            - 11 # S2MPG11_PCTRLSEL_UFS_EN - UFS_EN pin
            - 12 # S2MPG11_PCTRLSEL_LDO13S_EN - VLDO13S_EN pin

        $ref: /schemas/types.yaml#/definitions/uint32
        minimum: 0
        maximum: 12

      samsung,ext-control-gpios:
        description: |
          For rails where external control is done via a GPIO, this optional
          property describes the GPIO line used.

        maxItems: 1

    dependentRequired:
      samsung,ext-control-gpios: [ "samsung,ext-control" ]

properties:
  buckboost:
    type: object
    $ref: regulator.yaml#
    unevaluatedProperties: false
    description:
      Properties for the buck-boost regulator.

    properties:
      regulator-ramp-delay: false

patternProperties:
  # 12 bucks
  "^buck(([1-9]|10)s|[ad])$":
    type: object
    $ref: regulator.yaml#
    unevaluatedProperties: false
    description:
      Properties for a single buck regulator.

    properties:
      regulator-ramp-delay:
        enum: [6250, 12500, 25000]
        default: 6250

    allOf:
      - $ref: "#/definitions/s2mpg11-ext-control"

  # 11 standard LDOs
  "^ldo([3-79]|1[01245])s$":
    type: object
    $ref: regulator.yaml#
    unevaluatedProperties: false
    description:
      Properties for a single LDO regulator.

    properties:
      regulator-ramp-delay: false

  # 2 LDOs with possible external control
  "^ldo(8|13)s$":
    type: object
    $ref: regulator.yaml#
    unevaluatedProperties: false
    description:
      Properties for single LDO regulator.

    properties:
      regulator-ramp-delay: false

    allOf:
      - $ref: "#/definitions/s2mpg11-ext-control"

  # 2 LDOs with ramp support and possible external control
  "^ldo[12]s$":
    type: object
    $ref: regulator.yaml#
    unevaluatedProperties: false
    description:
      Properties for a single LDO regulator.

    properties:
      regulator-ramp-delay:
        enum: [6250, 12500]
        default: 6250

    allOf:
      - $ref: "#/definitions/s2mpg11-ext-control"

additionalProperties: false

allOf:
  - if:
      anyOf:
        - required: [buck4s]
        - required: [buck6s]
        - required: [buck7s]
        - required: [buck10s]
        - required: [buckboost]
    then:
      patternProperties:
        "^buck([467]|10|boost)s$":
          properties:
            samsung,ext-control: false

  - if:
      required:
        - buckboost
    then:
      properties:
        buckboost:
          properties:
            regulator-ramp-delay: false
```

## Documentation/devicetree/bindings/regulator/sgmicro,sgm3804.yaml
```yaml
# SPDX-License-Identifier: (GPL-2.0-only OR BSD-2-Clause)
%YAML 1.2
---
$id: http://devicetree.org/schemas/regulator/sgmicro,sgm3804.yaml#
$schema: http://devicetree.org/meta-schemas/core.yaml#

title: SGMicro SGM3804 I2C charge-pump regulator

maintainers:
  - Alexandre Hamamdjian <azkali.limited@gmail.com>
  - Philippe Simons <simons.philippe@gmail.com>

description:
  The SGM3804 is an I2C-controlled positive and negative output charge-pump
  regulator typically used to provide the AVDD and AVEE supplies for display
  panels. Two reset GPIOs are used to sequence the positive and negative
  outputs independently.

allOf:
  - $ref: regulator.yaml#

properties:
  compatible:
    const: sgmicro,sgm3804

  reg:
    maxItems: 1

  reset-gpios:
    minItems: 1
    maxItems: 2
    description:
      Reset/enable GPIOs for the positive (index 0) and, optionally, the
      negative (index 1) output rails.

required:
  - compatible
  - reg
  - reset-gpios

unevaluatedProperties: false

examples:
  - |
    #include <dt-bindings/gpio/gpio.h>

    i2c {
        #address-cells = <1>;
        #size-cells = <0>;

        regulator@3e {
            compatible = "sgmicro,sgm3804";
            reg = <0x3e>;
            reset-gpios = <&tlmm 10 GPIO_ACTIVE_HIGH>,
                          <&tlmm 11 GPIO_ACTIVE_HIGH>;
            regulator-name = "panel-avdd";
            regulator-min-microvolt = <5000000>;
            regulator-max-microvolt = <5000000>;
        };
    };
```

## Documentation/devicetree/bindings/regulator/sprd,sc2730-regulator.yaml
```yaml
# SPDX-License-Identifier: GPL-2.0-only OR BSD-2-Clause
%YAML 1.2
---
$id: http://devicetree.org/schemas/regulator/sprd,sc2730-regulator.yaml#
$schema: http://devicetree.org/meta-schemas/core.yaml#

title: Unisoc SC2730 Power Management IC regulators

maintainers:
  - Otto Pflüger <otto.pflueger@abscue.de>

properties:
  compatible:
    const: sprd,sc2730-regulator

patternProperties:
  "^DCDC_(CORE|CPU|GEN[0-1]|GPU|MEM|MEMQ|MODEM|SRAM)$":
    type: object
    $ref: regulator.yaml#
    unevaluatedProperties: false

  "^LDO_AVDD(12|18)$":
    type: object
    $ref: regulator.yaml#
    unevaluatedProperties: false

  "^LDO_VDD(18_DCXO|28)$":
    type: object
    $ref: regulator.yaml#
    unevaluatedProperties: false

  "^LDO_VDD(EMMCCORE|KPLED|LDO[0-2]|SD(CORE|IO)|SIM[0-2]|USB33|WCN|WIFIPA)$":
    type: object
    $ref: regulator.yaml#
    unevaluatedProperties: false

  "^LDO_VDDCAM(A0|A1|D0|D1|IO|MOT)$":
    type: object
    $ref: regulator.yaml#
    unevaluatedProperties: false

  "^LDO_VDDRF(1V25|18)$":
    type: object
    $ref: regulator.yaml#
    unevaluatedProperties: false

required:
  - compatible

additionalProperties: false
...
```
