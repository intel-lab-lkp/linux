## Documentation/devicetree/bindings/regulator/ti,lp8720.yaml
```yaml
# SPDX-License-Identifier: (GPL-2.0-only OR BSD-2-Clause)
%YAML 1.2
---
$id: http://devicetree.org/schemas/regulator/ti,lp8720.yaml#
$schema: http://devicetree.org/meta-schemas/core.yaml#

title: TI/National Semiconductor LP872x PMIC

description: >
  The LP8720 is a multi-function, programmable Power Management Unit,
  optimized for sub block power requirement solutions. This device
  integrates one highly efficient 400 mA step-down DC-DC converter with
  Dynamic Voltage Scale (DVS), five low-noise low dropout (LDO) voltage
  regulators, and a 400 KHz i2c-compatible interface to allow a host
  controller access to the internal control registers of the LP8720.
  Additionally, the LP8720 features programmable power-on sequencing.

  LP8720: https://www.ti.com/lit/ds/symlink/lp8720.pdf
  LP8725: https://www.ti.com/lit/ds/symlink/lp8725.pdf

maintainers:
  - Svyatoslav Ryhel <clamor95@gmail.com>

properties:
  compatible:
    enum:
      - ti,lp8720
      - ti,lp8725

  reg:
    maxItems: 1

  enable-gpios:
    description: GPIO specifier for EN pin control.
    maxItems: 1

  dvs-gpios:
    description: GPIO specifier for external DVS pin control.
    maxItems: 1

  ti,general-config:
    $ref: /schemas/types.yaml#/definitions/uint8
    description: >
      The value of LP872X_GENERAL_CFG register

      (LP8720)
      bit[2]: BUCK output voltage control by external DVS pin or register
                1 = external pin, 0 = bit7 of register 08h
      bit[1]: sleep control by external DVS pin or register
                1 = external pin, 0 = bit6 of register 08h
      bit[0]: time step unit(usec). 1 = 25, 0 = 50

      (LP8725)
      bit[7:6]: time step unit(usec). 00 = 32, 01 = 64, 10 = 128, 11 = 256
      bit[4]:   BUCK2 enable control. 1 = enable, 0 = disable
      bit[3]:   BUCK2 output voltage register address. 1 = 0Ah, 0 = 0Bh
      bit[2]:   BUCK1 output voltage control by external DVS pin or register
                  1 = register 08h, 0 = DVS
      bit[1]:   LDO sleep control. 1 = sleep mode, 0 = normal
      bit[0]:   BUCK1 enable control, 1 = enable, 0 = disable

      For more details, please see the datasheet.

  ti,update-config:
    type: boolean
    description: Define it when LP872X_GENERAL_CFG register should be set

  ti,dvs-vsel:
    $ref: /schemas/types.yaml#/definitions/uint8
    description: DVS selector. 0 = SEL_V1, 1 = SEL_V2.

  ti,dvs-state:
    $ref: /schemas/types.yaml#/definitions/uint8
    description: Initial DVS pin state. 0 = DVS_LOW, 1 = DVS_HIGH.

patternProperties:
  "^(vbatt|vin([1-3]|b|lilo[1-2]))-supply$":
    $ref: /schemas/types.yaml#/definitions/phandle
    description: |
      vbatt - input supply for ldo1 and all internal circuitry (lp8720 only).
      vin1 - input supply for ldo2 - ldo3 (lp8720) or ldo1 (lp8725).
      vin2 - input supply for ldo4 - ldo5 (lp8720) or ldo2 - ldo3 (lp8725).
      vin3 - input supply for ldo4 - ldo5 (lp8725).
      vinb - input supply for buck.
      vinlilo1 and vinlilo2 - input supply for lilo1 and lilo2.

  "^(buck|buck[1-2]|ldo[1-5]|lilo[1-2])$":
    $ref: /schemas/regulator/regulator.yaml#
    unevaluatedProperties: false

allOf:
  - if:
      properties:
        compatible:
          contains:
            const: ti,lp8720
    then:
      patternProperties:
        "^(vin(3|lilo[1-2]))-supply$": false
        "^(buck[1-2]|lilo[1-2])$": false

  - if:
      properties:
        compatible:
          contains:
            const: ti,lp8725
    then:
      properties:
        vbatt-supply: false
        buck: false

required:
  - compatible
  - reg

additionalProperties: false

examples:
  - |
    i2c {
        #address-cells = <1>;
        #size-cells = <0>;

        pmic@7d {
            compatible = "ti,lp8720";
            reg = <0x7d>;

            /* external DVS pin used, timestep is 25usec */
            ti,general-config = /bits/ 8 <0x03>;
            ti,update-config;

            /*
             * The dvs-gpio depends on the processor environment.
             * For example, following GPIO specifier means GPIO134 in OMAP4.
             */
            dvs-gpios = <&gpio5 6 0>;
            ti,dvs-vsel = /bits/ 8 <1>; /* SEL_V2 */
            ti,dvs-state = /bits/ 8 <1>; /* DVS_HIGH */

            ldo1 {
                regulator-min-microvolt = <1200000>;
                regulator-max-microvolt = <3300000>;
            };

            ldo2 {
                regulator-min-microvolt = <1200000>;
                regulator-max-microvolt = <3300000>;
            };

            ldo3 {
                regulator-min-microvolt = <1200000>;
                regulator-max-microvolt = <3300000>;
                regulator-boot-on;
            };

            ldo4 {
                regulator-min-microvolt = <800000>;
                regulator-max-microvolt = <2850000>;
                regulator-boot-on;
            };

            ldo5 {
                regulator-min-microvolt = <1200000>;
                regulator-max-microvolt = <3300000>;
            };

            buck {
                regulator-name = "VBUCK";
                regulator-min-microvolt = <800000>;
                regulator-max-microvolt = <2300000>;
            };
        };
    };
  - |
    i2c {
        #address-cells = <1>;
        #size-cells = <0>;

        pmic@7a {
            compatible = "ti,lp8725";
            reg = <0x7a>;

            /* Enable BUCK1,2, no DVS, normal LDO mode, timestep is 256usec */
            ti,general-config = /bits/ 8 <0xdd>;
            ti,update-config;

            ldo1 {
                regulator-min-microvolt = <1200000>;
                regulator-max-microvolt = <3300000>;
            };

            ldo2 {
                regulator-min-microvolt = <1200000>;
                regulator-max-microvolt = <3300000>;
            };

            ldo3 {
                regulator-min-microvolt = <1200000>;
                regulator-max-microvolt = <3300000>;
            };

            ldo4 {
                regulator-min-microvolt = <1200000>;
                regulator-max-microvolt = <3300000>;
                regulator-boot-on;
            };

            ldo5 {
                regulator-min-microvolt = <1200000>;
                regulator-max-microvolt = <3300000>;
                regulator-boot-on;
            };

            lilo1 {
                regulator-name = "VAUX1";
                regulator-min-microvolt = <800000>;
                regulator-max-microvolt = <3300000>;
            };

            lilo2 {
                regulator-name = "VAUX2";
                regulator-min-microvolt = <800000>;
                regulator-max-microvolt = <3300000>;
            };

            buck1 {
                regulator-name = "VBUCK1";
                regulator-min-microvolt = <800000>;
                regulator-max-microvolt = <3000000>;
                regulator-min-microamp  = <460000>;
                regulator-max-microamp  = <1370000>;
                regulator-boot-on;
            };

            buck2 {
                regulator-name = "VBUCK2";
                regulator-min-microvolt = <800000>;
                regulator-max-microvolt = <3000000>;
                regulator-min-microamp  = <460000>;
                regulator-max-microamp  = <1370000>;
                regulator-boot-on;
            };
        };
    };
```

## Documentation/devicetree/bindings/regulator/ti,pbias-regulator.yaml
```yaml
# SPDX-License-Identifier: (GPL-2.0-only OR BSD-2-Clause)
%YAML 1.2
---
$id: http://devicetree.org/schemas/regulator/ti,pbias-regulator.yaml#
$schema: http://devicetree.org/meta-schemas/core.yaml#

title: PBIAS internal regulator

maintainers:
  - Thomas Richard <thomas.richard@bootlin.com>

description: |
  PBIAS internal regulator for SD card dual voltage i/o pads on OMAP SoCs.

properties:
  compatible:
    items:
      - enum:
          - ti,pbias-dra7
          - ti,pbias-omap2
          - ti,pbias-omap3
          - ti,pbias-omap4
          - ti,pbias-omap5
      - const: ti,pbias-omap

  reg:
    maxItems: 1

  syscon:
    description: Phandle of the system control module
    $ref: /schemas/types.yaml#/definitions/phandle

patternProperties:
  '^pbias_*':
    type: object
    $ref: regulator.yaml#
    unevaluatedProperties: false

required:
  - compatible
  - reg
  - syscon

additionalProperties: false

allOf:
  - if:
      properties:
        compatible:
          contains:
            enum:
              - ti,pbias-omap2
    then:
      patternProperties:
        '^pbias_*':
          properties:
            regulator-name:
              contains:
                enum:
                  - pbias_mmc_omap2430

  - if:
      properties:
        compatible:
          contains:
            enum:
              - ti,pbias-omap3
    then:
      patternProperties:
        '^pbias_*':
          properties:
            regulator-name:
              contains:
                enum:
                  - pbias_mmc_omap2430
                  - pbias_sim_omap3

  - if:
      properties:
        compatible:
          contains:
            enum:
              - ti,pbias-omap4
    then:
      patternProperties:
        '^pbias_*':
          properties:
            regulator-name:
              contains:
                enum:
                  - pbias_mmc_omap4

  - if:
      properties:
        compatible:
          contains:
            enum:
              - ti,pbias-dra7
              - ti,pbias-omap5
    then:
      patternProperties:
        '^pbias_*':
          properties:
            regulator-name:
              contains:
                enum:
                  - pbias_mmc_omap5

examples:
  - |
    bus {
        #address-cells = <1>;
        #size-cells = <1>;

        pbias_regulator: pbias_regulator@0 {
            compatible = "ti,pbias-omap5", "ti,pbias-omap";
            reg = <0 0x4>;
            syscon = <&omap5_padconf_global>;
            pbias_mmc_reg: pbias_mmc_omap5 {
                regulator-name = "pbias_mmc_omap5";
                regulator-min-microvolt = <1800000>;
                regulator-max-microvolt = <3000000>;
            };
        };
    };
```
