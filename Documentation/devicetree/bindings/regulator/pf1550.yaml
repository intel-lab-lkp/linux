## Documentation/devicetree/bindings/regulator/pf1550.yaml
```yaml
# SPDX-License-Identifier: GPL-2.0
%YAML 1.2
---
$id: http://devicetree.org/schemas/regulator/pf1550.yaml#
$schema: http://devicetree.org/meta-schemas/core.yaml#

title: Regulators for PF1550 PMIC from NXP.

maintainers:
  - Samuel Kayode <samuel.kayode@savoirfairelinux.com>

description: |
  This module is part of the PF1550 MFD device. For more details
  see Documentation/devicetree/bindings/mfd/pf1550.yaml.

  The regulator controller is represented as a sub-node of the PMIC node
  on the device tree.

  The device has three LDO regulators, three buck converters and a DDR
  termination reference voltage.

properties:
  compatible:
    const: fsl,pf1550-regulator

patternProperties:
  "^(LDO[1-3]|SW[1-3]|VREFADDR)$":
    $ref: regulator.yaml#
    unevaluatedProperties: false

required:
  - compatible
additionalProperties: false

...
```

## Documentation/devicetree/bindings/regulator/richtek,rt5133.yaml
```yaml
# SPDX-License-Identifier: GPL-2.0-only OR BSD-2-Clause
%YAML 1.2
---
$id: http://devicetree.org/schemas/regulator/richtek,rt5133.yaml#
$schema: http://devicetree.org/meta-schemas/core.yaml#

title: Richtek RT5133 PMIC Regulator

maintainers:
  - ShihChia Chang <jeff_chang@richtek.com>

description:
  The RT5133 is an integrated Power Management IC for portable devices, featuring
  8 LDOs and 3 GPOs. It allows programmable output voltages, soft-start times,
  and protections via I2C. GPO operation depends on LDO1 voltage.

properties:
  compatible:
    enum:
      - richtek,rt5133

  reg:
    maxItems: 1

  enable-gpios:
    maxItems: 1

  wakeup-source: true

  interrupts:
    maxItems: 1

  gpio-controller: true

  "#gpio-cells":
    const: 2

  richtek,oc-shutdown-all:
    type: boolean
    description:
      Controls the behavior when any LDO (Low Dropout Regulator) enters an Over Current state.
      If set to true, all LDO channels will be shut down.
      If set to false (default), only the affected LDO channel will shut down itself.

  richtek,pgb-shutdown-all:
    type: boolean
    description:
      Controls the behavior when any LDO enters a Power Bad state.
      If set to true, all LDO channels will be shut down.
      If set to false (default), only the affected LDO channel will shut down itself.

  regulators:
    type: object
    additionalProperties: false

    properties:
      base:
        type: object
        $ref: regulator.yaml#
        unevaluatedProperties: false
        description:
          Properties for the base regulator, which is the top-level supply for
          LDO1 to LDO6. It functions merely as an on/off switch rather than
          regulating voltages. If none of LDO1 to LDO6 are in use, switching off
          the base will reduce the quiescent current.

        required:
          - regulator-name

    patternProperties:
      "^ldo([1-6])$":
        type: object
        $ref: regulator.yaml#
        unevaluatedProperties: false
        description:
          Properties for single LDO regulator

        required:
          - regulator-name

      "^ldo([7-8])$":
        type: object
        $ref: regulator.yaml#
        unevaluatedProperties: false
        description:
          Properties for single LDO regulator

        properties:
          vin-supply: true

        required:
          - regulator-name
          - vin-supply

required:
  - compatible
  - reg
  - interrupts
  - wakeup-source

unevaluatedProperties: false

examples:
  - |
    #include <dt-bindings/interrupt-controller/irq.h>
    i2c {
      #address-cells = <1>;
      #size-cells = <0>;

      pmic@18 {
        compatible = "richtek,rt5133";
        reg = <0x18>;
        wakeup-source;
        interrupts-extended = <&gpio 0 IRQ_TYPE_EDGE_FALLING>;
        enable-gpios = <&gpio 2 0>;
        gpio-controller;
        #gpio-cells = <2>;
        richtek,oc-shutdown-all;
        richtek,pgb-shutdown-all;
        regulators {
          base {
            regulator-name = "rt5133,base";
          };
          pvin78: ldo1 {
            regulator-name = "rt5133-ldo1";
            regulator-min-microvolt = <1800000>;
            regulator-max-microvolt = <3199998>;
            regulator-active-discharge = <1>;
          };
          ldo2 {
            regulator-name = "rt5133-ldo2";
            regulator-min-microvolt = <1800000>;
            regulator-max-microvolt = <3200000>;
            regulator-active-discharge = <1>;
          };
          ldo3 {
            regulator-name = "rt5133-ldo3";
            regulator-min-microvolt = <1700000>;
            regulator-max-microvolt = <3000000>;
            regulator-active-discharge = <1>;
          };
          ldo4 {
            regulator-name = "rt5133-ldo4";
            regulator-min-microvolt = <1700000>;
            regulator-max-microvolt = <3000000>;
            regulator-active-discharge = <1>;
          };
          ldo5 {
            regulator-name = "rt5133-ldo5";
            regulator-min-microvolt = <1700000>;
            regulator-max-microvolt = <3000000>;
            regulator-active-discharge = <1>;
          };
          ldo6 {
            regulator-name = "rt5133-ldo6";
            regulator-min-microvolt = <1700000>;
            regulator-max-microvolt = <3000000>;
            regulator-active-discharge = <1>;
          };
          ldo7 {
            regulator-name = "rt5133-ldo7";
            regulator-min-microvolt = <900000>;
            regulator-max-microvolt = <1200000>;
            regulator-active-discharge = <1>;
            vin-supply = <&pvin78>;
          };
          ldo8 {
            regulator-name = "rt5133-ldo8";
            regulator-min-microvolt = <855000>;
            regulator-max-microvolt = <1200000>;
            regulator-active-discharge = <1>;
            vin-supply = <&pvin78>;
          };
        };
      };
    };
```

## Documentation/devicetree/bindings/regulator/riscv,rpmi-mpxy-voltage.yaml
```yaml
# SPDX-License-Identifier: (GPL-2.0-only OR BSD-2-Clause)
%YAML 1.2
---
$id: http://devicetree.org/schemas/regulator/riscv,rpmi-mpxy-voltage.yaml#
$schema: http://devicetree.org/meta-schemas/core.yaml#

title: RISC-V RPMI voltage service group based message proxy

maintainers:
  - Joshua Yeong <joshua.yeong@starfivetech.com>

description: |
  The RISC-V Platform Management Interface (RPMI) [1] defines a
  messaging protocol which is modular and extensible. The supervisor
  software can send/receive RPMI messages via SBI MPXY extension [2]
  or some dedicated supervisor-mode RPMI transport.

  The RPMI specification [1] defines voltage service group for accessing
  and controlling the voltage domains managed by a platform
  microcontroller. The SBI implementation (machine mode firmware or
  hypervisor) can implement an SBI MPXY channel to allow RPMI voltage
  service group access to the supervisor software.

  ===========================================
  References
  ===========================================

  [1] RISC-V Platform Management Interface (RPMI) v1.0 (or higher)
      https://github.com/riscv-non-isa/riscv-rpmi/releases

  [2] RISC-V Supervisor Binary Interface (SBI) v3.0 (or higher)
      https://github.com/riscv-non-isa/riscv-sbi-doc/releases

properties:
  compatible:
    description:
      Intended for use by the SBI implementation.
    const: riscv,rpmi-mpxy-voltage

  mboxes:
    maxItems: 1
    description:
      Mailbox channel of the underlying RPMI transport.

  riscv,sbi-mpxy-channel-id:
    $ref: /schemas/types.yaml#/definitions/uint32
    description:
      The SBI MPXY channel id to be used for providing RPMI access to
      the supervisor software.

required:
  - compatible
  - mboxes
  - riscv,sbi-mpxy-channel-id

additionalProperties: false

examples:
  - |
    voltage-service {
        compatible = "riscv,rpmi-mpxy-voltage";
        mboxes = <&rpmi_shmem_mbox 0x7>;
        riscv,sbi-mpxy-channel-id = <0x1004>;
    };
...
```

## Documentation/devicetree/bindings/regulator/riscv,rpmi-voltage.yaml
```yaml
# SPDX-License-Identifier: (GPL-2.0-only OR BSD-2-Clause)
%YAML 1.2
---
$id: http://devicetree.org/schemas/regulator/riscv,rpmi-voltage.yaml#
$schema: http://devicetree.org/meta-schemas/core.yaml#

title: RISC-V RPMI voltage service group based regulator controller

maintainers:
  - Joshua Yeong <joshua.yeong@starfivetech.com>

description: |
  The RISC-V Platform Management Interface (RPMI) [1] defines a
  messaging protocol which is modular and extensible. The supervisor
  software can send/receive RPMI messages via SBI MPXY extension [2]
  or some dedicated supervisor-mode RPMI transport.

  The RPMI specification [1] defines voltage service group for accessing
  and controlling the voltage domains managed by a platform
  microcontroller. The supervisor software can access RPMI voltage
  service group via SBI MPXY channel or some dedicated supervisor-mode
  RPMI transport.

  The voltage domains are discovered at runtime from the platform
  microcontroller, which reports the name, the level format, the supported
  levels and the always-on capability of each one, so none of that is
  described here.

  A consumer names a domain in one of two ways. The first is through a
  "<name>-supply" phandle to a child of the optional "regulators" container,
  whose "reg" is the domain's RPMI DOMAIN_ID. The second needs no child with
  "#voltage-domain-cells" on the provider, a consumer lists
  "voltage-domains = <&provider DOMAIN_ID>" and names each entry in
  "voltage-domain-names", the way it names a voltage power domain.

  A child may also say what the board permits the rail to supply, which the
  platform microcontroller has no way to express. A child that gives no
  voltage constraint leaves the rail free to move within the levels the
  domain advertises.

  ===========================================
  References
  ===========================================

  [1] RISC-V Platform Management Interface (RPMI) v1.0 (or higher)
      https://github.com/riscv-non-isa/riscv-rpmi/releases

  [2] RISC-V Supervisor Binary Interface (SBI) v3.0 (or higher)
      https://github.com/riscv-non-isa/riscv-sbi-doc/releases

properties:
  compatible:
    description:
      Intended for use by the supervisor software.
    const: riscv,rpmi-voltage

  mboxes:
    maxItems: 1
    description:
      Mailbox channel of the underlying RPMI transport or SBI message proxy channel.

  "#voltage-domain-cells":
    const: 1
    description:
      Lets a consumer name a domain by its RPMI DOMAIN_ID, the single cell of
      a "voltage-domains" entry, without a child node for the domain.

  regulators:
    type: object
    additionalProperties: false
    description:
      Optional container giving discovered domains a node of their own, for
      consumers to reference and for board level constraints.

    properties:
      "#address-cells":
        const: 1

      "#size-cells":
        const: 0

    patternProperties:
      "^regulator@[0-9a-f]+$":
        type: object
        $ref: regulator.yaml#
        unevaluatedProperties: false

        properties:
          reg:
            maxItems: 1
            description:
              RPMI DOMAIN_ID of the voltage domain this node describes.

        required:
          - reg

    required:
      - "#address-cells"
      - "#size-cells"

required:
  - compatible
  - mboxes

additionalProperties: false

examples:
  - |
    rpmi_voltage: rpmi-voltage {
        compatible = "riscv,rpmi-voltage";
        mboxes = <&mpxy_mbox 0x1004 0x0>;
        #voltage-domain-cells = <1>;

        regulators {
            #address-cells = <1>;
            #size-cells = <0>;

            // A node only so that consumers can name the domain. Its
            // voltage stays free to move within the advertised levels.
            volt1_reg: regulator@1 {
                reg = <1>;
            };

            // A board level constraint. Equal bounds pin the rail, so the
            // supervisor applies 1.8V and refuses to move it afterwards.
            volt2_reg: regulator@2 {
                reg = <2>;
                regulator-min-microvolt = <1800000>;
                regulator-max-microvolt = <1800000>;
            };
        };
    };

    sensor {
        compatible = "vendor,sensor";
        vdd-supply = <&volt1_reg>;
    };

    codec {
        compatible = "vendor,codec";
        vdd-supply = <&volt2_reg>;
    };

    // Domains 3 and 4 by DOMAIN_ID, with no child node for either.
    phy {
        compatible = "vendor,phy";
        voltage-domains = <&rpmi_voltage 3>, <&rpmi_voltage 4>;
        voltage-domain-names = "vdda", "vddio";
    };
...
```
