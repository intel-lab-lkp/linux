## Documentation/devicetree/bindings/remoteproc/allwinner,sun55i-rproc.yaml
```yaml
# SPDX-License-Identifier: GPL-2.0-only OR BSD-2-Clause
%YAML 1.2
---
$id: http://devicetree.org/schemas/remoteproc/allwinner,sun55i-rproc.yaml#
$schema: http://devicetree.org/meta-schemas/core.yaml#

title: Allwinner XuanTie E906/E907 RISC-V Remoteproc

maintainers:
  - Jernej Skrabec <jernej.skrabec@gmail.com>
  - Samuel Holland <samuel@sholland.org>
  - Tim Michals <tcmichals@gmail.com>

description:
  The Allwinner T527, A527, and A523 (sun55i) SoCs integrate a T-Head
  (XuanTie) E906 or E907 RISC-V co-processor alongside the ARM Cortex-A55
  cluster. The co-processor runs bare-metal firmware loaded and lifecycle-
  managed by the Linux remoteproc framework.

  The driver controls CCU-integrated clocks (bus, core) and resets
  (cfg, core), programs the hardware boot-vector register, maps
  internal SRAM (SRAM_A3) windows, and connects to the Allwinner
  hardware mailbox (CPUX_MSGBOX) for VirtIO RPMsg IPC.

properties:
  compatible:
    const: allwinner,sun55i-a523-rproc

  reg:
    minItems: 1
    maxItems: 4
    description:
      Memory-mapped register regions. The following named regions are
      supported (all optional except at least one of r_sram or r_sram1) -
      "cfg" for RISC-V core control and boot-vector registers,
      "r_sram" for dedicated MCU SRAM Space 0,
      "r_sram1" for switchable MCU SRAM Space 1,
      "remap" for the hardware remap control register.

  reg-names:
    minItems: 1
    maxItems: 4
    items:
      enum:
        - cfg
        - r_sram
        - r_sram1
        - remap

  clocks:
    minItems: 1
    maxItems: 5

  clock-names:
    minItems: 1
    items:
      - const: bus
      - const: core
      - const: sram
      - const: msgbox
      - const: parent

  resets:
    minItems: 1
    maxItems: 4

  reset-names:
    minItems: 1
    items:
      - const: cfg
      - const: core
      - const: sram
      - const: msgbox

  mboxes:
    maxItems: 2
    description:
      Exactly two mailbox channels from the Allwinner CPUX_MSGBOX controller,
      one receive channel (RISC-V-to-ARM) and one transmit channel
      (ARM-to-RISC-V), used for VirtIO RPMsg kick notifications.

  mbox-names:
    items:
      - const: rx
      - const: tx

  firmware-name:
    maxItems: 1
    description:
      Name of the ELF firmware image to load from /lib/firmware/.
      Defaults to "riscv-firmware.elf" if not specified.

  memory-region:
    minItems: 1
    items:
      - description: VirtIO vring buffer region (DDR carveout)
      - description: DRAM firmware execution carveout
      - description: RemoteProc trace buffer carveout

  memory-region-names:
    minItems: 1
    items:
      - const: vram
      - const: dram
      - const: trace

  interrupts:
    maxItems: 1
    description:
      Optional hardware crash-notification interrupt. When present the
      driver calls rproc_report_crash() on assertion.

  interrupt-names:
    items:
      - const: crash

required:
  - compatible
  - reg
  - reg-names
  - clocks
  - clock-names
  - resets
  - reset-names
  - mboxes
  - mbox-names

additionalProperties: false

examples:
  - |
    remoteproc@7130000 {
        compatible = "allwinner,sun55i-a523-rproc";
        reg = <0x07130000 0x1000>,
              <0x07280000 0x40000>,
              <0x072c0000 0x40000>,
              <0x07010364 0x4>;
        reg-names = "cfg", "r_sram", "r_sram1", "remap";
        clocks = <&mcu_ccu 3>, <&mcu_ccu 4>;
        clock-names = "bus", "core";
        resets = <&mcu_ccu 0>, <&mcu_ccu 1>;
        reset-names = "cfg", "core";
        mboxes = <&msgbox 8>, <&msgbox 9>;
        mbox-names = "rx", "tx";
        firmware-name = "riscv-firmware.elf";
    };
```

## Documentation/devicetree/bindings/remoteproc/amd,microblaze.yaml
```yaml
# SPDX-License-Identifier: (GPL-2.0-only OR BSD-2-Clause)
%YAML 1.2
---
$id: http://devicetree.org/schemas/remoteproc/amd,microblaze.yaml#
$schema: http://devicetree.org/meta-schemas/core.yaml#

title: AMD MicroBlaze remote processor

maintainers:
  - Ben Levinsky <ben.levinsky@amd.com>

description:
  MicroBlaze remote processor controlled by Linux through the remoteproc
  framework.

  The executable firmware memory window is described in the
  MicroBlaze-local address space by the node's reg property and translated
  to the system physical address space with standard devicetree address
  translation provided by the parent bus node's ranges property.

properties:
  $nodename:
    pattern: "^remoteproc@[0-9a-f]+$"

  compatible:
    const: amd,microblaze

  reg:
    maxItems: 1
    description:
      MicroBlaze-local address and size of the executable firmware memory
      window.

  firmware-name:
    maxItems: 1

  reset-gpios:
    maxItems: 1

required:
  - compatible
  - reg
  - reset-gpios

additionalProperties: false

examples:
  - |
    #include <dt-bindings/gpio/gpio.h>

    / {
      #address-cells = <2>;
      #size-cells = <2>;

      bus@b0000000 {
        compatible = "simple-pm-bus";
        #address-cells = <1>;
        #size-cells = <1>;
        ranges = <0x0 0x0 0xb0000000 0x40000>;

        remoteproc@0 {
          compatible = "amd,microblaze";
          reg = <0x0 0x40000>;
          reset-gpios = <&mbv_reset_gpio 0 GPIO_ACTIVE_LOW>;
        };
      };
    };
```

## Documentation/devicetree/bindings/remoteproc/arm,rproc.yaml
```yaml
# SPDX-License-Identifier: (GPL-2.0 OR BSD-2-Clause)
%YAML 1.2
---
$id: http://devicetree.org/schemas/remoteproc/arm,rproc.yaml#
$schema: http://devicetree.org/meta-schemas/core.yaml#

title: Arm Remoteproc Devices

maintainers:
  - Abdellatif El Khlifi <abdellatif.elkhlifi@arm.com>

description: |
  Some Arm heterogeneous System-On-Chips feature remote processors that can
  be controlled with a reset control register and a reset status register to
  start or stop the processor.

  This document defines the bindings for these remote processors.

properties:
  compatible:
    enum:
      - arm,corstone1000-extsys

  reg:
    minItems: 2
    maxItems: 2
    description: |
      Address and size in bytes of the reset control register
      and the reset status register.
      Expects the registers to be in the order as above.
      Should contain an entry for each value in 'reg-names'.

  reg-names:
    description: |
      Required names for each of the reset registers defined in
      the 'reg' property. Expects the names from the following
      list, in the specified order, each representing the corresponding
      reset register.
    items:
      - const: reset-control
      - const: reset-status

  firmware-name:
    description: |
      Default name of the firmware to load to the remote processor.

required:
  - compatible
  - reg
  - reg-names
  - firmware-name

additionalProperties: false

examples:
  - |
    extsys0: remoteproc@1a010310 {
            compatible = "arm,corstone1000-extsys";
            reg = <0x1a010310 0x4>, <0x1a010314 0x4>;
            reg-names = "reset-control", "reset-status";
            firmware-name = "es0_flashfw.elf";
    };

    extsys1: remoteproc@1a010318 {
            compatible = "arm,corstone1000-extsys";
            reg = <0x1a010318 0x4>, <0x1a01031c 0x4>;
            reg-names = "reset-control", "reset-status";
            firmware-name = "es1_flashfw.elf";
    };
```

## Documentation/devicetree/bindings/remoteproc/arm,sse710-extsys.yaml
```yaml
# SPDX-License-Identifier: (GPL-2.0 OR BSD-2-Clause)
%YAML 1.2
---
$id: http://devicetree.org/schemas/remoteproc/arm,sse710-extsys.yaml#
$schema: http://devicetree.org/meta-schemas/core.yaml#

title: SSE-710 External System Remote Processor

maintainers:
  - Abdellatif El Khlifi <abdellatif.elkhlifi@arm.com>
  - Hugues Kamba Mpiana <hugues.kambampiana@arm.com>

description: |
  SSE-710 is an heterogeneous subsystem supporting up to two remote
  processors aka the External Systems.

properties:
  compatible:
    enum:
      - arm,sse710-extsys

  firmware-name:
    description:
      The default name of the firmware to load to the remote processor.

  '#extsys-id':
    description:
      The External System ID.
    enum: [0, 1]

  mbox-names:
    items:
      - const: txes0
      - const: rxes0

  mboxes:
    description:
      The list of Message Handling Unit (MHU) channels used for bidirectional
      communication. This property is only required if the virtio-based Rpmsg
      messaging bus is used. For more details see the Arm MHUv2 Mailbox
      Controller at devicetree/bindings/mailbox/arm,mhuv2.yaml

    minItems: 2
    maxItems: 2

  memory-region:
    description:
      If present, a phandle for a reserved memory area that used for vdev
      buffer, resource table, vring region and others used by the remote
      processor.
    minItems: 2
    maxItems: 32

required:
  - compatible
  - firmware-name
  - '#extsys-id'

additionalProperties: false

examples:
  - |
    reserved-memory {
        #address-cells = <2>;
        #size-cells = <2>;

        extsys0_vring0: vdev0vring0@82001000 {
            reg = <0 0x82001000 0 0x8000>;
            no-map;
        };

        extsys0_vring1: vdev0vring1@82009000 {
            reg = <0 0x82009000 0 0x8000>;
            no-map;
        };
    };

    syscon@1a010000 {
        compatible = "arm,sse710-host-base-sysctrl", "simple-mfd", "syscon";
        reg = <0x1a010000 0x1000>;

        extsys0 {
            compatible = "arm,sse710-extsys";
            #extsys-id = <0>;
            firmware-name = "es_flashfw.elf";
            mbox-names = "txes0", "rxes0";
            mboxes = <&mhu0_hes0 0 1>, <&mhu0_es0h 0 1>;
            memory-region = <&extsys0_vring0>, <&extsys0_vring1>;
        };
    };
```

## Documentation/devicetree/bindings/remoteproc/fsl,imx-rproc-psci.yaml
```yaml
# SPDX-License-Identifier: (GPL-2.0-only OR BSD-2-Clause)
%YAML 1.2
---
$id: http://devicetree.org/schemas/remoteproc/fsl,imx-rproc-psci.yaml#
$schema: http://devicetree.org/meta-schemas/core.yaml#

title: NXP i.MX Cortex-A Core Remote Processor via PSCI

maintainers:
  - Jiafei Pan <Jiafei.Pan@nxp.com>

description:
  This binding provides support for managing Cortex-A cores as remote
  processors on i.MX platforms using the PSCI (Power State Coordination
  Interface) for CPU power management operations. This allows single
  Cortex-A core or multiple Cortex-A cores to be controlled by Linux as
  a remote processor, enabling them to run RTOS or bare-metal applications.

properties:
  compatible:
    const: fsl,imx-rproc-psci

  fsl,cpus-bits:
    $ref: /schemas/types.yaml#/definitions/uint32
    description:
      Bitmask indicating which CPU cores are assigned to this remote
      processor instance. Each bit represents a CPU core, where bit N
      corresponds to CPU N. For example, 0x2 (0b10) assigns CPU core 1,
      while 0x6 (0b110) assigns CPU cores 1 and 2.

  memory-region:
    maxItems: 1
    description:
      Phandle to a reserved memory region to be used for the remote
      processor's code and data.

required:
  - compatible
  - fsl,cpus-bits
  - memory-region

additionalProperties: false

examples:
  - |
    / {
        reserved-memory {
            #address-cells = <2>;
            #size-cells = <2>;
            ranges;

            rtos_ca55_reserved: rtos-ca55@d0000000 {
                reg = <0 0xd0000000 0 0x10000000>;
                no-map;
            };
        };

        remoteproc-ca55-1 {
            compatible = "fsl,imx-rproc-psci";
            /* bitmask: 0b10, assign A55 Core 1 */
            fsl,cpus-bits = <0x2>;
            memory-region = <&rtos_ca55_reserved>;
        };
    };
```

## Documentation/devicetree/bindings/remoteproc/mediatek,mt8196-vcp.yaml
```yaml
# SPDX-License-Identifier: (GPL-2.0-only OR BSD-2-Clause)
%YAML 1.2
---
$id: http://devicetree.org/schemas/remoteproc/mediatek,mt8196-vcp.yaml#
$schema: http://devicetree.org/meta-schemas/core.yaml#

title: MediaTek Video Companion Processor (VCP)

maintainers:
  - Xiangzhi Tang <xiangzhi.tang@mediatek.com>

description:
  This binding provides support for the MediaTek Video Companion Processor
  (VCP), a Risc-V coprocessor found on some MediaTek SoCs.

properties:
  compatible:
    enum:
      - mediatek,mt8196-vcp

  reg:
    items:
      - description: sram base
      - description: cfg group IO
      - description: cfg core group IO
      - description: cfg sec group IO

  reg-names:
    items:
      - const: sram
      - const: cfg
      - const: cfg-core
      - const: cfg-sec

  interrupts:
    maxItems: 1

  mboxes:
    maxItems: 5

  mbox-names:
    items:
      - const: mbox0
      - const: mbox1
      - const: mbox2
      - const: mbox3
      - const: mbox4

  power-domains:
    maxItems: 1

  iommus:
    description:
      Using MediaTek IOMMU to apply larb ports for Multimedia Memory
      Management Unit and address translation.
    maxItems: 1

  memory-region:
    maxItems: 1

patternProperties:
  "^vcp@[a-f0-9]+$":
    type: object
    description:
      The MediaTek VCP integrated to SoC might be a multi-core version.
      The other cores are represented as child nodes of the boot core.
      There are some integration differences for the IP like the usage of
      address translator for translating SoC bus addresses into address
      space for the processor.

      The SRAM is shared by all cores, each VCP core only using a piece of
      SRAM memory. The power of SRAM should be enabled before booting VCP cores.
      The size of SRAM varies on different SoCs.

      The VCP cores have differences on different SoCs for Hart support.

    properties:
      compatible:
        enum:
          - mediatek,vcp-core

      reg:
        description: The base address and size of SRAM.
        maxItems: 1

      reg-names:
        const: sram

      mediatek,vcp-core-harts:
        $ref: /schemas/types.yaml#/definitions/uint32
        description: Number of harts in this VCP core.
        enum: [1, 2]

      mediatek,vcp-core-sram-offset:
        $ref: /schemas/types.yaml#/definitions/uint32
        description:
          Offset of the allocated SRAM memory for this VCP core.

    required:
      - compatible
      - reg
      - reg-names
      - mediatek,vcp-core-harts
      - mediatek,vcp-core-sram-offset

    additionalProperties: false

required:
  - compatible
  - reg
  - reg-names
  - interrupts
  - mboxes
  - mbox-names
  - power-domains
  - iommus
  - memory-region

additionalProperties: false

examples:
  - |
    #include <dt-bindings/interrupt-controller/arm-gic.h>
    #include <dt-bindings/interrupt-controller/irq.h>
    #include <dt-bindings/power/mt8196-power.h>

    vcp: vcp@31800000 {
        compatible = "mediatek,mt8196-vcp";
        reg = <0x31800000 0x60000>,
              <0x31a04000 0xa000>,
              <0x31bd0000 0x1000>,
              <0x31a70020 0x100>;
        reg-names = "sram",
                    "cfg",
                    "cfg-core",
                    "cfg-sec";

        interrupts = <GIC_SPI 787 IRQ_TYPE_LEVEL_HIGH 0>;

        mboxes = <&vcp_mailbox0>,
                 <&vcp_mailbox1>,
                 <&vcp_mailbox2>,
                 <&vcp_mailbox3>,
                 <&vcp_mailbox4>;
        mbox-names = "mbox0", "mbox1", "mbox2", "mbox3", "mbox4";

        power-domains = <&scpsys MT8196_POWER_DOMAIN_MM_PROC_DORMANT>;
        iommus = <&mm_smmu 160>;
        memory-region = <&vcp_resv_mem>;

        vcp@0 {
            compatible = "mediatek,vcp-core";
            reg = <0x0 0x31000>;
            reg-names = "sram";
            mediatek,vcp-core-harts = <2>;
            mediatek,vcp-core-sram-offset = <0x0>;
        };

        vcp@31000 {
            compatible = "mediatek,vcp-core";
            reg = <0x31000 0x60000>;
            reg-names = "sram";
            mediatek,vcp-core-harts = <1>;
            mediatek,vcp-core-sram-offset = <0x31000>;
        };
    };
```
