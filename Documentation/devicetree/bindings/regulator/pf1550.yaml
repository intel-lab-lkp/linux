## Documentation/devicetree/bindings/regulator/ti,twl6030-regulator.yaml
```yaml
# SPDX-License-Identifier: (GPL-2.0)
%YAML 1.2
---
$id: http://devicetree.org/schemas/regulator/ti,twl6030-regulator.yaml#
$schema: http://devicetree.org/meta-schemas/core.yaml#

title: Regulators in the TWL6030 PMIC

maintainers:
  - Andreas Kemnade <andreas@kemnade.info>

properties:
  regulator-vaux1:
    type: object
    $ref: regulator.yaml#
    unevaluatedProperties: false
    properties:
      compatible:
        const: "ti,twl6030-vaux1"
      ti,retain-on-reset:
        description:
          Does not turn off the supplies during warm
          reset. Could be needed for VMMC, as TWL6030
          reset sequence for this signal does not comply
          with the SD specification.
        type: boolean

    required:
      - compatible

  regulator-vaux2:
    type: object
    $ref: regulator.yaml#
    unevaluatedProperties: false
    properties:
      compatible:
        const: "ti,twl6030-vaux2"
      ti,retain-on-reset:
        description:
          Does not turn off the supplies during warm
          reset. Could be needed for VMMC, as TWL6030
          reset sequence for this signal does not comply
          with the SD specification.
        type: boolean

    required:
      - compatible

  regulator-vaux3:
    type: object
    $ref: regulator.yaml#
    unevaluatedProperties: false
    properties:
      compatible:
        const: "ti,twl6030-vaux3"
      ti,retain-on-reset:
        description:
          Does not turn off the supplies during warm
          reset. Could be needed for VMMC, as TWL6030
          reset sequence for this signal does not comply
          with the SD specification.
        type: boolean

    required:
      - compatible

  regulator-vmmc:
    type: object
    $ref: regulator.yaml#
    unevaluatedProperties: false
    properties:
      compatible:
        const: "ti,twl6030-vmmc"
      ti,retain-on-reset:
        description:
          Does not turn off the supplies during warm
          reset. Could be needed for VMMC, as TWL6030
          reset sequence for this signal does not comply
          with the SD specification.
        type: boolean

    required:
      - compatible

  regulator-vpp:
    type: object
    $ref: regulator.yaml#
    unevaluatedProperties: false
    properties:
      compatible:
        const: "ti,twl6030-vpp"
      ti,retain-on-reset:
        description:
          Does not turn off the supplies during warm
          reset. Could be needed for VMMC, as TWL6030
          reset sequence for this signal does not comply
          with the SD specification.
        type: boolean

    required:
      - compatible

  regulator-vusim:
    type: object
    $ref: regulator.yaml#
    unevaluatedProperties: false
    properties:
      compatible:
        const: "ti,twl6030-vusim"
      ti,retain-on-reset:
        description:
          Does not turn off the supplies during warm
          reset. Could be needed for VMMC, as TWL6030
          reset sequence for this signal does not comply
          with the SD specification.
        type: boolean

    required:
      - compatible

  regulator-vana:
    type: object
    $ref: regulator.yaml#
    unevaluatedProperties: false
    properties:
      compatible:
        const: "ti,twl6030-vana"
      ti,retain-on-reset:
        description:
          Does not turn off the supplies during warm
          reset. Could be needed for VMMC, as TWL6030
          reset sequence for this signal does not comply
          with the SD specification.
        type: boolean

    required:
      - compatible

  regulator-vcxio:
    type: object
    $ref: regulator.yaml#
    unevaluatedProperties: false
    properties:
      compatible:
        const: "ti,twl6030-vcxio"
      ti,retain-on-reset:
        description:
          Does not turn off the supplies during warm
          reset. Could be needed for VMMC, as TWL6030
          reset sequence for this signal does not comply
          with the SD specification.
        type: boolean

    required:
      - compatible

  regulator-vdac:
    type: object
    $ref: regulator.yaml#
    unevaluatedProperties: false
    properties:
      compatible:
        const: "ti,twl6030-vdac"
      ti,retain-on-reset:
        description:
          Does not turn off the supplies during warm
          reset. Could be needed for VMMC, as TWL6030
          reset sequence for this signal does not comply
          with the SD specification.
        type: boolean

    required:
      - compatible

  regulator-vusb:
    type: object
    $ref: regulator.yaml#
    unevaluatedProperties: false
    properties:
      compatible:
        const: "ti,twl6030-vusb"
      ti,retain-on-reset:
        description:
          Does not turn off the supplies during warm
          reset. Could be needed for VMMC, as TWL6030
          reset sequence for this signal does not comply
          with the SD specification.
        type: boolean

    required:
      - compatible

  regulator-v1v8:
    type: object
    $ref: regulator.yaml#
    unevaluatedProperties: false
    properties:
      compatible:
        const: "ti,twl6030-v1v8"
      ti,retain-on-reset:
        description:
          Does not turn off the supplies during warm
          reset. Could be needed for VMMC, as TWL6030
          reset sequence for this signal does not comply
          with the SD specification.
        type: boolean

    required:
      - compatible

  regulator-v2v1:
    type: object
    $ref: regulator.yaml#
    unevaluatedProperties: false
    properties:
      compatible:
        const: "ti,twl6030-v2v1"
      ti,retain-on-reset:
        description:
          Does not turn off the supplies during warm
          reset. Could be needed for VMMC, as TWL6030
          reset sequence for this signal does not comply
          with the SD specification.
        type: boolean

    required:
      - compatible

  regulator-vdd1:
    type: object
    $ref: regulator.yaml#
    unevaluatedProperties: false
    properties:
      compatible:
        const: "ti,twl6030-vdd1"
      ti,retain-on-reset:
        description:
          Does not turn off the supplies during warm
          reset. Could be needed for VMMC, as TWL6030
          reset sequence for this signal does not comply
          with the SD specification.
        type: boolean

    required:
      - compatible

  regulator-vdd2:
    type: object
    $ref: regulator.yaml#
    unevaluatedProperties: false
    properties:
      compatible:
        const: "ti,twl6030-vdd2"
      ti,retain-on-reset:
        description:
          Does not turn off the supplies during warm
          reset. Could be needed for VMMC, as TWL6030
          reset sequence for this signal does not comply
          with the SD specification.
        type: boolean

    required:
      - compatible

  regulator-vdd3:
    type: object
    $ref: regulator.yaml#
    unevaluatedProperties: false
    properties:
      compatible:
        const: "ti,twl6030-vdd3"
      ti,retain-on-reset:
        description:
          Does not turn off the supplies during warm
          reset. Could be needed for VMMC, as TWL6030
          reset sequence for this signal does not comply
          with the SD specification.
        type: boolean

    required:
      - compatible

unevaluatedProperties: false

examples:
  - |
    regulator-vaux1 {
        compatible = "ti,twl6030-vaux1";
        regulator-min-microvolt  = <1000000>;
        regulator-max-microvolt  = <3000000>;
    };
...
```

## Documentation/devicetree/bindings/regulator/ti,twl6032-regulator.yaml
```yaml
# SPDX-License-Identifier: (GPL-2.0)
%YAML 1.2
---
$id: http://devicetree.org/schemas/regulator/ti,twl6032-regulator.yaml#
$schema: http://devicetree.org/meta-schemas/core.yaml#

title: Regulators in the TWL6032 PMIC

maintainers:
  - Andreas Kemnade <andreas@kemnade.info>

properties:
  regulator-ldo1:
    type: object
    $ref: regulator.yaml#
    unevaluatedProperties: false
    properties:
      compatible:
        const: "ti,twl6032-ldo1"
      ti,retain-on-reset:
        description:
          Does not turn off the supplies during warm
          reset. Could be needed for VMMC, as TWL6030
          reset sequence for this signal does not comply
          with the SD specification.
        type: boolean

    required:
      - compatible

  regulator-ldo2:
    type: object
    $ref: regulator.yaml#
    unevaluatedProperties: false
    properties:
      compatible:
        const: "ti,twl6032-ldo2"
      ti,retain-on-reset:
        description:
          Does not turn off the supplies during warm
          reset. Could be needed for VMMC, as TWL6030
          reset sequence for this signal does not comply
          with the SD specification.
        type: boolean

    required:
      - compatible

  regulator-ldo3:
    type: object
    $ref: regulator.yaml#
    unevaluatedProperties: false
    properties:
      compatible:
        const: "ti,twl6032-ldo3"
      ti,retain-on-reset:
        description:
          Does not turn off the supplies during warm
          reset. Could be needed for VMMC, as TWL6030
          reset sequence for this signal does not comply
          with the SD specification.
        type: boolean

    required:
      - compatible

  regulator-ldo4:
    type: object
    $ref: regulator.yaml#
    unevaluatedProperties: false
    properties:
      compatible:
        const: "ti,twl6032-ldo4"
      ti,retain-on-reset:
        description:
          Does not turn off the supplies during warm
          reset. Could be needed for VMMC, as TWL6030
          reset sequence for this signal does not comply
          with the SD specification.
        type: boolean

    required:
      - compatible

  regulator-ldo5:
    type: object
    $ref: regulator.yaml#
    unevaluatedProperties: false
    properties:
      compatible:
        const: "ti,twl6032-ldo5"
      ti,retain-on-reset:
        description:
          Does not turn off the supplies during warm
          reset. Could be needed for VMMC, as TWL6030
          reset sequence for this signal does not comply
          with the SD specification.
        type: boolean

    required:
      - compatible

  regulator-ldo6:
    type: object
    $ref: regulator.yaml#
    unevaluatedProperties: false
    properties:
      compatible:
        const: "ti,twl6032-ldo6"
      ti,retain-on-reset:
        description:
          Does not turn off the supplies during warm
          reset. Could be needed for VMMC, as TWL6030
          reset sequence for this signal does not comply
          with the SD specification.
        type: boolean

    required:
      - compatible

  regulator-ldo7:
    type: object
    $ref: regulator.yaml#
    unevaluatedProperties: false
    properties:
      compatible:
        const: "ti,twl6032-ldo7"
      ti,retain-on-reset:
        description:
          Does not turn off the supplies during warm
          reset. Could be needed for VMMC, as TWL6030
          reset sequence for this signal does not comply
          with the SD specification.
        type: boolean

    required:
      - compatible

  regulator-ldoln:
    type: object
    $ref: regulator.yaml#
    unevaluatedProperties: false
    properties:
      compatible:
        const: "ti,twl6032-ldoln"
      ti,retain-on-reset:
        description:
          Does not turn off the supplies during warm
          reset. Could be needed for VMMC, as TWL6030
          reset sequence for this signal does not comply
          with the SD specification.
        type: boolean

    required:
      - compatible

  regulator-ldousb:
    type: object
    $ref: regulator.yaml#
    unevaluatedProperties: false
    properties:
      compatible:
        const: "ti,twl6032-ldousb"
      ti,retain-on-reset:
        description:
          Does not turn off the supplies during warm
          reset. Could be needed for VMMC, as TWL6030
          reset sequence for this signal does not comply
          with the SD specification.
        type: boolean

    required:
      - compatible

  regulator-smps3:
    type: object
    $ref: regulator.yaml#
    unevaluatedProperties: false
    properties:
      compatible:
        const: "ti,twl6032-smps3"
      ti,retain-on-reset:
        description:
          Does not turn off the supplies during warm
          reset. Could be needed for VMMC, as TWL6030
          reset sequence for this signal does not comply
          with the SD specification.
        type: boolean

    required:
      - compatible

  regulator-smps4:
    type: object
    $ref: regulator.yaml#
    unevaluatedProperties: false
    properties:
      compatible:
        const: "ti,twl6032-smps4"
      ti,retain-on-reset:
        description:
          Does not turn off the supplies during warm
          reset. Could be needed for VMMC, as TWL6030
          reset sequence for this signal does not comply
          with the SD specification.
        type: boolean

    required:
      - compatible

  regulator-vio:
    type: object
    $ref: regulator.yaml#
    unevaluatedProperties: false
    properties:
      compatible:
        const: "ti,twl6032-vio"
      ti,retain-on-reset:
        description:
          Does not turn off the supplies during warm
          reset. Could be needed for VMMC, as TWL6030
          reset sequence for this signal does not comply
          with the SD specification.
        type: boolean

    required:
      - compatible

unevaluatedProperties: false

examples:
  - |
    regulator-ldo1 {
        compatible = "ti,twl6032-ldo1";
        regulator-min-microvolt  = <1000000>;
        regulator-max-microvolt  = <3000000>;
    };
...
```
