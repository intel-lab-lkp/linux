## Documentation/devicetree/bindings/embedded-controller/lenovo,thinkpad-x13s-ec.yaml
```yaml
# SPDX-License-Identifier: (GPL-2.0-only OR BSD-2-Clause)
%YAML 1.2
---
$id: http://devicetree.org/schemas/embedded-controller/lenovo,thinkpad-x13s-ec.yaml#
$schema: http://devicetree.org/meta-schemas/core.yaml#

title: Lenovo ThinkPad X13s Embedded Controller

maintainers:
  - Clover <alex@ironrobin.net>

description:
  The Lenovo ThinkPad X13s has an I2C-connected embedded controller (EC)
  providing keyboard backlight control and event notifications. In addition
  to its event interrupt, the EC has a separate host-controlled power-state
  input used during transitions between normal operation and low power.

properties:
  compatible:
    const: lenovo,thinkpad-x13s-ec

  reg:
    const: 0x28

  interrupts:
    maxItems: 1

  power-state-gpios:
    maxItems: 1
    description:
      GPIO connected to the EC power-state input, driven by the host.
      The signal is high during normal operation and low in the low-power
      state. It is used together with I2C power-state commands, rather than
      as a power-supply enable or reset signal. The GPIO is active high.

  wakeup-source: true

required:
  - compatible
  - reg
  - interrupts
  - power-state-gpios

additionalProperties: false

examples:
  - |
    #include <dt-bindings/gpio/gpio.h>
    #include <dt-bindings/interrupt-controller/irq.h>

    i2c {
        #address-cells = <1>;
        #size-cells = <0>;

        embedded-controller@28 {
            compatible = "lenovo,thinkpad-x13s-ec";
            reg = <0x28>;
            interrupts-extended = <&gpio 1 IRQ_TYPE_EDGE_FALLING>;
            power-state-gpios = <&gpio 2 GPIO_ACTIVE_HIGH>;
            pinctrl-0 = <&ec_int_n>, <&ec_power_state>;
            pinctrl-names = "default";
            wakeup-source;
        };
    };
...
```

## Documentation/devicetree/bindings/embedded-controller/qcom,hamoa-ec.yaml
```yaml
# SPDX-License-Identifier: (GPL-2.0-only OR BSD-2-Clause)
%YAML 1.2
---
$id: http://devicetree.org/schemas/embedded-controller/qcom,hamoa-ec.yaml#
$schema: http://devicetree.org/meta-schemas/core.yaml#

title: Qualcomm Hamoa Embedded Controller.

maintainers:
  - Sibi Sankar <sibi.sankar@oss.qualcomm.com>

description:
  Qualcomm Snapdragon based Hamoa/Purwa and Glymur reference devices have an
  EC running on IT8987 and Nuvoton MCU chips respectively. The EC handles things
  like fan control, temperature sensors, access to EC internal state changes.

properties:
  compatible:
    items:
      - enum:
          - qcom,glymur-nuvoton-ec
          - qcom,hamoa-it8987-ec
      - const: qcom,hamoa-ec

  reg:
    const: 0x76

  interrupts:
    maxItems: 1

required:
  - compatible
  - reg
  - interrupts

additionalProperties: false

examples:
  - |
    #include <dt-bindings/interrupt-controller/irq.h>
    i2c {
        #address-cells = <1>;
        #size-cells = <0>;

        embedded-controller@76 {
            compatible = "qcom,hamoa-it8987-ec", "qcom,hamoa-ec";
            reg = <0x76>;

            interrupts-extended = <&tlmm 66 IRQ_TYPE_LEVEL_HIGH>;
        };
    };
...
```

## Documentation/devicetree/bindings/embedded-controller/synology,ds1825p-microp.yaml
```yaml
# SPDX-License-Identifier: (GPL-2.0-only OR BSD-2-Clause)
%YAML 1.2
---
$id: http://devicetree.org/schemas/embedded-controller/synology,ds1825p-microp.yaml#
$schema: http://devicetree.org/meta-schemas/core.yaml#

title: Synology NAS on-board Microcontroller

maintainers:
  - Markus Probst <markus.probst@posteo.de>

description: |
  Synology Microp is a microcontroller found in Synology NAS devices.
  It is connected to a serial port on the host device.

  It is necessary to properly shutdown and reboot the NAS device and
  provides additional functionality such as led control, fan speed control,
  a beeper and buttons on the NAS device.

properties:
  compatible:
    oneOf:
      - const: synology,ds223-microp
      - const: synology,ds411p-microp
      - const: synology,ds1010p-microp
      - const: synology,ds710p-microp
      - const: synology,ds723p-microp
      - const: synology,ds225p-microp
      - const: synology,rs422p-microp
      - maxItems: 2
        minItems: 2
        items:
          enum:
            - synology,ds923p-microp
            - synology,ds1522p-microp
      - minItems: 4
        maxItems: 4
        items:
          enum:
            - synology,ds918p-microp
            - synology,ds425p-microp
            - synology,ds1525p-microp
            - synology,ds925p-microp
      - minItems: 2
        maxItems: 2
        items:
          enum:
            - synology,ds725p-microp
            - synology,ds214play-microp
      - minItems: 3
        maxItems: 3
        items:
          enum:
            - synology,ds223j-microp
            - synology,ds124-microp
            - synology,ds118-microp
      - minItems: 3
        maxItems: 3
        items:
          enum:
            - synology,rs822p-microp
            - synology,rs1221p-microp
            - synology,rs1221rpp-microp
      - minItems: 2
        maxItems: 2
        items:
          enum:
            - synology,ds1825p-microp
            - synology,ds1823xsp-microp

  fan-failure-gpios:
    description: GPIOs needed to determine which fans stopped working on a fan failure event.
    minItems: 2
    maxItems: 3

required:
  - compatible

allOf:
  - if:
      properties:
        compatible:
          contains:
            enum:
              - synology,ds425p-microp
              - synology,rs422p-microp
              - synology,ds1522p-microp
              - synology,ds1010p-microp
              - synology,ds411p-microp
    then:
      required:
        - fan-failure-gpios
    else:
      properties:
        fan-failure-gpios: false

additionalProperties: false

examples:
  - |
    #include <dt-bindings/leds/common.h>
    #include <dt-bindings/gpio/gpio.h>

    embedded-controller {
      compatible = "synology,ds923p-microp", "synology,ds1522p-microp";

      fan-failure-gpios = <&gpio 68 GPIO_ACTIVE_HIGH>, <&gpio 69 GPIO_ACTIVE_HIGH>;
    };
```

## Documentation/devicetree/bindings/export-symbols.yaml
```yaml
# SPDX-License-Identifier: (GPL-2.0 OR BSD-2-Clause)
%YAML 1.2
---
$id: http://devicetree.org/schemas/export-symbols.yaml#
$schema: http://devicetree.org/meta-schemas/core.yaml#

title: Export symbols

maintainers:
  - Herve Codina <herve.codina@bootlin.com>

description: |
  An export-symbols node allows to export symbols for symbols resolution
  performed when applying a device tree overlay.

  When a device tree overlay is applied on a node having an export-symbols
  node, symbols listed in the export-symbols node are used to resolve undefined
  symbols referenced from the overlay.

properties:
  $nodename:
    const: export-symbols

patternProperties:
  "^[a-zA-Z_]?[a-zA-Z0-9_]*$":
    $ref: /schemas/types.yaml#/definitions/phandle
    description:
      A symbol exported in the form <symbol_name>=<phandle>.

additionalProperties: false

examples:
  - |
    /*
     * Allows 'connector' symbol used in a device-tree overlay to be resolved to
     * connector0 when the device-tree overlay is applied on connector0 node.
     */
    connector0: connector0 {
      export-symbols {
        connector = <&connector0>;
      };
    };
...
```

## Documentation/devicetree/bindings/extcon/extcon-ptn5150.yaml
```yaml
# SPDX-License-Identifier: GPL-2.0-only OR BSD-2-Clause
%YAML 1.2
---
$id: http://devicetree.org/schemas/extcon/extcon-ptn5150.yaml#
$schema: http://devicetree.org/meta-schemas/core.yaml#

title: PTN5150 CC (Configuration Channel) Logic device

maintainers:
  - Krzysztof Kozlowski <krzk@kernel.org>

description: |
  PTN5150 is a small thin low power CC logic chip supporting the USB Type-C
  connector application with CC control logic detection and indication
  functions.  It is interfaced to the host controller using an I2C interface.

properties:
  compatible:
    const: nxp,ptn5150

  int-gpios:
    maxItems: 1
    deprecated: true
    description:
      GPIO pin (input) connected to the PTN5150's INTB pin.
      Use "interrupts" instead.

  interrupts:
    maxItems: 1

  reg:
    maxItems: 1

  vbus-gpios:
    maxItems: 1
    description:
      GPIO pin (output) used to control VBUS. If skipped, no such control
      takes place.

  port:
    $ref: /schemas/graph.yaml#/properties/port
    description:
      A port node to link the usb controller for the dual role switch.

required:
  - compatible
  - interrupts
  - reg

additionalProperties: false

examples:
  - |
    #include <dt-bindings/gpio/gpio.h>
    #include <dt-bindings/interrupt-controller/irq.h>
    i2c {
        #address-cells = <1>;
        #size-cells = <0>;

        ptn5150@1d {
            compatible = "nxp,ptn5150";
            reg = <0x1d>;
            interrupt-parent = <&msmgpio>;
            interrupts = <78 IRQ_TYPE_LEVEL_HIGH>;
            vbus-gpios = <&msmgpio 148 GPIO_ACTIVE_HIGH>;
        };
    };

  - |
    /* id pin of ptn5150 have not connected to chip's id pin */
    #include <dt-bindings/clock/imx8mn-clock.h>
    #include <dt-bindings/interrupt-controller/irq.h>
    #include <dt-bindings/interrupt-controller/arm-gic.h>
    #include <dt-bindings/gpio/gpio.h>

    i2c {
        #address-cells = <1>;
        #size-cells = <0>;

        ptn5150@1d {
            compatible = "nxp,ptn5150";
            reg = <0x1d>;
            interrupt-parent = <&msmgpio>;
            interrupts = <78 IRQ_TYPE_LEVEL_HIGH>;
            vbus-gpios = <&msmgpio 148 GPIO_ACTIVE_HIGH>;

            port {
                    typec1_dr_sw: endpoint {
                    remote-endpoint = <&usb1_drd_sw>;
                 };
            };
        };
    };

    usb@32e40000 {
        compatible = "fsl,imx8mn-usb", "fsl,imx7d-usb", "fsl,imx27-usb";
        reg = <0x32e40000 0x200>;
        interrupts = <&gic GIC_SPI 40 IRQ_TYPE_LEVEL_HIGH>;
        clocks = <&clk IMX8MN_CLK_USB1_CTRL_ROOT>;
        usb-role-switch;

        port {
             usb1_drd_sw: endpoint {
                  remote-endpoint = <&typec1_dr_sw>;
             };
        };
    };
```

## Documentation/devicetree/bindings/extcon/extcon-rtk-type-c.yaml
```yaml
# SPDX-License-Identifier: (GPL-2.0-only OR BSD-2-Clause)
# Copyright 2023 Realtek Semiconductor Corporation
%YAML 1.2
---
$id: http://devicetree.org/schemas/extcon/extcon-rtk-type-c.yaml#
$schema: http://devicetree.org/meta-schemas/core.yaml#

title: Realtek DHC RTD SoCs USB Type-C detection

maintainers:
  - Stanley Chang <stanley_chang@realtek.com>

description: |
  Realtek digital home center (DHC) RTD series SoCs include a type c module.
  This module is able to detect the state of type c connector.

properties:
  compatible:
    enum:
      - realtek,rtd1295-type-c
      - realtek,rtd1312c-type-c
      - realtek,rtd1315e-type-c
      - realtek,rtd1319-type-c
      - realtek,rtd1319d-type-c
      - realtek,rtd1395-type-c
      - realtek,rtd1619-type-c
      - realtek,rtd1619b-type-c

  reg:
    maxItems: 1
    description: Address and length of register set for type-c module.

  interrupts:
    maxItems: 1

  nvmem-cells:
    maxItems: 1
    description:
      The phandle to nvmem cell that contains the trimming data.
      If unspecified, default value is used.

  pinctrl-names:
    const: default
    description: A pinctrl state names "default" must be defined.

  pinctrl-0:
    description:
      Should contain default pinctrl.

  nvmem-cell-names:
    const: usb-cal
    description:
      The type c parameter trimming data specified via efuse.

  realtek,rd-ctrl-gpio:
    description: The gpio node to control external Rd on board.
    maxItems: 1

required:
  - compatible
  - reg
  - interrupts

additionalProperties: false

examples:
  - |
    type-c@7220 {
        compatible = "realtek,rtd1619b-type-c";
        reg = <0x7220 0x20>;
        interrupts = <0 60 4>;

        pinctrl-names = "default";
        pinctrl-0 = <&usb_cc1_pins>, <&usb_cc2_pins>;
        nvmem-cells = <&otp_usb_cal>;
        nvmem-cell-names = "usb-cal";
    };
```

## Documentation/devicetree/bindings/extcon/maxim,max14526.yaml
```yaml
# SPDX-License-Identifier: (GPL-2.0-only OR BSD-2-Clause)
%YAML 1.2
---
$id: http://devicetree.org/schemas/extcon/maxim,max14526.yaml#
$schema: http://devicetree.org/meta-schemas/core.yaml#

title: Maxim MAX14526 MicroUSB Integrated Circuit (MUIC)

maintainers:
  - Svyatoslav Ryhel <clamor95@gmail.com>

properties:
  compatible:
    const: maxim,max14526-muic

  reg:
    maxItems: 1

  interrupts:
    maxItems: 1

required:
  - compatible
  - reg
  - interrupts

additionalProperties: false

examples:
  - |
    #include <dt-bindings/gpio/gpio.h>
    #include <dt-bindings/interrupt-controller/irq.h>

    i2c {
        #address-cells = <1>;
        #size-cells = <0>;

        muic@44 {
            compatible = "maxim,max14526-muic";
            reg = <0x44>;

            interrupt-parent = <&gpio>;
            interrupts = <72 IRQ_TYPE_EDGE_FALLING>;
        };
    };
...
```

## Documentation/devicetree/bindings/extcon/ti,extcon-palmas.yaml
```yaml
# SPDX-License-Identifier: (GPL-2.0-only OR BSD-2-Clause)
%YAML 1.2
---
$id: http://devicetree.org/schemas/extcon/ti,extcon-palmas.yaml#
$schema: http://devicetree.org/meta-schemas/core.yaml#

title: Texas Instruments PALMAS USB COMPARATOR

maintainers:
  - Roger Quadros <rogerq@ti.com>
  - Bhargav Joshi <j.bhargav.u@gmail.com>

properties:
  compatible:
    oneOf:
      - enum:
          - ti,palmas-usb-vid
          - ti,twl6035-usb-vid
      - enum:
          - ti,palmas-usb
          - ti,twl6035-usb
        deprecated: true

  ti,wakeup:
    type: boolean
    description:
      To enable the wakeup comparator in probe.

  ti,enable-id-detection:
    type: boolean
    description:
      Perform ID detection. If id-gpios is specified it performs ID detection
      using GPIO, otherwise using the OTG core.

  ti,enable-vbus-detection:
    type: boolean
    description:
      Perform VBUS detection.

  id-gpios:
    maxItems: 1

  id-gpio:
    maxItems: 1
    deprecated: true

  vbus-gpios:
    maxItems: 1

  vbus-gpio:
    maxItems: 1
    deprecated: true

  debounce-delay-ms:
    description:
      Debounce delay for GPIO ID pin in milliseconds.
    default: 20

required:
  - compatible

additionalProperties: false

examples:
  - |
    #include <dt-bindings/gpio/gpio.h>

    palmas_usb {
        compatible = "ti,palmas-usb-vid";
        ti,wakeup;
        ti,enable-id-detection;
        ti,enable-vbus-detection;
        id-gpios = <&palmas_gpio 0 GPIO_ACTIVE_HIGH>;
    };
```

## Documentation/devicetree/bindings/firmware/arm,ffa.yaml
```yaml
# SPDX-License-Identifier: (GPL-2.0 OR BSD-2-Clause)
%YAML 1.2
---
$id: http://devicetree.org/schemas/firmware/arm,ffa.yaml#
$schema: http://devicetree.org/meta-schemas/core.yaml#

title: Arm Firmware Framework for A-profile

maintainers:
  - Sudeep Holla <sudeep.holla@kernel.org>

description: |
  Arm Firmware Framework for A-profile (FF-A) firmware device node
  describing the   notification interrupt exposed to the normal world.

properties:
  $nodename:
    const: ffa

  compatible:
    const: arm,ffa

  interrupts:
    description:
      Per-CPU notification interrupt used by the normal world FF-A partition.
    maxItems: 1

required:
  - compatible
  - interrupts

additionalProperties: false

examples:
  - |
    #include <dt-bindings/interrupt-controller/arm-gic.h>
    #include <dt-bindings/interrupt-controller/irq.h>

    ffa {
        compatible = "arm,ffa";
        interrupts = <GIC_SGI 8 IRQ_TYPE_EDGE_RISING>;
    };
```
