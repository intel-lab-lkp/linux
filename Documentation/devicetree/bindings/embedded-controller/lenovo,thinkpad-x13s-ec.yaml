## Documentation/devicetree/bindings/firmware/mbedtee,rpc.yaml
```yaml
# SPDX-License-Identifier: (GPL-2.0-only OR BSD-2-Clause)
%YAML 1.2
---
$id: http://devicetree.org/schemas/firmware/mbedtee,rpc.yaml#
$schema: http://devicetree.org/meta-schemas/core.yaml#

title: MbedTEE Trusted Execution Environment

maintainers:
  - Xing Loong <xing.xl.loong@gmail.com>

description: |
  MbedTEE is a Trusted Execution Environment for embedded systems.
  This binding describes the shared-memory regions used for RPC
  communication between the Linux REE driver and MbedTEE OS.

  The REE and TEE CPUs sharing the RPC memory must be in a
  hardware-coherent domain (same CPU cluster, coherent caches).

  Two or three reserved-memory regions are required:

    rpc-t2r-ring  ring buffer for TEE-to-REE notifications (all platforms)
    rpc-t2r-shm   shared memory for TEE-to-REE RPC payloads (all platforms)
    rpc-r2t-ring  ring buffer for REE-to-TEE command submissions (RISC-V only)

  On ARM/AArch64 the transport uses SMC calls; TEE-to-REE
  notifications use a GIC SPI edge interrupt.

  On RISC-V the TEE notifies the REE via IMSIC MSI; the REE submits
  commands via shared-memory rpc-r2t-ring that the TEE polls. No
  REE-to-TEE interrupt is used. No SBI ecall is involved.

properties:
  $nodename:
    const: mbedtee

  compatible:
    const: mbedtee,rpc

  interrupts:
    description:
      GIC interrupt used by the TEE to notify the REE of pending RPC
      responses (ARM/AArch64 only). Not present on RISC-V platforms which
      use IMSIC platform MSI interrupts allocated dynamically at runtime.

  msi-parent:
    maxItems: 1
    description:
      IMSIC MSI controller used by the Linux driver to allocate the
      TEE-to-REE notification interrupt on RISC-V platforms. Not present on
      ARM/AArch64 platforms, which use the interrupts property.

  memory-region:
    minItems: 2
    maxItems: 3
    description:
      References to reserved-memory regions for REE<->TEE communication.
      Entries must match memory-region-names order.

  memory-region-names:
    minItems: 2
    maxItems: 3
    items:
      enum:
        - rpc-t2r-ring
        - rpc-t2r-shm
        - rpc-r2t-ring

required:
  - compatible

allOf:
  - if:
      required:
        - interrupts
    then:
      required:
        - interrupts
        - memory-region
        - memory-region-names
      properties:
        msi-parent: false
        memory-region:
          minItems: 2
          maxItems: 2
        memory-region-names:
          items:
            - const: rpc-t2r-ring
            - const: rpc-t2r-shm
    else:
      required:
        - msi-parent
        - memory-region
        - memory-region-names
      properties:
        memory-region:
          minItems: 3
          maxItems: 3
        memory-region-names:
          items:
            - const: rpc-t2r-ring
            - const: rpc-t2r-shm
            - const: rpc-r2t-ring

additionalProperties: false

examples:
  - |
    /* ARM TrustZone (SMC) */
    #include <dt-bindings/interrupt-controller/arm-gic.h>
    / {
      #address-cells = <2>;
      #size-cells = <2>;

      gic: interrupt-controller@2f000000 {
        compatible = "arm,gic-v3";
        reg = <0 0x2f000000 0 0x10000>,
              <0 0x2f100000 0 0x200000>;
        interrupt-controller;
        #interrupt-cells = <3>;
      };

      reserved-memory {
        #address-cells = <2>;
        #size-cells = <2>;
        ranges;

        mbedtee_t2r_ring: rpc-t2r-ring@85f10000 {
          reg = <0 0x85f10000 0 0x20000>;
          no-map;
        };

        mbedtee_t2r_shm: rpc-t2r-shm@85f30000 {
          reg = <0 0x85f30000 0 0x40000>;
          no-map;
        };
      };

      firmware {
        mbedtee {
          compatible = "mbedtee,rpc";
          interrupt-parent = <&gic>;
          interrupts = <GIC_SPI 72 IRQ_TYPE_EDGE_RISING>;
          memory-region = <&mbedtee_t2r_ring>, <&mbedtee_t2r_shm>;
          memory-region-names = "rpc-t2r-ring", "rpc-t2r-shm";
        };
      };
    };

  - |
    /* RISC-V IMSIC (ring-buffer polling REE->TEE, MSI TEE->REE) */
    / {
      #address-cells = <2>;
      #size-cells = <2>;

      cpus {
        #address-cells = <1>;
        #size-cells = <0>;

        cpu@0 {
          device_type = "cpu";
          reg = <0>;

          cpu0_intc: interrupt-controller {
            compatible = "riscv,cpu-intc";
            interrupt-controller;
            #interrupt-cells = <1>;
          };
        };
      };

      imsic: interrupt-controller@28000000 {
        compatible = "qemu,imsics", "riscv,imsics";
        reg = <0 0x28000000 0 0x1000>;
        interrupts-extended = <&cpu0_intc 9>;
        interrupt-controller;
        #interrupt-cells = <0>;
        msi-controller;
        #msi-cells = <0>;
        riscv,num-ids = <255>;
      };

      reserved-memory {
        #address-cells = <2>;
        #size-cells = <2>;
        ranges;

        rv_t2r_ring: rpc-t2r-ring@5f10000 {
          reg = <0 0x5f10000 0 0x20000>;
          no-map;
        };

        rv_t2r_shm: rpc-t2r-shm@5f30000 {
          reg = <0 0x5f30000 0 0x40000>;
          no-map;
        };

        rv_r2t_ring: rpc-r2t-ring@5f70000 {
          reg = <0 0x5f70000 0 0x20000>;
          no-map;
        };
      };

      /*
       * The riscv container avoids a duplicate /firmware/mbedtee path
       * with the ARM example above when the DT checker concatenates
       * examples into a single .dts.
       */
      riscv {
        firmware {
          mbedtee {
            compatible = "mbedtee,rpc";
            msi-parent = <&imsic>;
            memory-region = <&rv_t2r_ring>, <&rv_t2r_shm>,
                            <&rv_r2t_ring>;
            memory-region-names = "rpc-t2r-ring", "rpc-t2r-shm",
                                  "rpc-r2t-ring";
          };
        };
      };
    };
```

## Documentation/devicetree/bindings/firmware/mbedtee,tee.yaml
```yaml
# SPDX-License-Identifier: (GPL-2.0-only OR BSD-2-Clause)
%YAML 1.2
---
$id: http://devicetree.org/schemas/firmware/mbedtee,tee.yaml#
$schema: http://devicetree.org/meta-schemas/core.yaml#

title: MbedTEE

maintainers:
  - Xing Loong <xing.xl.loong@gmail.com>

description: |
  MbedTEE is a Trusted Execution Environment for embedded systems.
  It communicates with the REE (Linux) via shared-memory ring
  buffers using a fixed RPC protocol.

  We're using "mbedtee" as the vendor prefix for the open-source TEE
  project at https://github.com/mbedtee.

  The REE and TEE CPUs sharing the RPC memory must be in a
  hardware-coherent domain.

  Two or three reserved-memory regions are required. On ARM the
  transport uses SMC and a GIC SPI interrupt. On RISC-V the
  transport uses shared-memory rings and IMSIC MSI; the TEE polls
  r2t-ring for commands from the REE.

properties:
  compatible:
    const: mbedtee,tee

  interrupts:
    maxItems: 1

  msi-parent:
    maxItems: 1

  memory-region:
    minItems: 2
    maxItems: 3

  memory-region-names:
    description: |
      t2r-ring: ring buffer for TEE-to-REE notifications
      t2r-shm:  shared memory for TEE-to-REE RPC payloads
      r2t-ring: ring buffer for REE-to-TEE command submissions (RISC-V)
    minItems: 2
    items:
      - const: t2r-ring
      - const: t2r-shm
      - const: r2t-ring

required:
  - compatible
  - memory-region
  - memory-region-names

allOf:
  - if:
      required:
        - interrupts
    then:
      properties:
        msi-parent: false
        memory-region:
          maxItems: 2
        memory-region-names:
          maxItems: 2
    else:
      required:
        - msi-parent
      properties:
        interrupts: false
        memory-region:
          minItems: 3
        memory-region-names:
          minItems: 3

additionalProperties: false

examples:
  - |
    #include <dt-bindings/interrupt-controller/arm-gic.h>

    firmware {
        mbedtee {
            compatible = "mbedtee,tee";
            interrupts = <GIC_SPI 72 IRQ_TYPE_EDGE_RISING>;
            memory-region = <&t2r_ring>, <&t2r_shm>;
            memory-region-names = "t2r-ring", "t2r-shm";
        };
    };

  - |
    firmware {
        mbedtee {
            compatible = "mbedtee,tee";
            msi-parent = <&imsic>;
            memory-region = <&t2r_ring>, <&t2r_shm>, <&r2t_ring>;
            memory-region-names = "t2r-ring", "t2r-shm", "r2t-ring";
        };
    };
```

## Documentation/devicetree/bindings/firmware/mediatek,mt6895-scmi.yaml
```yaml
# SPDX-License-Identifier: (GPL-2.0 OR BSD-2-Clause)
# Copyright 2025 Collabora Ltd
%YAML 1.2
---
$id: http://devicetree.org/schemas/firmware/mediatek,mt6895-scmi.yaml#
$schema: http://devicetree.org/meta-schemas/core.yaml#

title: MediaTek System Control and Management Interface(SCMI) Vendor Protocols Extension

maintainers:
  - AngeloGioacchino Del Regno <angelogioacchino.delregno@collabora.com>

properties:
  protocol@80:
    $ref: '/schemas/firmware/arm,scmi.yaml#/$defs/protocol-node'
    unevaluatedProperties: false

    properties:
      reg:
        const: 0x80

additionalProperties: true
```

## Documentation/devicetree/bindings/firmware/mediatek,mt6991-hardware-voter.yaml
```yaml
# SPDX-License-Identifier: (GPL-2.0 OR BSD-2-Clause)
# Copyright 2025 Collabora Ltd
%YAML 1.2
---
$id: http://devicetree.org/schemas/firmware/mediatek,mt6991-hardware-voter.yaml#
$schema: http://devicetree.org/meta-schemas/core.yaml#

title: MediaTek Hardware Voter (HWV)

maintainers:
  - AngeloGioacchino Del Regno <angelogioacchino.delregno@collabora.com>

description:
  The MediaTek Hardware Voter (HWV) is a SoC-internal fixed-function MCU
  used to collect votes from both the Application Processor and from the
  various other remote processors present in the SoC, and transparently
  turn on or off various hardware resources (for example, power domains
  or system clocks) based on aggregation of votes done in the HWV MCU's
  internal state machine, therefore guaranteeing synchronization of the
  hardware resource requests between all components of the SoC and hence
  avoiding, for example, unclocked or unpowered access to the hardware.

properties:
  $nodename:
    pattern: "^system-controller@[0-9a-f]+$"

  compatible:
    const: mediatek,mt6991-hardware-voter

  reg:
    items:
      - description: Address and size of the Hardware Voter MMIO

  power-controller:
    $ref: /schemas/power/mediatek,power-controller.yaml

required:
  - compatible
  - reg

additionalProperties: true

examples:
 - |
   scp_hwv: system-controller@14500000 {
     compatible = "mediatek,mt6991-hardware-voter";
     reg = <0 0x14500000 0 0x3000>;

     power-controller {
       compatible = "mediatek,mt8196-hwv-scp-power-controller";
       #address-cells = <1>;
       #size-cells = <0>;
       #power-domain-cells = <1>;
     };
   };

   /*
    * For RFC patch only, this will be removed at patch v1
    * Note 1: Clock controllers have more than 90 registers in HWV
    * Note 2: The HWV integrates the power controller, so that's why
    *         that is a child node of HWV, but the clock controllers
    *         are completely separated (in hardware) from the HWV's
    *         physical location (other than address space)... so it
    *         would be wrong to place those as children of HWV I think.
    */
   clock-controller@16640000 {
     comaptible = "mediatek,mt8196-pericfg-ao";
     mediatek,hardware-voter = <&scp_hwv>;
     #clock-cells = <1>;
   };
```

## Documentation/devicetree/bindings/firmware/nxp,scmi.yaml
```yaml
# SPDX-License-Identifier: (GPL-2.0 OR BSD-2-Clause)
# Copyright 2024 NXP
%YAML 1.2
---
$id: http://devicetree.org/schemas/firmware/nxp,scmi.yaml#
$schema: http://devicetree.org/meta-schemas/core.yaml#

title: i.MX System Control and Management Interface (SCMI) Protocol Extension

maintainers:
  - Peng Fan <peng.fan@nxp.com>

allOf:
  - $ref: arm,scmi.yaml#

properties:
  protocol@11:
    $ref: 'arm,scmi.yaml#/$defs/protocol-node'
    unevaluatedProperties: false

    properties:
      reg:
        const: 0x81

  protocol@13:
    $ref: 'arm,scmi.yaml#/$defs/protocol-node'
    unevaluatedProperties: false

    properties:
      reg:
        const: 0x84

      wakeup-sources:
        description: each entry consists of 2 integers and represents the source and edge
        items:
          items:
            - description: the wakeup source
            - description: the wakeup edge
        $ref: /schemas/types.yaml#/definitions/uint32-matrix

additionalProperties: false

examples:
  - |
    firmware {
        scmi {
            #address-cells = <1>;
            #size-cells = <0>;

            protocol@81 {
              reg = <0x81>;
            };

            protocol@84 {
              reg = <0x84>;
              wakeup-sources = <6 1
                                7 1
                                8 1
                                9 1
                                10 1>;
            };
         };
    };
...
```

## Documentation/devicetree/bindings/firmware/opensbi,config.yaml
```yaml
# SPDX-License-Identifier: (GPL-2.0-only OR BSD-2-Clause)
%YAML 1.2
---
$id: http://devicetree.org/schemas/firmware/opensbi,config.yaml#
$schema: http://devicetree.org/meta-schemas/core.yaml#

title: OpenSBI Firmware Configuration

maintainers:

description: |
  OpenSBI configuration data passed in the chosen node.

properties:
  compatible:
    const: opensbi,config

  cold-boot-harts:
    $ref: /schemas/types.yaml#/definitions/phandle-array
    description:
      List of hart CPU nodes selected as cold boot harts by OpenSBI.

required:
  - compatible

additionalProperties: false

examples:
  - |
    / {
        chosen {
            opensbi-config {
                compatible = "opensbi,config";
                cold-boot-harts = <&cpu0>;
            };
        };
    };
...
```
