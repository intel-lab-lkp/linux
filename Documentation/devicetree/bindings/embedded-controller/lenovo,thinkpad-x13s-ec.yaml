## Documentation/devicetree/bindings/firmware/arm,ras-cper.yaml
```yaml
# SPDX-License-Identifier: (GPL-2.0-only OR BSD-2-Clause)
%YAML 1.2
---
$id: http://devicetree.org/schemas/firmware/arm,ras-cper.yaml#
$schema: http://devicetree.org/meta-schemas/core.yaml#

title: Arm RAS CPER provider

maintainers:
  - Ahmed Tiba <ahmed.tiba@arm.com>

description:
  Arm Reliability, Availability and Serviceability (RAS) firmware can expose
  a firmware-first CPER error source directly via DeviceTree. Firmware
  provides the CPER Generic Error Status block and notifies the OS through
  an interrupt.

properties:
  compatible:
    const: arm,ras-cper

  memory-region:
    minItems: 1
    items:
      - description:
          CPER Generic Error Status block exposed by firmware.
      - description:
          Optional firmware-owned ack buffer used on platforms
          where firmware needs an explicit "ack" handshake before overwriting
          the CPER buffer. Firmware watches bit 0 and expects the OS to set it
          once the current status block has been consumed.

  interrupts:
    maxItems: 1
    description:
      Interrupt used to signal that a new status record is ready.

required:
  - compatible
  - memory-region
  - interrupts

additionalProperties: false

examples:
  - |
    #include <dt-bindings/interrupt-controller/arm-gic.h>

    error-handler {
      compatible = "arm,ras-cper";
      memory-region = <&ras_cper_buffer>, <&ras_cper_ack>;
      interrupts = <GIC_SPI 32 IRQ_TYPE_LEVEL_HIGH>;
    };
...
```

## Documentation/devicetree/bindings/firmware/arm,ras-ffh.yaml
```yaml
# SPDX-License-Identifier: (GPL-2.0-only OR BSD-2-Clause)
%YAML 1.2
---
$id: http://devicetree.org/schemas/firmware/arm,ras-ffh.yaml#
$schema: http://devicetree.org/meta-schemas/core.yaml#

title: Arm Firmware-First Handler (FFH) CPER provider

maintainers:
  - Ahmed Tiba <ahmed.tiba@arm.com>

description: |
  Arm Reliability, Availability and Serviceability (RAS) firmware can expose
  a firmware-first handler (FFH) that provides UEFI CPER Generic Error Status
  blocks directly via DeviceTree. The firmware owns the CPER buffer
  and notifies the OS through an interrupt.

properties:
  compatible:
    const: arm,ras-ffh

  reg:
    minItems: 1
    items:
      - description:
          CPER Generic Error Status block exposed by firmware
      - description:
          Optional 32- or 64-bit doorbell register used on platforms
          where firmware needs an explicit "ack" handshake before overwriting
          the CPER buffer. Firmware watches bit 0 and expects the OS to set it
          once the current status block has been consumed.

  interrupts:
    maxItems: 1
    description:
      Interrupt used to signal that a new status record is ready.

  memory-region:
    $ref: /schemas/types.yaml#/definitions/phandle
    description:
      Optional phandle to the reserved-memory entry that backs the status
      buffer so firmware and the OS use the same carved-out region.

required:
  - compatible
  - reg
  - interrupts

additionalProperties: false

examples:
  - |
    #include <dt-bindings/interrupt-controller/arm-gic.h>

    reserved-memory {
      #address-cells = <2>;
      #size-cells = <2>;
      ras_cper_buffer: cper@fe800000 {
        reg = <0x0 0xfe800000 0x0 0x1000>;
        no-map;
      };
    };

    error-handler@fe800000 {
      compatible = "arm,ras-ffh";
      reg = <0xfe800000 0x1000>,
            <0xfe810000 0x4>;
      memory-region = <&ras_cper_buffer>;
      interrupts = <GIC_SPI 32 IRQ_TYPE_LEVEL_HIGH>;
    };
...
```

## Documentation/devicetree/bindings/firmware/coreboot.yaml
```yaml
# SPDX-License-Identifier: (GPL-2.0 OR BSD-2-Clause)
%YAML 1.2
---
$id: http://devicetree.org/schemas/firmware/coreboot.yaml#
$schema: http://devicetree.org/meta-schemas/core.yaml#

title: COREBOOT firmware information

maintainers:
  - Julius Werner <jwerner@chromium.org>

description:
  The device tree node to communicate the location of coreboot's
  memory-resident bookkeeping structures to the kernel. Coreboot's
  FIT image payload can insert the node into the device tree. If a
  second-stage bootloader (a coreboot "payload") is used, then it
  is responsible for inserting the node.

properties:
  compatible:
    const: coreboot
  reg:
    description: Address and length of the following two memory regions
    items:
      - description:
          The coreboot table. This is a list of variable-sized descriptors
          that contain various compile- and run-time generated firmware
          parameters. It is identified by the magic string "LBIO" in its first
          four bytes.

          See coreboot's src/commonlib/include/commonlib/coreboot_tables.h for
          details.
      - description:
          The CBMEM area. This is a downward-growing memory region used by
          coreboot to dynamically allocate data structures that remain resident.
          It may or may not include the coreboot table as one of its members. It
          is identified by a root node descriptor with the magic number
          0xc0389481 that resides in the topmost 8 bytes of the area.

          See coreboot's src/include/imd.h for details.

required:
  - compatible
  - reg

additionalProperties: false

examples:
  - |
    firmware {
        #address-cells = <1>;
        #size-cells = <1>;
        ranges;

        /* Firmware actually emits "coreboot" node without unit name */
        coreboot@fdfea000 {
            compatible = "coreboot";
            reg = <0xfdfea000 0x264>, <0xfdfea000 0x16000>;
        };
    };
```

## Documentation/devicetree/bindings/firmware/cznic,turris-mox-rwtm.yaml
```yaml
# SPDX-License-Identifier: (GPL-2.0-only OR BSD-2-Clause)
%YAML 1.2
---
$id: http://devicetree.org/schemas/firmware/cznic,turris-mox-rwtm.yaml#
$schema: http://devicetree.org/meta-schemas/core.yaml#

title: Turris Mox rWTM firmware interface

maintainers:
  - Marek Behún <kabel@kernel.org>

description: |
  This device tree node should be used on Turris Mox, or potentially
  another A3700 compatible device running the Mox's rWTM firmware in
  the secure processor (for example it is possible to flash this
  firmware into EspressoBin).

properties:
  compatible:
    oneOf:
      - const: marvell,armada-3700-rwtm-firmware

      - items:
        - const: marvell,armada-3700-rwtm-firmware
        - const: cznic,turris-mox-rwtm

  mboxes:
    description: Reference to the associated mailbox.
    maxItems: 1

required:
  - compatible
  - mboxes

additionalProperties: false

examples:
  - |
    armada-3700-rwtm {
        compatible = "marvell,armada-3700-rwtm-firmware";
        mboxes = <&rwtm 0>;
    };

...
```

## Documentation/devicetree/bindings/firmware/fsl,imx-se.yaml
```yaml
# SPDX-License-Identifier: (GPL-2.0-only OR BSD-2-Clause)
%YAML 1.2
---
$id: http://devicetree.org/schemas/firmware/fsl,imx-se.yaml#
$schema: http://devicetree.org/meta-schemas/core.yaml#

title: NXP i.MX HW Secure Enclave(s) EdgeLock Enclave

maintainers:
  - Pankaj Gupta <pankaj.gupta@nxp.com>

description: |
  NXP's SoC may contain one or multiple embedded secure-enclave HW
  IP(s) like i.MX EdgeLock Enclave, V2X etc. These NXP's HW IP(s)
  enables features like
    - Hardware Security Module (HSM),
    - Security Hardware Extension (SHE), and
    - Vehicular to Anything (V2X)

  Communication interface to the secure-enclaves is based on the
  messaging unit(s).

properties:
  '#address-cells':
    const: 1

  '#size-cells':
    const: 0

  compatible:
    enum:
      - fsl,imx8ulp-ele
      - fsl,imx93-ele

patternProperties:
  "^[0-9a-z]*-if@[0-9]+$":
    type: object
    description:
      Communication interface to secure-enclave node, that defines hardware
      properties to required to establish the communication. There can be
      multiple interfaces to the same secure-enclave. Each interface is
      enumerated with reg property. It optionally defines properties
      depending on the compatible string and interface enum identifier.

    properties:
      reg:
        maxItems: 1
        description: Identifier of the communication interface to secure-enclave.

      mboxes:
        description: contain a list of phandles to mailboxes.
        items:
          - description: Specify the mailbox used to send message to se firmware
          - description: Specify the mailbox used to receive message from se firmware

      mbox-names:
        items:
          - const: tx
          - const: rx
          - const: txdb
          - const: rxdb
        minItems: 2

      memory-region:
        description: contains a list of phandles to reserved external memory.
        items:
          - description: It is used by secure-enclave firmware. It is an optional
              property based on compatible and identifier to communication interface.
              (see bindings/reserved-memory/reserved-memory.txt)

      sram:
        description: contains a list of phandles to sram.
        $ref: /schemas/types.yaml#/definitions/phandle-array
        items:
          - description: Phandle to the device SRAM. It is an optional property
              based on compatible and identifier to communication interface.

    required:
      - reg
      - mboxes
      - mbox-names

allOf:
  # memory-region
  - if:
      properties:
        compatible:
          contains:
            enum:
              - fsl,imx8ulp-ele
              - fsl,imx93-ele
    then:
      patternProperties:
        "^[0-9a-z]*-if@[0-9]+$":
          allOf:
            - if:
                properties:
                  reg:
                    items:
                      - enum:
                          - 0
              then:
                required:
                  - memory-region
              else:
                not:
                  required:
                    - memory-region
  # sram
  - if:
      properties:
        compatible:
          contains:
            enum:
              - fsl,imx8ulp-ele
    then:
      patternProperties:
        "^[0-9a-z]*-if@[0-9]+$":
          allOf:
            - if:
                properties:
                  reg:
                    items:
                      - enum:
                          - 0
              then:
                required:
                  - sram
              else:
                not:
                  required:
                    - sram

additionalProperties: false

examples:
  - |
    ele {
      compatible = "fsl,imx8ulp-ele";
      #address-cells = <1>;
      #size-cells = <0>;

      ele-if@0 {
        reg = <0x0>;
        mboxes = <&s4muap 0 0>, <&s4muap 1 0>;
        mbox-names = "tx", "rx";
        sram = <&sram0>;
        memory-region = <&ele_reserved>;
      };
    };
  - |
    ele {
      compatible = "fsl,imx93-ele";
      #address-cells = <1>;
      #size-cells = <0>;

      ele-if@0 {
        reg = <0x0>;
        mboxes = <&s4muap 0 0>, <&s4muap 1 0>;
        mbox-names = "tx", "rx";
        memory-region = <&ele_reserved>;
      };
    };
  - |
    v2x {
      compatible = "fsl,imx95-v2x";
      #address-cells = <1>;
      #size-cells = <0>;

      v2x-if@0 {
        reg = <0x0>;
        mboxes = <&v2x_mu 0 0>, <&v2x_mu 1 0>;
        mbox-names = "tx", "rx";
      };
      v2x-if@1 {
        reg = <0x1>;
        mboxes = <&v2x_mu6 0 0>, <&v2x_mu6 1 0>;
        mbox-names = "txdb", "rxdb";
      };
      v2x-if@2 {
        reg = <0x2>;
        mboxes = <&v2x_mu7 0 0>, <&v2x_mu7 1 0>;
        mbox-names = "tx", "rx";
      };
    };
...
```

## Documentation/devicetree/bindings/firmware/google,gs101-acpm-ipc.yaml
```yaml
# SPDX-License-Identifier: (GPL-2.0-only OR BSD-2-Clause)
# Copyright 2024 Linaro Ltd.
%YAML 1.2
---
$id: http://devicetree.org/schemas/firmware/google,gs101-acpm-ipc.yaml#
$schema: http://devicetree.org/meta-schemas/core.yaml#

title: Samsung Exynos ACPM mailbox protocol

maintainers:
  - Tudor Ambarus <tudor.ambarus@linaro.org>

description: |
  ACPM (Alive Clock and Power Manager) is a firmware that operates on the
  APM (Active Power Management) module that handles overall power management
  activities. ACPM and masters regard each other as independent hardware
  component and communicate with each other using mailbox messages and
  shared memory.

  This binding is intended to define the interface the firmware implementing
  ACPM provides for OSPM in the device tree.

properties:
  compatible:
    const: google,gs101-acpm-ipc

  mboxes:
    maxItems: 1

  pmic:
    description: Child node describing the main PMIC.
    type: object
    additionalProperties: true

    properties:
      compatible:
        const: samsung,s2mpg10-pmic

  pmic2:
    description: Child node describing the sub PMIC.
    type: object
    additionalProperties: true

    properties:
      compatible:
        const: samsung,s2mpg11-pmic

  shmem:
    description:
      List of phandle pointing to the shared memory (SHM) area. The memory
      contains channels configuration data and the TX/RX ring buffers that
      are used for passing messages to/from the ACPM firmware.
    maxItems: 1

required:
  - compatible
  - mboxes
  - shmem

additionalProperties: false

examples:
  - |
    #include <dt-bindings/gpio/gpio.h>
    #include <dt-bindings/interrupt-controller/irq.h>
    #include <dt-bindings/regulator/samsung,s2mpg10-regulator.h>

    power-management {
        compatible = "google,gs101-acpm-ipc";
        mboxes = <&ap2apm_mailbox>;
        shmem = <&apm_sram>;

        pmic {
            compatible = "samsung,s2mpg10-pmic";
            interrupts-extended = <&gpa0 6 IRQ_TYPE_LEVEL_LOW>;

            vinl3m-supply = <&buck8m>;

            regulators {
                ldo1m {
                    regulator-name = "vdd_ldo1";
                    regulator-min-microvolt = <700000>;
                    regulator-max-microvolt = <1300000>;
                };

                ldo20m {
                    regulator-name = "vdd_ldo1";
                    regulator-min-microvolt = <700000>;
                    regulator-max-microvolt = <1300000>;
                    samsung,ext-control = <S2MPG10_PCTRLSEL_LDO20M_EN>;
                };

                // ...

                buck8m {
                    regulator-name = "vdd_mif";
                    regulator-min-microvolt = <450000>;
                    regulator-max-microvolt = <1300000>;
                    regulator-ramp-delay = <6250>;
                };
            };
        };

        pmic2 {
            compatible = "samsung,s2mpg11-pmic";
            interrupts-extended = <&gpa0 7 IRQ_TYPE_LEVEL_LOW>;

            vinl1s-supply = <&buck8m>;
            vinl2s-supply = <&buck6s>;

            regulators {
                buckd {
                    regulator-ramp-delay = <6250>;
                    samsung,ext-control = <S2MPG11_PCTRLSEL_UFS_EN>;
                    samsung,ext-control-gpios = <&gpp0 1 GPIO_ACTIVE_HIGH>;
                };
            };
        };
    };
```

## Documentation/devicetree/bindings/firmware/linux,smbios-table.yaml
```yaml
# SPDX-License-Identifier: (GPL-2.0-only OR BSD-2-Clause)
# Copyright 2025 Arista Networks
%YAML 1.2
---
$id: http://devicetree.org/schemas/firmware/linux,smbios-table.yaml#
$schema: http://devicetree.org/meta-schemas/core.yaml#

title: Memory location for SMBIOS table 

description: |
  This property is used in the /chosen node to pass the physical address
  of SMBIOS (System Management BIOS) or DMI (Desktop Management Interface)
  tables from firmware to the kernel. This is typically used on non-EFI
  platforms like ARM/ARM64.
  
maintainers:
  - Adriana Nicolae <adriana@arista.com>
  - Rob Herring <robh+dt@kernel.org>

properties:
  linux,smbios3-table:
    $ref: /schemas/types.yaml#/definitions/uint64
    description:
      The 64-bit physical address of the SMBIOSv3 entry point structure.

additionalProperties: true
```
