## Documentation/devicetree/bindings/reserved-memory/arm,ffa-lend-pool.yaml
```yaml
# SPDX-License-Identifier: (GPL-2.0-only OR BSD-2-Clause)
%YAML 1.2
---
$id: http://devicetree.org/schemas/reserved-memory/arm,ffa-lend-pool.yaml#
$schema: http://devicetree.org/meta-schemas/core.yaml#

title: Arm FF-A Memory Lend Pool

maintainers:
  - Vincent Donnefort <vdonnefort@google.com>

description: |
  When memory is lent to the Secure world via FF-A, CPU speculative accesses
  from Non-Secure to the lent pages can still occur as long as it retains a
  cacheable mapping to it.

  Ideally, lent memory would be "no-map", but that would mean giving up MiBs of
  useful memory. Instead, "arm,ffa-lend-pool" defines a reserved-memory CMA pool
  to manage unmapping pages prior to lending and restoring them when reclaimed.

allOf:
  - $ref: reserved-memory.yaml

properties:
  compatible:
    const: arm,ffa-lend-pool

  no-map: false

required:
  - compatible
  - reusable

unevaluatedProperties: false

examples:
  - |
    / {
        compatible = "foo";
        model = "foo";
        #address-cells = <2>;
        #size-cells = <2>;

        reserved-memory {
            #address-cells = <2>;
            #size-cells = <2>;
            ranges;

            ffa_lend: ffa-lend-pool {
                compatible = "arm,ffa-lend-pool";
                reusable;
                size = <0x0 0x4000000>;
            };
        };
    };
```

## Documentation/devicetree/bindings/reserved-memory/bootstage.yaml
```yaml
# SPDX-License-Identifier: GPL-2.0-only OR BSD-2-Clause
%YAML 1.2
---
$id: http://devicetree.org/schemas/reserved-memory/bootstage.yaml#
$schema: http://devicetree.org/meta-schemas/core.yaml#

title: Bootstage stash

description: |
  This binding represents a reserved memory region containing bootstage stash
  data generated by a previous bootloader stage.

maintainers:
  - Francesco Valla <francesco@valla.it>

allOf:
  - $ref: reserved-memory.yaml

properties:
  compatible:
    const: bootstage

  reg:
    description: page-aligned region of memory containing bootstage stash data

required:
  - compatible
  - reg
  - no-map

unevaluatedProperties: false

examples:
  - |
    reserved-memory {
        #address-cells = <2>;
        #size-cells = <1>;

        bootstage: bootstage@12340000 {
            compatible = "bootstage";
            reg = <0x00 0x12340000 0x2000>;
            no-map;
        };
    };
```

## Documentation/devicetree/bindings/reserved-memory/google,debug-kinfo.yaml
```yaml
# SPDX-License-Identifier: GPL-2.0-only OR BSD-2-Clause
%YAML 1.2
---
$id: http://devicetree.org/schemas/reserved-memory/google,debug-kinfo.yaml#
$schema: http://devicetree.org/meta-schemas/core.yaml#

title: Google Pixel Kinfo reserved memory

maintainers:
  - Eugen Hristev <eugen.hristev@linaro.org>
  - Mukesh Ojha <mukesh.ojha@oss.qualcomm.com>

description:
  Reserved memory region for storing kernel debugging information that
  can be read by firmware and bootloader on Google Pixel platforms.

allOf:
  - $ref: reserved-memory.yaml

properties:
  compatible:
    const: google,debug-kinfo

  reg:
    maxItems: 1
    description: >
      Page-aligned region of memory containing debugging data of the
      running kernel.

required:
  - compatible
  - reg
  - no-map

unevaluatedProperties: false

examples:
  - |
    reserved-memory {
        #address-cells = <1>;
        #size-cells = <1>;

        debug-kinfo@fa00000 {
            compatible = "google,debug-kinfo";
            reg = <0xfa00000 0x1000>;
            no-map;
        };
    };
```

## Documentation/devicetree/bindings/reserved-memory/google,kinfo.yaml
```yaml
# SPDX-License-Identifier: GPL-2.0-only OR BSD-2-Clause
%YAML 1.2
---
$id: http://devicetree.org/schemas/reserved-memory/google,kinfo.yaml#
$schema: http://devicetree.org/meta-schemas/core.yaml#

title: Google Pixel Kinfo reserved memory

maintainers:
  - Eugen Hristev <eugen.hristev@linaro.org>
  - Mukesh Ojha <mukesh.ojha@oss.qualcomm.com>

description: |
  This binding represents reserved-memory used to store data for firmware/bootloader
  on the Pixel platform. The stored data is debugging information of the running
  kernel.

allOf:
  - $ref: reserved-memory.yaml

properties:
  compatible:
    const: google,debug-kinfo

  reg:
    description: page-aligned region of memory containing debugging data of running kernel

required:
  - compatible
  - reg
  - no-map

unevaluatedProperties: false

examples:
  - |
    reserved-memory {
        #address-cells = <1>;
        #size-cells = <1>;

        debug-kinfo@fa00000 {
            compatible = "google,debug-kinfo";
            reg = <0xfa00000 0x1000>;
            no-map;
        };
    };
```

## Documentation/devicetree/bindings/reserved-memory/intel,wakeup-mailbox.yaml
```yaml
# SPDX-License-Identifier: GPL-2.0-only OR BSD-2-Clause
%YAML 1.2
---
$id: http://devicetree.org/schemas/reserved-memory/intel,wakeup-mailbox.yaml#
$schema: http://devicetree.org/meta-schemas/core.yaml#

title: Wakeup Mailbox for Intel processors

description: |
  The Wakeup Mailbox provides a mechanism for the operating system to wake up
  secondary CPUs on Intel processors. It is an alternative to the INIT-!INIT-
  SIPI sequence used on most x86 systems.

  Firmware must define the enable-method property in the CPU nodes as
  "intel,wakeup-mailbox" to use the mailbox.

  Firmware implements the wakeup mailbox as a 4KB-aligned memory region of size
  of 4KB. It is memory that the firmware reserves so that each secondary CPU can
  have the operating system send a single message to them. The firmware is
  responsible for putting the secondary CPUs in a state to check the mailbox.

  The structure of the mailbox is as follows:

  Field           Byte   Byte  Description
                 Length Offset
  ------------------------------------------------------------------------------
  Command          2      0    Command to wake up the secondary CPU:
                                        0: Noop
                                        1: Wakeup: Jump to the wakeup_vector
                                        2-0xFFFF: Reserved:
  Reserved         2      2    Must be 0.
  APIC_ID          4      4    APIC ID of the secondary CPU to wake up.
  Wakeup_Vector    8      8    The wakeup address for the secondary CPU.
  ReservedForOs 2032     16    Reserved for OS use.
  ReservedForFW 2048   2048    Reserved for firmware use.
  ------------------------------------------------------------------------------

  To wake up a secondary CPU, the operating system 1) prepares the wakeup
  routine; 2) populates the address of the wakeup routine address into the
  Wakeup_Vector field; 3) populates the APIC_ID field with the APIC ID of the
  secondary CPU; 4) writes Wakeup in the Command field. Upon receiving the
  Wakeup command, the secondary CPU acknowledges the command by writing Noop in
  the Command field and jumps to the Wakeup_Vector. The operating system can
  send the next command only after the Command field is changed to Noop.

  The secondary CPU will no longer check the mailbox after waking up. The
  secondary CPU must ignore the command if its APIC_ID written in the mailbox
  does not match its own.

  When entering the Wakeup_Vector, interrupts must be disabled and 64-bit
  addressing mode must be enabled. Paging mode must be enabled. The virtual
  address of the Wakeup_Vector page must be equal to its physical address.
  Segment selectors are not used.

maintainers:
  - Ricardo Neri <ricardo.neri-calderon@linux.intel.com>

allOf:
  - $ref: reserved-memory.yaml

properties:
  compatible:
    const: intel,wakeup-mailbox

  alignment:
    description: The mailbox must be 4KB-aligned.
    const: 0x1000

required:
  - compatible
  - alignment
  - reg

unevaluatedProperties: false

examples:
  - |
    reserved-memory {
        #address-cells = <2>;
        #size-cells = <1>;

        wakeup-mailbox@12340000 {
            compatible = "intel,wakeup-mailbox";
            alignment = <0x1000>;
            reg = <0x0 0x12340000 0x1000>;
        };
    };
```

## Documentation/devicetree/bindings/reserved-memory/mediatek,secure_cma_chunkmem.yaml
```yaml
# SPDX-License-Identifier: (GPL-2.0-only OR BSD-2-Clause)
%YAML 1.2
---
$id: http://devicetree.org/schemas/reserved-memory/mediatek,secure_cma_chunkmem.yaml#
$schema: http://devicetree.org/meta-schemas/core.yaml#

title: MediaTek Secure Video Path Reserved Memory

description:
  This binding describes the reserved memory for secure video path.

maintainers:
  - Yong Wu <yong.wu@mediatek.com>

allOf:
  - $ref: reserved-memory.yaml

properties:
  compatible:
    const: mediatek,secure_cma_chunkmem

required:
  - compatible
  - reg
  - reusable

unevaluatedProperties: false

examples:
  - |

    reserved-memory {
        #address-cells = <1>;
        #size-cells = <1>;
        ranges;

        reserved-memory@80000000 {
            compatible = "mediatek,secure_cma_chunkmem";
            reusable;
            reg = <0x80000000 0x18000000>;
        };
    };
```

## Documentation/devicetree/bindings/reserved-memory/nvidia,tegra-video-protection-region.yaml
```yaml
# SPDX-License-Identifier: (GPL-2.0 OR BSD-2-Clause)
%YAML 1.2
---
$id: http://devicetree.org/schemas/reserved-memory/nvidia,tegra-video-protection-region.yaml#
$schema: http://devicetree.org/meta-schemas/core.yaml#

title: NVIDIA Tegra Video Protection Region (VPR)

maintainers:
  - Thierry Reding <thierry.reding@gmail.com>
  - Jon Hunter <jonathanh@nvidia.com>

description: |
  NVIDIA Tegra chips have long supported a mechanism to protect a single,
  contiguous memory region from non-secure memory accesses. Typically this
  region is used for decoding and playback of DRM protected content. Various
  devices, such as the display controller and multimedia engines (video
  decoder) can access this region in a secure way. Access from the CPU is
  generally forbidden.

  Two variants exist for VPR: one is fixed in both the base address and size,
  while the other is resizable. Fixed VPR can be described by just a "reg"
  property specifying the base address and size, whereas the resizable VPR
  is defined by a size/alignment pair of properties. For resizable VPR the
  memory is reusable by the rest of the system when it's unused for VPR and
  therefore the "reusable" property must be specified along with it. For a
  fixed VPR, the memory is permanently protected, and therefore it's not
  reusable and must also be marked as "no-map" to prevent any (including
  speculative) accesses to it.

allOf:
  - $ref: reserved-memory.yaml

properties:
  compatible:
    const: nvidia,tegra-video-protection-region

dependencies:
  size: [alignment, reusable]
  alignment: [size, reusable]
  reusable: [alignment, size]

  reg: [no-map]
  no-map: [reg]

unevaluatedProperties: false

oneOf:
  - required:
      - compatible
      - reg

  - required:
      - compatible
      - size
```

## Documentation/devicetree/bindings/reserved-memory/secure_cma_region.yaml
```yaml
# SPDX-License-Identifier: (GPL-2.0-only OR BSD-2-Clause)
%YAML 1.2
---
$id: http://devicetree.org/schemas/reserved-memory/secure_cma_region.yaml#
$schema: http://devicetree.org/meta-schemas/core.yaml#

title: Secure Reserved CMA Region

description:
  This binding describes a CMA region that can dynamically transition
between secure and non-secure states that a TEE can allocate memory
from.

maintainers:
  - Yong Wu <yong.wu@mediatek.com>

allOf:
  - $ref: reserved-memory.yaml

properties:
  compatible:
    const: secure_cma_region

required:
  - compatible
  - reg
  - reusable

unevaluatedProperties: false

examples:
  - |

    reserved-memory {
        #address-cells = <1>;
        #size-cells = <1>;
        ranges;

        reserved-memory@80000000 {
            compatible = "secure_cma_region";
            reusable;
            reg = <0x80000000 0x18000000>;
        };
    };
```

## Documentation/devicetree/bindings/reset/apple,t8103-cio-reset.yaml
```yaml
# SPDX-License-Identifier: GPL-2.0 OR BSD-2-Clause
%YAML 1.2
---
$id: http://devicetree.org/schemas/reset/apple,t8103-cio-reset.yaml#
$schema: http://devicetree.org/meta-schemas/core.yaml#

title: Apple SoC CIO (USB4/Thunderbolt) block reset controller

maintainers:
  - Sven Peter <sven@kernel.org>

description: |
  The CIO (Converged I/O) blocks on Apple Silicon SoCs have a reset
  inside the power manager (PMGR) that has to be deasserted before
  their co-processor can be booted. On t8103 each port comes with a
  dedicated register page, represented as a standalone node. On t600x a
  single register shared by all ports of a die with one request bit per
  port is used instead. Since this register is located in the middle of
  the PMGR MMIO region it is represented as a sub-node of the PMGR
  syscon with reg used as an offset into it.

  In both cases the reset id is the CIO port index on the die.

properties:
  compatible:
    oneOf:
      - enum:
          - apple,t8103-cio-reset
          - apple,t6000-cio-reset
      - items:
          - const: apple,t8112-cio-reset
          - const: apple,t8103-cio-reset
      - items:
          - const: apple,t6020-cio-reset
          - const: apple,t6000-cio-reset

  reg:
    maxItems: 1

  '#reset-cells':
    const: 1

required:
  - compatible
  - reg
  - '#reset-cells'

additionalProperties: false

examples:
  - |
    soc {
        #address-cells = <2>;
        #size-cells = <2>;

        reset-controller@23b784000 {
            compatible = "apple,t8103-cio-reset";
            reg = <0x2 0x3b784000 0x0 0x8000>;
            #reset-cells = <1>;
        };
    };
  - |
    power-management@28e080000 {
        compatible = "apple,t6000-pmgr", "apple,pmgr", "syscon", "simple-mfd";
        reg = <0x8e080000 0x1c000>;
        #address-cells = <1>;
        #size-cells = <1>;

        reset-controller@1a034 {
            compatible = "apple,t6000-cio-reset";
            reg = <0x1a034 0x4>;
            #reset-cells = <1>;
        };
    };
```

## Documentation/devicetree/bindings/reset/brcm,bcm63138-pmb.yaml
```yaml
# SPDX-License-Identifier: (GPL-2.0-only OR BSD-2-Clause)
%YAML 1.2
---
$id: http://devicetree.org/schemas/reset/brcm,bcm63138-pmb.yaml#
$schema: http://devicetree.org/meta-schemas/core.yaml#

title: Broadcom BCM63138 Processor Monitor Bus

description: This document describes the BCM63138 processor monitor bus.

maintainers:
  - Philipp Zabel <p.zabel@pengutronix.de>
  - Kanak Shilledar <kanakshilledar111@protonmail.com>

properties:
  compatible:
    const: brcm,bcm63138-pmb

  reg:
    description: base register address and size for this bus controller
    maxItems: 1

  "#reset-cells":
    description: |
      must be 2 first cell is the address within the bus instance
      designated by the phandle, and the second is the number of zones
      for this peripheral.
    const: 2

required:
  - compatible
  - reg
  - "#reset-cells"

additionalProperties: false

examples:
  - |
    pmb0: reset-controller@4800c0 {
        compatible = "brcm,bcm63138-pmb";
        reg = <0x4800c0 0x10>;
        #reset-cells = <2>;
    };
```
