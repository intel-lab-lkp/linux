## Documentation/devicetree/bindings/reset/cix,sky1-audss-reset.yaml
```yaml
# SPDX-License-Identifier: (GPL-2.0-only OR BSD-2-Clause)
%YAML 1.2
---
$id: http://devicetree.org/schemas/reset/cix,sky1-audss-reset.yaml#
$schema: http://devicetree.org/meta-schemas/core.yaml#

title: Cix Sky1 audio subsystem reset controller

maintainers:
  - Joakim Zhang <joakim.zhang@cixtech.com>

description: |
  Reset provider for the Cix Sky1 audio subsystem (AUDSS).

  This node is a child of a cix,sky1-audss-cru MFD/syscon node (see
  cix,sky1-audss-cru.yaml). It does not have a reg property; software reset
  bits are accessed through the parent CRU regmap.

  Each #reset-cells index maps to a software reset line for an AUDSS block
  (I2S, HDA, DMA, mailbox, watchdog, timer, etc.). Indices are defined in
  sky1-reset-audss.h.

properties:
  compatible:
    const: cix,sky1-audss-reset

  '#reset-cells':
    const: 1
    description:
      Reset indices are defined in include/dt-bindings/reset/sky1-reset-audss.h.

required:
  - compatible
  - '#reset-cells'

additionalProperties: false

examples:
  - |
    #include <dt-bindings/reset/sky1-reset-audss.h>

    cru: syscon@7110000 {
        compatible = "cix,sky1-audss-cru", "simple-mfd", "syscon";
        reg = <0x7110000 0x10000>;

        audss_rst: reset-controller {
            compatible = "cix,sky1-audss-reset";
            #reset-cells = <1>;
        };
    };
```

## Documentation/devicetree/bindings/reset/cix,sky1-rst.yaml
```yaml
# SPDX-License-Identifier: (GPL-2.0-only OR BSD-2-Clause)
%YAML 1.2
---
$id: http://devicetree.org/schemas/reset/cix,sky1-rst.yaml#
$schema: http://devicetree.org/meta-schemas/core.yaml#

title: CIX Sky1 Reset Register Region

maintainers:
  - Gary Yang <gary.yang@cixtech.com>
  - Xueyuan Chen <xueyuan.chen21@gmail.com>

description: |
  An assortment of registers that control elements of the CIX Sky1 SoC,
  including resets, clocks, among others.
  The Reset block acts as a system controller (syscon) and provides
  reset capabilities to various peripherals.

properties:
  compatible:
    items:
      - enum:
          - cix,sky1-src-s5
          - cix,sky1-src-fch
      - const: syscon

  reg:
    maxItems: 1

  '#reset-cells':
    description:
      The peripherals on the CIX Sky1 SoC have reset support.
      The reset consumer should specify the desired peripheral via the
      ID defined in include/dt-bindings/reset/cix,sky1-rst.h.
    const: 1

required:
  - compatible
  - reg
  - '#reset-cells'

additionalProperties: false

examples:
  - |
    #include <dt-bindings/reset/cix,sky1-rst.h>
    reset-controller@16000000 {
      compatible = "cix,sky1-src-s5", "syscon";
      reg = <0x16000000 0x1000>;
      #reset-cells = <1>;
    };
```

## Documentation/devicetree/bindings/reset/eswin,eic7700-reset.yaml
```yaml
# SPDX-License-Identifier: (GPL-2.0-only OR BSD-2-Clause)
%YAML 1.2
---
$id: http://devicetree.org/schemas/reset/eswin,eic7700-reset.yaml#
$schema: http://devicetree.org/meta-schemas/core.yaml#

title: ESWIN EIC7700 SoC reset controller

maintainers:
  - Yifeng Huang <huangyifeng@eswincomputing.com>
  - Xuyang Dong <dongxuyang@eswincomputing.com>

description:
  The system reset controller can be used to reset various peripheral
  controllers in ESWIN eic7700 SoC.

properties:
  compatible:
    const: eswin,eic7700-reset

  reg:
    maxItems: 1

  '#reset-cells':
    const: 1

required:
  - compatible
  - reg
  - '#reset-cells'

additionalProperties: false

examples:
  - |
    #include <dt-bindings/reset/eswin,eic7700-reset.h>

    reset-controller@51828000 {
        compatible = "eswin,eic7700-reset";
        reg = <0x51828000 0x80000>;
        #reset-cells = <1>;
    };
```

## Documentation/devicetree/bindings/reset/fsl,imx95-gpu-blk-ctrl.yaml
```yaml
# SPDX-License-Identifier: (GPL-2.0-only OR BSD-2-Clause)
%YAML 1.2
---
$id: http://devicetree.org/schemas/reset/fsl,imx95-gpu-blk-ctrl.yaml#
$schema: http://devicetree.org/meta-schemas/core.yaml#

title: Freescale i.MX95 GPU Block Controller

maintainers:
  - Marek Vasut <marex@denx.de>

description: |
  This reset controller is a block of ad-hoc debug registers, one of
  which is a single-bit GPU reset.

properties:
  compatible:
    - const: fsl,imx95-gpu-blk-ctrl

  reg:
    maxItems: 1

  clocks:
    maxItems: 1

  power-domains:
    maxItems: 1

  '#reset-cells':
    const: 1

required:
  - compatible
  - reg
  - clocks
  - power-domains
  - '#reset-cells'

additionalProperties: false

examples:
  - |
    reset-controller@4d810000 {
        compatible = "fsl,imx95-gpu-blk-ctrl";
        reg = <0x0 0x4d810000 0x0 0xc>;
        clocks = <&scmi_clk IMX95_CLK_GPUAPB>;
        power-domains = <&scmi_devpd IMX95_PD_GPU>;
        #reset-cells = <1>;
    };
```

## Documentation/devicetree/bindings/reset/marvell,armada8k-reset.yaml
```yaml
# SPDX-License-Identifier: (GPL-2.0 OR BSD-2-Clause)
# Copyright 2025 Wilson Ding <dingwei@marvell.com>
%YAML 1.2
---
$id: http://devicetree.org/schemas/reset/marvell,armada8k-reset.yaml#
$schema: http://devicetree.org/meta-schemas/core.yaml#

title: Marvell Armada8K reset controller

maintainers:
  - Wilson Ding <dingwei@marvell.com>

description: The reset controller node must be a sub-node of the system
  controller node on Armada7K/8K or CN913x SoCs.

properties:
  compatible:
    const: marvell,armada8k-reset

  reg:
    description:
      The register offset (to syscon register address) and size
    maxItems: 1

  "#reset-cells":
    const: 1

required:
  - compatible
  - reg
  - "#reset-cells"

additionalProperties: false

examples:
  - |
    syscon0: system-controller@440000 {
        compatible = "syscon", "simple-mfd";
        reg = <0x440000 0x2000>;
        #address-cells = <1>;
        #size-cells = <1>;

        swrst: reset-controller@268 {
            compatible = "marvell,armada8k-reset";
            reg = <0x268 0x4>;
            #reset-cells = <1>;
        };
    };
```

## Documentation/devicetree/bindings/reset/mediatek,smi-reset.yaml
```yaml
# SPDX-License-Identifier: (GPL-2.0-only OR BSD-2-Clause)
# Copyright (c) 2024 MediaTek Inc.
%YAML 1.2
---
$id: http://devicetree.org/schemas/reset/mediatek,smi-reset.yaml#
$schema: http://devicetree.org/meta-schemas/core.yaml#

title: MediaTek SMI Reset Controller

maintainers:
  - Friday Yang <friday.yang@mediatek.com>

description: |
  This reset controller node is used to perform reset management
  of SMI larbs on MediaTek platform. It is used to implement various
  reset functions required when SMI larbs apply clamp operation.

  For list of all valid reset indices see
    <dt-bindings/reset/mt8188-resets.h> for MT8188.

properties:
  compatible:
    enum:
      - mediatek,smi-reset-mt8188

  "#reset-cells":
    const: 1

  mediatek,larb-rst-syscon:
    $ref: /schemas/types.yaml#/definitions/phandle
    description: phandle of the SMI larb's reset controller syscon.

required:
  - compatible
  - "#reset-cells"
  - mediatek,larb-rst-syscon

additionalProperties: false

examples:
  - |
    imgsys1_dip_top_rst: reset-controller {
          compatible = "mediatek,smi-reset-mt8188";
          #reset-cells = <1>;
          mediatek,larb-rst-syscon = <&imgsys1_dip_top>;
    };
```

## Documentation/devicetree/bindings/reset/microchip,rst.yaml
```yaml
# SPDX-License-Identifier: (GPL-2.0-only OR BSD-2-Clause)
%YAML 1.2
---
$id: http://devicetree.org/schemas/reset/microchip,rst.yaml#
$schema: http://devicetree.org/meta-schemas/core.yaml#

title: Microchip Sparx5 Switch Reset Controller

maintainers:
  - Steen Hegelund <steen.hegelund@microchip.com>
  - Lars Povlsen <lars.povlsen@microchip.com>

description: |
  The Microchip Sparx5 Switch provides reset control and implements the following
  functions
    - One Time Switch Core Reset (Soft Reset)

properties:
  $nodename:
    pattern: "^reset-controller@[0-9a-f]+$"

  compatible:
    enum:
      - microchip,sparx5-switch-reset
      - microchip,lan966x-switch-reset

  reg:
    minItems: 1
    items:
      - description: global control block registers
      - description: cpu system block registers

  reg-names:
    minItems: 1
    items:
      - const: gcb
      - const: cpu

  "#reset-cells":
    const: 1

  cpu-syscon:
    $ref: /schemas/types.yaml#/definitions/phandle
    description: syscon used to access CPU reset

allOf:
  # Allow to use the second reg item instead of cpu-syscon
  - if:
      required:
        - cpu-syscon
    then:
      properties:
        reg:
          maxItems: 1
        reg-names:
          maxItems: 1
    else:
      properties:
        reg:
          minItems: 2
        reg-names:
          minItems: 2

required:
  - compatible
  - reg
  - reg-names
  - "#reset-cells"

additionalProperties: false

examples:
  - |
    reset: reset-controller@11010008 {
        compatible = "microchip,sparx5-switch-reset";
        reg = <0x11010008 0x4>;
        reg-names = "gcb";
        #reset-cells = <1>;
        cpu-syscon = <&cpu_ctrl>;
    };

    /*
     * The following construction can be used if the cpu-syscon device is not
     * present. This is the case when the LAN966x is used as a PCI device.
     */
    reset-controller@22010008 {
        compatible = "microchip,lan966x-switch-reset";
        reg = <0xe200400c 0x4>,
              <0xe00c0000 0xa8>;
        reg-names = "gcb", "cpu";
        #reset-cells = <1>;
    };
```

## Documentation/devicetree/bindings/reset/nxp,imx8ulp-avd-sim-reset.yaml
```yaml
# SPDX-License-Identifier: (GPL-2.0-only OR BSD-2-Clause)
%YAML 1.2
---
$id: http://devicetree.org/schemas/reset/nxp,imx8ulp-avd-sim-reset.yaml#
$schema: http://devicetree.org/meta-schemas/core.yaml#

title: NXP i.MX8ULP System Integration Module Reset Controller

maintainers:
  - Liu Ying <victor.liu@nxp.com>

description:
  Some instances of i.MX8ULP's SIM may offer control over the reset of some
  components of a certain domain (example - AVD-SIM).

properties:
  compatible:
    items:
      - enum:
          - nxp,imx8ulp-avd-sim-reset
      - const: syscon

  reg:
    maxItems: 1

  clocks:
    maxItems: 1

  '#reset-cells':
    const: 1

  mux-controller:
    $ref: /schemas/mux/reg-mux.yaml#

required:
  - compatible
  - reg
  - clocks
  - '#reset-cells'
  - mux-controller

additionalProperties: false

examples:
  - |
    #include <dt-bindings/clock/imx8ulp-clock.h>
    syscon@2da50000 {
      compatible = "nxp,imx8ulp-avd-sim-reset", "syscon";
      reg = <0x2da50000 0x38>;
      clocks = <&pcc5 IMX8ULP_CLK_AVD_SIM>;
      #reset-cells = <1>;

      mux-controller {
        compatible = "mmio-mux";
        #mux-control-cells = <1>;
        mux-reg-masks = <0x8 0x00000200>;
      };
    };
```

## Documentation/devicetree/bindings/reset/sophgo,cv1800-reset.yaml
```yaml
# SPDX-License-Identifier: (GPL-2.0-only OR BSD-2-Clause)
%YAML 1.2
---
$id: http://devicetree.org/schemas/reset/sophgo,cv1800-reset.yaml#
$schema: http://devicetree.org/meta-schemas/core.yaml#

title: Cvitek CV18xx/Sophgo SG2000 Reset Controller

maintainers:
  - Alexander Sverdlin <alexander.sverdlin@gmail.com>

properties:
  compatible:
    const: sophgo,cv1800-reset

  sophgo,rtcsys-ctrl:
    description: phandle of the "RTCSYS_CTRL" syscon block
    $ref: /schemas/types.yaml#/definitions/phandle

  sophgo,rtcsys-core:
    description: phandle of the "RTCSYS_CORE" syscon block
    $ref: /schemas/types.yaml#/definitions/phandle

required:
  - compatible
  - sophgo,rtcsys-ctrl
  - sophgo,rtcsys-core

additionalProperties: false

examples:
  - |
    soc-reset {
        compatible = "sophgo,cv1800-reset";
        sophgo,rtcsys-ctrl = <&rtcsys_ctrl>;
        sophgo,rtcsys-core = <&rtcsys_core>;
    };
...
```
