## Documentation/devicetree/bindings/remoteproc/qcom,qdu1000-mpss-pas.yaml
```yaml
# SPDX-License-Identifier: GPL-2.0 OR BSD-2-Clause
%YAML 1.2
---
$id: http://devicetree.org/schemas/remoteproc/qcom,qdu1000-mpss-pas.yaml#
$schema: http://devicetree.org/meta-schemas/core.yaml#

title: Qualcomm QDU1000 Modem Peripheral Authentication Service

maintainers:
  - Melody Olvera <quic_molvera@quicinc.com>
  - Komal Bajaj <quic_kbajaj@quicinc.com>

description:
  Qualcomm QDU1000 SoC Peripheral Authentication Service loads and boots firmware
  on the Qualcomm DSP Hexagon core.

properties:
  compatible:
    enum:
      - qcom,qdu1000-mpss-pas

  reg:
    items:
      - description: Address offset and size for MPSS PAS register set
      - description: Address offset and size for MPSS RMB register set

  reg-names:
    items:
      - const: base
      - const: rmb

  clocks:
    items:
      - description: XO clock

  clock-names:
    items:
      - const: xo

  qcom,qmp:
    $ref: /schemas/types.yaml#/definitions/phandle
    description: Reference to the AOSS side-channel message RAM.

  smd-edge: false

  firmware-name:
    items:
      - description: Firmware name of the Hexagon core
      - description: Firmware name of the Hexagon Devicetree

  memory-region:
    items:
      - description: Memory region for main Firmware authentication
      - description: Memory region for Devicetree Firmware authentication
      - description: DSM Memory region

  power-domains:
    items:
      - description: CX power domain
      - description: MSS power domain

  power-domain-names:
    items:
      - const: cx
      - const: mss

required:
  - compatible
  - reg
  - reg-names
  - memory-region

allOf:
  - $ref: /schemas/remoteproc/qcom,pas-common.yaml#

unevaluatedProperties: false

examples:
  - |
    #include <dt-bindings/clock/qcom,rpmh.h>
    #include <dt-bindings/interconnect/qcom,qdu1000-rpmh.h>
    #include <dt-bindings/interrupt-controller/arm-gic.h>
    #include <dt-bindings/interrupt-controller/irq.h>
    #include <dt-bindings/mailbox/qcom-ipcc.h>
    #include <dt-bindings/power/qcom-rpmpd.h>

    remoteproc@4080000 {
        compatible = "qcom,qdu1000-mpss-pas";
        reg = <0x4080000 0x4040>,
              <0x4180000 0x1000>;
        reg-names = "base", "rmb";

        clocks = <&rpmhcc RPMH_CXO_CLK>;
        clock-names = "xo";

        interrupts-extended = <&intc GIC_SPI 264 IRQ_TYPE_EDGE_RISING>,
                              <&smp2p_modem_in 0 IRQ_TYPE_EDGE_RISING>,
                              <&smp2p_modem_in 1 IRQ_TYPE_EDGE_RISING>,
                              <&smp2p_modem_in 2 IRQ_TYPE_EDGE_RISING>,
                              <&smp2p_modem_in 3 IRQ_TYPE_EDGE_RISING>,
                              <&smp2p_modem_in 7 IRQ_TYPE_EDGE_RISING>;
        interrupt-names = "wdog", "fatal", "ready", "handover",
                          "stop-ack", "shutdown-ack";

        memory-region = <&mpss_mem>, <&dtb_mpss_mem>, <&mpss_dsm_mem>;

        firmware-name = "qcom/qdu1000/modem.mbn",
                        "qcom/qdu1000/modem_dtb.mbn";

        power-domains = <&rpmhpd QDU1000_CX>,
                        <&rpmhpd QDU1000_MSS>;
        power-domain-names = "cx", "mss";

        interconnects = <&mc_virt MASTER_LLCC &mc_virt SLAVE_EBI1>;

        qcom,qmp = <&aoss_qmp>;

        qcom,smem-states = <&smp2p_adsp_out 0>;
        qcom,smem-state-names = "stop";

        glink-edge {
            interrupts-extended = <&ipcc IPCC_CLIENT_MPSS
                                         IPCC_MPROC_SIGNAL_GLINK_QMP
                                         IRQ_TYPE_EDGE_RISING>;
            mboxes = <&ipcc IPCC_CLIENT_MPSS IPCC_MPROC_SIGNAL_GLINK_QMP>;

            label = "modem";
            qcom,remote-pid = <2>;
        };
```

## Documentation/devicetree/bindings/remoteproc/remoteproc-tee.yaml
```yaml
# SPDX-License-Identifier: (GPL-2.0 OR BSD-2-Clause)
%YAML 1.2
---
$id: http://devicetree.org/schemas/remoteproc/remoteproc-tee.yaml#
$schema: http://devicetree.org/meta-schemas/core.yaml#

title: TEE Remote Processor Control Service (UUID 80a4c275-0a47-4905-8285-1486a9771a08)

maintainers:
  - Arnaud Pouliquen <arnaud.pouliquen@foss.st.com>

description:
  Node describing a TEE-based remote processor control service implemented as
  a Trusted Application identified by UUID 80a4c275-0a47-4905-8285-1486a9771a08.

  This binding is intended to define the interface for remoteproc services
  implemented as TAs running in a TEE, and is used by the a remoteproc driver
  to bind to such a service and control a remote processor through it.

properties:
  compatible:
    const: 80a4c275-0a47-4905-8285-1486a9771a08

required:
  - compatible

additionalProperties: false

examples:
  - |
    firmware {
        tee_rproc: optee-rproc {
            compatible = "80a4c275-0a47-4905-8285-1486a9771a08";
        };
    };
...
```

## Documentation/devicetree/bindings/remoteproc/remoteproc-virtio.yaml
```yaml
# SPDX-License-Identifier: (GPL-2.0 OR BSD-2-Clause)
%YAML 1.2
---
$id: http://devicetree.org/schemas/remoteproc/remoteproc-virtio.yaml#
$schema: http://devicetree.org/meta-schemas/core.yaml#

title: Virtio devices over remoteproc

description: |
  Virtio devices ("vdevs") can be exposed using the remoteproc infrastructure
  and its resource table. For some of them, a device tree node might be needed
  to describe remote undiscoverable hardware and/or connect consumers and
  providers.

maintainers:
  - Francesco Valla <francesco@valla.it>

properties:
  virtio:
    description: Contains a group of Virtio devices exposed by the remoteproc.

    properties:
      '#address-cells':
        const: 1

      '#size-cells':
        const: 0

    patternProperties:
      "^vdev@[0-9a-f]+$":
        type: object

        properties:
          reg:
            description: Virtio device index inside the resource table.
            maxItems: 1

        additionalProperties:
          type: object
          $ref: /schemas/virtio/virtio-device.yaml
          maxItems: 1

        required:
          - reg

    additionalProperties: false

    required:
      - '#address-cells'
      - '#size-cells'

additionalProperties: true

examples:
  - |
    remoteproc-cm33 {
      virtio {
          #address-cells = <1>;
          #size-cells = <0>;

          vdev@0 {
              reg = <0>;

              gpio {
                  compatible = "virtio,device29";

                  gpio-controller;
                  #gpio-cells = <2>;
              };
          };

          vdev@1 {
              reg = <1>;

              i2c {
                  compatible = "virtio,device22";

                  #address-cells = <1>;
                  #size-cells = <0>;

                  eeprom@50 {
                      compatible = "atmel,24c1025";
                      reg = <0x50>;
                  };
              };
          };
      };
    };
...
```

## Documentation/devicetree/bindings/remoteproc/sophgo,cv1800b-c906l.yaml
```yaml
# SPDX-License-Identifier: (GPL-2.0 OR BSD-2-Clause)
%YAML 1.2
---
$id: http://devicetree.org/schemas/remoteproc/sophgo,cv1800b-c906l.yaml#
$schema: http://devicetree.org/meta-schemas/core.yaml#

title: Sophgo C906L remote processor controller for CV1800B SoC

maintainers:
  - Junhui Liu <junhui.liu@pigmoral.tech>

description:
  Document the bindings for the C906L remoteproc component that loads and boots
  firmwares on the CV1800B SoC.

properties:
  compatible:
    const: sophgo,cv1800b-c906l

  firmware-name:
    $ref: /schemas/types.yaml#/definitions/string
    description:
      The name of the firmware file to load for this remote processor, relative
      to the firmware search path (typically /lib/firmware/).

  memory-region:
    description:
      Phandle to a reserved memory region that is used to load the firmware for
      this remote processor. The remote processor will use this memory region
      as its execution memory.

  resets:
    maxItems: 1

  sophgo,syscon:
    $ref: /schemas/types.yaml#/definitions/phandle
    description:
      A phandle to the SEC_SYS region, used for configuration of the remote processor.

required:
  - compatible
  - firmware-name
  - memory-region
  - resets
  - sophgo,syscon

additionalProperties: false

examples:
  - |
    reserved-memory {
        #address-cells = <1>;
        #size-cells = <1>;
        ranges;

        c906l_mem: region@83f40000 {
            reg = <0x83f40000 0xc0000>;
            no-map;
        };
    };

    c906l-rproc {
        compatible = "sophgo,cv1800b-c906l";
        firmware-name = "c906l-firmware.elf";
        memory-region = <&c906l_mem>;
        resets = <&rst 294>;
        sophgo,syscon = <&sec_sys>;
    };
```

## Documentation/devicetree/bindings/remoteproc/st,stm32-rproc-tee.yaml
```yaml
# SPDX-License-Identifier: (GPL-2.0 OR BSD-2-Clause)
%YAML 1.2
---
$id: http://devicetree.org/schemas/remoteproc/st,stm32-rproc-tee.yaml#
$schema: http://devicetree.org/meta-schemas/core.yaml#

title: STMicroelectronics STM32 remote processor controlled via TEE

maintainers:
  - Arnaud Pouliquen <arnaud.pouliquen@foss.st.com>

description: |
  STM32MP remote processor controlled by a Trusted Application
  running in OP-TEE. This node is a child of the TEE remoteproc service
  (UUID 80a4c275-0a47-4905-8285-1486a9771a08) and exposes a remoteproc
  instance managed by the Linux remoteproc core via the TEE rproc service.

  Firmware loading, authentication and remote processor start/stop are managed
  by the TEE application. The STM32-specific driver handles platform resources
  such as the mailboxes and reserved-memory.

properties:
  compatible:
    const: st,stm32mp15-m4-tee

  reg:
    description: |
      Remote processor identifier used by the TEE service. The <0> value
      in the example denotes a single instance with ID 0.
    maxItems: 1

  mboxes:
    description: |
      Mailbox channels used for rpmsg/virtio functionality and processor
      shutdown.
    maxItems: 3

  mbox-names:
    items:
      - const: vq0
      - const: vq1
      - const: shutdown

  memory-region:
    description: |
      List of phandles to reserved-memory nodes describing the memory layout
      for the interprocessors communication.

  interrupts:
    description: |
      Optional watchdog / status interrupt line used to detect crashes
      and optionally wake up the system.
    maxItems: 1

  st,auto-boot:
    type: boolean
    description: |
      If present, the remote processor will be automatically started by
      the remoteproc core at boot.

  wakeup-source:
    type: boolean
    description: |
      Indicates that the watchdog interrupt can be used as a wakeup source.

required:
  - compatible
  - reg

additionalProperties: false

examples:
  - |
    rproc_service: rproc-service@0 {
      compatible = "rproc-service-80a4c275-0a47-4905-8285-1486a9771a08";
      reg = <0 0>;
      #address-cells = <1>;
      #size-cells = <0>;
      status = "okay";

      m4: m4@0 {
        compatible = "st,stm32mp15-m4-tee";
        reg = <0>;

        mboxes = <&ipcc 0>, <&ipcc 1>, <&ipcc 2>;
        mbox-names = "vq0", "vq1", "shutdown";

        memory-region = <&vdev0vring0>, <&m_ipc_shm>, <&mcuram2>,
                        <&vdev0vring1>, <&vdev0buffer>, <&retram>;

        interrupt-parent = <&exti>;
        interrupts = <68 1>;

        st,auto-boot;
        wakeup-source;

        status = "okay";
      };
    };
...
```

## Documentation/devicetree/bindings/remoteproc/ti,keystone-rproc.yaml
```yaml
# SPDX-License-Identifier: (GPL-2.0-only OR BSD-2-Clause)
%YAML 1.2
---
$id: http://devicetree.org/schemas/remoteproc/ti,keystone-rproc.yaml#
$schema: http://devicetree.org/meta-schemas/core.yaml#

title: TI Keystone DSP devices

maintainers:
  - Suman Anna <s-anna@ti.com>

description: >
  The TI Keystone 2 family of SoCs usually have one or more (up to 8) TI DSP
  Core sub-systems that are used to offload some of the processor-intensive
  tasks or algorithms, for achieving various system level goals.

  These processor sub-systems usually contain additional sub-modules like L1
  and/or L2 caches/SRAMs, an Interrupt Controller, an external memory
  controller, a dedicated local power/sleep controller etc. The DSP processor
  core in Keystone 2 SoCs is usually a TMS320C66x CorePac processor.

  Each DSP Core sub-system is represented as a single DT node, and should also
  have an alias with the stem 'rproc' defined. Each node has a number of
  required or optional properties that enable the OS running on the host
  processor (ARM CorePac) to perform the device management of the remote
  processor and to communicate with the remote processor.

properties:
  compatible:
    enum:
      - ti,k2hk-dsp
      - ti,k2l-dsp
      - ti,k2e-dsp
      - ti,k2g-dsp

  reg:
    minItems: 3
    maxItems: 3

  reg-names:
    items:
      - const: l2sram
      - const: l1pram
      - const: l1dram

  interrupts:
    minItems: 2
    maxItems: 2

  interrupt-names:
    items:
      - const: vring
      - const: exception

  ti,syscon-dev:
    description: Phandle and offset to syscon device
    $ref: /schemas/types.yaml#/definitions/phandle-array
    items:
      - items:
          - description: Phandle to Keystone Device State Control node
          - description: offset of the DSP boot address register

  resets:
    maxItems: 1
    description:
      refer to either of the following reset bindings for the reset argument
      specifier as per SoC,
      Documentation/devicetree/bindings/reset/ti-syscon-reset.txt for
      66AK2HK/66AK2L/66AK2E SoCs or,
      Documentation/devicetree/bindings/reset/ti,sci-reset.yaml for 66AK2G SoCs

  kick-gpios:
    maxItems: 1
    description:
      GPIO used by the virtio IPC stack to interrupt the remote processor. See
      Documentation/devicetree/bindings/gpio/ti,keystone-dsp-gpio.yaml

  memory-region:
    maxItems: 1
    description:
      Reserved memory node can be CMA memory node, and should be defined as per
      Documentation/devicetree/bindings/reserved-memory/reserved-memory.txt

  clocks:
    maxItems: 1
    description:
      Input clock (66AK2HK/66AK2L/66AK2E only), see
      Documentation/devicetree/bindings/clock/ti,keystone,psc-clock.yaml

  power-domains:
    maxItems: 1
    description:
      PM domain provider phandle and DSP device id (66AK2G only), see
      Documentation/devicetree/bindings/soc/ti/sci-pm-domain.yaml

required:
  - compatible
  - reg
  - reg-names
  - interrupts
  - interrupt-names
  - ti,syscon-dev
  - resets
  - kick-gpios

allOf:
  - if:
      properties:
        compatible:
          contains:
            const: ti,k2g-dsp
    then:
      properties:
        clocks: false
      required:
        - power-domains
    else:
      properties:
        power-domains: false
      required:
        - clocks

additionalProperties: false

examples:
  - |
    dsp@10800000 {
      compatible = "ti,k2g-dsp";
      reg = <0x10800000 0x00100000>,
            <0x10e00000 0x00008000>,
            <0x10f00000 0x00008000>;
      reg-names = "l2sram", "l1pram", "l1dram";
      power-domains = <&k2g_pds 0x0046>;
      ti,syscon-dev = <&devctrl 0x844>;
      resets = <&k2g_reset 0x0046 0x1>;
      interrupts = <0>, <8>;
      interrupt-names = "vring", "exception";
      kick-gpios = <&dspgpio0 27 0>;
      memory-region = <&dsp_common_memory>;
    };
```
