## Documentation/devicetree/bindings/mfd/syna,sl261x-gbl.yaml
```yaml
# SPDX-License-Identifier: (GPL-2.0-only OR BSD-2-Clause)
%YAML 1.2
---
$id: http://devicetree.org/schemas/mfd/syna,sl261x-gbl.yaml#
$schema: http://devicetree.org/meta-schemas/core.yaml#

title: Synaptics SL261x global and control register blocks

maintainers:
  - Jisheng Zhang <jszhang@kernel.org>

description: |
  The SL261x global and control register blocks contain clock, reset, and
  pin control registers. Each functional child uses its parent's register
  range. The CPU clock controller also refers to the chip control syscon.

properties:
  compatible:
    oneOf:
      - items:
          - const: syna,sl261x-avio-gbl
          - const: syscon
          - const: simple-mfd
      - items:
          - const: syna,sl261x-cpu-wrp
          - const: syscon
          - const: simple-mfd
      - items:
          - const: syna,sl261x-chip-control
          - const: syscon
          - const: simple-mfd
      - items:
          - const: syna,sl261x-mcu-gbl
          - const: syscon
          - const: simple-mfd

  reg:
    maxItems: 1

  clock:
    type: object
    additionalProperties: true

  pin-controller:
    type: object
    additionalProperties: true

  reset:
    type: object
    additionalProperties: true

required:
  - compatible
  - reg

allOf:
  - if:
      properties:
        compatible:
          contains:
            const: syna,sl261x-avio-gbl
    then:
      required:
        - clock
      properties:
        clock:
          properties:
            compatible:
              const: syna,sl261x-aio-clk
        pin-controller: false
        reset: false

  - if:
      properties:
        compatible:
          contains:
            const: syna,sl261x-cpu-wrp
    then:
      required:
        - clock
      properties:
        clock:
          properties:
            compatible:
              const: syna,sl261x-cpu-clk
        pin-controller: false
        reset: false

  - if:
      properties:
        compatible:
          contains:
            const: syna,sl261x-chip-control
    then:
      required:
        - clock
        - pin-controller
        - reset
      properties:
        clock:
          properties:
            compatible:
              const: syna,sl261x-soc-clk
        pin-controller:
          properties:
            compatible:
              const: syna,sl261x-soc-pinctrl
        reset:
          properties:
            compatible:
              const: syna,sl261x-soc-reset

  - if:
      properties:
        compatible:
          contains:
            const: syna,sl261x-mcu-gbl
    then:
      required:
        - clock
        - pin-controller
        - reset
      properties:
        clock:
          properties:
            compatible:
              const: syna,sl261x-system-clk
        pin-controller:
          properties:
            compatible:
              const: syna,sl261x-system-pinctrl
        reset:
          properties:
            compatible:
              const: syna,sl261x-system-reset

additionalProperties: false

examples:
  - |
    osc: clock-osc {
        compatible = "fixed-clock";
        #clock-cells = <0>;
        clock-frequency = <25000000>;
    };

    avio_gbl: avio-gbl@f7490000 {
        compatible = "syna,sl261x-avio-gbl", "syscon", "simple-mfd";
        reg = <0xf7490000 0x4000>;

        aioclk: clock {
            compatible = "syna,sl261x-aio-clk";
            #clock-cells = <1>;
            clocks = <&osc>;
        };
    };

    chip: chip-control@f7e10000 {
        compatible = "syna,sl261x-chip-control", "syscon", "simple-mfd";
        reg = <0xf7e10000 0x10000>;

        clk: clock {
            compatible = "syna,sl261x-soc-clk";
            #clock-cells = <1>;
            clocks = <&osc>;
        };

        pinctrl: pin-controller {
            compatible = "syna,sl261x-soc-pinctrl";
        };

        rst: reset {
            compatible = "syna,sl261x-soc-reset";
            #reset-cells = <1>;
        };
    };

    cpu_wrp: cpu-wrp@f7e30000 {
        compatible = "syna,sl261x-cpu-wrp", "syscon", "simple-mfd";
        reg = <0xf7e30000 0x4000>;

        cpuclk: clock {
            compatible = "syna,sl261x-cpu-clk";
            #clock-cells = <1>;
            clocks = <&osc>;
            syna,gbl-syscon = <&chip>;
        };
    };

    mcu_gbl: mcu-gbl@e5025000 {
        compatible = "syna,sl261x-mcu-gbl", "syscon", "simple-mfd";
        reg = <0xe5025000 0x1000>;

        sm_clk: clock {
            compatible = "syna,sl261x-system-clk";
            #clock-cells = <1>;
        };

        sm_pinctrl: pin-controller {
            compatible = "syna,sl261x-system-pinctrl";
        };

        sm_rst: reset {
            compatible = "syna,sl261x-system-reset";
            #reset-cells = <1>;
        };
    };
...
```

## Documentation/devicetree/bindings/mfd/ti,keystone-devctrl.yaml
```yaml
# SPDX-License-Identifier: (GPL-2.0-only OR BSD-2-Clause)
%YAML 1.2
---
$id: http://devicetree.org/schemas/mfd/ti,keystone-devctrl.yaml#
$schema: http://devicetree.org/meta-schemas/core.yaml#

title: Texas Instruments Keystone Device State Control

maintainers:
  - Ivan Khoronzhuk <ivan.khoronzhuk@ti.com>

description:
  The Keystone II devices have a set of registers that are used to control the
  status of its peripherals. This node is intended to allow access to this
  functionality.

properties:
  compatible:
    minItems: 2
    items:
      - const: ti,keystone-devctrl
      - const: syscon
      - const: simple-mfd

  reg:
    maxItems: 1

  "#address-cells":
    const: 1

  "#size-cells":
    const: 1

  ranges: true

patternProperties:
  "^keystone_dsp_gpio@[0-9a-f]+$":
    type: object
    description: Keystone DSP GPIO controller

  "^keystone_irq@[0-9a-f]+$":
    type: object
    description: Keystone DSP to ARM interrupt controller

  "^reset-controller@[0-9a-f]+$":
    type: object
    description: Keystone reset controller

required:
  - compatible
  - reg

allOf:
  - if:
      properties:
        compatible:
          contains:
            const: simple-mfd
    then:
      required:
        - "#address-cells"
        - "#size-cells"
        - ranges
    else:
      properties:
        "#address-cells": false
        "#size-cells": false
        ranges: false

additionalProperties: false

examples:
  - |
    device-state-control@2620000 {
        compatible = "ti,keystone-devctrl", "syscon";
        reg = <0x02620000 0x1000>;
    };

  - |
    #include <dt-bindings/interrupt-controller/arm-gic.h>

    device-state-control@2620000 {
        compatible = "ti,keystone-devctrl", "syscon", "simple-mfd";
        reg = <0x02620000 0x1000>;
        #address-cells = <1>;
        #size-cells = <1>;
        ranges = <0x0 0x02620000 0x1000>;

        keystone_irq@2a0 {
            compatible = "ti,keystone-irq";
            reg = <0x2a0 0x4>;
            interrupts = <GIC_SPI 4 IRQ_TYPE_EDGE_RISING>;
            interrupt-controller;
            #interrupt-cells = <1>;
            ti,syscon-dev = <&devctrl 0x2a0>;
        };

        reset-controller@328 {
            compatible = "ti,keystone-reset";
            reg = <0x328 0x10>;
            ti,syscon-pll = <&pllctrl 0xe4>;
            ti,syscon-dev = <&devctrl 0x328>;
            ti,wdt-list = <0>;
        };
    };
```

## Documentation/devicetree/bindings/mfd/ti,lm3533.yaml
```yaml
# SPDX-License-Identifier: (GPL-2.0-only OR BSD-2-Clause)
%YAML 1.2
---
$id: http://devicetree.org/schemas/mfd/ti,lm3533.yaml#
$schema: http://devicetree.org/meta-schemas/core.yaml#

title: TI LM3533 Complete Lighting Power Solution

description: >
  The LM3533 is a complete power source for backlight, keypad, and indicator LEDs
  in smartphone handsets. The high-voltage inductive boost converter provides the
  power for two series LED strings display backlight and keypad functions.

  https://www.ti.com/product/LM3533

maintainers:
  - Svyatoslav Ryhel <clamor95@gmail.com>

properties:
  compatible:
    const: ti,lm3533

  reg:
    maxItems: 1

  enable-gpios:
    description: GPIO to use to enable/disable the backlight (HWEN pin).
    maxItems: 1

  ti,boost-ovp-microvolt:
    description:
      Boost OVP select (16V, 24V, 32V, 40V)
    enum: [ 16000000, 24000000, 32000000, 40000000 ]
    default: 16000000

  ti,boost-freq-hz:
    description:
      Boost frequency select (500KHz or 1MHz)
    enum: [ 500000, 1000000 ]
    default: 500000

  light-sensor:
    type: object
    description:
      Properties for an illumination sensor.
    additionalProperties: false

    properties:
      compatible:
        const: ti,lm3533-als

      ti,resistor-value-ohm:
        $ref: /schemas/types.yaml#/definitions/uint32
        description:
          Internal configuration resister value when ALS is in Analog Sensor
          mode and PWM mode is disabled.
        minimum: 1575
        maximum: 200000

      ti,pwm-mode:
        type: boolean
        description:
          Switch for mode in which ALS is running. If this propertly is set
          then ALS is running in PWM mode, internal resistor value is set to
          high-impedance (0) and resistor-value-ohm propertly is ignored.

    required:
      - compatible

required:
  - compatible
  - reg
  - enable-gpios
  - light-sensor
  - backlight-0
  - backlight-1
  - led-0
  - led-1
  - led-2
  - led-3

patternProperties:
  "^backlight-[01]$":
    type: object
    description:
      Properties for a backlight device.

    $ref: /schemas/leds/backlight/common.yaml#

    properties:
      compatible:
        const: ti,lm3533-backlight

      default-brightness: true

      ti,max-current-microamp:
        description:
          Maximum current in µA with a 800 µA step.
        enum: [ 5000, 5800, 6600, 7400, 8200, 9000, 9800,
                10600, 11400, 12200, 13000, 13800, 14600,
                15400, 16200, 17000, 17800, 18600, 19400,
                20200, 21000, 21800, 22600, 23400, 24200,
                25000, 25800, 26600, 27400, 28200, 29000,
                29800 ]
        default: 5000

      ti,pwm-config-mask:
        $ref: /schemas/types.yaml#/definitions/uint32
        description:
          Control Bank PWM Configuration Register mask that allows to configure
          PWM input in Zones 0-4
          BIT(0) - PWM Input is enabled
          BIT(1) - PWM Input is enabled in Zone 0
          BIT(2) - PWM Input is enabled in Zone 1
          BIT(3) - PWM Input is enabled in Zone 2
          BIT(4) - PWM Input is enabled in Zone 3
          BIT(5) - PWM Input is enabled in Zone 4

      ti,linear-mapping-mode:
        description:
          Enable linear mapping mode. If disabled, then it will use exponential
          mapping mode in which the ramp up/down appears to have a more uniform
          transition to the human eye.
        type: boolean

      ti,hardware-controlled:
        description:
          Each backlight has its own voltage Control Bank (A and B) and there are
          two HVLED sinks which by default are linked to respective Bank. Setting
          this property will link both sinks to a Control Bank of backlight where
          property is defined.
        type: boolean

    required:
      - compatible

    additionalProperties: false

  "^led-[0-3]$":
    type: object
    description:
      Properties for a led device.

    $ref: /schemas/leds/common.yaml#

    properties:
      compatible:
        const: ti,lm3533-leds

      linux,default-trigger: true

      ti,max-current-microamp:
        description:
          Maximum current in µA with a 800 µA step.
        enum: [ 5000, 5800, 6600, 7400, 8200, 9000, 9800,
                10600, 11400, 12200, 13000, 13800, 14600,
                15400, 16200, 17000, 17800, 18600, 19400,
                20200, 21000, 21800, 22600, 23400, 24200,
                25000, 25800, 26600, 27400, 28200, 29000,
                29800 ]
        default: 5000

      ti,pwm-config-mask:
        $ref: /schemas/types.yaml#/definitions/uint32
        description:
          Same descryption and function as for backlight.

    required:
      - compatible

    additionalProperties: false

additionalProperties: false

examples:
  - |
    #include <dt-bindings/gpio/gpio.h>

    i2c {
        #address-cells = <1>;
        #size-cells = <0>;

        led-controller@36 {
            compatible = "ti,lm3533";
            reg = <0x36>;

            enable-gpios = <&gpio 110 GPIO_ACTIVE_HIGH>;

            ti,boost-ovp-microvolt = <24000000>;
            ti,boost-freq-hz = <500000>;

            backlight-0 {
                compatible = "ti,lm3533-backlight";

                ti,max-current-microamp = <23400>;
                default-brightness = <113>;
                ti,hardware-controlled;
            };

            backlight-1 {
                compatible = "ti,lm3533-backlight";
                status = "disabled";
            };

            led-0 {
                compatible = "ti,lm3533-leds";
                status = "disabled";
            };

            led-1 {
                compatible = "ti,lm3533-leds";
                status = "disabled";
            };

            led-2 {
                compatible = "ti,lm3533-leds";
                status = "disabled";
            };

            led-3 {
                compatible = "ti,lm3533-leds";
                status = "disabled";
            };

            light-sensor {
                compatible = "ti,lm3533-als";
                status = "disabled";
            };
        };
    };
...
```
