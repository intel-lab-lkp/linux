## Documentation/devicetree/bindings/mfd/ti,lm8502.yaml
```yaml
# SPDX-License-Identifier: GPL-2.0-only OR BSD-2-Clause
%YAML 1.2
---
$id: http://devicetree.org/schemas/mfd/ti,lm8502.yaml#
$schema: http://devicetree.org/meta-schemas/core.yaml#

title: TI LM8502 combo LED + haptic controller

maintainers:
  - Herman van Hazendonk <github.com@herrie.org>

description: |
  The TI LM8502 is an I2C combo device with ten constant-current LED
  outputs (D1..D10) and an internal H-bridge that drives a vibrator
  motor. Pin D10 is shared between the tenth LED channel and the
  haptic output; the haptic driver writes D10_CURRENT_CTRL = 0 at each
  start to mux the pin to the H-bridge path.

  The chip is exposed in Linux as an MFD with two children:
    - ti,lm8502-leds   - LED-class outputs D1..D10
    - ti,lm8502-haptic - EV_FF / FF_RUMBLE input device

  The parent node owns the I2C client, the chip-enable GPIO and the
  vcc regulator; children share access to the parent's regmap.

properties:
  compatible:
    const: ti,lm8502

  reg:
    maxItems: 1

  vcc-supply:
    description:
      Power supply for the chip (V_DD). On platforms where this supply
      is provided by an RPM-managed LDO with "regulator-allow-set-load",
      the driver will request High Power Mode (~100 mA) so the internal
      boost converter and ten LED outputs are not current-starved.

  enable-gpios:
    maxItems: 1
    description:
      GPIO connected to the chip-enable pin. Pulled high by the driver
      at probe time and dropped low across PM suspend.

  pinctrl-names: true
  pinctrl-0: true

  leds:
    type: object
    additionalProperties: false
    description: LED-class child for outputs D1..D10.

    properties:
      compatible:
        const: ti,lm8502-leds

      '#address-cells':
        const: 1

      '#size-cells':
        const: 0

    patternProperties:
      '^led@[0-9]$':
        type: object
        $ref: /schemas/leds/common.yaml#
        unevaluatedProperties: false

        properties:
          reg:
            description:
              Zero-based D-channel index (0 = D1 .. 9 = D10).
            minimum: 0
            maximum: 9

          led-max-microamp:
            description: |
              Per-channel current cap. The chip's MAX_CURRENT field
              quantises this to one of four buckets:
                <=3000  - 3 mA
                <=6000  - 6 mA
                <=9000  - 9 mA  (default)
                 >9000  - 12.75 mA
            default: 9000

        required:
          - reg

    required:
      - compatible

  haptic:
    type: object
    additionalProperties: false
    description: FF_RUMBLE child for the internal H-bridge vibrator output.

    properties:
      compatible:
        const: ti,lm8502-haptic

      ti,invert-direction:
        type: boolean
        description:
          Flip the H-bridge polarity bit in HAPTIC_FEEDBACK_CTRL so the
          motor spins in the direction the board expects.

    required:
      - compatible

required:
  - compatible
  - reg

additionalProperties: false

examples:
  - |
    #include <dt-bindings/gpio/gpio.h>
    #include <dt-bindings/leds/common.h>

    i2c {
        #address-cells = <1>;
        #size-cells = <0>;

        led-controller@33 {
            compatible = "ti,lm8502";
            reg = <0x33>;

            vcc-supply = <&pm8058_l16>;
            enable-gpios = <&tlmm 121 GPIO_ACTIVE_HIGH>;

            leds {
                compatible = "ti,lm8502-leds";
                #address-cells = <1>;
                #size-cells = <0>;

                led@0 {
                    reg = <0>;
                    label = "lm8502:white:navi_left";
                    color = <LED_COLOR_ID_WHITE>;
                    function = LED_FUNCTION_INDICATOR;
                    led-max-microamp = <9000>;
                };

                led@1 {
                    reg = <1>;
                    label = "lm8502:white:navi_right";
                    color = <LED_COLOR_ID_WHITE>;
                    function = LED_FUNCTION_INDICATOR;
                    led-max-microamp = <9000>;
                };
            };

            haptic {
                compatible = "ti,lm8502-haptic";
                ti,invert-direction;
            };
        };
    };
```

## Documentation/devicetree/bindings/mfd/ti,omap-usb-host.yaml
```yaml
# SPDX-License-Identifier: (GPL-2.0-only OR BSD-2-Clause)
%YAML 1.2
---
$id: http://devicetree.org/schemas/mfd/ti,omap-usb-host.yaml#
$schema: http://devicetree.org/meta-schemas/core.yaml#

title: OMAP HS USB Host

maintainers:
  - Thomas Richard <thomas.richard@bootlin.com>

description: |
  description

properties:
  compatible:
    const: ti,usbhs-host

  reg:
    maxItems: 1

  ti,hwmods:
    const: usb_host_hs

  num-ports:
    description:
      number of USB ports. Usually this is automatically detected from the IP's
      revision register but can be overridden by specifying this property. A
      maximum of 3 ports are supported at the moment.
    maximum: 3

  single-ulpi-bypass:
    $ref: /schemas/types.yaml#/definitions/flag
    description:
      Must be present if the controller contains a single ULPI bypass control
      bit. e.g. OMAP3 silicon <= ES2.1ULPI bypass control bit.
      e.g. OMAP3 silicon <= ES2.1.

  clocks:
    description: clock-specifier

  clock-names:
    oneOf:
      - items:
          - const: usbhost_120m_fck
      - items:
          - const: refclk_60m_int
          - const: refclk_60m_ext_p1
          - const: refclk_60m_ext_p2

  "#address-cells":
    const: 1

  "#size-cells":
    const: 1

  ranges: true

patternProperties:
  "^port[0-3]-mode$":
    $ref: /schemas/types.yaml#/definitions/string
    description:
      String specifying the port mode for port N, where N can be from 1 to 3.
      the port mode is not specified, that port is treated as unused. When
      specified, it must be one of the following.
    enum:
      - ehci-phy
      - ehci-tll
      - ehci-hsic
      - ohci-phy-6pin-datse0
      - ohci-phy-6pin-dpdm
      - ohci-phy-3pin-datse0
      - ohci-phy-4pin-dpdm
      - ohci-tll-6pin-datse0
      - ohci-tll-6pin-dpdm
      - ohci-tll-3pin-datse0
      - ohci-tll-4pin-dpdm
      - ohci-tll-2pin-datse0
      - ohci-tll-2pin-dpdm

  "^usb@":
    type: object

required:
  - compatible
  - reg

allOf:
  - if:
      patternProperties:
        "^usb@": true
    then:
      required:
        - ranges
        - "#address-cells"
        - "#size-cells"

additionalProperties: false

examples:
  - |
    bus {
        #address-cells = <1>;
        #size-cells = <1>;

        usbhshost: usbhshost@4a064000 {
            compatible = "ti,usbhs-host";
            reg = <0x4a064000 0x800>;
            ti,hwmods = "usb_host_hs";
            port1-mode = "ehci-phy";
            port2-mode = "ehci-tll";
            port3-mode = "ehci-phy";
            #address-cells = <1>;
            #size-cells = <1>;
            ranges;

            usbhsohci: usb@4a064800 {
                compatible = "ti,ohci-omap3";
                reg = <0x4a064800 0x400>;
                interrupt-parent = <&gic>;
                interrupts = <0 76 0x4>;
            };

            usbhsehci: usb@4a064c00 {
                compatible = "ti,ehci-omap";
                reg = <0x4a064c00 0x400>;
                interrupt-parent = <&gic>;
                interrupts = <0 77 0x4>;
            };
        };
    };
```

## Documentation/devicetree/bindings/mfd/ti,tac5x1x.yaml
```yaml
# SPDX-License-Identifier: GPL-2.0-only OR BSD-2-Clause
%YAML 1.2
---
$id: http://devicetree.org/schemas/mfd/ti,tac5x1x.yaml#
$schema: http://devicetree.org/meta-schemas/core.yaml#

title: Texas Instruments TAC5x1x Multi-Function Audio Device

maintainers:
  - Niranjan H Y <niranjan.hy@ti.com>

description: |
  TAC5x1x family of low-power, high-performance audio codecs with integrated
  GPIO controller and diagnostic capabilities.

  This is the parent binding. Child nodes are bound by these bindings:
  - Pin controller: Documentation/devicetree/bindings/pinctrl/ti,tac5x1x-pinctrl.yaml
  - Audio codec: Documentation/devicetree/bindings/sound/ti,tac5x1x.yaml

  Hardware features:
  - Audio ADC/DAC with configurable impedance and voltage references
  - 4-pin GPIO controller with alternate functions (PDM, IRQ)
  - Analog voltage and current monitoring circuits
  - Diagnostic fault detection with interrupt generation

  Device datasheets can be found at:
    TAA5212:    https://www.ti.com/lit/ds/symlink/taa5212.pdf
    TAA5412-Q1: https://www.ti.com/lit/ds/symlink/taa5412-q1.pdf
    TAC5111:    https://www.ti.com/lit/ds/symlink/tac5111.pdf
    TAC5112:    https://www.ti.com/lit/ds/symlink/tac5112.pdf
    TAC5211:    https://www.ti.com/lit/ds/symlink/tac5211.pdf
    TAC5212:    https://www.ti.com/lit/ds/symlink/tac5212.pdf
    TAC5301:    https://www.ti.com/lit/ds/symlink/tac5301-q1.pdf
    TAC5311-Q1: https://www.ti.com/lit/ds/symlink/tac5311-q1.pdf
    TAC5312-Q1: https://www.ti.com/lit/ds/symlink/tac5312-q1.pdf
    TAC5411-Q1: https://www.ti.com/lit/ds/symlink/tac5411-q1.pdf
    TAC5412-Q1: https://www.ti.com/lit/ds/symlink/tac5412-q1.pdf
    TAD5112:    https://www.ti.com/lit/ds/symlink/tad5112.pdf
    TAD5212:    https://www.ti.com/lit/ds/symlink/tad5212.pdf

properties:
  compatible:
    enum:
      - ti,taa5212
      - ti,taa5412
      - ti,tac5111
      - ti,tac5112
      - ti,tac5211
      - ti,tac5212
      - ti,tac5301
      - ti,tac5311
      - ti,tac5312
      - ti,tac5411
      - ti,tac5412
      - ti,tad5112
      - ti,tad5212

  reg:
    maxItems: 1
    description: I2C slave address

  reset-gpios:
    maxItems: 1
    description: Hardware reset control pin (active low)

  interrupts:
    maxItems: 1
    description: |
      Interrupt from device diagnostic circuits to host processor.
      Generated on voltage/current fault conditions and other diagnostic events.

  clocks:
    maxItems: 1
    description: Master clock input (MCLK)

  clock-names:
    items:
      - const: mclk

  avdd-supply:
    description: |
      Analog supply voltage input (AVDD pin).
      Typical voltages: 1.8V, 3.0V, 3.3V, 5.0V

  iovdd-supply:
    description: |
      Digital I/O supply voltage input (IOVDD pin).
      Typical voltages: 1.8V, 3.3V

  ti,vref-voltage:
    description: |
      Internal voltage reference setting in microvolts.

      Supported values:
      - 1375000: VREF = 1.375V
      - 2500000: VREF = 2.5V
      - 2750000: VREF = 2.75V

      Constraint: Selected VREF must be lower than AVDD supply voltage.
    $ref: /schemas/types.yaml#/definitions/uint32
    enum: [1375000, 2500000, 2750000]
    default: 2500000

  ti,micbias-voltage:
    description: |
      Microphone bias output voltage in microvolts.

      Configuration options:
      - VREF voltage: Set to same value as ti,vref-voltage
      - 0.5 × VREF: Set to half of ti,vref-voltage value
      - AVDD voltage: Set to AVDD supply voltage value

      Note: When set to AVDD voltage, hardware automatically overrides
      VREF setting to 2.75V regardless of ti,vref-voltage property.
    $ref: /schemas/types.yaml#/definitions/uint32
    minimum: 687500
    maximum: 3300000

  ti,adc1-impedance:
    description: |
      ADC Channel 1 input impedance in Ohms.
      Supported impedance values:
      - 5000: 5k input impedance
      - 10000: 10k input impedance
      - 40000: 40k input impedance
      Available only for TAC5111, TAC5211, TAC5212, and TAA5212 variants.
    $ref: /schemas/types.yaml#/definitions/uint32
    enum: [5000, 10000, 40000]
    default: 10000

  ti,adc2-impedance:
    description: |
      ADC Channel 2 input impedance in Ohms.
      Supported impedance values:
      - 5000: 5k input impedance
      - 10000: 10k input impedance
      - 40000: 40k input impedance
      Available on stereo variants only (TAA5212, TAC5212).
    $ref: /schemas/types.yaml#/definitions/uint32
    enum: [5000, 10000, 40000]
    default: 10000

  ti,out2x-vcom-cfg:
    description: |
      Channel OUT2x VCOM reference voltage selection.

      Configuration options:
      - 0: VCOM = 0.6 × VREF
      - 1: VCOM = AVDD / 2

      Available on devices with stereo DAC output.
    $ref: /schemas/types.yaml#/definitions/uint32
    enum: [0, 1]
    default: 0

  ti,gpa-threshold:
    description: |
      General Purpose Analog voltage monitoring thresholds in millivolts.
      Format: [low_threshold_mv, high_threshold_mv]

      Monitoring range: 0mV to 6000mV, Resolution: ~24mV per step
      Default thresholds: 200mV (low), 2600mV (high)

      Generates interrupt on voltage fault conditions.
    $ref: /schemas/types.yaml#/definitions/uint32-array
    minItems: 2
    maxItems: 2
    items:
      minimum: 200
      maximum: 6000
    default: [200, 2600]

  ti,in-ch-en:
    description: |
      Enable input channel diagnostic monitoring circuits.

      When enabled (1), activates hardware monitoring for:
      - Input channel fault detection
      - Micbias current monitoring (if ti,micbias-threshold configured)
      - Input overvoltage detection

      Available on: TAC5301, TAC5311, TAC5312, TAC5411, TAC5412, TAA5412
    $ref: /schemas/types.yaml#/definitions/uint32
    enum: [0, 1]
    default: 0

  ti,out-ch-en:
    description: |
      Enable output channel diagnostic monitoring circuits.

      When enabled (1), activates hardware monitoring for:
      - Output channel fault detection
      - Driver fault monitoring
      - Short circuit detection

      Available on: TAC5301, TAC5311, TAC5312, TAC5411, TAC5412, TAA5412
    $ref: /schemas/types.yaml#/definitions/uint32
    enum: [0, 1]
    default: 0

  ti,incl-se-inm:
    description: |
      Include INxM pins in single-ended input diagnostic scan.

      When enabled (1), includes negative input pins (INxM) in diagnostic
      monitoring for single-ended input configurations.
    $ref: /schemas/types.yaml#/definitions/uint32
    enum: [0, 1]
    default: 0

  ti,incl-ac-coup:
    description: |
      Include AC-coupled input channels in diagnostic scan.

      When enabled (1), includes AC-coupled input channels in the
      diagnostic monitoring system.
    $ref: /schemas/types.yaml#/definitions/uint32
    enum: [0, 1]
    default: 0

  ti,micbias-threshold:
    description: |
      Microphone bias current monitoring thresholds in microamps.
      Format: [low_threshold_ua, high_threshold_ua]

      Current monitoring range: 100uA to 33000uA, Resolution: ~132uA per step
      Default thresholds: 2600uA (low), 18000uA (high)

      Hardware monitors actual current flow through MICBIAS pin.
      Generates interrupts on fault conditions when ti,in-ch-en = <1>.

      Available on: TAC5301, TAC5311, TAC5312, TAC5411, TAC5412, TAA5412
    $ref: /schemas/types.yaml#/definitions/uint32-array
    minItems: 2
    maxItems: 2
    items:
      minimum: 100
      maximum: 33000
    default: [2600, 18000]

required:
  - compatible
  - reg
  - avdd-supply
  - iovdd-supply

unevaluatedProperties: false
```
