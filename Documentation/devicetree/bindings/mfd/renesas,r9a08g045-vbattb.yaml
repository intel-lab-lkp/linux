## Documentation/devicetree/bindings/mfd/rockchip,rk816.yaml
```yaml
# SPDX-License-Identifier: GPL-2.0-only OR BSD-2-Clause
%YAML 1.2
---
$id: http://devicetree.org/schemas/mfd/rockchip,rk816.yaml#
$schema: http://devicetree.org/meta-schemas/core.yaml#

title: RK816 Power Management Integrated Circuit

maintainers:
  - Chris Zhong <zyw@rock-chips.com>
  - Zhang Qing <zhangqing@rock-chips.com>

description: |
  Rockchip RK816 series PMIC. This device consists of an i2c controlled MFD
  that includes regulators, a RTC, a gpio controller, and a power button.

properties:
  compatible:
    enum:
      - rockchip,rk816

  reg:
    maxItems: 1

  interrupts:
    maxItems: 1

  '#clock-cells':
    description: |
      See <dt-bindings/clock/rockchip,rk808.h> for clock IDs.
    const: 1

  clock-output-names:
    description:
      From common clock binding to override the default output clock name.
    maxItems: 2

  gpio-controller: true

  '#gpio-cells':
    const: 2

  system-power-controller:
    type: boolean
    description:
      Telling whether or not this PMIC is controlling the system power.

  wakeup-source:
    type: boolean
    description:
      Device can be used as a wakeup source.

  vcc1-supply:
    description:
      The input supply for DCDC_REG1.

  vcc2-supply:
    description:
      The input supply for DCDC_REG2.

  vcc3-supply:
    description:
      The input supply for DCDC_REG3.

  vcc4-supply:
    description:
      The input supply for DCDC_REG4.

  vcc5-supply:
    description:
      The input supply for LDO_REG1, LDO_REG2, and LDO_REG3.

  vcc6-supply:
    description:
      The input supply for LDO_REG4, LDO_REG5, and LDO_REG6.

  vcc7-supply:
    description:
      The input supply for BOOST.

  vcc8-supply:
    description:
      The input supply for OTG_SWITCH.

  regulators:
    type: object
    patternProperties:
      "^(DCDC_REG[1-4]|LDO_REG[1-6]|BOOST|OTG_SWITCH)$":
        type: object
        $ref: ../regulator/regulator.yaml#
        unevaluatedProperties: false
    unevaluatedProperties: false

required:
  - compatible
  - reg
  - interrupts
  - "#clock-cells"

additionalProperties: false

examples:
  - |
    #include <dt-bindings/pinctrl/rockchip.h>
    #include <dt-bindings/interrupt-controller/irq.h>
    #include <dt-bindings/gpio/gpio.h>

    i2c {
        #address-cells = <1>;
        #size-cells = <0>;

        rk816: pmic@1a {
            compatible = "rockchip,rk816";
            reg = <0x1a>;
            interrupt-parent = <&gpio0>;
            interrupts = <RK_PA2 IRQ_TYPE_LEVEL_LOW>;

            clock-output-names = "xin32k", "rk816-clkout2";
            pinctrl-names = "default";
            pinctrl-0 = <&pmic_int_l>;
            gpio-controller;
            system-power-controller;
            wakeup-source;
            #clock-cells = <1>;
            #gpio-cells = <2>;

            vcc1-supply = <&vcc_sys>;
            vcc2-supply = <&vcc_sys>;
            vcc3-supply = <&vcc_sys>;
            vcc4-supply = <&vcc_sys>;
            vcc5-supply = <&vcc33_io>;
            vcc6-supply = <&vcc_sys>;

            regulators {
                vdd_cpu: DCDC_REG1 {
                    regulator-name = "vdd_cpu";
                    regulator-min-microvolt = <750000>;
                    regulator-max-microvolt = <1450000>;
                    regulator-ramp-delay = <6001>;
                    regulator-initial-mode = <1>;
                    regulator-always-on;
                    regulator-boot-on;

                    regulator-state-mem {
                        regulator-off-in-suspend;
                    };
                };

                vdd_logic: DCDC_REG2 {
                    regulator-name = "vdd_logic";
                    regulator-min-microvolt = <800000>;
                    regulator-max-microvolt = <1250000>;
                    regulator-ramp-delay = <6001>;
                    regulator-initial-mode = <1>;
                    regulator-always-on;
                    regulator-boot-on;

                    regulator-state-mem {
                        regulator-on-in-suspend;
                        regulator-suspend-microvolt = <1000000>;
                    };
                };

                vcc_ddr: DCDC_REG3 {
                    regulator-name = "vcc_ddr";
                    regulator-initial-mode = <1>;
                    regulator-always-on;
                    regulator-boot-on;

                    regulator-state-mem {
                        regulator-on-in-suspend;
                    };
                };

                vcc33_io: DCDC_REG4 {
                    regulator-min-microvolt = <3300000>;
                    regulator-max-microvolt = <3300000>;
                    regulator-name = "vcc33_io";
                    regulator-initial-mode = <1>;
                    regulator-always-on;
                    regulator-boot-on;

                    regulator-state-mem {
                        regulator-on-in-suspend;
                        regulator-suspend-microvolt = <3300000>;
                    };
                };

                vccio_pmu: LDO_REG1 {
                    regulator-min-microvolt = <3300000>;
                    regulator-max-microvolt = <3300000>;
                    regulator-name = "vccio_pmu";
                    regulator-always-on;
                    regulator-boot-on;

                    regulator-state-mem {
                        regulator-on-in-suspend;
                        regulator-suspend-microvolt = <3300000>;
                    };
                };

                vcc_tp: LDO_REG2 {
                    regulator-min-microvolt = <3300000>;
                    regulator-max-microvolt = <3300000>;
                    regulator-name = "vcc_tp";

                    regulator-state-mem {
                        regulator-off-in-suspend;
                    };
                };

                vdd_10: LDO_REG3 {
                    regulator-min-microvolt = <1000000>;
                    regulator-max-microvolt = <1000000>;
                    regulator-name = "vdd_10";
                    regulator-always-on;
                    regulator-boot-on;

                    regulator-state-mem {
                        regulator-on-in-suspend;
                        regulator-suspend-microvolt = <1000000>;
                    };
                };

                vcc18_lcd: LDO_REG4 {
                    regulator-min-microvolt = <1800000>;
                    regulator-max-microvolt = <1800000>;
                    regulator-name = "vcc18_lcd";

                    regulator-state-mem {
                        regulator-on-in-suspend;
                        regulator-suspend-microvolt = <1800000>;
                    };
                };

                vccio_sd: LDO_REG5 {
                    regulator-min-microvolt = <1800000>;
                    regulator-max-microvolt = <3300000>;
                    regulator-name = "vccio_sd";

                    regulator-state-mem {
                        regulator-on-in-suspend;
                        regulator-suspend-microvolt = <3300000>;
                    };
                };

                vdd10_lcd: LDO_REG6 {
                    regulator-min-microvolt = <1000000>;
                    regulator-max-microvolt = <1000000>;
                    regulator-name = "vdd10_lcd";

                    regulator-state-mem {
                        regulator-on-in-suspend;
                        regulator-suspend-microvolt = <1000000>;
                    };
                };
            };
        };
    };
```

## Documentation/devicetree/bindings/mfd/rohm,bd79124.yaml
```yaml
# SPDX-License-Identifier: GPL-2.0-only OR BSD-2-Clause
%YAML 1.2
---
$id: http://devicetree.org/schemas/mfd/rohm,bd79124.yaml#
$schema: http://devicetree.org/meta-schemas/core.yaml#

title: ROHM BD79124 ADC/GPO

maintainers:
  - Matti Vaittinen <mazziesaccount@gmail.com>

description: |
  The ROHM BD79124 is a 12-bit, 8-channel, SAR ADC. The ADC supports
  an automatic measurement mode, with an alarm interrupt for out-of-window
  measurements. ADC input pins can be also configured as general purpose
  outputs.

properties:
  compatible:
    const: rohm,bd79124

  reg:
    description:
      I2C slave address.
    maxItems: 1

  interrupts:
    maxItems: 1

  gpio-controller: true

  "#gpio-cells":
    const: 1
    description:
      The pin number.

  vdd-supply: true

  iovdd-supply: true

patternProperties:
  "^channel@[0-9a-f]+$":
    type: object
    $ref: /schemas/iio/adc/adc.yaml#
    description: Represents ADC channel.

    properties:
      reg:
        items:
          minimum: 1
          maximum: 8

    required:
      - reg

    additionalProperties: false

  "-pins$":
    type: object
    $ref: /schemas/pinctrl/pinmux-node.yaml

    properties:
      function:
        enum: [gpo, adc]

      groups:
        description:
          List of pin groups affected by the functions specified in this
          subnode.
        items:
          enum: [ain0, ain1, ain2, ain3, ain4, ain5, ain6, ain7]

      pins:
        items:
          enum: [ain0, ain1, ain2, ain3, ain4, ain5, ain6, ain7]

    additionalProperties: false

required:
  - compatible
  - reg
  - iovdd-supply
  - vdd-supply

additionalProperties: false

examples:
  - |
    #include <dt-bindings/interrupt-controller/irq.h>
    #include <dt-bindings/leds/common.h>
    i2c {
        #address-cells = <1>;
        #size-cells = <0>;
        adc: adc@10 {
            compatible = "rohm,bd79124";
            reg = <0x10>;
            interrupt-parent = <&gpio1>;
            interrupts = <29 8>;
            vdd-supply = <&dummyreg>;
            iovdd-supply = <&dummyreg>;

            adcpins: adc-pins {
                pins = "ain0", "ain1", "ain5", "ain7";
                function = "adc";
            };
            gpopins: gpo-pins {
                groups = "ain2", "ain3", "ain4", "ain6";
                function = "gpo";
            };
        };
    };
```

## Documentation/devicetree/bindings/mfd/samsung,s2dos05.yaml
```yaml
# SPDX-License-Identifier: (GPL-2.0 OR BSD-2-Clause)
%YAML 1.2
---
$id: http://devicetree.org/schemas/mfd/samsung,s2dos05.yaml#
$schema: http://devicetree.org/meta-schemas/core.yaml#

title: Samsung S2DOS05 Power Management IC

maintainers:
  - Dzmitry Sankouski <dsankouski@gmail.com>

description:
  This is a device tree bindings for S2DOS family of Power Management IC (PMIC).

  The S2DOS05 is a companion power management IC for the panel and touchscreen
  in smart phones. Provides voltage regulators and
  ADC for power/current measurements.

  Regulator section has 4 LDO and 1 BUCK regulators and also
  provides ELVDD, ELVSS, AVDD lines.

properties:
  compatible:
    const: samsung,s2dos05

  reg:
    maxItems: 1

  regulators:
    patternProperties:
      "^buck1|ldo[1-4]$":
        type: object
        $ref: /schemas/regulator/regulator.yaml#
        unevaluatedProperties: false

        required:
          - regulator-name

    additionalProperties: false

required:
  - compatible
  - reg
  - regulators

additionalProperties: false

examples:
  - |
    i2c {
      #address-cells = <1>;
      #size-cells = <0>;

      pmic@60 {
        compatible = "samsung,s2dos05";
        reg = <0x60>;

            regulators {
                ldo1 {
                    regulator-name = "s2dos05-ldo1";
                    regulator-min-microvolt = <1500000>;
                    regulator-max-microvolt = <2000000>;
                    regulator-active-discharge = <0x1>;
                };

                ldo2 {
                    regulator-name = "s2dos05-ldo2";
                    regulator-min-microvolt = <1800000>;
                    regulator-max-microvolt = <1800000>;
                    regulator-active-discharge = <0x1>;
                    regulator-boot-on;
                };

                ldo3 {
                    regulator-name = "s2dos05-ldo3";
                    regulator-min-microvolt = <3000000>;
                    regulator-max-microvolt = <3000000>;
                    regulator-active-discharge = <0x1>;
                    regulator-boot-on;
                };

                ldo4 {
                    regulator-name = "s2dos05-ldo4";
                    regulator-min-microvolt = <2700000>;
                    regulator-max-microvolt = <3775000>;
                    regulator-active-discharge = <0x1>;
                };

                buck1 {
                    regulator-name = "s2dos05-buck1";
                    regulator-min-microvolt = <850000>;
                    regulator-max-microvolt = <2100000>;
                    regulator-active-discharge = <0x1>;
                };
            };
        };
    };

...
```

## Documentation/devicetree/bindings/mfd/samsung,s2mpg10.yaml
```yaml
# SPDX-License-Identifier: GPL-2.0-only OR BSD-2-Clause
%YAML 1.2
---
$id: http://devicetree.org/schemas/mfd/samsung,s2mpg10.yaml#
$schema: http://devicetree.org/meta-schemas/core.yaml#

title: Samsung S2MPG10 Power Management IC

maintainers:
  - André Draszik <andre.draszik@linaro.org>

description: |
  This is part of the device tree bindings for the S2MPG family of Power
  Management IC (PMIC).

  The Samsung S2MPG10 is a Power Management IC for mobile applications with buck
  converters, various LDOs, power meters, RTC, clock outputs, and additional
  GPIO interfaces.

properties:
  compatible:
    const: samsung,s2mpg10-pmic

  clocks:
    $ref: /schemas/clock/samsung,s2mps11.yaml
    description:
      Child node describing clock provider.

  interrupts:
    maxItems: 1

  regulators:
    type: object
    description:
      List of child nodes that specify the regulators.

  system-power-controller: true

  wakeup-source: true

patternProperties:
  "^vinb([1-9]|10)m-supply$":
    description:
      Phandle to the power supply for each buck rail of this PMIC. There is a
      1:1 mapping of supply to rail, e.g. vinb1m-supply supplies buck1m.

  "^vinl([1-9]|1[0-5])m-supply$":
    description: |
      Phandle to the power supply for one or multiple LDO rails of this PMIC.
      The mapping of supply to rail(s) is as follows:
        vinl1m - ldo13m
        vinl2m - ldo15m
        vinl3m - ldo1m, ldo5m, ldo7m
        vinl4m - ldo3m, ldo8m
        vinl5m - ldo16m
        vinl6m - ldo17m
        vinl7m - ldo6m, ldo11m, ldo24m, ldo28m
        vinl8m - ldo12m
        vinl9m - ldo2m, ldo4m
        vinl10m - ldo9m, ldo14m, ldo18m, 19m, ldo20m, ldo25m
        vinl11m - ldo23m, ldo31m
        vinl12m - ldo29m
        vinl13m - ldo30m
        vinl14m - ldo21m
        vinl15m - ldo10m, ldo22m, ldo26m, ldo27m

required:
  - compatible
  - interrupts
  - regulators

additionalProperties: false

allOf:
  - if:
      properties:
        compatible:
          contains:
            const: samsung,s2mpg10-pmic
    then:
      properties:
        regulators:
          $ref: /schemas/regulator/samsung,s2mpg10-regulator.yaml
```
