## Documentation/devicetree/bindings/mfd/renesas,r9a08g045-vbattb.yaml
```yaml
# SPDX-License-Identifier: (GPL-2.0-only OR BSD-2-Clause)
%YAML 1.2
---
$id: http://devicetree.org/schemas/mfd/renesas,r9a08g045-vbattb.yaml#
$schema: http://devicetree.org/meta-schemas/core.yaml#

title: Renesas Battery Backup Function (VBATTB)

description:
  Renesas VBATTB is an always on powered module (backed by battery) which
  controls the RTC clock (VBATTCLK), tamper detection logic and a small
  general usage memory (128B).

maintainers:
  - Claudiu Beznea <claudiu.beznea.uj@bp.renesas.com>

properties:
  compatible:
    const: renesas,r9a08g045-vbattb

  reg:
    maxItems: 1

  ranges: true

  interrupts:
    items:
      - description: tamper detector interrupt

  interrupt-names:
    items:
      - const: tampdi

  clocks:
    items:
      - description: VBATTB module clock

  clock-names:
    items:
      - const: bclk

  power-domains:
    maxItems: 1

  resets:
    items:
      - description: VBATTB module reset

  '#address-cells':
    const: 2

  '#size-cells':
    const: 2

patternProperties:
  "^clock-controller@1c+$":
    type: object
    description: VBATTCLK clock

    properties:
      compatible:
        const: renesas,r9a08g045-vbattb-clk

      reg:
        maxItems: 1

      clocks:
        items:
          - description: input clock for VBATTCLK

      clock-names:
        description: |
          Use xin if connected to an external crystal oscillator.
          Use clkin if connected to an external hardware device generating the
          clock.
        enum:
          - xin
          - clkin

      '#clock-cells':
        const: 0

      renesas,vbattb-load-nanofarads:
        description: load capacitance of the on board xtal
        $ref: /schemas/types.yaml#/definitions/uint32
        enum: [ 4000, 7000, 9000, 12500 ]

    required:
      - compatible
      - reg
      - clocks
      - clock-names
      - '#clock-cells'
      - renesas,vbattb-load-nanofarads

    additionalProperties: false

required:
  - compatible
  - reg
  - interrupts
  - interrupt-names
  - clocks
  - clock-names
  - power-domains
  - resets

additionalProperties: false

examples:
  - |
    #include <dt-bindings/clock/r9a08g045-cpg.h>
    #include <dt-bindings/interrupt-controller/arm-gic.h>

    vbattb@1005c000 {
        compatible = "renesas,r9a08g045-vbattb";
        reg = <0x1005c000 0x1000>;
        ranges = <0 0 0x1005c000 0 0x1000>;
        interrupts = <GIC_SPI 43 IRQ_TYPE_LEVEL_HIGH>;
        interrupt-names = "tampdi";
        clocks = <&cpg CPG_MOD R9A08G045_VBAT_BCLK>;
        clock-names = "bclk";
        power-domains = <&cpg>;
        resets = <&cpg R9A08G045_VBAT_BRESETN>;
        #address-cells = <2>;
        #size-cells = <2>;

        clock-controller@1c {
            compatible = "renesas,r9a08g045-vbattb-clk";
            reg = <0 0x1c 0 0x10>;
            clocks = <&vbattb_xtal>;
            clock-names = "xin";
            #clock-cells = <0>;
            renesas,vbattb-load-nanofarads = <12500>;
        };
    };
```

## Documentation/devicetree/bindings/mfd/renesas,rzg3s-vbattb.yaml
```yaml
# SPDX-License-Identifier: (GPL-2.0-only OR BSD-2-Clause)
%YAML 1.2
---
$id: http://devicetree.org/schemas/mfd/renesas,rzg3s-vbattb.yaml#
$schema: http://devicetree.org/meta-schemas/core.yaml#

title: Renesas Battery Backup Function (VBATTB)

description:
  Renesas VBATTB is a module which controls the RTC clock (VBATTCLK), tamper
  detection logic and a small general usage memory (128B).

maintainers:
  - Claudiu Beznea <claudiu.beznea.uj@bp.renesas.com>

properties:
  compatible:
    items:
      - const: renesas,rzg3s-vbattb
      - const: syscon
      - const: simple-mfd

  reg:
    maxItems: 1

  ranges: true

  interrupts:
    maxItems: 1

  interrupt-names:
    maxItems: 1

  clocks:
    maxItems: 1

  clock-names:
    maxItems: 1

  power-domains:
    maxItems: 1

  resets:
    maxItems: 1

  '#address-cells':
    const: 2

  '#size-cells':
    const: 2

patternProperties:
  "^clock-controller@[0-9a-f]+$":
    $ref: /schemas/clock/renesas,rzg3s-vbattb-clk.yaml#
    description: VBATTCLK clock

required:
  - compatible
  - reg
  - interrupts
  - interrupt-names
  - clocks
  - clock-names
  - power-domains
  - resets

additionalProperties: false

examples:
  - |
    #include <dt-bindings/clock/r9a08g045-cpg.h>
    #include <dt-bindings/interrupt-controller/arm-gic.h>

    vbattb: vbattb@1005c000 {
        compatible = "renesas,rzg3s-vbattb", "syscon", "simple-mfd";
        reg = <0x1005c000 0x1000>;
        ranges = <0 0 0x1005c000 0 0x1000>;
        interrupts = <GIC_SPI 43 IRQ_TYPE_LEVEL_HIGH>;
        interrupt-names = "tampdi";
        clocks = <&cpg CPG_MOD R9A08G045_VBAT_BCLK>;
        clock-names = "bclk";
        power-domains = <&cpg>;
        resets = <&cpg R9A08G045_VBAT_BRESETN>;
        #address-cells = <2>;
        #size-cells = <2>;
        status = "disabled";

        vbattclk: clock-controller@1c {
            compatible = "renesas,rzg3s-vbattb-clk";
            reg = <0 0x1c 0 0x10>;
            clocks = <&cpg CPG_MOD R9A08G045_VBAT_BCLK>, <&vbattb_xtal>;
            clock-names = "bclk", "vbattb_xtal";
            #clock-cells = <0>;
            power-domains = <&cpg>;
            status = "disabled";
        };
    };

...
```

## Documentation/devicetree/bindings/mfd/rockchip,rk801.yaml
```yaml
# SPDX-License-Identifier: GPL-2.0-only OR BSD-2-Clause
%YAML 1.2
---
$id: http://devicetree.org/schemas/mfd/rockchip,rk801.yaml#
$schema: http://devicetree.org/meta-schemas/core.yaml#

title: RK801 Power Management Integrated Circuit

maintainers:
  - Joseph Chen <chenjh@rock-chips.com>

description: |
  Rockchip RK801 series PMIC. This device consists of an i2c controlled MFD
  that includes multiple switchable regulators.

properties:
  compatible:
    enum:
      - rockchip,rk801

  reg:
    maxItems: 1

  interrupts:
    maxItems: 1

  rockchip,system-power-controller:
    type: boolean
    description:
      Telling whether or not this PMIC is controlling the system power.

  system-power-controller: true

  wakeup-source:
    type: boolean
    description:
      Device can be used as a wakeup source.

  vcc1-supply:
    description:
      The input supply for DCDC_REG1.

  vcc2-supply:
    description:
      The input supply for DCDC_REG2.

  vcc3-supply:
    description:
      The input supply for DCDC_REG3.

  vcc4-supply:
    description:
      The input supply for DCDC_REG4.

  vcc5-supply:
    description:
      The input supply for LDO_REG1.

  vcc6-supply:
    description:
      The input supply for LDO_REG2.

  vcc7-supply:
    description:
      The input supply for SWITCH_REG.

  regulators:
    type: object
    patternProperties:
      "^(DCDC_REG[1-4]|LDO_REG[1-2]|SWITCH_REG)$":
        type: object
        $ref: /schemas/regulator/regulator.yaml#
        unevaluatedProperties: false
    unevaluatedProperties: false

required:
  - compatible
  - reg
  - interrupts

additionalProperties: false

examples:
  - |
    #include <dt-bindings/pinctrl/rockchip.h>
    #include <dt-bindings/interrupt-controller/irq.h>
    #include <dt-bindings/gpio/gpio.h>
    i2c {
        #address-cells = <1>;
        #size-cells = <0>;

        rk801: rk801@27 {
            compatible = "rockchip,rk801";
            reg = <0x27>;
            interrupt-parent = <&gpio0>;
            interrupts = <RK_PC0 IRQ_TYPE_LEVEL_LOW>;
            pwrctrl-gpios = <&gpio0 RK_PC1 GPIO_ACTIVE_HIGH>;
            pinctrl-names = "default";
            pinctrl-0 = <&pmic_int_l>;
            rockchip,system-power-controller;
            wakeup-source;

            vcc1-supply = <&vcc12v_dcin>;
            vcc2-supply = <&vcc12v_dcin>;
            vcc3-supply = <&vcc5v0_sys>;
            vcc4-supply = <&vcc5v0_sys>;
            vcc5-supply = <&vcc3v3_sys>;
            vcc6-supply = <&vcc3v3_sys>;
            vcc7-supply = <&vcc3v3_sys>;

            regulators {
                vdd_cpu: DCDC_REG1 {
                    regulator-name = "vdd_cpu";
                    regulator-min-microvolt = <500000>;
                    regulator-max-microvolt = <1500000>;
                    regulator-initial-mode = <0x1>;
                    regulator-boot-on;
                    regulator-always-on;
                    regulator-state-mem {
                        regulator-mode = <0x2>;
                        regulator-off-in-suspend;
                        regulator-suspend-microvolt = <950000>;
                    };
                };

                vcc3v3_sys: DCDC_REG2 {
                    regulator-name = "vcc3v3_sys";
                    regulator-min-microvolt = <3300000>;
                    regulator-max-microvolt = <3300000>;
                    regulator-initial-mode = <0x1>;
                    regulator-boot-on;
                    regulator-always-on;
                    regulator-state-mem {
                        regulator-mode = <0x2>;
                        regulator-on-in-suspend;
                        regulator-suspend-microvolt = <3300000>;
                    };
                };

                vcc_ddr: DCDC_REG3 {
                    regulator-name = "vcc_ddr";
                    regulator-boot-on;
                    regulator-always-on;
                    regulator-state-mem {
                        regulator-mode = <0x2>;
                        regulator-on-in-suspend;
                    };
                };

                vdd_logic: DCDC_REG4 {
                    regulator-name = "vdd_logic";
                    regulator-min-microvolt = <500000>;
                    regulator-max-microvolt = <1500000>;
                    regulator-initial-mode = <0x1>;
                    regulator-boot-on;
                    regulator-always-on;
                    regulator-state-mem {
                        regulator-mode = <0x2>;
                        regulator-off-in-suspend;
                        regulator-suspend-microvolt = <900000>;
                    };
                };

                vdd0v9_sys: LDO_REG1 {
                    regulator-name = "vdd0v9_sys";
                    regulator-min-microvolt = <900000>;
                    regulator-max-microvolt = <900000>;
                    regulator-boot-on;
                    regulator-always-on;
                    regulator-state-mem {
                        regulator-off-in-suspend;
                        regulator-suspend-microvolt = <900000>;
                    };
                };

                vcc_1v8: LDO_REG2 {
                    regulator-name = "vcc_1v8";
                    regulator-min-microvolt = <1800000>;
                    regulator-max-microvolt = <1800000>;
                    regulator-boot-on;
                    regulator-always-on;
                    regulator-state-mem {
                        regulator-off-in-suspend;
                        regulator-suspend-microvolt = <1800000>;
                    };
                };

                vcc_3v3: SWITCH_REG {
                    regulator-name = "vcc_3v3";
                    regulator-boot-on;
                    regulator-always-on;
                    regulator-state-mem {
                        regulator-off-in-suspend;
                        regulator-suspend-microvolt = <3300000>;
                    };
                };
            };
        };
    };
```
