## Documentation/devicetree/bindings/mfd/ti,twl4030-power.yaml
```yaml
# SPDX-License-Identifier: (GPL-2.0-only OR BSD-2-Clause)
%YAML 1.2
---
$id: http://devicetree.org/schemas/mfd/ti,twl4030-power.yaml#
$schema: http://devicetree.org/meta-schemas/core.yaml#

title: Texas Instruments TWL4030-family Power Management Module

maintainers:
  - Peter Ujfalusi <peter.ujfalusi@gmail.com>

description: |
  The power management module inside the TWL family provides several facilities
  to control the power resources, including power scripts. For now, the
  binding only supports the complete shutdown of the system after poweroff.

properties:
  compatible:
    description: |
      The compatible string determines the specific power configuration.
        "ti,twl4030-power": Standard power control.
        "ti,twl4030-power-reset": Recommended for OMAP3530 and similar SoCs
          that require a special configuration for warm reset to work correctly.
        "ti,twl4030-power-idle": Loads the TI-recommended configuration for
          idle modes into the PMIC.
        "ti,twl4030-power-idle-osc-off": Uses the recommended idle configuration
          but also shuts down the external oscillator. This may not work on all
          boards depending on the oscillator wiring.

    enum:
      - ti,twl4030-power
      - ti,twl4030-power-reset
      - ti,twl4030-power-idle
      - ti,twl4030-power-idle-osc-off

  ti,system-power-controller:
    type: boolean
    description:
      Indicates that the TWL4030 is the power supply master of the system,
      allowing it to initiate system power-off.

  ti,use_poweroff:
    type: boolean
    description: Deprecated name for ti,system-power-controller.
    deprecated: true

required:
  - compatible

additionalProperties: false

examples:
  - |
    i2c {
      clock-frequency = <2600000>;
      #address-cells = <1>;
      #size-cells = <0>;

      twl: twl@48 {
        reg = <0x48>;
        interrupts = <7>; /* SYS_NIRQ cascaded to intc */
        interrupt-parent = <&intc>;

        twl_power: power {
          compatible = "ti,twl4030-power";
          ti,use_poweroff;
        };
      };
    };
```

## Documentation/devicetree/bindings/mfd/ti,twl6040.yaml
```yaml
# SPDX-License-Identifier: (GPL-2.0-only OR BSD-2-Clause)
%YAML 1.2
---
$id: http://devicetree.org/schemas/mfd/ti,twl6040.yaml#
$schema: http://devicetree.org/meta-schemas/core.yaml#

title: Texas Instruments TWL6040/TWL6041 Audio Codec

maintainers:
  - Peter Ujfalusi <peter.ujfalusi@gmail.com>

description:
  The TWL6040s are 8-channel high quality low-power audio codecs providing
  audio, vibra and GPO functionality on OMAP4+ platforms.
  They are connected to the host processor via i2c for commands, McPDM for
  audio data and commands.

properties:
  compatible:
    enum:
      - ti,twl6040
      - ti,twl6041

  reg:
    const: 0x4b

  interrupts:
    maxItems: 1

  gpio-controller: true

  '#gpio-cells':
    const: 1

  '#clock-cells':
    description: TWL6040 is a provider of PDMCLK which is used by McPDM.
    const: 0

  vio-supply:
    description: Regulator for the VIO supply.

  v2v1-supply:
    description: Regulator for the V2V1 supply.

  enable-active-high:
    type: boolean
    description: If present, powers on the device during boot.

  clocks:
    minItems: 1
    maxItems: 2
    description: Phandle to the clk32k and/or mclk clock providers.

  clock-names:
    minItems: 1
    maxItems: 2
    items:
      enum: [clk32k, mclk]

  # Vibra functionality :

  vddvibl-supply:
    description: Regulator for the left vibra motor supply.

  vddvibr-supply:
    description: Regulator for the right vibra motor supply.

  vibra:
    type: object
    description: Node for vibra motor configuration parameters.
    properties:
      ti,vibldrv-res:
        $ref: /schemas/types.yaml#/definitions/uint32
        description: Resistance parameter for the left driver.

      ti,vibrdrv-res:
        $ref: /schemas/types.yaml#/definitions/uint32
        description: Resistance parameter for the right driver.

      ti,viblmotor-res:
        $ref: /schemas/types.yaml#/definitions/uint32
        description: Resistance parameter for the left motor.

      ti,vibrmotor-res:
        $ref: /schemas/types.yaml#/definitions/uint32
        description: Resistance parameter for the right motor.

      vddvibl_uV:
        $ref: /schemas/types.yaml#/definitions/uint32
        description: Optional override for the VDDVIBL default voltage (in uV).

      vddvibr_uV:
        $ref: /schemas/types.yaml#/definitions/uint32
        description: Optional override for the VDDVIBR default voltage (in uV).
    required:
      - ti,vibldrv-res
      - ti,vibrdrv-res
      - ti,viblmotor-res
      - ti,vibrmotor-res
    additionalProperties: false

required:
  - compatible
  - reg
  - interrupts
  - gpio-controller
  - '#gpio-cells'
  - '#clock-cells'
  - vio-supply
  - v2v1-supply
  - vddvibl-supply
  - vddvibr-supply
  - vibra

additionalProperties: false

examples:
  - |
    #include <dt-bindings/interrupt-controller/arm-gic.h>
    i2c {
      #address-cells = <1>;
      #size-cells = <0>;

      audio-codec@4b {
        compatible = "ti,twl6040";
        reg = <0x4b>;

        interrupts = <GIC_SPI 119 IRQ_TYPE_LEVEL_HIGH>;
        interrupt-parent = <&gic>;

        gpio-controller;
        #gpio-cells = <1>;
        #clock-cells = <0>;

        vio-supply = <&v1v8>;
        v2v1-supply = <&v2v1>;
        enable-active-high;

        clocks = <&clk32k>;
        clock-names = "clk32k";

        /* regulators for vibra motor */
        vddvibl-supply = <&vbat>;
        vddvibr-supply = <&vbat>;

        vibra {
          /* Vibra driver, motor resistance parameters */
          ti,vibldrv-res = <8>;
          ti,vibrdrv-res = <3>;
          ti,viblmotor-res = <10>;
          ti,vibrmotor-res = <10>;
        };
      };
    };
```

## Documentation/devicetree/bindings/mfd/ti,usbhs-tll.yaml
```yaml
# SPDX-License-Identifier: (GPL-2.0-only OR BSD-2-Clause)
%YAML 1.2
---
$id: http://devicetree.org/schemas/mfd/ti,usbhs-tll.yaml#
$schema: http://devicetree.org/meta-schemas/core.yaml#

title: OMAP HS USB Host TLL (Transceiver-Less Interface)

maintainers:
  - <rogerq@kernel.org>

properties:
  compatible:
    enum:
      - ti,usbhs-tll

  reg:
    maxItems: 1

  interrupts:
    maxItems: 1

  clocks:
    minItems: 1

  clock-names:
    items:
      - const: usb_tll_hs_usb_ch0_clk
      - const: usb_tll_hs_usb_ch1_clk
      - const: usb_tll_hs_usb_ch2_clk
    minItems: 2

required:
  - compatible
  - reg
  - interrupts

additionalProperties: false

examples:
  - |
    usbhstll@4a062000 {
      compatible = "ti,usbhs-tll";
      reg = <0x4a062000 0x1000>;
      interrupts = <78>;
    };
```

## Documentation/devicetree/bindings/mfd/traverse,ten64-controller.yaml
```yaml
# SPDX-License-Identifier: (GPL-2.0-only OR BSD-2-Clause)
%YAML 1.2
---
$id: http://devicetree.org/schemas/mfd/traverse,ten64-controller.yaml#
$schema: http://devicetree.org/meta-schemas/core.yaml#

title: Traverse Ten64 board microcontroller

maintainers:
  - Mathew McBride <matt@traverse.com.au>

description: |
  The board microcontroller on the Ten64 board family is responsible for
  management of power sources on the board, as well as signalling the SoC
  to power on and reset.

  Communication between the SoC and controller is via I2C, at a fixed address
  of 0x7e. While the controller firmware implements several functions, there
  are presently no parameters that are configurable by DT properties, except
  those that are required of an I2C bus endpoint.

properties:
  compatible:
    const: traverse,ten64-controller

  reg:
    maxItems: 1

required:
  - compatible
  - reg

additionalProperties: false

examples:
  - |
    i2c {
        #address-cells = <1>;
        #size-cells = <0>;

        board-controller@7e {
            compatible = "traverse,ten64-controller";
            reg = <0x7e>;
        };
    };
```

## Documentation/devicetree/bindings/mfd/x-powers,ac200.yaml
```yaml
# SPDX-License-Identifier: (GPL-2.0-only OR BSD-2-Clause)
%YAML 1.2
---
$id: http://devicetree.org/schemas/mfd/x-powers,ac200.yaml#
$schema: http://devicetree.org/meta-schemas/core.yaml#

title: X-Powers AC200 mixed-signal IC

maintainers:
  - James Hilliard <james.hilliard1@gmail.com>
  - Jernej Skrabec <jernej.skrabec@gmail.com>

description:
  The AC200 is a mixed-signal companion IC containing audio, video, RTC and
  Fast Ethernet PHY functions. Its control registers are accessed over I2C.

properties:
  compatible:
    const: x-powers,ac200

  reg:
    maxItems: 1

  clocks:
    maxItems: 1
    description:
      AC200 input clock. When using the Ethernet PHY, its configured rate must
      be 24 or 27 MHz, matching the rates encoded by the documented EPHY clock
      selector.

  interrupts:
    maxItems: 1
    description:
      The shared open-drain INTB output for the TV encoder, Ethernet PHY and
      RTC interrupts. Omit when INTB is not connected.

  interrupt-controller: true

  '#interrupt-cells':
    const: 1
    description:
      The interrupt number, as defined in
      include/dt-bindings/mfd/x-powers,ac200.h.

  codec:
    type: object
    $ref: /schemas/sound/dai-common.yaml#
    unevaluatedProperties: false

    properties:
      compatible:
        const: x-powers,ac200-codec

      '#sound-dai-cells':
        const: 0

      ac-ldoin-supply:
        description: The 3.3 V supply for the audio codec LDO input.

    required:
      - compatible
      - '#sound-dai-cells'
      - ac-ldoin-supply

  tv-encoder:
    type: object
    additionalProperties: false

    properties:
      compatible:
        const: x-powers,ac200-tve

      interrupts:
        maxItems: 1
        description:
          Cable detection interrupt routed through the AC200 interrupt
          controller. Omit when INTB is not connected. Cable detection status
          can also be read over I2C without an interrupt.

      tv-vcc-supply:
        description: The 3.3 V supply for the composite-video DAC.

      nvmem-cells:
        maxItems: 1

      nvmem-cell-names:
        items:
          - const: bandgap

      ports:
        $ref: /schemas/graph.yaml#/properties/ports

        properties:
          port@0:
            $ref: /schemas/graph.yaml#/properties/port
            description: Input from the display pipeline, carrying CCIR656.

          port@1:
            $ref: /schemas/graph.yaml#/properties/port
            description: Output to the composite-video connector.

        required:
          - port@0
          - port@1

    required:
      - compatible
      - tv-vcc-supply
      - ports

    dependencies:
      nvmem-cells: [ nvmem-cell-names ]
      nvmem-cell-names: [ nvmem-cells ]

required:
  - compatible
  - reg
  - clocks

allOf:
  - if:
      properties:
        tv-encoder:
          anyOf:
            - required: [ interrupts ]
            - required: [ interrupts-extended ]
      required:
        - tv-encoder
    then:
      required:
        - interrupts
        - interrupt-controller
        - '#interrupt-cells'

dependencies:
  interrupt-controller: [ '#interrupt-cells', interrupts ]
  '#interrupt-cells': [ interrupt-controller ]

additionalProperties: false

examples:
  - |
    #include <dt-bindings/interrupt-controller/irq.h>
    #include <dt-bindings/mfd/x-powers,ac200.h>

    i2c {
        #address-cells = <1>;
        #size-cells = <0>;

        mixed-signal@10 {
            compatible = "x-powers,ac200";
            reg = <0x10>;
            clocks = <&pwm 5>;
            interrupt-parent = <&pio>;
            interrupts = <1 20 IRQ_TYPE_LEVEL_LOW>;
            interrupt-controller;
            #interrupt-cells = <1>;

            codec {
                compatible = "x-powers,ac200-codec";
                #sound-dai-cells = <0>;
                ac-ldoin-supply = <&reg_aldo2>;
            };

            tv-encoder {
                compatible = "x-powers,ac200-tve";
                interrupts = <AC200_IRQ_TVE>;
                tv-vcc-supply = <&reg_aldo2>;

                ports {
                    #address-cells = <1>;
                    #size-cells = <0>;

                    port@0 {
                        reg = <0>;

                        tve_in: endpoint {
                            remote-endpoint = <&tcon_out_tve>;
                        };
                    };

                    port@1 {
                        reg = <1>;

                        tve_out: endpoint {
                            remote-endpoint = <&composite_in>;
                        };
                    };
                };
            };
        };
    };
  - |
    i2c {
        #address-cells = <1>;
        #size-cells = <0>;

        mixed-signal@10 {
            compatible = "x-powers,ac200";
            reg = <0x10>;
            clocks = <&pwm 5>;
            /* INTB is not connected. */

            tv-encoder {
                compatible = "x-powers,ac200-tve";
                tv-vcc-supply = <&reg_aldo2>;

                ports {
                    #address-cells = <1>;
                    #size-cells = <0>;

                    port@0 {
                        reg = <0>;

                        endpoint {
                            remote-endpoint = <&tcon_out_tve>;
                        };
                    };

                    port@1 {
                        reg = <1>;

                        endpoint {
                            remote-endpoint = <&composite_in>;
                        };
                    };
                };
            };
        };
    };
...
```

## Documentation/devicetree/bindings/microchip/ip-versioning.txt
```
Devicetree compatible string versioning for Microchip FPGA IP blocks and reference designs

This document describes the versioning guidelines for compatible strings
used on Microchip FPGA IP blocks and reference designs.

IP block-specific compatible strings are in the form:
"microchip,<ip-block-name>-rtl-v<major version number>"
or optionally:
"microchip,<ip-block-name>-rtl-v<major version number>.<minor version number>"

<ip-block-name> should be the name of the IP in Libero's IP catalog.
In most cases a major version should be sufficient, as breaking changes are
intended to be accompanied by a version update, but if not, the optional minor
version should be used,

An example is:
  compatible = "microchip,corei2c-rtl-v7";

If the IP is integrated as a "hard" peripheral in an SoC, the expectation is
that there will be a fallback to the IP block it was derived from, if
appropriate, such as:
  compatible = "microchip,mpfs-i2c", "microchip,corei2c-rtl-v7";

The versioning scheme for reference designs that Microchip provides for its
development kits is similar:
"microchip,<soc>-<board>-reference-rtl-v<yymm>".

This should be followed by a fallback compatible belonging to the board itself:
"microchip,<soc>-<board>"
and then one for the soc:
"microchip,<soc>"

For example:
  compatible = "microchip,mpfs-icicle-reference-rtl-v2210", "microchip,mpfs-icicle-kit", "microchip,mpfs";
```
