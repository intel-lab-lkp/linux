## Documentation/devicetree/bindings/mfd/sie,cronos-cpld.yaml
```yaml
# SPDX-License-Identifier: (GPL-2.0 OR BSD-2-Clause)
# Copyright 2023 Raptor Engineering, LLC
%YAML 1.2
---
$id: http://devicetree.org/schemas/mfd/sie,cronos-cpld.yaml#
$schema: http://devicetree.org/meta-schemas/core.yaml#

title: SIE Cronos Platform Controller CPLD multi-function device

maintainers:
  - Timothy Pearson <tpearson@raptorengineering.com>

description: |
  The SIE Cronos Platform Controller CPLD is a multi-purpose platform controller
  that provides both a watchdog timer and an LED controller. As both functions
  are provided by the same CPLD, a multi-function device is exposed as the
  parent of both functions.

properties:
  compatible:
    const: sie,cronos-cpld

  reg:
    maxItems: 1

  '#address-cells':
    const: 1

  '#size-cells':
    const: 1

  leds:
    type: object
    description: Cronos Platform Status LEDs

    properties:
      compatible:
        const: sie,cronos-leds

  watchdog:
    type: object
    description: Cronos Platform Watchdog Timer

    properties:
      compatible:
        const: sie,cronos-watchdog

required:
  - compatible
  - reg

additionalProperties: false

examples:
  - |
    cpld: cpld@3f {
      compatible = "sie,cronos-cpld";
      reg = <0x3f>;

      watchdog {
        compatible = "sie,cronos-watchdog";
      };

      leds {
        compatible = "sie,cronos-leds";
      };
    };
```

## Documentation/devicetree/bindings/mfd/sony,cronos-cpld.yaml
```yaml
# SPDX-License-Identifier: (GPL-2.0 OR BSD-2-Clause)
# Copyright 2023 Raptor Engineering, LLC
%YAML 1.2
---
$id: http://devicetree.org/schemas/mfd/sony,cronos-cpld.yaml#
$schema: http://devicetree.org/meta-schemas/core.yaml#

title: Sony Cronos Platform Controller CPLD multi-function device

maintainers:
  - Timothy Pearson <tpearson@raptorengineering.com>

description: |
  The Sony Cronos Platform Controller CPLD is a multi-purpose platform
  controller that provides both a watchdog timer and an LED controller for the
  Sony Interactive Entertainment Cronos x86 server platform. As both functions
  are provided by the same CPLD, a multi-function device is exposed as the
  parent of both functions.

properties:
  compatible:
    const: sony,cronos-cpld

  reg:
    maxItems: 1

  leds:
    type: object
    description: Cronos Platform Status LEDs

    properties:
      compatible:
        const: sony,cronos-leds

      sony,led-mask:
        $ref: /schemas/types.yaml#/definitions/uint32
        minimum: 0x0
        maximum: 0x7fff
        description: |
          A bitmask that specifies which LEDs are present and can be controlled
          by the Cronos CPLD. Bits 0-5 correspond to platform Status LEDs, bits
          6-10 correspond to Link LEDs, and bits 11-14 correspond to the Power
          State LEDs. All other bits are unused. The default value is 0x7fff
          (all possible LEDs enabled).

    additionalProperties: false

  watchdog:
    type: object
    description: Cronos Platform Watchdog Timer

    properties:
      compatible:
        const: sony,cronos-watchdog

      sony,default-timeout:
        $ref: /schemas/types.yaml#/definitions/uint32
        description: |
          The default timeout with which the watchdog timer is initialized, in
          seconds. Supported values are: 10, 20, 30, 40, 50, 60, 70, 80. All
          other values will be rounded down to the nearest supported value.  The
          default value is 80.

    additionalProperties: false

required:
  - compatible
  - reg

additionalProperties: false

examples:
  - |
    i2c {
      #address-cells = <1>;
      #size-cells = <0>;

      cpld@3f {
        compatible = "sony,cronos-cpld";
        reg = <0x3f>;

        watchdog {
          compatible = "sony,cronos-watchdog";
          sony,default-timeout = <20>;
        };

        leds {
          compatible = "sony,cronos-leds";
          sony,led-mask = <0x7fff>;
        };
      };
    };
```

## Documentation/devicetree/bindings/mfd/sony,cronos-smc.yaml
```yaml
# SPDX-License-Identifier: (GPL-2.0 OR BSD-2-Clause)
# Copyright 2025-2026 Raptor Engineering, LLC
%YAML 1.2
---
$id: http://devicetree.org/schemas/mfd/sony,cronos-smc.yaml#
$schema: http://devicetree.org/meta-schemas/core.yaml#

title: Sony Cronos Platform Controller CPLD multi-function device

maintainers:
  - Georgy Yakovlev <Georgy.Yakovlev@sony.com>

description:
  The Sony Cronos Platform Controller CPLD is a multi-purpose platform
  controller that provides both a watchdog timer and an LED controller for the
  Sony Interactive Entertainment Cronos x86 server platform. As both functions
  are provided by the same CPLD, a multi-function device is exposed as the
  parent of both functions.

properties:
  compatible:
    const: sony,cronos-smc

  reg:
    maxItems: 1

  leds:
    type: object
    $ref: /schemas/leds/common.yaml#
    additionalProperties: false
    description: |
      The Cronos LED controller is a subfunction of the Cronos platform
      controller, which is a multi-function device.

      Each led is represented as a child node of sony,cronos-led. Fifteen RGB
      LEDs are supported by the platform.

    properties:
      compatible:
        const: sony,cronos-led

      reg:
        maxItems: 1

      "#address-cells":
        const: 1

      "#size-cells":
        const: 0

    patternProperties:
      "^multi-led@[0-9a-f]$":
        type: object
        $ref: /schemas/leds/leds-class-multicolor.yaml#
        unevaluatedProperties: false

        properties:
          reg:
            description:
              LED channel number (0..14)
            minimum: 0
            maximum: 14

        required:
          - reg

    required:
      - compatible
      - "#address-cells"
      - "#size-cells"

  watchdog:
    type: object

    $ref: /schemas/watchdog/watchdog.yaml

    properties:
      compatible:
        const: sony,cronos-watchdog

      timeout-sec: true

    required:
      - compatible

    additionalProperties: false

required:
  - compatible
  - reg

unevaluatedProperties: false

examples:
  - |
    #include <dt-bindings/leds/common.h>
    i2c {
        #address-cells = <1>;
        #size-cells = <0>;

        smc@3f {
            compatible = "sony,cronos-smc";
            reg = <0x3f>;

            watchdog {
                compatible = "sony,cronos-watchdog";

                timeout-sec = <20>;
            };

            leds {
                compatible = "sony,cronos-led";
                #address-cells = <1>;
                #size-cells = <0>;

                multi-led@0 {
                    /*
                     * No subnodes are needed, this controller only supports RGB
                     * LEDs.
                     */
                    reg = <0>;
                    color = <LED_COLOR_ID_MULTI>;
                    function = LED_FUNCTION_STATUS;
                };
            };
        };
    };
```

## Documentation/devicetree/bindings/mfd/sprd,sc2731.yaml
```yaml
# SPDX-License-Identifier: (GPL-2.0 OR BSD-2-Clause)
%YAML 1.2
---
$id: http://devicetree.org/schemas/mfd/sprd,sc2731.yaml#
$schema: http://devicetree.org/meta-schemas/core.yaml#

title: Spreadtrum SC27xx PMIC

maintainers:
  - Orson Zhai <orsonzhai@gmail.com>
  - Baolin Wang <baolin.wang7@gmail.com>
  - Chunyan Zhang <zhang.lyra@gmail.com>

description: |
  Spreadtrum PMICs belonging to the SC27xx series integrate all mobile handset
  power management, audio codec, battery management and user interface support
  functions in a single chip. They have 6 major functional blocks:
    - DCDCs to support CPU, memory
    - LDOs to support both internal and external requirements
    - Battery management system, such as charger, fuel gauge
    - Audio codec
    - User interface functions, such as indicator, flash LED and so on
    - IC level interface, such as power on/off control, RTC, typec and so on

properties:
  $nodename:
    pattern: '^pmic@[0-9a-f]+$'

  compatible:
    enum:
      - sprd,sc2720
      - sprd,sc2721
      - sprd,sc2723
      - sprd,sc2730
      - sprd,sc2731

  reg:
    maxItems: 1

  interrupts:
    maxItems: 1

  interrupt-controller: true
  spi-max-frequency: true

  '#address-cells':
    const: 1

  '#interrupt-cells':
    const: 1

  '#size-cells':
    const: 0

  regulators:
    type: object
    $ref: /schemas/regulator/sprd,sc2731-regulator.yaml#

patternProperties:
  "^adc@[0-9a-f]+$":
    type: object
    $ref: /schemas/iio/adc/sprd,sc2720-adc.yaml#

  "^charger@[0-9a-f]+$":
    type: object
    $ref: /schemas/power/supply/sc2731-charger.yaml#

  "^efuse@[0-9a-f]+$":
    type: object
    $ref: /schemas/nvmem/sprd,sc2731-efuse.yaml#

  "^fuel-gauge@[0-9a-f]+$":
    type: object
    $ref: /schemas/power/supply/sc27xx-fg.yaml#

  "^gpio@[0-9a-f]+$":
    type: object
    $ref: /schemas/gpio/sprd,gpio-eic.yaml#

  "^led-controller@[0-9a-f]+$":
    type: object
    $ref: /schemas/leds/sprd,sc2731-bltc.yaml#

  "^rtc@[0-9a-f]+$":
    type: object
    $ref: /schemas/rtc/sprd,sc2731-rtc.yaml#

  "^vibrator@[0-9a-f]+$":
    type: object
    $ref: /schemas/input/sprd,sc27xx-vibrator.yaml#

required:
  - compatible
  - reg
  - interrupts
  - interrupt-controller
  - spi-max-frequency
  - '#address-cells'
  - '#interrupt-cells'
  - '#size-cells'

additionalProperties: false

examples:
  - |
    #include <dt-bindings/interrupt-controller/arm-gic.h>
    #include <dt-bindings/interrupt-controller/irq.h>

    spi {
      #address-cells = <1>;
      #size-cells = <0>;

      pmic@0 {
        compatible = "sprd,sc2731";
        reg = <0>;
        interrupts = <GIC_SPI 31 IRQ_TYPE_LEVEL_HIGH>;
        interrupt-controller;
        spi-max-frequency = <26000000>;
        #address-cells = <1>;
        #interrupt-cells = <1>;
        #size-cells = <0>;
      };
    };
...
```

## Documentation/devicetree/bindings/mfd/sprd,sc27xx-pmic.yaml
```yaml
# SPDX-License-Identifier: (GPL-2.0 OR BSD-2-Clause)
%YAML 1.2
---
$id: http://devicetree.org/schemas/mfd/sprd,sc27xx-pmic.yaml#
$schema: http://devicetree.org/meta-schemas/core.yaml#

title: |
  Spreadtrum SC27xx and UMP96xx Power Management Integrated Circuit (PMIC)

maintainers:
  - Orson Zhai <orsonzhai@gmail.com>
  - Baolin Wang <baolin.wang7@gmail.com>
  - Chunyan Zhang <zhang.lyra@gmail.com>

description: |
  The Spreadtrum SC27xx series PMICs contain SC2720, SC2721, SC2723, SC2730, SC2731
  and UMP96xx series PMICs contain ump9620, ump962 and ump9622. The Spreadtrum PMIC
  belonging to SC27xx series and ump962x series integrates all mobile handset power
  management, audio codec, battery management and user interface support function in
  a single chip. It has 6 major functional.

blocks:
  - DCDCs to support CPU, memory.
  - LDOs to support both internal and external requirement.
  - Battery management system, such as charger, fuel gauge.
  - Audio codec.
  - User interface function, such as indicator, flash LED and so on.
  - IC level interface, such as power on/off control, RTC and typec and so on.

allOf:
  - $ref: /schemas/spi/sprd,spi-adi.yaml#

properties:
  compatible:
    enum:
      - sprd,sc2720
      - sprd,sc2721
      - sprd,sc2723
      - sprd,sc2730
      - sprd,sc2731
      - sprd,ump9620
      - sprd,ump9621
      - sprd,ump9622

  reg:
    maxItems: 7
    description: The address of the device chip select

  spi-max-frequency:
    default: 26000000

  interrupts: true

  interrupt-controller:
    description: Marks the device node as an interrupt controller.

  interrupt-cells:
    const: 2
    description: The number of cells to describe an PMIC IRQ, must be 2.

required:
  - compatible
  - reg
  - spi-max-frequency
  - '#address-cells' # Child device offset number of cells, must be 1.
  - '#size-cells' # Child device size number of cells, must be 0.

unevaluatedProperties: false

Example:
  - |
    adi_bus {
        pmic@0 {
            compatible = "sprd,sc2731";
            reg = <0>;
            spi-max-frequency = <26000000>;
            interrupts = <GIC_SPI 31 IRQ_TYPE_LEVEL_HIGH>;
            interrupt-controller;
            #interrupt-cells = <2>;
            #address-cells = <1>;
            #size-cells = <0>;
        };
    };
...
```

## Documentation/devicetree/bindings/mfd/starfive,jh7110-hdmi-subsystem.yaml
```yaml
# SPDX-License-Identifier: (GPL-2.0-only OR BSD-2-Clause)
%YAML 1.2
---
$id: http://devicetree.org/schemas/mfd/starfive,jh7110-hdmi-subsystem.yaml#
$schema: http://devicetree.org/meta-schemas/core.yaml#

title: StarFive JH7110 HDMI subsystem

maintainers:
  - Michal Wilczynski <m.wilczynski@samsung.com>

description:
  The StarFive JH7110 HDMI block is a monolithic IP containing both
  the digital controller logic and the analog PHY logic in a single
  register space. It sits inside the video output subsystem, which owns
  the NoC bus clock and reset gating this region and the power domain it
  belongs to.

properties:
  compatible:
    const: starfive,jh7110-hdmi-subsystem

  reg:
    maxItems: 1

  phy:
    $ref: /schemas/phy/starfive,jh7110-inno-hdmi-phy.yaml#

  controller:
    $ref: /schemas/display/bridge/starfive,jh7110-inno-hdmi-controller.yaml#

required:
  - compatible
  - reg
  - phy
  - controller

additionalProperties: false

examples:
  - |
    #include <dt-bindings/clock/starfive,jh7110-crg.h>
    #include <dt-bindings/reset/starfive,jh7110-crg.h>

    soc {
        #address-cells = <1>;
        #size-cells = <1>;

        hdmi@29590000 {
            compatible = "starfive,jh7110-hdmi-subsystem";
            reg = <0x29590000 0x4000>;

            controller {
                compatible = "starfive,jh7110-inno-hdmi-controller";
                clocks = <&voutcrg JH7110_VOUTCLK_HDMI_TX_SYS>,
                         <&voutcrg JH7110_VOUTCLK_HDMI_TX_MCLK>,
                         <&voutcrg JH7110_VOUTCLK_HDMI_TX_BCLK>,
                         <&hdmi_phy>;
                clock-names = "pclk", "mclk", "bclk", "pixel";
                interrupts = <99>;
                phys = <&hdmi_phy>;
                resets = <&voutcrg JH7110_VOUTRST_HDMI_TX_HDMI>;
                starfive,vout-syscon = <&vout_syscon>;

                ports {
                    #address-cells = <1>;
                    #size-cells = <0>;

                    port@0 {
                        reg = <0>;

                        endpoint {
                            remote-endpoint = <&dpu_out_dpi0>;
                        };
                    };

                    port@1 {
                        reg = <1>;

                        endpoint {
                            remote-endpoint = <&hdmi_con_in>;
                        };
                    };
                };
            };

            hdmi_phy: phy {
                compatible = "starfive,jh7110-inno-hdmi-phy";
                clocks = <&xin24m>;
                #clock-cells = <0>;
                #phy-cells = <0>;
            };
        };
    };
...
```
