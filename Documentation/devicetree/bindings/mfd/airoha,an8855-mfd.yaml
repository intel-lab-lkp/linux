## Documentation/devicetree/bindings/mfd/nvidia,vrs-pseq.yaml
```yaml
# SPDX-License-Identifier: (GPL-2.0-only OR BSD-2-Clause)
%YAML 1.2
---
$id: http://devicetree.org/schemas/mfd/nvidia,vrs-pseq.yaml#
$schema: http://devicetree.org/meta-schemas/core.yaml#

title: NVIDIA Voltage Regulator Specification Power Sequencer

maintainers:
  - Shubhi Garg <shgarg@nvidia.com>

description:
  NVIDIA Voltage Regulator Specification Power Sequencer device controls
  ON/OFF and suspend/resume power sequencing of system power rails for NVIDIA
  SoCs. It provides 32kHz RTC clock support with backup battery for system
  timing. The device also acts as an interrupt controller for managing
  interrupts from the VRS power sequencer.

properties:
  compatible:
    const: nvidia,vrs-pseq

  reg:
    maxItems: 1

  interrupts:
    maxItems: 1

  interrupt-controller: true

  '#interrupt-cells':
    const: 2
    description:
      The first cell is the IRQ number, the second cell is the trigger type.

required:
  - compatible
  - reg
  - interrupts
  - interrupt-controller
  - "#interrupt-cells"

additionalProperties: false

examples:
  - |
    #include <dt-bindings/interrupt-controller/irq.h>
    i2c {
        #address-cells = <1>;
        #size-cells = <0>;

        vrs@3c {
            compatible = "nvidia,vrs-pseq";
            reg = <0x3c>;
            interrupt-parent = <&pmc>;
            interrupts = <24 IRQ_TYPE_LEVEL_LOW>;
            interrupt-controller;
            #interrupt-cells = <2>;
       };
    };
```

## Documentation/devicetree/bindings/mfd/nxp,mc33978.yaml
```yaml
# SPDX-License-Identifier: (GPL-2.0-only OR BSD-2-Clause)
%YAML 1.2
---
$id: http://devicetree.org/schemas/mfd/nxp,mc33978.yaml#
$schema: http://devicetree.org/meta-schemas/core.yaml#

title: NXP MC33978/MC34978 Multiple Switch Detection Interface

maintainers:
  - David Jander <david@protonic.nl>
  - Oleksij Rempel <o.rempel@pengutronix.de>

description: |
  The MC33978 and MC34978 are Multiple Switch Detection Interface (MSDI)
  devices with 22 switch inputs, integrated fault detection, and analog
  multiplexer (AMUX) for voltage/temperature monitoring.

allOf:
  - $ref: /schemas/spi/spi-peripheral-props.yaml#

properties:
  compatible:
    enum:
      - nxp,mc33978
      - nxp,mc34978

  reg:
    maxItems: 1
    description: SPI chip select number

  spi-max-frequency:
    maximum: 8000000
    description: Maximum SPI clock frequency (up to 8 MHz)

  interrupts:
    maxItems: 1
    description: |
      INT_B pin interrupt. Active-low, indicates pin state changes or
      fault conditions.

  interrupt-controller: true

  '#interrupt-cells':
    const: 2
    description: |
      First cell is the IRQ number (0-21 for pins, 22 for faults).
      Second cell is the trigger type (IRQ_TYPE_* from interrupt-controller.h).

  vddq-supply:
    description: Digital supply voltage

  vbatp-supply:
    description: Battery/power supply

  pinctrl:
    type: object
    $ref: /schemas/pinctrl/nxp,mc33978-pinctrl.yaml#
    description: |
      Pinctrl and GPIO controller child node for the 22 switch inputs.

required:
  - compatible
  - reg
  - interrupts
  - interrupt-controller
  - '#interrupt-cells'

unevaluatedProperties: false

examples:
  - |
    #include <dt-bindings/interrupt-controller/irq.h>
    #include <dt-bindings/gpio/gpio.h>

    spi {
        #address-cells = <1>;
        #size-cells = <0>;

        msdi: mc33978@0 {
            compatible = "nxp,mc33978";
            reg = <0>;
            spi-max-frequency = <4000000>;

            interrupt-parent = <&gpiog>;
            interrupts = <9 IRQ_TYPE_LEVEL_LOW>;
            interrupt-controller;
            #interrupt-cells = <2>;

            vddq-supply = <&reg_3v3>;
            vbatp-supply = <&reg_12v>;

            pinctrl {
                compatible = "nxp,mc33978-pinctrl";
                gpio-controller;
                #gpio-cells = <2>;
            };
        };
    };
```

## Documentation/devicetree/bindings/mfd/nxp,p3h2840-i3c-hub.yaml
```yaml
# SPDX-License-Identifier: (GPL-2.0-only OR BSD-2-Clause)
# Copyright 2025 NXP

%YAML 1.2
---
$id: http://devicetree.org/schemas/mfd/nxp,p3h2840-i3c-hub.yaml#
$schema: http://devicetree.org/meta-schemas/core.yaml#

title: NXP P3H2X4X I3C HUB

maintainers:
  - Aman Kumar Pandey <aman.kumarpandey@nxp.com>
  - Vikash Bansal <vikash.bansal@nxp.com>

description: |
  P3H2x4x (P3H2440/P3H2441/P3H2840/P3H2841) is a family of multiport I3C
  hub devices that connect to:-
  1. A host CPU via I3C/I2C/SMBus bus on upstream side and connect to multiple
     peripheral devices on the downstream  side.
  2. Have two Controller Ports which can support either
     I2C/SMBus or I3C buses and connect to a CPU, BMC or SOC.
  3. P3H2840/ P3H2841 are 8 port I3C hub with eight I3C/I2C Target Port.
  4. P3H2440/ P3H2441 are 4 port I3C hub with four I3C/I2C Target Port.
     Target ports can be configured as I2C/SMBus, I3C or GPIO and connect to
     peripherals.

allOf:
  - $ref: /schemas/i3c/i3c.yaml#

properties:
  compatible:
    items:
      - const: nxp,p3h2840

  cp0-ldo-microvolt:
    description:
      Selects the voltage for controller Port 0, in microvolts.
    enum: [1000000, 1100000, 1200000, 1800000]
    default: 1000000

  cp1-ldo-microvolt:
    description:
      Selects the voltage for controller Port 1, in microvolts.
    enum: [1000000, 1100000, 1200000, 1800000]
    default: 1000000

  tp0145-ldo-microvolt:
    description:
      Selects the voltage for target Port 0/1/4/5, in microvolts.
    enum: [1000000, 1100000, 1200000, 1800000]
    default: 1000000

  tp2367-ldo-microvolt:
    description:
      Selects the voltage for target Port 2/3/6/7, in microvolts.
    enum: [1000000, 1100000, 1200000, 1800000]
    default: 1000000

  tp0145-pullup-ohms:
    description:
      Selects the pull up resistance for target Port 0/1/4/5, in ohms.
    enum: [250, 500, 1000, 2000]
    default: 500

  tp2367-pullup-ohms:
    description:
      Selects the pull up resistance for target Port 2/3/6/7, in ohms.
    enum: [250, 500, 1000, 2000]
    default: 500

  cp0-io-strength-ohms:
    description:
      Selects the IO drive strength for controller Port 0, in ohms.
    enum: [20, 30, 40, 50]
    default: 20

  cp1-io-strength-ohms:
    description:
      Selects the IO drive strength for controller Port 1, in ohms.
    enum: [20, 30, 40, 50]
    default: 20

  tp0145-io-strength-ohms:
    description:
      Selects the IO drive strength for target port 0/1/4/5, in ohms.
    enum: [20, 30, 40, 50]
    default: 20

  tp2367-io-strength-ohms:
    description:
      Selects the IO drive strength for target port 2/3/6/7, in ohms.
    enum: [20, 30, 40, 50]
    default: 20

  cp0-supply:
    description: Phandle to voltage regulator providing power to controller port 0.

  cp1-supply:
    description: Phandle to voltage regulator providing power to controller port 1.

  tp0145-supply:
    description: Phandle to voltage regulator providing power to target port 0/1/4/5.

  tp2367-supply:
    description: Phandle to voltage regulator providing power to target port 2/3/6/7.

  regulators:
    type: object
    additionalProperties: false

    properties:
      cp0:
        type: object
        $ref: /schemas/regulator/regulator.yaml#
        unevaluatedProperties: false

      cp1:
        type: object
        $ref: /schemas/regulator/regulator.yaml#
        unevaluatedProperties: false

      tp0145:
        type: object
        $ref: /schemas/regulator/regulator.yaml#
        unevaluatedProperties: false

      tp2367:
        type: object
        $ref: /schemas/regulator/regulator.yaml#
        unevaluatedProperties: false

patternProperties:
  "^i3c@[0-7]$":
    type: object
    $ref: /schemas/i3c/i3c.yaml#
    unevaluatedProperties: false

    properties:
      reg:
        description:
          The I3C HUB Target Port number.
        maxItems: 1

      pullup-enable:
        type: boolean
        description:
          Enables the on-die pull-up for Target Port.

  "^(i2c|smbus)@[0-7]$":
    type: object
    $ref: /schemas/i2c/i2c-controller.yaml#
    unevaluatedProperties: false

    properties:
      reg:
        description:
          The I3C HUB Target Port number.
        maxItems: 1

      pullup-enable:
        type: boolean
        description:
          Enables the on-die pull-up for Target Port.

unevaluatedProperties: false

examples:
  - |
    i3c {
        #address-cells = <3>;
        #size-cells = <0>;

        hub@70,236153000c2 {
            reg = <0x70 0x236 0x3000c2>;
            #address-cells = <1>;
            #size-cells = <0>;
            assigned-address = <0x50>;

            cp0-ldo-microvolt = <1800000>;
            cp1-ldo-microvolt = <1800000>;
            tp0145-ldo-microvolt = <1800000>;
            tp2367-ldo-microvolt = <1800000>;
            tp0145-pullup-ohm = <1000>;
            tp2367-pullup-ohm = <1000>;
            cp0-io-strength-ohm = <50>;
            cp1-io-strength-ohm = <50>;
            tp0145-io-strength-ohm = <50>;
            tp2367-io-strength-ohm = <50>;
            cp0-supply = <&cp0>;
            tp0145-supply = <&tp0145>;
            tp2367-supply = <&tp2367>;

            regulators {
                cp0 {
                    regulator-name = "cp0";
                    regulator-min-microvolt = <1000000>;
                    regulator-max-microvolt = <1800000>;
                };

                cp1 {
                    regulator-name = "cp1";
                    regulator-min-microvolt = <1000000>;
                    regulator-max-microvolt = <1800000>;
                };

                tp0145 {
                    regulator-name = "tp0145";
                    regulator-min-microvolt = <1000000>;
                    regulator-max-microvolt = <1800000>;
                };

                tp2367 {
                    regulator-name = "tp2367";
                    regulator-min-microvolt = <1000000>;
                    regulator-max-microvolt = <1800000>;
                };
            };

            smbus@0 {
                reg = <0x0>;
                #address-cells = <1>;
                #size-cells = <0>;
                pullup-enable;
            };

            i2c@1 {
                reg = <0x1>;
                #address-cells = <1>;
                #size-cells = <0>;
                pullup-enable;
            };

            i3c@2 {
                reg = <0x2>;
                #address-cells = <3>;
                #size-cells = <0>;
                pullup-enable;
            };
        };
    };
```

## Documentation/devicetree/bindings/mfd/nxp,siul2.yaml
```yaml
# SPDX-License-Identifier: (GPL-2.0-only OR BSD-2-Clause)
# Copyright 2024 NXP
%YAML 1.2
---
$id: http://devicetree.org/schemas/mfd/nxp,siul2.yaml#
$schema: http://devicetree.org/meta-schemas/core.yaml#

title: System Integration Unit Lite2 (SIUL2)

maintainers:
  - Andrei Stefanescu <andrei.stefanescu@oss.nxp.com>

description: |
  SIUL2 is a hardware block which implements pinmuxing,
  pinconf, GPIOs (some with interrupt capability) and
  registers which contain information about the SoC.
  There are generally two SIUL2 modules whose functionality
  is grouped together. For example interrupt configuration
  registers are part of SIUL2_1 even though interrupts are
  also available for SIUL2_0 pins.

  The following register types are exported by SIUL2:
    - MIDR (MCU ID Register) - information related to the SoC
    - interrupt configuration registers
    - MSCR (Multiplexed Signal Configuration Register) - pinmuxing and pinconf
    - IMCR (Input Multiplexed Signal Configuration Register)- pinmuxing
    - PGPDO (Parallel GPIO Pad Data Out Register) - GPIO output value
    - PGPDI (Parallel GPIO Pad Data In Register) - GPIO input value

  Most registers are 32bit wide with the exception of PGPDO/PGPDI which are
  16bit wide.

properties:
  compatible:
    enum:
      - nxp,s32g2-siul2
      - nxp,s32g3-siul2

  reg:
    items:
      - description: SIUL2_0 module memory
      - description: SIUL2_1 module memory

  reg-names:
    items:
      - const: siul20
      - const: siul21

  gpio-controller: true

  '#gpio-cells':
    const: 2

  gpio-ranges:
    minItems: 2
    maxItems: 2

  gpio-reserved-ranges:
    minItems: 2

  interrupts:
    maxItems: 1

  interrupt-controller: true

  '#interrupt-cells':
    const: 2

  nvmem-layout:
    $ref: /schemas/nvmem/layouts/nvmem-layout.yaml#
    description:
      This container may reference an NVMEM layout parser.

patternProperties:
  '-hog(-[0-9]+)?$':
    required:
      - gpio-hog

  '-pins$':
    type: object
    additionalProperties: false

    patternProperties:
      '-grp[0-9]$':
        type: object
        allOf:
          - $ref: /schemas/pinctrl/pinmux-node.yaml#
          - $ref: /schemas/pinctrl/pincfg-node.yaml#
        description:
          Pinctrl node's client devices specify pin muxes using subnodes,
          which in turn use the standard properties below.

        properties:
          bias-disable: true
          bias-high-impedance: true
          bias-pull-up: true
          bias-pull-down: true
          drive-open-drain: true
          input-enable: true
          output-enable: true

          pinmux:
            description: |
              An integer array for representing pinmux configurations of
              a device. Each integer consists of a PIN_ID and a 4-bit
              selected signal source(SSS) as IOMUX setting, which is
              calculated as: pinmux = (PIN_ID << 4 | SSS)

          slew-rate:
            description: Supported slew rate based on Fmax values (MHz)
            enum: [83, 133, 150, 166, 208]

        additionalProperties: false

required:
  - compatible
  - reg
  - reg-names
  - gpio-controller
  - "#gpio-cells"
  - gpio-ranges
  - gpio-reserved-ranges
  - interrupts
  - interrupt-controller
  - "#interrupt-cells"

additionalProperties: false

examples:
  - |
    #include <dt-bindings/interrupt-controller/arm-gic.h>
    #include <dt-bindings/interrupt-controller/irq.h>

    siul2: siul2@4009c000 {
      compatible = "nxp,s32g2-siul2";
      reg = <0x4009c000 0x179c>,
            <0x44010000 0x17b0>;
      reg-names = "siul20", "siul21";
      gpio-controller;
      #gpio-cells = <2>;
      gpio-ranges = <&siul2 0 0 102>, <&siul2 112 112 79>;
      gpio-reserved-ranges = <102 10>, <123 21>;
      interrupt-controller;
      #interrupt-cells = <2>;
      interrupts = <GIC_SPI 210 IRQ_TYPE_LEVEL_HIGH>;

      jtag_pins: jtag-pins {
        jtag-grp0 {
          pinmux = <0x0>;
          input-enable;
          bias-pull-up;
          slew-rate = <166>;
        };

        jtag-grp1 {
          pinmux = <0x11>;
          slew-rate = <166>;
        };

        jtag-grp2 {
          pinmux = <0x40>;
          input-enable;
          bias-pull-down;
          slew-rate = <166>;
        };

        jtag-grp3 {
          pinmux = <0x23c0>,
                   <0x23d0>,
                   <0x2320>;
        };

        jtag-grp4 {
          pinmux = <0x51>;
          input-enable;
          bias-pull-up;
          slew-rate = <166>;
        };
      };

      nvmem-layout {
        compatible = "fixed-layout";
        #address-cells = <1>;
        #size-cells = <1>;

        soc-major@0 {
          reg = <0 0x4>;
        };
      };
    };
...
```
