## Documentation/devicetree/bindings/mfd/airoha,an8855-mfd.yaml
```yaml
# SPDX-License-Identifier: (GPL-2.0-only OR BSD-2-Clause)
%YAML 1.2
---
$id: http://devicetree.org/schemas/mfd/airoha,an8855-mfd.yaml#
$schema: http://devicetree.org/meta-schemas/core.yaml#

title: Airoha AN8855 Switch SoC

maintainers:
  - Christian Marangi <ansuelsmth@gmail.com>

description: >
  Airoha AN8855 Switch is a SoC that expose various peripherals like an
  Ethernet Switch, a NVMEM provider and Ethernet PHYs.

  It does also support i2c and timers but those are not currently
  supported/used.

properties:
  compatible:
    const: airoha,an8855-mfd

  reg:
    minItems: 1
    maxItems: 5

  reg-names:
    minItems: 1
    maxItems: 5

  efuse:
    type: object
    $ref: /schemas/nvmem/airoha,an8855-efuse.yaml
    description:
      EFUSE exposed by the Airoha AN8855 Switch. This child node definition
      should follow the bindings specified in
      Documentation/devicetree/bindings/nvmem/airoha,an8855-efuse.yaml

  ethernet-switch:
    type: object
    $ref: /schemas/net/dsa/airoha,an8855-switch.yaml
    description:
      Switch exposed by the Airoha AN8855 Switch. This child node definition
      should follow the bindings specified in
      Documentation/devicetree/bindings/net/dsa/airoha,an8855-switch.yaml

  mdio:
    type: object
    $ref: /schemas/net/airoha,an8855-mdio.yaml
    description:
      MDIO exposed by the Airoha AN8855 Switch. This child node definition
      should follow the bindings specified in
      Documentation/devicetree/bindings/net/airoha,an8855-mdio.yaml

required:
  - compatible
  - reg
  - reg-names

additionalProperties: false

examples:
  - |
    #include <dt-bindings/gpio/gpio.h>

    mdio {
        #address-cells = <1>;
        #size-cells = <0>;

        mfd@1 {
            compatible = "airoha,an8855-mfd";
            reg = <1>, <2>;
            reg-names = "phy0", "phy1";

            efuse {
                compatible = "airoha,an8855-efuse";

                #nvmem-cell-cells = <0>;

                nvmem-layout {
                    compatible = "fixed-layout";
                    #address-cells = <1>;
                    #size-cells = <1>;

                    shift_sel_port0_tx_a: shift-sel-port0-tx-a@c {
                       reg = <0xc 0x4>;
                    };

                    shift_sel_port0_tx_b: shift-sel-port0-tx-b@10 {
                        reg = <0x10 0x4>;
                    };

                    shift_sel_port0_tx_c: shift-sel-port0-tx-c@14 {
                        reg = <0x14 0x4>;
                    };

                    shift_sel_port0_tx_d: shift-sel-port0-tx-d@18 {
                       reg = <0x18 0x4>;
                    };

                    shift_sel_port1_tx_a: shift-sel-port1-tx-a@1c {
                        reg = <0x1c 0x4>;
                    };

                    shift_sel_port1_tx_b: shift-sel-port1-tx-b@20 {
                        reg = <0x20 0x4>;
                    };

                    shift_sel_port1_tx_c: shift-sel-port1-tx-c@24 {
                       reg = <0x24 0x4>;
                    };

                    shift_sel_port1_tx_d: shift-sel-port1-tx-d@28 {
                        reg = <0x28 0x4>;
                    };
                };
            };

            ethernet-switch {
                compatible = "airoha,an8855-switch";

                reset-gpios = <&pio 39 0>;

                airoha,ext-surge;

                ports {
                    #address-cells = <1>;
                    #size-cells = <0>;

                    port@0 {
                        reg = <0>;
                        label = "lan1";
                        phy-mode = "internal";
                        phy-handle = <&internal_phy1>;
                    };

                    port@1 {
                        reg = <1>;
                        label = "lan2";
                        phy-mode = "internal";
                        phy-handle = <&internal_phy2>;
                    };

                    port@5 {
                        reg = <5>;
                        label = "cpu";
                        ethernet = <&gmac0>;
                        phy-mode = "2500base-x";

                        fixed-link {
                            speed = <2500>;
                            full-duplex;
                            pause;
                        };
                    };
                };
            };

            mdio {
                compatible = "airoha,an8855-mdio";
                #address-cells = <1>;
                #size-cells = <0>;

                internal_phy1: phy@1 {
                  reg = <1>;

                  nvmem-cells = <&shift_sel_port0_tx_a>,
                      <&shift_sel_port0_tx_b>,
                      <&shift_sel_port0_tx_c>,
                      <&shift_sel_port0_tx_d>;
                  nvmem-cell-names = "tx_a", "tx_b", "tx_c", "tx_d";
                };

                internal_phy2: phy@2 {
                  reg = <2>;

                  nvmem-cells = <&shift_sel_port1_tx_a>,
                      <&shift_sel_port1_tx_b>,
                      <&shift_sel_port1_tx_c>,
                      <&shift_sel_port1_tx_d>;
                  nvmem-cell-names = "tx_a", "tx_b", "tx_c", "tx_d";
                };
            };
        };
    };
```

## Documentation/devicetree/bindings/mfd/airoha,en7581-scu-sysctl.yaml
```yaml
# SPDX-License-Identifier: (GPL-2.0 OR BSD-2-Clause)
%YAML 1.2
---
$id: http://devicetree.org/schemas/mfd/airoha,en7581-scu-sysctl.yaml#
$schema: http://devicetree.org/meta-schemas/core.yaml#

title: Airoha EN7581 SCU (System Controller Unit)

maintainers:
  - Christian Marangi <ansuelsmth@gmail.com>

description:
  Airoha EN7581 SoC expose registers to control miscellaneous
  pheriperals via the SCU (System Controller Unit).

  Example of these pheriperals are reset-controller, clock-controller,
  PCIe line speed controller and bits to configure different Serdes ports
  for USB or Ethernet usage.

properties:
  compatible:
    items:
      - const: airoha,en7581-scu-sysctl
      - const: syscon
      - const: simple-mfd

  reg:
    maxItems: 1

  clock-controller:
    type: object
    $ref: /schemas/clock/airoha,en7523-scu.yaml
    description:
      Child node definition for EN7581 Clock controller

  system-controller:
    type: object
    $ref: /schemas/soc/airoha/airoha,an7581-scu-ssr.yaml
    description:
      Child node definition for EN7581 System Status Register

required:
  - compatible
  - reg

additionalProperties: false

examples:
  - |
    #include <dt-bindings/soc/airoha,scu-ssr.h>

    system-controller@1fb00000 {
        compatible = "airoha,en7581-scu-sysctl", "syscon", "simple-mfd";
        reg = <0x1fb00000 0x970>;

        clock-controller {
            compatible = "airoha,en7581-scu";

            #clock-cells = <1>;
            #reset-cells = <1>;
        };

        system-controller {
            compatible = "airoha,an7581-scu-ssr";

            airoha,serdes-usb2 = <AIROHA_SCU_SSR_USB2_PCIE2>;
        };
    };
```

## Documentation/devicetree/bindings/mfd/ams,as3722.yaml
```yaml
# SPDX-License-Identifier: (GPL-2.0-only OR BSD-2-Clause)
%YAML 1.2
---
$id: http://devicetree.org/schemas/mfd/ams,as3722.yaml#
$schema: http://devicetree.org/meta-schemas/core.yaml#

title: AMS AS3722 Power Management IC

maintainers:
  - Laxman Dewangan <ldewangan@nvidia.com>
  - Lee Jones <lee.jones@linaro.org>

properties:
  compatible:
    const: ams,as3722

  reg:
    maxItems: 1

  interrupts:
    maxItems: 1

  # standard properties
  interrupt-controller:
    description:
      The AS3722 has an internal interrupt controller which takes the interrupt
      request from internal sub-blocks like RTC, regulators, GPIOs as well as
      external input.

  "#interrupt-cells":
    description:
      The first cell is the IRQ number. IRQ numbers for different interrupt
      source of AS3722 are defined at dt-bindings/mfd/as3722.h. The second cell
      is the flags, as defined in dt-bindings/interrupt-controller/irq.h.

    const: 2

  # from gpio.yaml
  gpio-controller: true

  "#gpio-cells":
    const: 2

  # optional properties
  ams,enable-internal-int-pullup:
    description:
      Enable internal pullup on interrupt pin when present. Omitting this will
      disable internal pullup on INT pin.

    $ref: /schemas/types.yaml#/definitions/flag

  ams,enable-internal-i2c-pullup:
    description:
      Enable internal pullup on I2C SCL/SDA pins when present. Omitting this
      will disable internal pullup on I2C SCL/SDA lines.

    $ref: /schemas/types.yaml#/definitions/flag

  ams,enable-ac-ok-power-on:
    description:
      When present, enable exit out of power off mode with AC_OK pin (pin
      enabled in power off mode).

    $ref: /schemas/types.yaml#/definitions/flag

  ams,system-power-controller:
    description:
      The AS3722 supports the system power off by turning off all its rails.
      The device node should contain this boolean property to enable this
      functionality.

    $ref: /schemas/types.yaml#/definitions/flag

  pinmux:
    description:
      Device has 8 GPIO pins which can be configured as GPIO as well as the
      special IO functions.

    type: object
    additionalProperties: false

    patternProperties:
      "^gpio[0-7_]+$":
        description:
          Child nodes of the pinmux node represent some desired configuration
          for a list of pins. This configuration can include the mux function
          to select on those pin(s), and various pin configuration parameters,
          such as pull-up, open drain.

        type: object
        allOf:
          - $ref: ../pinctrl/pincfg-node.yaml#
          - $ref: ../pinctrl/pinmux-node.yaml#
        additionalProperties: false

        properties:
          pins:
            items:
              enum: [ gpio0, gpio1, gpio2, gpio3, gpio4, gpio5, gpio6, gpio7 ]

          function:
            enum: [ gpio, interrupt-out, gpio-in-interrupt,
                    vsup-vbat-low-undebounce-out, vsup-vbat-low-debounce-out,
                    voltage-in-standby, oc-pg-sd0, oc-pg-sd6, powergood-out,
                    pwm-in, pwm-out, clk32k-out, watchdog-in, soft-reset-in ]

          bias-pull-up:
            type: boolean

          bias-pull-down:
            type: boolean

          bias-disable: true
          bias-high-impedance: true
          drive-open-drain: true

        required:
          - pins

  regulators:
    description:
      Device has multiple DCDC and LDOs. The node "regulators" is required if
      regulator functionality is needed.

    type: object
    additionalProperties: false

    properties:
      vsup-sd2-supply:
        description: input supply for SD2

      vsup-sd3-supply:
        description: input supply for SD3

      vsup-sd4-supply:
        description: input supply for SD4

      vsup-sd5-supply:
        description: input supply for SD5

      vin-ldo0-supply:
        description: input supply for LDO0

      vin-ldo1-6-supply:
        description: input supply for LDO1 and LDO6

      vin-ldo2-5-7-supply:
        description: input supply for LDO2, LDO5 and LDO7

      vin-ldo3-4-supply:
        description: input supply for LDO3 and LDO4

      vin-ldo9-10-supply:
        description: input supply for LDO9 and LDO10

      vin-ldo11-supply:
        description: input supply for LDO11

    patternProperties:
      "^(sd[0-6]|ldo[0-7]|ldo9|ldo10|ldo11)$":
        description:
          These sub-nodes must be named after one of the regulators found on
          the AS3277. Each sub-node should contain the constraints and
          initialization information for that regulator.

        $ref: /schemas/regulator/regulator.yaml#
        unevaluatedProperties: false
        type: object

        properties:
          ams,ext-control:
            description:
              External control of the rail. The value of this property will
              tell which external input is controlling this rail. Valid values
              are 0, 1, 2 ad 3. If this property does not exist, the default
              value is 0. The external control pin macros are defined in
              dt-bindings/mfd/as3722.h.

            $ref: /schemas/types.yaml#/definitions/uint32
            oneOf:
              - description: there is no external control of this rail
                const: 0
              - description: rail is controlled by ENABLE1 input pin
                const: 1
              - description: rail is controlled by ENABLE2 input pin
                const: 2
              - description: rail is controlled by ENABLE3 input pin
                const: 3
            default: 0

          ams,enable-tracking:
            description: Enable tracking with SD1, only supported by LDO3.

            $ref: /schemas/types.yaml#/definitions/flag

unevaluatedProperties: false

required:
  - compatible
  - reg
  - interrupt-controller
  - "#interrupt-cells"
  - gpio-controller
  - "#gpio-cells"

allOf:
  - $ref: /schemas/gpio/gpio.yaml

examples:
  - |
    #include <dt-bindings/mfd/as3722.h>

    i2c {
        #address-cells = <1>;
        #size-cells = <0>;

        pmic@48 {
            compatible = "ams,as3722";
            reg = <0x48>;

            ams,system-power-controller;

            interrupt-parent = <&intc>;
            interrupt-controller;
            #interrupt-cells = <2>;

            gpio-controller;
            #gpio-cells = <2>;

            pinctrl-names = "default";
            pinctrl-0 = <&as3722_default>;

            as3722_default: pinmux {
                gpio0 {
                    pins = "gpio0";
                    function = "gpio";
                    bias-pull-down;
                };

                gpio1_2_4_7 {
                    pins = "gpio1", "gpio2", "gpio4", "gpio7";
                    function = "gpio";
                    bias-pull-up;
                };

                gpio5 {
                    pins = "gpio5";
                    function = "clk32k-out";
                };
            };

            regulators {
                vsup-sd2-supply = <&vdd_5v0_sys>;

                sd0 {
                    regulator-name = "vdd_cpu";
                    regulator-min-microvolt = <700000>;
                    regulator-max-microvolt = <1400000>;
                    regulator-always-on;
                    ams,ext-control = <2>;
                };

                sd1 {
                    regulator-name = "vdd_core";
                    regulator-min-microvolt = <700000>;
                    regulator-max-microvolt = <1400000>;
                    regulator-always-on;
                    ams,ext-control = <1>;
                };

                sd2 {
                    regulator-name = "vddio_ddr";
                    regulator-min-microvolt = <1350000>;
                    regulator-max-microvolt = <1350000>;
                    regulator-always-on;
                };

                sd4 {
                    regulator-name = "avdd-hdmi-pex";
                    regulator-min-microvolt = <1050000>;
                    regulator-max-microvolt = <1050000>;
                    regulator-always-on;
                };

                sd5 {
                    regulator-name = "vdd-1v8";
                    regulator-min-microvolt = <1800000>;
                    regulator-max-microvolt = <1800000>;
                    regulator-always-on;
                };
            };
        };
    };
```
