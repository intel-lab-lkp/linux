## Documentation/devicetree/bindings/mfd/fsl,mc13xxx.yaml
```yaml
# SPDX-License-Identifier: (GPL-2.0-only OR BSD-2-Clause)
%YAML 1.2
---
$id: http://devicetree.org/schemas/mfd/fsl,mc13xxx.yaml#
$schema: http://devicetree.org/meta-schemas/core.yaml#

title: Freescale MC13xxx Power Management Integrated Circuits (PMIC)

maintainers:
  - Alexander Kurz <akurz@blala.de>

description:
  The MC13xxx PMIC series consists of the three models MC13783, MC13892
  and MC34708 and provide regulators and other features like RTC, ADC,
  LED, touchscreen, codec and input buttons.

  Link to datasheets
    https://www.nxp.com/docs/en/data-sheet/MC13783.pdf
    https://www.nxp.com/docs/en/data-sheet/MC13892.pdf
    https://www.nxp.com/docs/en/data-sheet/MC34708.pdf

properties:
  compatible:
    enum:
      - fsl,mc13783
      - fsl,mc13892
      - fsl,mc34708

  reg:
    description: I2C slave address or SPI chip select number.
    maxItems: 1

  spi-max-frequency: true

  spi-cs-high: true

  system-power-controller: true

  interrupts:
    maxItems: 1

  buttons:
    type: object
    $ref: /schemas/input/input.yaml#
    description: Buttons
    properties:
      reg:
        description: |
          One of
          MC13783 BUTTON IDs:
            0: ONOFD1
            1: ONOFD2
            2: ONOFD3
          MC13892 BUTTON IDs:
            0: PWRON1
            1: PWRON2
            2: PWRON3
          MC34708 BUTTON IDs:
            0: PWRON1
            1: PWRON2

      debounce-delay-ms:
        enum: [0, 30, 150, 750]
        default: 30
        description: |
          Sets the debouncing delay in milliseconds.
          Valid values: 0, 30, 150 and 750ms.

      active-low:
        description: Set active when pin is pulled low.

      fsl,enable-reset:
        description: |
          Setting of the global reset option.
        type: boolean

  leds:
    type: object
    $ref: /schemas/leds/common.yaml#
    description: |
      Leds
    properties:
      reg:
        description: |
          One of
          MC13783 LED IDs
            0: Main display
            1: AUX display
            2: Keypad
            3: Red 1
            4: Green 1
            5: Blue 1
            6: Red 2
            7: Green 2
            8: Blue 2
            9: Red 3
            10: Green 3
            11: Blue 3
          MC13892 LED IDs
            0: Main display
            1: AUX display
            2: Keypad
            3: Red
            4: Green
            5: Blue
          MC34708 LED IDs
            0: Charger Red
            1: Charger Green
        maxItems: 1
      fsl,led-control:
        $ref: /schemas/types.yaml#/definitions/uint32-array
        description: |
          Setting for LED-Control register array length depends on model,
          mc13783: 6, mc13892: 4, mc34708: 1

  regulators:
    type: object
    $ref: /schemas/regulator/regulator.yaml#
    description: |
      List of child nodes specifying the regulators, depending on chip variant:
      * MC13783: gpo[1-4], pwgt[12]spi, sw[12][ab], sw3, vaudio, vcam, vdig,
      vesim, vgen, viohi, violo, vmmc[12], vrf[12], vrfbg, vrfcp, vrfdig,
      vrfref, vsim and vvib.
      * MC13892: gpo[1-4], pwgt[12]spi, sw[1-4], swbst, vaudio, vcam, vcoincell,
      vdig, vgen[1-3], viohi, vpll, vsd, vusb, vusb2, vvideo.
      Each child node is defined using the standard binding for regulators and
      the optional regulator properties defined below.

  fsl,mc13xxx-uses-adc:
    type: boolean
    description: Indicate the ADC is being used

  fsl,mc13xxx-uses-codec:
    type: boolean
    description: Indicate the Audio Codec is being used

  fsl,mc13xxx-uses-rtc:
    type: boolean
    description: Indicate the RTC is being used

  fsl,mc13xxx-uses-touch:
    type: boolean
    description: Indicate the touchscreen controller is being used

required:
  - compatible
  - reg

allOf:
  - if:
      properties:
        compatible:
          contains:
            const: fsl,mc13783
    then:
      properties:
        buttons:
          properties:
            reg:
              enum: [0, 1, 2]
        leds:
          properties:
            fsl,led-control:
              minItems: 6
              maxItems: 6
        regulators:
          patternProperties:
            "^gpo[1-4]|pwgt[12]spi|sw[12][ab]|sw3|vaudio|vcam|vdig|vesim|vgen|viohi|violo|vmmc[12]|vrf[12]|vrfbg|vrfcp|vrfdig|vrfref|vsim|vvib$":
              type: object
              $ref: /schemas/regulator/regulator.yaml#

  - if:
      properties:
        compatible:
          contains:
            const: fsl,mc13892
    then:
      properties:
        buttons:
          properties:
            reg:
              enum: [0, 1, 2]
        leds:
          properties:
            fsl,led-control:
              minItems: 4
              maxItems: 4
        regulators:
          patternProperties:
            "^gpo[1-4]|pwgt[12]spi|sw[1-4]|swbst|vaudio|vcam|vcoincell|vdig|vgen[1-3]|viohi|vpll|vsd|vusb|vusb2|vvideo$":
              type: object
              $ref: /schemas/regulator/regulator.yaml#

  - if:
      properties:
        compatible:
          contains:
            const: fsl,mc34708
    then:
      properties:
        buttons:
          properties:
            reg:
              enum: [0, 1]
        leds:
          properties:
            fsl,led-control:
              minItems: 1
              maxItems: 1

additionalProperties: false

examples:
  - |
    #include <dt-bindings/gpio/gpio.h>
    #include <dt-bindings/interrupt-controller/irq.h>
    #include <dt-bindings/leds/common.h>

    spi {
        #address-cells = <1>;
        #size-cells = <0>;

        pmic: mc13892@0 {
            compatible = "fsl,mc13892";
            reg = <0>;
            spi-max-frequency = <1000000>;
            spi-cs-high;
            interrupt-parent = <&gpio0>;
            interrupts = <8 IRQ_TYPE_LEVEL_HIGH>;
            fsl,mc13xxx-uses-rtc;
            fsl,mc13xxx-uses-adc;

            buttons {
                #address-cells = <1>;
                #size-cells = <0>;
                onkey1@0 {
                    reg = <0>;
                    debounce-delay-ms = <30>;
                    active-low;
                    fsl,enable-reset;
                };
            };

            leds {
                #address-cells = <1>;
                #size-cells = <0>;
                fsl,led-control = <0x000 0x000 0x0e0 0x000>;

                sysled@3 {
                    reg = <3>;
                    label = "system:red:live";
                    linux,default-trigger = "heartbeat";
                };
            };

            regulators {
                sw1_reg: sw1 {
                    regulator-min-microvolt = <600000>;
                    regulator-max-microvolt = <1375000>;
                    regulator-boot-on;
                    regulator-always-on;
                };

                sw2_reg: sw2 {
                    regulator-min-microvolt = <900000>;
                    regulator-max-microvolt = <1850000>;
                    regulator-boot-on;
                    regulator-always-on;
                };
            };
        };
    };
```

## Documentation/devicetree/bindings/mfd/khadas,mcu.yaml
```yaml
# SPDX-License-Identifier: (GPL-2.0-only OR BSD-2-Clause)
%YAML 1.2
---
$id: http://devicetree.org/schemas/mfd/khadas,mcu.yaml#
$schema: http://devicetree.org/meta-schemas/core.yaml#

title: Khadas on-board Microcontroller

maintainers:
  - Neil Armstrong <neil.armstrong@linaro.org>

description: |
  Khadas embeds a microcontroller on their VIM and Edge boards adding some
  system feature as PWM Fan control (for VIM2 rev14, VIM3, Edge2), User memory
  storage, IR/Key resume control, system power LED control and more.

properties:
  compatible:
    enum:
      - khadas,mcu    # Used by VIM2 rev14, VIM3
      - khadas,mcu-v2 # Used by Edge2

  "#cooling-cells": # Only needed for boards having FAN control feature
    const: 2

  reg:
    maxItems: 1

required:
  - compatible
  - reg

additionalProperties: false

examples:
  - |
    i2c {
      #address-cells = <1>;
      #size-cells = <0>;
      khadas_mcu: system-controller@18 {
        compatible = "khadas,mcu";
        reg = <0x18>;
        #cooling-cells = <2>;
      };
    };
```

## Documentation/devicetree/bindings/mfd/max7360.yaml
```yaml
# SPDX-License-Identifier: (GPL-2.0-only OR BSD-2-Clause)
%YAML 1.2
---
$id: http://devicetree.org/schemas/mfd/max7360.yaml#
$schema: http://devicetree.org/meta-schemas/core.yaml#

title: Maxim MAX7360 Keypad, Rotary encoder, PWM and GPIO controller

maintainers:
  - Kamel Bouhara <kamel.bouhara@bootlin.com>
  - Mathieu Dubois-Briand <mathieu.dubois-briand@bootlin.com>

description: |
  Maxim MAX7360 MFD device, with following functions:
    - keypad controller
    - rotary controller
    - GPIO and GPO controller
    - PWM controller

  https://www.analog.com/en/products/max7360.html

properties:
  compatible:
    enum:
      - maxim,max7360

  reg:
    maxItems: 1

  interrupts:
    description: The interrupt line the device is connected to.
    maxItems: 1

required:
  - compatible
  - reg
  - interrupts

unevaluatedProperties: false

examples:
  - |
    #include <dt-bindings/interrupt-controller/arm-gic.h>

    i2c {
      #address-cells = <1>;
      #size-cells = <0>;

      max7360@38 {
        compatible = "maxim,max7360";
        reg = <0x38>;

        interrupt-parent = <&gpio1>;
        interrupts = <23 IRQ_TYPE_LEVEL_LOW>;
      };
    };
```

## Documentation/devicetree/bindings/mfd/maxim,max7360.yaml
```yaml
# SPDX-License-Identifier: (GPL-2.0-only OR BSD-2-Clause)
%YAML 1.2
---
$id: http://devicetree.org/schemas/mfd/maxim,max7360.yaml#
$schema: http://devicetree.org/meta-schemas/core.yaml#

title: Maxim MAX7360 Keypad, Rotary encoder, PWM and GPIO controller

maintainers:
  - Kamel Bouhara <kamel.bouhara@bootlin.com>
  - Mathieu Dubois-Briand <mathieu.dubois-briand@bootlin.com>

description: |
  Maxim MAX7360 device, with following functions:
    - keypad controller
    - rotary controller
    - GPIO and GPO controller
    - PWM controller

  https://www.analog.com/en/products/max7360.html

allOf:
  - $ref: /schemas/input/matrix-keymap.yaml#
  - $ref: /schemas/input/input.yaml#

properties:
  compatible:
    enum:
      - maxim,max7360

  reg:
    maxItems: 1

  interrupts:
    maxItems: 2

  interrupt-names:
    items:
      - const: inti
      - const: intk

  keypad-debounce-delay-ms:
    description: Keypad debounce delay in ms
    minimum: 9
    maximum: 40
    default: 9

  rotary-debounce-delay-ms:
    description: Rotary encoder debounce delay in ms
    minimum: 0
    maximum: 15
    default: 0

  linux,axis:
    description: The input subsystem axis to map to this rotary encoder.

  "#pwm-cells":
    const: 3

  gpio:
    $ref: /schemas/gpio/maxim,max7360-gpio.yaml#
    description:
      PORT0 to PORT7 general purpose input/output pins configuration.

  gpo:
    $ref: /schemas/gpio/maxim,max7360-gpio.yaml#
    description: >
      COL2 to COL7 general purpose output pins configuration.
      Allows to use unused keypad columns as outputs.
      The MAX7360 has 8 column lines and 6 of them can be used as GPOs. GPIOs
      numbers used for this gpio-controller node do correspond to the column
      numbers: values 0 and 1 are never valid, values from 2 to 7 might be valid
      depending on the value of the keypad,num-column property.

patternProperties:
  '-pins$':
    type: object
    description:
      Pinctrl node's client devices use subnodes for desired pin configuration.
      Client device subnodes use below standard properties.
    $ref: /schemas/pinctrl/pincfg-node.yaml

    properties:
      pins:
        description:
          List of gpio pins affected by the properties specified in this
          subnode.
        items:
          pattern: '^PORT[0-7]|ROTARY$'
        minItems: 1
        maxItems: 8

      function:
        description:
          Specify the alternative function to be configured for the specified
          pins.
        enum: [gpio, pwm, rotary]

    additionalProperties: false

required:
  - compatible
  - reg
  - interrupts
  - interrupt-names
  - linux,keymap
  - linux,axis
  - "#pwm-cells"
  - gpio
  - gpo

unevaluatedProperties: false

examples:
  - |
    #include <dt-bindings/input/input.h>
    #include <dt-bindings/interrupt-controller/arm-gic.h>

    i2c {
      #address-cells = <1>;
      #size-cells = <0>;

      io-expander@38 {
        compatible = "maxim,max7360";
        reg = <0x38>;

        interrupt-parent = <&gpio1>;
        interrupts = <23 IRQ_TYPE_LEVEL_LOW>,
                     <24 IRQ_TYPE_LEVEL_LOW>;
        interrupt-names = "inti", "intk";

        keypad,num-rows = <8>;
        keypad,num-columns = <4>;
        linux,keymap = <
          MATRIX_KEY(0x00, 0x00, KEY_F5)
          MATRIX_KEY(0x01, 0x00, KEY_F4)
          MATRIX_KEY(0x02, 0x01, KEY_F6)
          >;
        keypad-debounce-delay-ms = <10>;
        autorepeat;

        rotary-debounce-delay-ms = <2>;
        linux,axis = <0>; /* REL_X */

        #pwm-cells = <3>;

        max7360_gpio: gpio {
          compatible = "maxim,max7360-gpio";

          gpio-controller;
          #gpio-cells = <2>;
          maxim,constant-current-disable = <0x06>;

          interrupt-controller;
          #interrupt-cells = <0x2>;
        };

        max7360_gpo: gpo {
          compatible = "maxim,max7360-gpo";

          gpio-controller;
          #gpio-cells = <2>;
        };

        backlight_pins: backlight-pins {
          pins = "PORT2";
          function = "pwm";
        };
      };
    };
```
