## Documentation/devicetree/bindings/mfd/asus,ec.yaml
```yaml
# SPDX-License-Identifier: (GPL-2.0 OR BSD-2-Clause)
%YAML 1.2
---
$id: http://devicetree.org/schemas/mfd/asus,ec.yaml#
$schema: http://devicetree.org/meta-schemas/core.yaml#

title: ASUS Transformer's Embedded Controller

description:
  Several Nuvoton based Embedded Controller attached to an I2C bus,
  running a custom ASUS firmware, specific to the Asus Transformer
  device series.

maintainers:
  - Svyatoslav Ryhel <clamor95@gmail.com>

properties:
  compatible:
    oneOf:
      - enum:
          - asus,ec-pad  # Pad part of Asus Transformer
          - asus,ec-dock # Dock part of Asus Transformer
  reg:
    maxItems: 1

  interrupts:
    maxItems: 1

  request-gpio:
    maxItems: 1

  asus,dockram:
    $ref: /schemas/types.yaml#/definitions/phandle
    description: I2C device used to access power related functions.

  asus,clear-factory-mode:
    type: boolean
    description: clear Factory Mode bit in EC control register

  battery:
    type: object
    $ref: /schemas/power/supply/power-supply.yaml
    unevaluatedProperties: false

    properties:
      compatible:
        const: asus,ec-battery

    required:
      - compatible

  charger:
    type: object
    $ref: /schemas/power/supply/power-supply.yaml
    additionalProperties: false

    properties:
      compatible:
        const: asus,ec-charger

      monitored-battery: true

    required:
      - compatible

  keyboard-ext:
    type: object
    description: top row of multimedia keys
    additionalProperties: false

    properties:
      compatible:
        const: asus,ec-keys

    required:
      - compatible

  led:
    type: object
    additionalProperties: false

    properties:
      compatible:
        const: asus,ec-led

    required:
      - compatible

  serio:
    type: object
    description: keyboard and touchpad
    additionalProperties: false

    properties:
      compatible:
        const: asus,ec-kbc

    required:
      - compatible

required:
  - compatible
  - reg
  - interrupts
  - request-gpio
  - asus,dockram

additionalProperties: false

examples:
  - |
    #include <dt-bindings/gpio/gpio.h>
    #include <dt-bindings/interrupt-controller/irq.h>

    i2c {
      #address-cells = <1>;
      #size-cells = <0>;

      embedded-controller@19 {
        compatible = "asus,ec-dock";
        reg = <0x19>;

        interrupt-parent = <&gpio>;
        interrupts = <151 IRQ_TYPE_LEVEL_LOW>;

        request-gpio = <&gpio 134 GPIO_ACTIVE_LOW>;
        asus,dockram = <&dockram_ec>;

        battery {
          compatible = "asus,ec-battery";
          monitored-battery = <&dock_battery>;
        };

        charger {
          compatible = "asus,ec-charger";
          monitored-battery = <&dock_battery>;
        };

        keyboard-ext {
          compatible = "asus,ec-keys";
        };

        led {
          compatible = "asus,ec-led";
        };

        serio {
          compatible = "asus,ec-kbc";
        };
      };
    };
...
```

## Documentation/devicetree/bindings/mfd/cirrus,cs40l26.yaml
```yaml
# SPDX-License-Identifier: GPL-2.0-only OR BSD-2-Clause
%YAML 1.2
---
$id: http://devicetree.org/schemas/mfd/cirrus,cs40l26.yaml#
$schema: http://devicetree.org/meta-schemas/core.yaml#

title: Cirrus Logic CS40L26 Boosted Haptic Amplifier

maintainers:
  - Fred Treven <ftreven@opensource.cirrus.com>
  - patches@opensource.cirrus.com

description:
  CS40L26 is a Boosted Haptic Driver with Integrated DSP, Waveform Memory,
  Advanced Closed Loop Algorithms, and LRA protection

properties:
  compatible:
    enum:
      - cirrus,cs40l26a
      - cirrus,cs40l27b

  reg:
    maxItems: 1

  interrupts:
    maxItems: 1

  reset-gpios:
    maxItems: 1

  va-supply:
    description: Regulator for VA analog voltage

  vp-supply:
    description: Regulator for VP voltage

  cirrus,bst-ipk-microamp:
    description:
      Maximum current that can be drawn by the device's boost converter.
    multipleOf: 50000
    minimum: 1600000
    maximum: 4800000
    default: 4500000

  cirrus,bst-ctl-microvolt:
    description: Maximum target voltage to which DSP may increase the VBST supply.
    multipleOf: 50000
    minimum: 2550000
    maximum: 11000000
    default: 11000000

required:
  - compatible
  - reg
  - interrupts
  - reset-gpios

additionalProperties: false

examples:
  - |
    #include <dt-bindings/gpio/gpio.h>
    #include <dt-bindings/interrupt-controller/irq.h>

    i2c {
      #address-cells = <1>;
      #size-cells = <0>;

      haptic-driver@58 {
        compatible = "cirrus,cs40l26a";
        reg = <0x58>;
        interrupt-parent = <&gpio>;
        interrupts = <57 IRQ_TYPE_LEVEL_LOW>;
        reset-gpios = <&gpio 54 GPIO_ACTIVE_LOW>;
        va-supply = <&vreg>;
        vp-supply = <&vreg>;
        cirrus,bst-ctl-microvolt = <2600000>;
        cirrus,bst-ipk-microamp = <1650000>;
      };
    };
```

## Documentation/devicetree/bindings/mfd/dlg,da9062.yaml
```yaml
# SPDX-License-Identifier: (GPL-2.0-only OR BSD-2-Clause)
%YAML 1.2
---
$id: http://devicetree.org/schemas/mfd/dlg,da9062.yaml#
$schema: http://devicetree.org/meta-schemas/core.yaml#

title: Dialog DA9062 Power Management Integrated Circuit (PMIC)

maintainers:
  - Biju Das <biju.das.jz@bp.renesas.com>

description: |
  Product information for the DA9062 and DA9061 devices can be found here:
  - https://www.dialog-semiconductor.com/products/da9062
  - https://www.dialog-semiconductor.com/products/da9061

  The DA9062 PMIC consists of:

  Device                   Supply Names    Description
  ------                   ------------    -----------
  da9062-regulator        :               : LDOs & BUCKs
  da9062-rtc              :               : Real-Time Clock
  da9062-onkey            :               : On Key
  da9062-watchdog         :               : Watchdog Timer
  da9062-thermal          :               : Thermal
  da9062-gpio             :               : GPIOs

  The DA9061 PMIC consists of:

  Device                   Supply Names    Description
  ------                   ------------    -----------
  da9062-regulator        :               : LDOs & BUCKs
  da9062-onkey            :               : On Key
  da9062-watchdog         :               : Watchdog Timer
  da9062-thermal          :               : Thermal

properties:
  compatible:
    enum:
      - dlg,da9062
      - dlg,da9061

  reg:
    maxItems: 1

  interrupts:
    maxItems: 1

  interrupt-controller: true

  "#interrupt-cells":
    const: 2

  gpio-controller: true

  "#gpio-cells":
    const: 2

  watchdog:
    type: object
    $ref: /schemas/watchdog/watchdog.yaml#
    unevaluatedProperties: false
    properties:
      compatible:
        const: dlg,da9062-watchdog

      dlg,use-sw-pm:
        type: boolean
        description:
          Disable the watchdog during suspend.
          Only use this option if you can't use the watchdog automatic suspend
          function during a suspend (see register CONTROL_B).

  rtc:
    type: object
    $ref: /schemas/rtc/rtc.yaml#
    unevaluatedProperties: false
    properties:
      compatible:
        const: dlg,da9062-rtc

  thermal:
    type: object
    unevaluatedProperties: false
    properties:
      compatible:
        const: dlg,da9062-thermal

  gpio:
    type: object
    $ref: /schemas/gpio/gpio.yaml#
    unevaluatedProperties: false
    properties:
      compatible:
        const: dlg,da9062-gpio

  onkey:
    type: object
    $ref: /schemas/input/input.yaml#
    unevaluatedProperties: false
    properties:
      compatible:
        const: dlg,da9062-onkey

      dlg,disable-key-power:
        type: boolean
        description: |
          Disable power-down using a long key-press.
          If this entry does not exist then by default the key-press triggered
          power down is enabled and the OnKey will support both KEY_POWER and
          KEY_SLEEP.

  regulators:
    type: object
    additionalProperties: false
    patternProperties:
      "^(ldo[1-9]|buck[1-4])$":
        $ref: /schemas/regulator/regulator.yaml
        unevaluatedProperties: false

required:
  - compatible
  - reg

additionalProperties: false

examples:
  - |
    #include <dt-bindings/interrupt-controller/irq.h>
    #include <dt-bindings/regulator/dlg,da9063-regulator.h>
    i2c {
      #address-cells = <1>;
      #size-cells = <0>;
      pmic@58 {
        compatible = "dlg,da9062";
        reg = <0x58>;
        #interrupt-cells = <2>;
        interrupt-parent = <&gpio1>;
        interrupts = <2 IRQ_TYPE_LEVEL_LOW>;
        interrupt-controller;

        rtc {
          compatible = "dlg,da9062-rtc";
        };

        onkey {
          compatible = "dlg,da9062-onkey";
        };

        watchdog {
          compatible = "dlg,da9062-watchdog";
          dlg,use-sw-pm;
        };

        thermal {
          compatible = "dlg,da9062-thermal";
          status = "disabled";
        };

        gpio {
          compatible = "dlg,da9062-gpio";
          status = "disabled";
        };

        regulators {
          buck1 {
            regulator-name = "vdd_arm";
            regulator-min-microvolt = <925000>;
            regulator-max-microvolt = <1380000>;
            regulator-initial-mode = <DA9063_BUCK_MODE_SYNC>;
            regulator-always-on;
          };
          buck2 {
            regulator-name = "vdd_soc";
            regulator-min-microvolt = <1150000>;
            regulator-max-microvolt = <1380000>;
            regulator-initial-mode = <DA9063_BUCK_MODE_SYNC>;
            regulator-always-on;
          };
          buck3 {
            regulator-name = "vdd_ddr3";
            regulator-min-microvolt = <1500000>;
            regulator-max-microvolt = <1500000>;
            regulator-initial-mode = <DA9063_BUCK_MODE_SYNC>;
            regulator-always-on;
          };
          buck4 {
            regulator-name = "vdd_eth";
            regulator-min-microvolt = <1200000>;
            regulator-max-microvolt = <1200000>;
            regulator-initial-mode = <DA9063_BUCK_MODE_SYNC>;
            regulator-always-on;
          };
          ldo1 {
            regulator-name = "vdd_snvs";
            regulator-min-microvolt = <3000000>;
            regulator-max-microvolt = <3000000>;
            regulator-always-on;
          };
          ldo2 {
            regulator-name = "vdd_high";
            regulator-min-microvolt = <3000000>;
            regulator-max-microvolt = <3000000>;
            regulator-always-on;
          };
          ldo3 {
            regulator-name = "vdd_eth_io";
            regulator-min-microvolt = <2500000>;
            regulator-max-microvolt = <2500000>;
          };
          ldo4 {
            regulator-name = "vdd_emmc";
            regulator-min-microvolt = <1800000>;
            regulator-max-microvolt = <1800000>;
            regulator-always-on;
          };
        };
      };
    };
...
```

## Documentation/devicetree/bindings/mfd/fsl,imx28-lradc.yaml
```yaml
# SPDX-License-Identifier: (GPL-2.0-only OR BSD-2-Clause)
%YAML 1.2
---
$id: http://devicetree.org/schemas/mfd/fsl,imx28-lradc.yaml#
$schema: http://devicetree.org/meta-schemas/core.yaml#

title: Freescale MXS LRADC

maintainers:
  - Frank Li <Frank.Li@nxp.com>

properties:
  compatible:
    enum:
      - fsl,imx23-lradc
      - fsl,imx28-lradc

  reg:
    maxItems: 1

  interrupts:
    minItems: 1
    maxItems: 13

  '#io-channel-cells':
    const: 1

  clocks:
    maxItems: 1

  fsl,lradc-touchscreen-wires:
    $ref: /schemas/types.yaml#/definitions/uint32
    enum: [4, 5]
    description:
      Number of wires used to connect the touchscreen
      to LRADC. Valid value is either 4 or 5. If this
      property is not present, then the touchscreen is
      disabled. 5 wires is valid for i.MX28 SoC only.

  fsl,ave-ctrl:
    $ref: /schemas/types.yaml#/definitions/uint32
    default: 4
    minimum: 1
    maximum: 32
    description:
      number of samples per direction to calculate an average value.

  fsl,ave-delay:
    $ref: /schemas/types.yaml#/definitions/uint32
    minimum: 2
    maximum: 2048
    description:
      delay between consecutive samples.
      It is used if 'fsl,ave-ctrl' > 1, counts at
      2 kHz and its default is 2 (= 1 ms)


  fsl,settling:
    $ref: /schemas/types.yaml#/definitions/uint32
    minimum: 1
    maximum: 2047
    description:
      delay between plate switch to next sample.
      It counts at 2 kHz and its default is 10 (= 5 ms)


required:
  - compatible
  - reg
  - interrupts

additionalProperties: false

examples:
  - |
    adc@80050000 {
        compatible = "fsl,imx23-lradc";
        reg = <0x80050000 0x2000>;
        interrupts = <36 37 38 39 40 41 42 43 44>;
        fsl,lradc-touchscreen-wires = <4>;
        fsl,ave-ctrl = <4>;
        fsl,ave-delay = <2>;
        fsl,settling = <10>;
    };
```

## Documentation/devicetree/bindings/mfd/fsl,imx8ulp-avd-sim.yaml
```yaml
# SPDX-License-Identifier: (GPL-2.0 OR BSD-2-Clause)
%YAML 1.2
---
$id: http://devicetree.org/schemas/mfd/fsl,imx8ulp-avd-sim.yaml#
$schema: http://devicetree.org/meta-schemas/core.yaml#

title: NXP i.MX8ULP Audio-Video Domain System Integration Module

maintainers:
  - Liu Ying <victor.liu@nxp.com>

description: |
  The AVD-SIM module provides configuration options for components of AVD.

properties:
  compatible:
    items:
      - const: fsl,imx8ulp-avd-sim
      - const: syscon
      - const: simple-mfd

  reg:
    maxItems: 1

  clocks:
    maxItems: 1

required:
  - compatible
  - reg
  - clocks

additionalProperties: false

examples:
  - |
    #include <dt-bindings/clock/imx8ulp-clock.h>
    avd_sim: syscon@2da50000 {
        compatible = "fsl,imx8ulp-avd-sim", "syscon", "simple-mfd";
        reg = <0x2da50000 0x38>;
        clocks = <&pcc5 IMX8ULP_CLK_AVD_SIM>;
    };
```
