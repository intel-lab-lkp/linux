## Documentation/devicetree/bindings/mfd/maxim,max77705.yaml
```yaml
# SPDX-License-Identifier: GPL-2.0-only OR BSD-2-Clause
%YAML 1.2
---
$id: http://devicetree.org/schemas/mfd/maxim,max77705.yaml#
$schema: http://devicetree.org/meta-schemas/core.yaml#

title: Maxim MAX77705 Companion Power Management IC and USB Type-C interface IC

maintainers:
  - Dzmitry Sankouski <dsankouski@gmail.com>

description: |
  The Maxim MAX77705 is a Companion Power Management and Type-C
  interface IC which includes charger, fuelgauge, LED, haptic motor driver and
  Type-C management IC.

properties:
  compatible:
    const: maxim,max77705

  "#address-cells":
    const: 1

  "#size-cells":
    const: 0

  reg:
    maxItems: 1

  interrupts:
    maxItems: 1

  charger:
    $ref: /schemas/power/supply/power-supply.yaml
    unevaluatedProperties: false
    properties:
      compatible:
        const: maxim,max77705-charger

    required:
      - compatible
      - monitored-battery

  fuel-gauge:
    $ref: /schemas/power/supply/maxim,max17042-base.yaml#
    unevaluatedProperties: false

  haptic:
    type: object
    additionalProperties: false

    properties:
      compatible:
        const: maxim,max77705-haptic

      haptic-supply: true

      pwms:
        maxItems: 1

    required:
      - compatible
      - haptic-supply
      - pwms

  leds:
    type: object
    additionalProperties: false
    description:
      Up to 4 LED channels supported.

    patternProperties:
      "^led@[0-3]$":
        type: object
        $ref: /schemas/leds/common.yaml#
        unevaluatedProperties: false

        properties:
          reg:
            maxItems: 1

        required:
          - reg

    properties:
      compatible:
        const: maxim,max77705-rgb

      "#address-cells":
        const: 1

      "#size-cells":
        const: 0

      multi-led:
        type: object
        $ref: /schemas/leds/leds-class-multicolor.yaml#
        unevaluatedProperties: false

        properties:
          "#address-cells":
            const: 1

          "#size-cells":
            const: 0

        patternProperties:
          "^led@[0-3]$":
            type: object
            $ref: /schemas/leds/common.yaml#
            unevaluatedProperties: false

            properties:
              reg:
                maxItems: 1

            required:
              - reg

    required:
      - compatible

required:
  - compatible

additionalProperties: false

examples:
  - |
    #include <dt-bindings/interrupt-controller/irq.h>
    #include <dt-bindings/leds/common.h>

    i2c {
        #address-cells = <1>;
        #size-cells = <0>;

        pmic@66 {
            compatible = "maxim,max77705";
            reg = <0x66>;
            interrupt-parent = <&pm8998_gpios>;
            interrupts = <11 IRQ_TYPE_LEVEL_LOW>;
            pinctrl-0 = <&chg_int_default>;
            pinctrl-names = "default";
            #address-cells = <1>;
            #size-cells = <0>;

            leds {
                compatible = "maxim,max77705-rgb";

                multi-led {
                    color = <LED_COLOR_ID_RGB>;
                    function = LED_FUNCTION_STATUS;
                    #address-cells = <1>;
                    #size-cells = <0>;

                    led@1 {
                        reg = <1>;
                        color = <LED_COLOR_ID_RED>;
                    };

                    led@2 {
                        reg = <2>;
                        color = <LED_COLOR_ID_GREEN>;
                    };

                    led@3 {
                        reg = <3>;
                        color = <LED_COLOR_ID_BLUE>;
                    };
                };
            };

            max77705_charger: charger {
                compatible = "maxim,max77705-charger";
                monitored-battery = <&battery>;
            };

            fuel-gauge {
                compatible = "maxim,max77705-battery";
                power-supplies = <&max77705_charger>;
                maxim,rsns-microohm = <5000>;
            };

            haptic {
                compatible = "maxim,max77705-haptic";
                haptic-supply = <&vib_regulator>;
                pwms = <&vib_pwm 0 50000>;
            };
        };
    };
```

## Documentation/devicetree/bindings/mfd/mediatek,mt6363.yaml
```yaml
# SPDX-License-Identifier: (GPL-2.0-only OR BSD-2-Clause)
%YAML 1.2
---
$id: http://devicetree.org/schemas/mfd/mediatek,mt6363.yaml#
$schema: http://devicetree.org/meta-schemas/core.yaml#

title: MediaTek MT6363 series SPMI PMICs multi-function device

maintainers:
  - AngeloGioacchino Del Regno <angelogioacchino.delregno@collabora.com>

description: |
  Some MediaTek Power Management ICs (PMICs) found in board designs with
  the Helio, Dimensity and/or Kompanio series of SoCs are interfaced to
  the chip via the System Power Management Interface (SPMI) bus.

  These PMICs are multi-function devices with various sub modules.
  For example, those may include one, or more of the following:
  - Auxiliary ADC Controller
  - Clock Controller
  - eFuses
  - GPIO Controller
  - Interrupt Controller
  - Keys
  - LEDs Controller
  - Regulators
  - RTC

properties:
  compatible:
    enum:
      - mediatek,mt6363
      - mediatek,mt6373

  reg:
    maxItems: 1

  '#address-cells':
    const: 1

  '#size-cells':
    const: 0

  interrupts:
    maxItems: 1

  interrupt-controller: true

  "#interrupt-cells":
    const: 3

patternProperties:
  "^adc@[0-9a-f]+$":
    type: object
    $ref: /schemas/iio/adc/mediatek,mt6359-auxadc.yaml#

  "^regulators@[0-9a-f]+$":
    type: object
    oneOf:
      - $ref: /schemas/regulator/mediatek,mt6363-regulator.yaml#
      - $ref: /schemas/regulator/mediatek,mt6373-regulator.yaml#

required:
  - compatible
  - reg
  - '#address-cells'
  - '#size-cells'

additionalProperties: false

examples:
  - |
    #include <dt-bindings/interrupt-controller/irq.h>
    #include <dt-bindings/spmi/spmi.h>

    spmi {
      #address-cells = <2>;
      #size-cells = <0>;

      pmic@4 {
        compatible = "mediatek,mt6363";
        reg = <0x4 SPMI_USID>;
        interrupts = <4 64 IRQ_TYPE_LEVEL_HIGH>;
        interrupt-controller;
        #address-cells = <1>;
        #interrupt-cells = <3>;
        #size-cells = <0>;

        regulators@30 {
          compatible = "mediatek,mt6363-regulator";
          reg = <0x30>;

          vio18 {
            regulator-name = "pp1800-vio18-s3";
            regulator-min-microvolt = <1800000>;
            regulator-max-microvolt = <1800000>;
            regulator-allowed-modes = <0 2>;
            regulator-allow-set-load;
            regulator-over-current-protection;
          };
        };

        adc@1000 {
          compatible = "mediatek,mt6363-auxadc";
          reg = <0x1000>;
          #io-channel-cells = <1>;
        };
      };
    };
```
