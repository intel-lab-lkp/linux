## Documentation/devicetree/bindings/mfd/omap-usb-tll.yaml
```yaml
# SPDX-License-Identifier: (GPL-2.0-only OR BSD-2-Clause)
%YAML 1.2
---
$id: http://devicetree.org/schemas/mfd/omap-usb-tll.yaml#
$schema: http://devicetree.org/meta-schemas/core.yaml#

title: OMAP HS USB Host TLL (Transceiver-Less Interface)

maintainers:
  - <maintainer@kernel.org>

properties:
  compatible:
    enum:
      - ti,usbhs-tll

  reg:
    maxItems: 1

  interrupts:
    maxItems: 1

  ti,hwmod:
    const: usb_tll_hs

  clocks:
    minItems: 2

  clock-names:
    items:
      - const: usb_tll_hs_usb_ch0_clk
      - const: usb_tll_hs_usb_ch1_clk
      - const: usb_tll_hs_usb_ch2_clk
    minItems: 2

required:
  - compatible
  - reg
  - interrupts
  - ti,hwmod

additionalProperties: false

examples:
  - |
    usbhstll@4a062000 {
      compatible = "ti,usbhs-tll";
      reg = <0x4a062000 0x1000>;
      interrupts = <78>;
      ti,hwmod = "usb_tll_hs";
    };
```

## Documentation/devicetree/bindings/mfd/pf1550.yaml
```yaml
# SPDX-License-Identifier: GPL-2.0
%YAML 1.2
---
$id: http://devicetree.org/schemas/mfd/pf1550.yaml#
$schema: http://devicetree.org/meta-schemas/core.yaml#

title: PF1550 low power PMIC from NXP.

maintainers:
  - Samuel Kayode <samuel.kayode@savoirfairelinux.com>

description: |
  PF1550 is a low power PMIC providing battery charging and power supply for
  low power IoT and wearable applications.

  For device-tree bindings of other sub-modules (regulator, power supply and
  onkey) refer to the binding documents under the respective sub-system
  directories.

properties:
  compatible:
    const: fsl,pf1550

  reg:
    description:
      I2C device address.
    maxItems: 1

  interrupts:
    maxItems: 1

  regulators:
    $ref: /schemas/regulator/pf1550.yaml

  charger:
    $ref: /schemas/power/supply/pf1550_charger.yaml

  onkey:
    $ref: /schemas/input/pf1550_onkey.yaml

required:
  - compatible
  - reg
  - interrupts

additionalProperties: false

examples:
  - |
    #include <dt-bindings/interrupt-controller/irq.h>
    #include <dt-bindings/input/linux-event-codes.h>
    i2c {
        #address-cells = <1>;
        #size-cells = <0>;

        pmic@8 {
            compatible = "fsl,pf1550";
            reg = <0x8>;

            interrupt-parent = <&gpio1>;
            interrupts = <2 IRQ_TYPE_LEVEL_LOW>;

            onkey {
                compatible = "fsl,pf1550-onkey";
                linux,keycodes = <KEY_POWER>;
            };

            charger {
                compatible = "fsl,pf1550-charger";
                
                fsl,min-system-microvolt = <3700000>;
                fsl,thermal-regulation = <75>;
            };

            regulators {
                compatible = "fsl,pf1550-regulator";
 
                sw1_reg: SW1 {
                    regulator-name = "SW1";
                    regulator-min-microvolt = <600000>;
                    regulator-max-microvolt = <1387500>;
                    regulator-always-on;
                    regulator-ramp-delay = <6250>;
                };

                sw2_reg: SW2 {
                    regulator-name = "SW2";
                    regulator-min-microvolt = <600000>;
                    regulator-max-microvolt = <1387500>;
                    regulator-always-on;
                };

                sw3_reg: SW3 {
                    regulator-name = "SW3";
                    regulator-min-microvolt = <1800000>;
                    regulator-max-microvolt = <3300000>;
                    regulator-always-on;
                };

                vldo1_reg: LDO1 {
                    regulator-name = "LDO1";
                    regulator-min-microvolt = <750000>;
                    regulator-max-microvolt = <3300000>;
                    regulator-always-on;
                };

                vldo2_reg: LDO2 {
                    regulator-name = "LDO2";
                    regulator-min-microvolt = <1800000>;
                    regulator-max-microvolt = <3300000>;
                    regulator-always-on;
                };

                vldo3_reg: LDO3 {
                    regulator-name = "LDO3";
                    regulator-min-microvolt = <750000>;
                    regulator-max-microvolt = <3300000>;
                    regulator-always-on;
                };
            };
        };
    };
```

## Documentation/devicetree/bindings/mfd/realtek,iso-system.yaml
```yaml
# SPDX-License-Identifier: (GPL-2.0-only OR BSD-2-Clause)
%YAML 1.2
---
$id: http://devicetree.org/schemas/mfd/realtek,iso-system.yaml#
$schema: http://devicetree.org/meta-schemas/core.yaml#

title: Realtek ISO System Controller

description: |
  The Realtek ISO System Controller is a register area that contains
  miscellaneous system registers for the SoC and serves as a parent node
  for other functions.

maintainers:
  - James Tai <james.tai@realtek.com>
  - Yu-Chun Lin <eleanor.lin@realtek.com>

properties:
  compatible:
    items:
      - enum:
          - realtek,iso-system
      - const: syscon
      - const: simple-mfd

  reg:
    maxItems: 1

  ranges:
    maxItems: 1

  '#address-cells':
    const: 1

  '#size-cells':
    const: 1

  reg-io-width:
    const: 4

patternProperties:
  "^.*@[0-9a-f]+$":
    type: object
    description: Catch-all for other sub-devices in the ISO area.

required:
  - compatible
  - reg
  - ranges
  - '#address-cells'
  - '#size-cells'
  - reg-io-width

additionalProperties: false

examples:
  - |
    iso: syscon@7000 {
        compatible = "realtek,iso-system", "syscon", "simple-mfd";
        reg = <0x7000 0x1000>;
        ranges = <0x0 0x7000 0x1000>;
        reg-io-width = <4>;
        #address-cells = <1>;
        #size-cells = <1>;
    };
```

## Documentation/devicetree/bindings/mfd/realtek,misc.yaml
```yaml
# SPDX-License-Identifier: (GPL-2.0-only OR BSD-2-Clause)
%YAML 1.2
---
$id: http://devicetree.org/schemas/mfd/realtek,misc.yaml#
$schema: http://devicetree.org/meta-schemas/core.yaml#

title: Realtek MISC System Controller

description:
  The Realtek MISC System Controller is a register area that contains
  miscellaneous system registers for the SoC and serves as a parent node
  for other functions.

maintainers:
  - James Tai <james.tai@realtek.com>
  - Yu-Chun Lin <eleanor.lin@realtek.com>

properties:
  compatible:
    items:
      - enum:
          - realtek,misc
      - const: syscon
      - const: simple-mfd

  reg:
    maxItems: 1

  ranges:
    maxItems: 1

  '#address-cells':
    const: 1

  '#size-cells':
    const: 1

patternProperties:
  "^serial@[0-9a-f]+$":
    type: object
    description: UART controllers inside MISC area

required:
  - compatible
  - reg
  - ranges
  - '#address-cells'
  - '#size-cells'

additionalProperties: false

examples:
  - |
    #include <dt-bindings/interrupt-controller/arm-gic.h>

    syscon@7000 {
        compatible = "realtek,misc", "syscon", "simple-mfd";
        reg = <0x7000 0x1000>;
        ranges = <0x0 0x7000 0x1000>;
        #address-cells = <1>;
        #size-cells = <1>;

        uart0: serial@800 {
            compatible = "snps,dw-apb-uart";
            reg = <0x800 0x100>;
            clock-frequency = <432000000>;
            interrupts = <GIC_SPI 68 IRQ_TYPE_LEVEL_HIGH>;
            reg-io-width = <4>;
            reg-shift = <2>;
            status = "disabled";
        };
    };
```

## Documentation/devicetree/bindings/mfd/realtek,rtl9302c-switch.yaml
```yaml
# SPDX-License-Identifier: (GPL-2.0-only OR BSD-2-Clause)
%YAML 1.2
---
$id: http://devicetree.org/schemas/mfd/realtek,switch.yaml#
$schema: http://devicetree.org/meta-schemas/core.yaml#

title: Realtek Switch with Internal CPU

maintainers:
  - Chris Packham <chris.packham@alliedtelesis.co.nz>

description:
  The RTL9302 is an Ethernet switch with an integrated CPU. A number of
  different peripherals are accessed through a common register block,
  represented here as a syscon node.

properties:
  compatible:
    items:
      - enum:
          - realtek,rtl9302c-switch
      - const: syscon
      - const: simple-mfd

  reg:
    maxItems: 1

  reboot:
    $ref: /schemas/power/reset/syscon-reboot.yaml#

required:
  - compatible
  - reg
  - reboot

additionalProperties: false

examples:
  - |
    ethernet-switch@1b000000 {
      compatible = "realtek,rtl9302c-switch", "syscon", "simple-mfd";
      reg = <0x1b000000 0x10000>;

      reboot {
        compatible = "syscon-reboot";
        offset = <0x0c>;
        value = <0x01>;
      };
    };
```

## Documentation/devicetree/bindings/mfd/realtek,switch.yaml
```yaml
# SPDX-License-Identifier: (GPL-2.0-only OR BSD-2-Clause)
%YAML 1.2
---
$id: http://devicetree.org/schemas/mfd/realtek,switch.yaml#
$schema: http://devicetree.org/meta-schemas/core.yaml#

title: Realtek Switch with Internal CPU

description:
  The RTL9302 ethernet switch has an internal CPU. The switch is a multi-port
  networking switch that supports many interfaces. Additionally, the device can
  support MDIO, SPI and I2C busses.

maintainers:
  - Chris Packham <chris.packham@alliedtelesis.co.nz>

properties:
  compatible:
    items:
      - enum:
          - realtek,rtl9302c-switch
      - const: syscon
      - const: simple-mfd

  reg:
    maxItems: 1

  reboot:
    $ref: /schemas/power/reset/syscon-reboot.yaml#

required:
  - compatible
  - reg
  - reboot

additionalProperties: false

examples:
  - |
    switch0: ethernet-switch@1b000000 {
      compatible = "realtek,rtl9302c-switch", "syscon", "simple-mfd";
      reg = <0x1b000000 0x10000>;

      reboot {
        compatible = "syscon-reboot";
        offset = <0x0c>;
        value = <0x01>;
      };
    };
```
