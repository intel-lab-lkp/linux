## Documentation/devicetree/bindings/pci/nvidia,tegra-pcie.yaml
```yaml
# SPDX-License-Identifier: (GPL-2.0-only OR BSD-2-Clause)
%YAML 1.2
---
$id: http://devicetree.org/schemas/pci/nvidia,tegra-pcie.yaml#
$schema: http://devicetree.org/meta-schemas/core.yaml#

title: NVIDIA Tegra PCIe Controller

maintainers:
  - Jon Hunter <jonathanh@nvidia.com>
  - Thierry Reding <treding@nvidia.com>

description:
  PCIe controller found on NVIDIA Tegra SoCs which supports multiple
  root ports and platform-specific clock, reset, and power supply
  configurations.

properties:
  compatible:
    enum:
      - nvidia,tegra20-pcie
      - nvidia,tegra30-pcie
      - nvidia,tegra124-pcie
      - nvidia,tegra210-pcie
      - nvidia,tegra186-pcie

  reg:
    items:
      - description: PADS registers
      - description: AFI registers
      - description: Configuration space region

  reg-names:
    items:
      - const: pads
      - const: afi
      - const: cs

  interrupts:
    items:
      - description: Controller interrupt
      - description: MSI interrupt

  interrupt-names:
    items:
      - const: intr
      - const: msi

  clocks:
    minItems: 3
    items:
      - description: PCIe clock
      - description: AFI clock
      - description: PLL_E clock
      - description: Optional CML clock

  clock-names:
    description: Names of clocks used by the PCIe controller
    minItems: 3
    items:
      - const: pex
      - const: afi
      - const: pll_e
      - const: cml

  resets:
    items:
      - description: PCIe reset
      - description: AFI reset
      - description: PCIe-X reset

  reset-names:
    items:
      - const: pex
      - const: afi
      - const: pcie_x

  power-domains:
    maxItems: 1

  interconnects:
    minItems: 1
    maxItems: 2

  interconnect-names:
    items:
      - const: dma-mem
      - const: write

  pinctrl-names:
    items:
      - const: default
      - const: idle

  pinctrl-0: true
  pinctrl-1: true

  operating-points-v2:
    description:
      Defines operating points with required frequency and voltage values,
      and the opp-supported-hw property.

  iommus:
    maxItems: 1

  avdd-pex-supply:
    description: Power supply for analog PCIe logic. Must supply 1.05 V.

  vdd-pex-supply:
    description: Power supply for digital PCIe I/O. Must supply 1.05 V.

  avdd-pex-pll-supply:
    description: Power supply for dedicated (internal) PCIe PLL. Must supply 1.05 V.

  avdd-plle-supply:
    description: Power supply for PLLE, which is shared with SATA. Must supply 1.05 V.

  vddio-pex-clk-supply:
    description: Power supply for PCIe clock. Must supply 3.3 V.

  vddio-pex-ctl-supply:
    description: Power supply for PCIe control I/O partition. Must supply 1.8 V.

  hvdd-pex-supply:
    description: High-voltage supply for PCIe I/O and PCIe output clocks. Must supply 3.3 V.

  avdd-pexa-supply:
    description: Power supply for analog PCIe logic. Must supply 1.05 V.

  vdd-pexa-supply:
    description: Power supply for digital PCIe I/O. Must supply 1.05 V.

  avdd-pexb-supply:
    description: Power supply for analog PCIe logic. Must supply 1.05 V.

  vdd-pexb-supply:
    description: Power supply for digital PCIe I/O. Must supply 1.05 V.

  avddio-pex-supply:
    description: Power supply for analog PCIe logic. Must supply 1.05 V.

  dvddio-pex-supply:
    description: Power supply for digital PCIe I/O. Must supply 1.05 V.

  hvddio-pex-supply:
    description: High-voltage supply for PCIe I/O and PCIe output clocks. Must supply 1.8 V.

  dvdd-pex-supply:
    description: Power supply for digital PCIe I/O. Must supply 1.05 V.

  hvdd-pex-pll-supply:
    description: High-voltage supply for PLLE (shared with USB3). Must supply 1.8 V.

  vddio-pexctl-aud-supply:
    description: Power supply for PCIe side band signals. Must supply 1.8 V.

patternProperties:
  "^pci@[0-9a-f]+(,[0-9a-f]+)?$":
    type: object
    allOf:
      - $ref: /schemas/pci/pci-pci-bridge.yaml#
    properties:
      reg:
        maxItems: 1

      nvidia,num-lanes:
        description: Number of lanes used by this PCIe port
        $ref: /schemas/types.yaml#/definitions/uint32
        enum: [1, 2, 4]

      phys:
        description: Phandles to PCIe PHYs
        items:
          maxItems: 1
        minItems: 1
        maxItems: 4

      phy-names:
        description: Names of PCIe PHYs
        items:
          pattern: "^pcie(-[0-3])?$"
        minItems: 1
        maxItems: 4

    required:
      - nvidia,num-lanes

    unevaluatedProperties: false

allOf:
  - $ref: /schemas/pci/pci-host-bridge.yaml#
  - if:
      properties:
        compatible:
          contains:
            enum:
              - nvidia,tegra20-pcie
              - nvidia,tegra186-pcie
    then:
      properties:
        clocks:
          maxItems: 3
        clock-names:
          items:
            - const: pex
            - const: afi
            - const: pll_e
        resets:
          maxItems: 3
        reset-names:
          items:
            - const: pex
            - const: afi
            - const: pcie_x

  - if:
      properties:
        compatible:
          contains:
            enum:
              - nvidia,tegra30-pcie
              - nvidia,tegra124-pcie
              - nvidia,tegra210-pcie
    then:
      properties:
        clocks:
          maxItems: 4
        clock-names:
          items:
            - const: pex
            - const: afi
            - const: pll_e
            - const: cml
        resets:
          maxItems: 3
        reset-names:
          items:
            - const: pex
            - const: afi
            - const: pcie_x

  - if:
      properties:
        compatible:
          contains:
            enum:
              - nvidia,tegra20-pcie
              - nvidia,tegra30-pcie
    then:
      required:
        - power-domains
        - operating-points-v2

  - if:
      properties:
        compatible:
          contains:
            enum:
              - nvidia,tegra186-pcie
    then:
      required:
        - interconnects
        - iommus

  - if:
      properties:
        compatible:
          contains:
            enum:
              - nvidia,tegra210-pcie
    then:
      required:
        - pinctrl-names
        - pinctrl-0
        - pinctrl-1

  - if:
      properties:
        compatible:
          contains:
            enum:
              - nvidia,tegra20-pcie
    then:
      required:
        - avdd-pex-supply
        - vdd-pex-supply
        - avdd-pex-pll-supply
        - avdd-plle-supply
        - vddio-pex-clk-supply

  - if:
      properties:
        compatible:
          contains:
            enum:
              - nvidia,tegra30-pcie
    then:
      required:
        - avdd-pex-pll-supply
        - avdd-plle-supply
        - vddio-pex-ctl-supply
        - hvdd-pex-supply
      anyOf:
        - required:
            - avdd-pexa-supply
            - vdd-pexa-supply
        - required:
            - avdd-pexb-supply
            - vdd-pexb-supply

  - if:
      properties:
        compatible:
          contains:
            enum:
              - nvidia,tegra124-pcie
    then:
      required:
        - avddio-pex-supply
        - dvddio-pex-supply
        - hvdd-pex-supply
        - vddio-pex-ctl-supply

  - if:
      properties:
        compatible:
          contains:
            enum:
              - nvidia,tegra210-pcie
    then:
      required:
        - hvddio-pex-supply
        - dvddio-pex-supply
        - vddio-pex-ctl-supply

  - if:
      properties:
        compatible:
          contains:
            enum:
              - nvidia,tegra186-pcie
    then:
      required:
        - dvdd-pex-supply
        - hvdd-pex-pll-supply
        - hvdd-pex-supply
        - vddio-pexctl-aud-supply

required:
  - compatible
  - reg
  - reg-names
  - clocks
  - clock-names
  - resets
  - reset-names
  - interrupts
  - interrupt-map
  - interrupt-map-mask

unevaluatedProperties: false

examples:
  - |
    #include <dt-bindings/interrupt-controller/arm-gic.h>
    #include <dt-bindings/interrupt-controller/irq.h>

    bus {
        #address-cells = <1>;
        #size-cells = <1>;

        pcie@80003000 {
            compatible = "nvidia,tegra20-pcie";
            device_type = "pci";
            reg = <0x80003000 0x00000800>,
                  <0x80003800 0x00000200>,
                  <0x90000000 0x10000000>;
            reg-names = "pads", "afi", "cs";
            interrupts = <GIC_SPI 98 IRQ_TYPE_LEVEL_HIGH>,
                         <GIC_SPI 99 IRQ_TYPE_LEVEL_HIGH>;
            interrupt-names = "intr", "msi";
            interrupt-parent = <&intc>;

            #interrupt-cells = <1>;
            interrupt-map-mask = <0 0 0 0>;
            interrupt-map = <0 0 0 0 &intc GIC_SPI 98 IRQ_TYPE_LEVEL_HIGH>;

            bus-range = <0x00 0xff>;
            #address-cells = <3>;
            #size-cells = <2>;

            ranges = <0x02000000 0 0x80000000 0x80000000 0 0x00001000>,
                     <0x02000000 0 0x80001000 0x80001000 0 0x00001000>,
                     <0x01000000 0 0          0x82000000 0 0x00010000>,
                     <0x02000000 0 0xa0000000 0xa0000000 0 0x08000000>,
                     <0x42000000 0 0xa8000000 0xa8000000 0 0x18000000>;

            clocks = <&tegra_car 70>,
                     <&tegra_car 72>,
                     <&tegra_car 118>;
            clock-names = "pex", "afi", "pll_e";
            resets = <&tegra_car 70>,
                     <&tegra_car 72>,
                     <&tegra_car 74>;
            reset-names = "pex", "afi", "pcie_x";
            power-domains = <&pd_core>;
            operating-points-v2 = <&pcie_dvfs_opp_table>;

            avdd-pex-supply = <&reg_pex_1v05>;
            vdd-pex-supply = <&reg_pex_1v05>;
            avdd-pex-pll-supply = <&reg_pexpll_1v05>;
            avdd-plle-supply = <&reg_plle_1v05>;
            vddio-pex-clk-supply = <&reg_pexclk_3v3>;

            status = "okay";

            pci@1,0 {
                device_type = "pci";
                assigned-addresses = <0x82000800 0 0x80000000 0 0x1000>;
                reg = <0x000800 0 0 0 0>;
                bus-range = <0x00 0xff>;
                status = "okay";

                #address-cells = <3>;
                #size-cells = <2>;
                ranges;

                nvidia,num-lanes = <2>;
            };

            pci@2,0 {
                device_type = "pci";
                assigned-addresses = <0x82001000 0 0x80001000 0 0x1000>;
                reg = <0x001000 0 0 0 0>;
                bus-range = <0x00 0xff>;
                status = "okay";

                #address-cells = <3>;
                #size-cells = <2>;
                ranges;

                nvidia,num-lanes = <2>;
            };
        };
    };
  - |
    #include <dt-bindings/interrupt-controller/arm-gic.h>
    #include <dt-bindings/interrupt-controller/irq.h>

    bus {
        #address-cells = <2>;
        #size-cells = <2>;

        pcie@1003000 {
            compatible = "nvidia,tegra210-pcie";
            device_type = "pci";
            reg = <0x0 0x01003000 0x0 0x00000800>,
                  <0x0 0x01003800 0x0 0x00000800>,
                  <0x0 0x02000000 0x0 0x10000000>;
            reg-names = "pads", "afi", "cs";
            interrupts = <GIC_SPI 98 IRQ_TYPE_LEVEL_HIGH>,
                         <GIC_SPI 99 IRQ_TYPE_LEVEL_HIGH>;
            interrupt-names = "intr", "msi";
            interrupt-parent = <&gic>;

            #interrupt-cells = <1>;
            interrupt-map-mask = <0 0 0 0>;
            interrupt-map = <0 0 0 0 &gic GIC_SPI 98 IRQ_TYPE_LEVEL_HIGH>;

            bus-range = <0x00 0xff>;
            #address-cells = <3>;
            #size-cells = <2>;

            ranges = <0x02000000 0 0x01000000 0x0 0x01000000 0 0x00001000>,
                     <0x02000000 0 0x01001000 0x0 0x01001000 0 0x00001000>,
                     <0x01000000 0 0x0        0x0 0x12000000 0 0x00010000>,
                     <0x02000000 0 0x13000000 0x0 0x13000000 0 0x0d000000>,
                     <0x42000000 0 0x20000000 0x0 0x20000000 0 0x20000000>;

            clocks = <&tegra_car 70>,
                     <&tegra_car 72>,
                     <&tegra_car 263>,
                     <&tegra_car 300>;
            clock-names = "pex", "afi", "pll_e", "cml";
            resets = <&tegra_car 70>,
                     <&tegra_car 72>,
                     <&tegra_car 74>;
            reset-names = "pex", "afi", "pcie_x";

            pinctrl-names = "default", "idle";
            pinctrl-0 = <&pex_dpd_disable>;
            pinctrl-1 = <&pex_dpd_enable>;

            hvddio-pex-supply = <&reg_pex_1v8>;
            dvddio-pex-supply = <&reg_pex_1v05>;
            vddio-pex-ctl-supply = <&reg_pexctl_1v8>;

            status = "okay";

            pci@1,0 {
                device_type = "pci";
                assigned-addresses = <0x82000800 0 0x01000000 0 0x1000>;
                reg = <0x000800 0 0 0 0>;
                bus-range = <0x00 0xff>;
                status = "okay";

                #address-cells = <3>;
                #size-cells = <2>;
                ranges;

                nvidia,num-lanes = <4>;
            };

            pci@2,0 {
                device_type = "pci";
                assigned-addresses = <0x82001000 0 0x01001000 0 0x1000>;
                reg = <0x001000 0 0 0 0>;
                bus-range = <0x00 0xff>;
                status = "okay";

                #address-cells = <3>;
                #size-cells = <2>;
                ranges;

                nvidia,num-lanes = <1>;
            };
        };
    };
```
