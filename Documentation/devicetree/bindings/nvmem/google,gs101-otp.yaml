## Documentation/devicetree/bindings/pci/nxp,s32-pcie.yaml
```yaml
# SPDX-License-Identifier: (GPL-2.0-only OR BSD-2-Clause)
%YAML 1.2
---
$id: http://devicetree.org/schemas/pci/nxp,s32-pcie.yaml#
$schema: http://devicetree.org/meta-schemas/core.yaml#

title: NXP S32G2xx/S32G3xx PCIe controller

maintainers:
  - Bogdan Hamciuc <bogdan.hamciuc@nxp.com>
  - Ionut Vicovan <ionut.vicovan@nxp.com>

description:
  This PCIe controller is based on the Synopsys DesignWare PCIe IP.
  The S32G SoC family has two PCIe controllers, which can be configured as
  either Root Complex or Endpoint.

properties:
  compatible:
    oneOf:
      - enum:
          - nxp,s32g2-pcie     # S32G2 SoCs RC mode
      - items:
          - const: nxp,s32g3-pcie
          - const: nxp,s32g2-pcie

  reg:
    maxItems: 7

  reg-names:
    items:
      - const: dbi
      - const: dbi2
      - const: atu
      - const: dma
      - const: ctrl
      - const: config
      - const: addr_space

  interrupts:
    maxItems: 8

  interrupt-names:
    items:
      - const: link-req-stat
      - const: dma
      - const: msi
      - const: phy-link-down
      - const: phy-link-up
      - const: misc
      - const: pcs
      - const: tlp-req-no-comp

required:
  - compatible
  - reg
  - reg-names
  - interrupts
  - interrupt-names
  - ranges
  - phys

allOf:
  - $ref: /schemas/pci/snps,dw-pcie-common.yaml#
  - $ref: /schemas/pci/pci-bus.yaml#

unevaluatedProperties: false

examples:
  - |
    #include <dt-bindings/interrupt-controller/arm-gic.h>
    #include <dt-bindings/phy/phy.h>

    bus {
        #address-cells = <2>;
        #size-cells = <2>;

        pcie@40400000 {
            compatible = "nxp,s32g3-pcie",
                         "nxp,s32g2-pcie";
            reg = <0x00 0x40400000 0x0 0x00001000>,   /* dbi registers */
                  <0x00 0x40420000 0x0 0x00001000>,   /* dbi2 registers */
                  <0x00 0x40460000 0x0 0x00001000>,   /* atu registers */
                  <0x00 0x40470000 0x0 0x00001000>,   /* dma registers */
                  <0x00 0x40481000 0x0 0x000000f8>,   /* ctrl registers */
                  /*
                   * RC configuration space, 4KB each for cfg0 and cfg1
                   * at the end of the outbound memory map
                   */
                  <0x5f 0xffffe000 0x0 0x00002000>,
                  <0x58 0x00000000 0x0 0x40000000>; /* 1GB EP addr space */
            reg-names = "dbi", "dbi2", "atu", "dma", "ctrl",
                        "config", "addr_space";
            dma-coherent;
            #address-cells = <3>;
            #size-cells = <2>;
            device_type = "pci";
            ranges =
                  /*
                   * downstream I/O, 64KB and aligned naturally just
                   * before the config space to minimize fragmentation
                   */
                  <0x81000000 0x0 0x00000000 0x5f 0xfffe0000 0x0 0x00010000>,
                  /*
                   * non-prefetchable memory, with best case size and
                   * alignment
                   */
                  <0x82000000 0x0 0x00000000 0x58 0x00000000 0x7 0xfffe0000>;

            bus-range = <0x0 0xff>;
            interrupts =  <GIC_SPI 124 IRQ_TYPE_LEVEL_HIGH>,
                          <GIC_SPI 123 IRQ_TYPE_LEVEL_HIGH>,
                          <GIC_SPI 125 IRQ_TYPE_LEVEL_HIGH>,
                          <GIC_SPI 126 IRQ_TYPE_LEVEL_HIGH>,
                          <GIC_SPI 127 IRQ_TYPE_LEVEL_HIGH>,
                          <GIC_SPI 132 IRQ_TYPE_LEVEL_HIGH>,
                          <GIC_SPI 133 IRQ_TYPE_LEVEL_HIGH>,
                          <GIC_SPI 134 IRQ_TYPE_LEVEL_HIGH>;
            interrupt-names = "link-req-stat", "dma", "msi",
                              "phy-link-down", "phy-link-up", "misc",
                              "pcs", "tlp-req-no-comp";
            #interrupt-cells = <1>;
            interrupt-map-mask = <0 0 0 0x7>;
            interrupt-map = <0 0 0 1 &gic 0 0 GIC_SPI 128 IRQ_TYPE_LEVEL_HIGH>,
                            <0 0 0 2 &gic 0 0 GIC_SPI 129 IRQ_TYPE_LEVEL_HIGH>,
                            <0 0 0 3 &gic 0 0 GIC_SPI 130 IRQ_TYPE_LEVEL_HIGH>,
                            <0 0 0 4 &gic 0 0 GIC_SPI 131 IRQ_TYPE_LEVEL_HIGH>;

            phys = <&serdes0 PHY_TYPE_PCIE 0 0>;
        };
    };
```

## Documentation/devicetree/bindings/pci/pci-ep.yaml
```yaml
# SPDX-License-Identifier: (GPL-2.0-only OR BSD-2-Clause)
%YAML 1.2
---
$id: http://devicetree.org/schemas/pci/pci-ep.yaml#
$schema: http://devicetree.org/meta-schemas/core.yaml#

title: PCI Endpoint Controller

description: |
  Common properties for PCI Endpoint Controller Nodes.

maintainers:
  - Kishon Vijay Abraham I <kishon@kernel.org>
  - Manivannan Sadhasivam <manivannan.sadhasivam@linaro.org>

properties:
  $nodename:
    pattern: "^pcie-ep@"

  max-functions:
    description: Maximum number of functions that can be configured
    $ref: /schemas/types.yaml#/definitions/uint8
    minimum: 1
    default: 1
    maximum: 255

  max-virtual-functions:
    description: Array representing the number of virtual functions corresponding to each physical
      function
    $ref: /schemas/types.yaml#/definitions/uint8-array
    minItems: 1
    maxItems: 255

  max-link-speed:
    $ref: /schemas/types.yaml#/definitions/uint32
    enum: [ 1, 2, 3, 4 ]

  num-lanes:
    description: maximum number of lanes
    $ref: /schemas/types.yaml#/definitions/uint32
    minimum: 1
    default: 1
    maximum: 16

  ref-clk-mode:
    description: Reference clocking architechture
    enum:
      - common-clk        # Common Reference Clock (provided by RC side)
      - common-clk-ep     # Common Reference Clock (provided by EP side)
      - common-clk-ep-ssc # Common Reference Clock With Spread (provided by EP side)
      - srns              # Separate Reference Clocks No Spread
      - sris              # Separate Reference Clocks Independent Spread

  linux,pci-domain:
    description:
      If present this property assigns a fixed PCI domain number to a PCI
      Endpoint Controller, otherwise an unstable (across boots) unique number
      will be assigned. It is required to either not set this property at all
      or set it for all PCI endpoint controllers in the system, otherwise
      potentially conflicting domain numbers may be assigned to endpoint
      controllers. The domain number for each endpoint controller in the system
      must be unique.
    $ref: /schemas/types.yaml#/definitions/uint32

required:
  - compatible

additionalProperties: true
```

## Documentation/devicetree/bindings/pci/qcom,pcie-eliza.yaml
```yaml
# SPDX-License-Identifier: (GPL-2.0-only OR BSD-2-Clause)
%YAML 1.2
---
$id: http://devicetree.org/schemas/pci/qcom,pcie-eliza.yaml#
$schema: http://devicetree.org/meta-schemas/core.yaml#

title: Qualcomm Eliza PCI Express Root Complex

maintainers:
  - Bjorn Andersson <andersson@kernel.org>
  - Manivannan Sadhasivam <mani@kernel.org>

description:
  Qualcomm ELIZA SoC (and compatible) PCIe root complex controller is based on
  the Synopsis DesignWare PCIe IP.

properties:
  compatible:
    const: qcom,pcie-eliza

  reg:
    minItems: 5
    maxItems: 6

  reg-names:
    minItems: 5
    items:
      - const: parf # Qualcomm specific registers
      - const: dbi # DesignWare PCIe registers
      - const: elbi # External local bus interface registers
      - const: atu # ATU address space
      - const: config # PCIe configuration space
      - const: mhi # MHI registers

  clocks:
    maxItems: 7

  clock-names:
    items:
      - const: aux # Auxiliary clock
      - const: cfg # Configuration clock
      - const: bus_master # Master AXI clock
      - const: bus_slave # Slave AXI clock
      - const: slave_q2a # Slave Q2A clock
      - const: ddrss_sf_tbu # PCIe SF TBU clock
      - const: cnoc_sf_axi # Config NoC PCIe1 AXI clock

  interrupts:
    minItems: 8
    maxItems: 9

  interrupt-names:
    minItems: 8
    items:
      - const: msi0
      - const: msi1
      - const: msi2
      - const: msi3
      - const: msi4
      - const: msi5
      - const: msi6
      - const: msi7
      - const: global

  resets:
    maxItems: 2

  reset-names:
    items:
      - const: pci # PCIe core reset
      - const: link_down # PCIe link down reset

required:
  - power-domains
  - resets
  - reset-names

allOf:
  - $ref: qcom,pcie-common.yaml#

unevaluatedProperties: false

examples:
  - |
    #include <dt-bindings/clock/qcom,eliza-gcc.h>
    #include <dt-bindings/interrupt-controller/arm-gic.h>
    #include <dt-bindings/interconnect/qcom,eliza-rpmh.h>

    soc {
        #address-cells = <2>;
        #size-cells = <2>;

        pcie@1c00000 {
            compatible = "qcom,pcie-eliza";
            reg = <0 0x01c00000 0 0x3000>,
                  <0 0x40000000 0 0xf1d>,
                  <0 0x40000f20 0 0xa8>,
                  <0 0x40001000 0 0x1000>,
                  <0 0x40100000 0 0x100000>;
            reg-names = "parf", "dbi", "elbi", "atu", "config";
            ranges = <0x01000000 0x0 0x00000000 0x0 0x40200000 0x0 0x100000>,
                     <0x02000000 0x0 0x40300000 0x0 0x40300000 0x0 0x3d00000>;

            bus-range = <0x00 0xff>;
            device_type = "pci";
            linux,pci-domain = <0>;
            num-lanes = <1>;

            #address-cells = <3>;
            #size-cells = <2>;

            clocks = <&gcc GCC_PCIE_0_AUX_CLK>,
                     <&gcc GCC_PCIE_0_CFG_AHB_CLK>,
                     <&gcc GCC_PCIE_0_MSTR_AXI_CLK>,
                     <&gcc GCC_PCIE_0_SLV_AXI_CLK>,
                     <&gcc GCC_PCIE_0_SLV_Q2A_AXI_CLK>,
                     <&gcc GCC_DDRSS_PCIE_SF_QTB_CLK>,
                     <&gcc GCC_CNOC_PCIE_SF_AXI_CLK>;
            clock-names = "aux",
                          "cfg",
                          "bus_master",
                          "bus_slave",
                          "slave_q2a",
                          "ddrss_sf_tbu",
                          "cnoc_sf_axi";

            dma-coherent;

            interrupts = <GIC_SPI 376 IRQ_TYPE_LEVEL_HIGH>,
                         <GIC_SPI 478 IRQ_TYPE_LEVEL_HIGH>,
                         <GIC_SPI 479 IRQ_TYPE_LEVEL_HIGH>,
                         <GIC_SPI 535 IRQ_TYPE_LEVEL_HIGH>,
                         <GIC_SPI 536 IRQ_TYPE_LEVEL_HIGH>,
                         <GIC_SPI 537 IRQ_TYPE_LEVEL_HIGH>,
                         <GIC_SPI 540 IRQ_TYPE_LEVEL_HIGH>,
                         <GIC_SPI 653 IRQ_TYPE_LEVEL_HIGH>,
                         <GIC_SPI 370 IRQ_TYPE_LEVEL_HIGH>;
            interrupt-names = "msi0", "msi1", "msi2", "msi3",
                              "msi4", "msi5", "msi6", "msi7", "global";
            #interrupt-cells = <1>;
            interrupt-map-mask = <0 0 0 0x7>;
            interrupt-map = <0 0 0 1 &intc 0 0 0 564 IRQ_TYPE_LEVEL_HIGH>, /* int_a */
                            <0 0 0 2 &intc 0 0 0 565 IRQ_TYPE_LEVEL_HIGH>, /* int_b */
                            <0 0 0 3 &intc 0 0 0 566 IRQ_TYPE_LEVEL_HIGH>, /* int_c */
                            <0 0 0 4 &intc 0 0 0 567 IRQ_TYPE_LEVEL_HIGH>; /* int_d */

            interconnects = <&pcie_noc MASTER_PCIE_0 0 &mc_virt SLAVE_EBI1 0>,
                            <&gem_noc MASTER_APPSS_PROC 0 &cnoc_main SLAVE_PCIE_0 0>;
            interconnect-names = "pcie-mem", "cpu-pcie";

            iommu-map = <0x0 &apps_smmu 0x1480 0x1>,
                        <0x100 &apps_smmu 0x1481 0x1>;

            pinctrl-0 = <&pcie0_default_state>;
            pinctrl-names = "default";

            power-domains = <&gcc GCC_PCIE_0_GDSC>;

            resets = <&gcc GCC_PCIE_0_BCR>,
                     <&gcc GCC_PCIE_0_LINK_DOWN_BCR>;
            reset-names = "pci",
                          "link_down";

        };
    };
```
