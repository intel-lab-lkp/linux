## Documentation/devicetree/bindings/nvmem/google,gs101-otp.yaml
```yaml
# SPDX-License-Identifier: (GPL-2.0-only OR BSD-2-Clause)
%YAML 1.2
---
$id: http://devicetree.org/schemas/nvmem/google,gs101-otp.yaml#
$schema: http://devicetree.org/meta-schemas/core.yaml#

title: Google GS101 OTP Controller

maintainers:
  - Tudor Ambarus <tudor.ambarus@linaro.org>

description: |
  OTP controller drives a NVMEM memory where system or user specific data
  can be stored. The OTP controller register space if of interest as well
  because it contains dedicated registers where it stores the Product ID
  and the Chip ID (apart other things like TMU or ASV info).

allOf:
  - $ref: nvmem.yaml#
  - $ref: nvmem-deprecated-cells.yaml

properties:
  compatible:
    items:
      - const: google,gs101-otp

  clocks:
    maxItems: 1

  clock-names:
    const: pclk

  reg:
    maxItems: 1

  power-domains:
    maxItems: 1

required:
  - compatible
  - reg
  - "#address-cells"
  - "#size-cells"
  - clock-names
  - clocks

unevaluatedProperties: false

examples:
  - |
    #include <dt-bindings/clock/google,gs101.h>

    otp: efuse@10000000 {
        compatible = "google,gs101-otp";
        reg = <0x10000000 0xf084>;
        #address-cells = <1>;
        #size-cells = <1>;
        clocks = <&cmu_misc CLK_GOUT_MISC_OTP_CON_TOP_PCLK>;
        clock-names = "pclk";

        product_id: product_id@0 {
            reg = <0x0 0x4>;
        };

        chip_id: chip-id@4 {
            reg = <0x4 0x10>;
        };
    };
```

## Documentation/devicetree/bindings/nvmem/layouts/u-boot,env.yaml
```yaml
# SPDX-License-Identifier: GPL-2.0 OR BSD-2-Clause
%YAML 1.2
---
$id: http://devicetree.org/schemas/nvmem/layouts/u-boot,env.yaml#
$schema: http://devicetree.org/meta-schemas/core.yaml#

title: NVMEM layout of U-Boot environment variables

maintainers:
  - Rafał Miłecki <rafal@milecki.pl>

description:
  U-Boot uses environment variables to store device parameters and
  configuration. They may be used for booting process, setup or keeping end user
  info.

  Data is stored using U-Boot specific formats (variant specific header and NUL
  separated key-value pairs).

properties:
  compatible:
    oneOf:
      - description: A standalone env data block
        const: u-boot,env
      - description: Two redundant blocks with active one flagged
        const: u-boot,env-redundant-bool
      - description: Two redundant blocks with active having higher counter
        const: u-boot,env-redundant-count
      - description: Broadcom's variant with custom header
        const: brcm,env

additionalProperties: false

examples:
  - |
    partitions {
        compatible = "fixed-partitions";
        #address-cells = <1>;
        #size-cells = <1>;

        partition@0 {
            reg = <0x0 0x40000>;
            label = "u-boot";
            read-only;
        };

        partition@40000 {
            reg = <0x40000 0x10000>;
            label = "u-boot-env";

            nvmem-layout {
                compatible = "u-boot,env";
            };
        };
    };
```

## Documentation/devicetree/bindings/nvmem/mediatek,mt6323-efuse.yaml
```yaml
# SPDX-License-Identifier: (GPL-2.0-only OR BSD-2-Clause)
%YAML 1.2
---
$id: http://devicetree.org/schemas/nvmem/mediatek,mt6323-efuse.yaml#
$schema: http://devicetree.org/meta-schemas/core.yaml#

title: MediaTek MT6323 PMIC EFUSE

description: |
  MT6323 efuse is used for storing calibration data, such as thermal sensor
  calibration.

maintainers:
  - Roman Vivchar <rva333@protonmail.com>

allOf:
  - $ref: nvmem.yaml#

properties:
  compatible:
    const: mediatek,mt6323-efuse

required:
  - compatible

unevaluatedProperties: false

examples:
  - |
    mt6323_efuse: efuse {
      compatible = "mediatek,mt6323-efuse";

      nvmem-layout {
        compatible = "fixed-layout";
        #address-cells = <1>;
        #size-cells = <1>;

        mt6323_thermal_calibration_data: thermal-data@14 {
          reg = <0x14 0x4>;
        };
      };
    };
```

## Documentation/devicetree/bindings/nvmem/nuvoton,npcm750-otp.yaml
```yaml
# SPDX-License-Identifier: (GPL-2.0-only OR BSD-2-Clause)
%YAML 1.2
---
$id: http://devicetree.org/schemas/nvmem/nuvoton,npcm750-otp.yaml#
$schema: http://devicetree.org/meta-schemas/core.yaml#

title: Nuvoton NPCM7xx OTP (One-Time Programmable) Memory

maintainers:
  - Kuan-Wei Chiu <visitorckw@gmail.com>

allOf:
  - $ref: nvmem.yaml#

properties:
  compatible:
    enum:
      - nuvoton,npcm750-key-storage
      - nuvoton,npcm750-fuse-array

  reg:
    maxItems: 1

required:
  - compatible
  - reg

unevaluatedProperties: false

examples:
  - |
    otp@f0189000 {
        compatible = "nuvoton,npcm750-key-storage";
        reg = <0xf0189000 0x1000>;
    };
```

## Documentation/devicetree/bindings/nvmem/nxp,lpc1850-otp.yaml
```yaml
# SPDX-License-Identifier: GPL-2.0-only OR BSD-2-Clause
%YAML 1.2
---
$id: http://devicetree.org/schemas/nvmem/nxp,lpc1850-otp.yaml#
$schema: http://devicetree.org/meta-schemas/core.yaml#

title: NXP LPC18xx / LPC43xx One-Time Programmable (OTP) memory

maintainers:
  - Srinivas Kandagatla <srini@kernel.org>

description:
  The internal OTP memory in NXP LPC18xx and LPC43xx microcontrollers
  provides a dedicated non-volatile storage area designed for permanent,
  one-time configuration and data storage.The OTP controller manages write
  protection, programming sequencing, and error detection mechanisms to
  guarantee reliable and safe permanent programming under software control.

allOf:
  - $ref: nvmem.yaml#

properties:
  compatible:
    const: nxp,lpc1850-otp

  reg:
    maxItems: 1

  "#address-cells":
    const: 1

  "#size-cells":
    const: 1

required:
  - compatible
  - reg
  - "#address-cells"
  - "#size-cells"

unevaluatedProperties: false

examples:
  - |
    otp@40045000 {
        compatible = "nxp,lpc1850-otp";
        reg = <0x40045000 0x1000>;
        #address-cells = <1>;
        #size-cells = <1>;
    };
...
```

## Documentation/devicetree/bindings/nvmem/spmi-nvmem.yaml
```yaml
# SPDX-License-Identifier: GPL-2.0-only OR BSD-2-Clause
%YAML 1.2
---
$id: http://devicetree.org/schemas/nvmem/spmi-nvmem.yaml#
$schema: http://devicetree.org/meta-schemas/core.yaml#

title: Generic SPMI NVMEM

description: Exports a series of SPMI registers as NVMEM cells

maintainers:
  - Sasha Finkelstein <fnkl.kernel@gmail.com>

allOf:
  - $ref: nvmem.yaml#

properties:
  compatible:
    items:
      - enum:
          - apple,maverick-pmic
          - apple,sera-pmic
          - apple,stowe-pmic
      - const: spmi-nvmem

  reg:
    maxItems: 1

required:
  - compatible
  - reg

unevaluatedProperties: false

examples:
  - |
    #include <dt-bindings/spmi/spmi.h>

    pmic@f {
        compatible = "apple,maverick-pmic", "spmi-nvmem";
        reg = <0xf SPMI_USID>;

        nvmem-layout {
            compatible = "fixed-layout";
            #address-cells = <1>;
            #size-cells = <1>;

            boot_stage: boot-stage@6001 {
                reg = <0x6001 0x1>;
            };
        };
    };

...
```

## Documentation/devicetree/bindings/nvmem/st,stm32-tamp-nvram.yaml
```yaml
# SPDX-License-Identifier: (GPL-2.0-only OR BSD-2-Clause)
%YAML 1.2
---
$id: http://devicetree.org/schemas/nvmem/st,stm32-tamp-nvram.yaml#
$schema: http://devicetree.org/meta-schemas/core.yaml#

title: STMicroelectronics STM32 TAMP's NVRAM

description: |
  The TAMP peripheral integrates, amongst others, Non Volatile RAM
  (NVRAM) with 32/128 32-bit backup registers which can be used by
  software to store information or communicate with a boot loader.

maintainers:
  - Dario Binacchi <dario.binacchi@amarulasolutions.com>

allOf:
  - $ref: nvmem.yaml#

properties:
  compatible:
    enum:
      - st,stm32mp15-tamp-nvram
      - st,stm32mp25-tamp-nvram

  reg:
    maxItems: 1

required:
  - compatible
  - reg

unevaluatedProperties: false

examples:
  - |
    nvram: nvram@46010100 {
        compatible = "st,stm32mp25-tamp-nvram";
        reg = <0x46010100 0x200>;

        nvmem-layout {
            compatible = "fixed-layout";
            #address-cells = <1>;
            #size-cells = <1>;

            fwu_info: tamp-bkp@c0 {
                reg = <0xc0 0x4>;
            };

            boot_mode: tamp-bkp@180 {
                reg = <0x180 0x4>;
            };
        };
    };
...
```

## Documentation/devicetree/bindings/nvmem/ti,efuses.yaml
```yaml
# SPDX-License-Identifier: GPL-2.0-only OR BSD-2-Clause
%YAML 1.2
---
$id: http://devicetree.org/schemas/nvmem/ti,efuses.yaml#
$schema: http://devicetree.org/meta-schemas/core.yaml#

title: TI SoC eFuse-based NVMEM

maintainers:
  - Judith Mendez <jm@ti.com>

allOf:
  - $ref: nvmem.yaml#
  - $ref: nvmem-deprecated-cells.yaml#

properties:
  compatible:
    - const: ti,am62p-efuse

  reg:
    maxItems: 1

required:
  - compatible
  - reg

unevaluatedProperties: false

examples:
  - |
    efuse@43000230 {
        compatible = "ti,am62p-efuse";
        reg = <0x43000230 0x4>;
    };

...
```

## Documentation/devicetree/bindings/nvmem/xlnx,zynqmp-nvmem.yaml
```yaml
# SPDX-License-Identifier: (GPL-2.0-only OR BSD-2-Clause)
%YAML 1.2
---
$id: http://devicetree.org/schemas/nvmem/xlnx,zynqmp-nvmem.yaml#
$schema: http://devicetree.org/meta-schemas/core.yaml#

title: Zynq UltraScale+ MPSoC Non Volatile Memory interface

description: |
    The ZynqMP MPSoC provides access to the hardware related data
    like SOC revision, IDCODE and specific purpose efuses.

maintainers:
  - Kalyani Akula <kalyani.akula@amd.com>
  - Praveen Teja Kundanala <praveen.teja.kundanala@amd.com>

allOf:
  - $ref: "nvmem.yaml#"

properties:
  compatible:
    const: xlnx,zynqmp-nvmem-fw

  '#address-cells':
    const: 1

  '#size-cells':
    const: 1

required:
  - compatible

patternProperties:
  "^soc_revision@0$":
    type: object
    description:
      This node is used to read SOC version and IDCODE of ZynqMP. Read-only.

    properties:
      reg:
        maxItems: 1

    required:
      - reg

  "^efuse_dna@c$":
    type: object
    description:
      This node is used to read DNA of ZynqMP SOC. Read-only.

    properties:
      reg:
        maxItems: 1

    required:
      - reg

  "^efuse_usr(0@20|1@24|2@28|3@2c|4@30|5@34|6@38|7@3c)$":
    type: object
    description:
      Eight 32-bit user efuses. Read and Write is supported.

    properties:
      reg:
        maxItems: 1

    required:
      - reg

  "^efuse_miscusr@40$":
    type: object
    description:
      32-bit MISC user efuse space. Read and Write is supported.

    properties:
      reg:
        maxItems: 1

    required:
      - reg

  "^efuse_chash@50$":
    type: object
    description:
      32-bit PUF chash space. Read and Write is supported.

    properties:
      reg:
        maxItems: 1

    required:
      - reg

  "^efuse_pufmisc@54$":
    type: object
    description:
      32-bit PUF MISC control space. Read and Write is supported.

    properties:
      reg:
        maxItems: 1

    required:
      - reg

  "^efuse_sec@58$":
    type: object
    description:
      32-bit secure control space. Read and Write is supported.

    properties:
      reg:
        maxItems: 1

    required:
      - reg

  "^efuse_spkid@5c$":
    type: object
    description:
      32-bit SPK ID. Read and Write is supported.

    properties:
      reg:
        maxItems: 1

    required:
      - reg

  "^efuse_aeskey@60$":
    type: object
    description:
      256-bit aes key. Only Write is supported.

    properties:
      reg:
        maxItems: 1

    required:
      - reg

  "^efuse_ppk0hash@a0$":
    type: object
    description:
      384-bit PPK0 hash. Read and Write is supported.

    properties:
      reg:
        maxItems: 1

    required:
      - reg

  "^efuse_ppk1hash@d0$":
    type: object
    description:
      384-bit PPK1 hash. Read and Write is supported.

    properties:
      reg:
        maxItems: 1

    required:
      - reg

  "^efuse_pufuser@100$":
    type: object
    description:
      This node represents the 127(0x7F) 32-bit PUF(Physical Unclonable Function)
      helper data efuses which are repurposed as user fuses.
      Read and Write is supported.

    properties:
      reg:
        maxItems: 1

    required:
      - reg

additionalProperties: false

examples:
  - |
    nvmem_firmware {
        compatible = "xlnx,zynqmp-nvmem-fw";
        #address-cells = <1>;
        #size-cells = <1>;

        /* Data cells */
        soc_revision: soc_revision@0 {
            reg = <0x0 0x4>;
        };
        /*
        * efuse memory access:
        * all the efuse fields need to be read
        * with the exact size specified in the node
        */
        /* DNA */
        efuse_dna: efuse_dna@c {
            reg = <0xc 0xc>;
        };
        /* User 0 */
        efuse_usr0: efuse_usr0@20 {
            reg = <0x20 0x4>;
        };
        /* User 1 */
        efuse_usr1: efuse_usr1@24 {
            reg = <0x24 0x4>;
        };
        /* User 2 */
        efuse_usr2: efuse_usr2@28 {
            reg = <0x28 0x4>;
        };
        /* User 3 */
        efuse_usr3: efuse_usr3@2c {
            reg = <0x2c 0x4>;
        };
        /* User 4 */
        efuse_usr4: efuse_usr4@30 {
            reg = <0x30 0x4>;
        };
        /* User 5 */
        efuse_usr5: efuse_usr5@34 {
            reg = <0x34 0x4>;
        };
        /* User 6 */
        efuse_usr6: efuse_usr6@38 {
            reg = <0x38 0x4>;
        };
        /* User 7 */
        efuse_usr7: efuse_usr7@3c {
            reg = <0x3c 0x4>;
        };
        /* Misc user control bits */
        efuse_miscusr: efuse_miscusr@40 {
            reg = <0x40 0x4>;
        };
        /* PUF chash */
        efuse_chash: efuse_chash@50 {
            reg = <0x50 0x4>;
        };
        /* PUF misc */
        efuse_pufmisc: efuse_pufmisc@54 {
            reg = <0x54 0x4>;
        };
        /* SEC_CTRL */
        efuse_sec: efuse_sec@58 {
            reg = <0x58 0x4>;
        };
        /* SPK ID */
        efuse_spkid: efuse_spkid@5c {
            reg = <0x5c 0x4>;
        };
        /* AES Key */
        efuse_aeskey: efuse_aeskey@60 {
            reg = <0x60 0x20>;
        };
        /* PPK0 hash */
        efuse_ppk0hash: efuse_ppk0hash@a0 {
            reg = <0xa0 0x30>;
        };
        /* PPK1 hash */
        efuse_ppk1hash: efuse_ppk1hash@d0 {
            reg = <0xd0 0x30>;
        };
        /* PUF user fuses */
        efuse_pufuser: efuse_pufuser@100  {
            reg = <0x100 0x7F>;
        };
    };
```
