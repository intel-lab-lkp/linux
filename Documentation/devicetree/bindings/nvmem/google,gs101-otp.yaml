## Documentation/devicetree/bindings/pci/qcom,qcs615-pcie.yaml
```yaml
# SPDX-License-Identifier: (GPL-2.0-only OR BSD-2-Clause)
%YAML 1.2
---
$id: http://devicetree.org/schemas/pci/qcom,qcs615-pcie.yaml#
$schema: http://devicetree.org/meta-schemas/core.yaml#

title: Qualcomm QCS615 PCI Express Root Complex

maintainers:
  - Bjorn Andersson <andersson@kernel.org>
  - Manivannan Sadhasivam <manivannan.sadhasivam@linaro.org>

description:
  Qualcomm QCS615 SoC (and compatible) PCIe root complex controller is based on
  the Synopsys DesignWare PCIe IP.

properties:
  compatible:
    const: qcom,qcs615-pcie

  reg:
    minItems: 6
    maxItems: 6

  reg-names:
    items:
      - const: parf # Qualcomm specific registers
      - const: dbi # DesignWare PCIe registers
      - const: elbi # External local bus interface registers
      - const: atu # ATU address space
      - const: config # PCIe configuration space
      - const: mhi # MHI registers

  clocks:
    minItems: 6
    maxItems: 6

  clock-names:
    items:
      - const: aux # Auxiliary clock
      - const: cfg # Configuration clock
      - const: bus_master # Master AXI clock
      - const: bus_slave # Slave AXI clock
      - const: slave_q2a # Slave Q2A clock
      - const: ref # REFERENCE clock

  interrupts:
    minItems: 9
    maxItems: 9

  interrupt-names:
    items:
      - const: msi0
      - const: msi1
      - const: msi2
      - const: msi3
      - const: msi4
      - const: msi5
      - const: msi6
      - const: msi7
      - const: global

  resets:
    maxItems: 1

  reset-names:
    items:
      - const: pci # PCIe core reset

allOf:
  - $ref: qcom,pcie-common.yaml#

unevaluatedProperties: false

examples:
  - |
    #include <dt-bindings/clock/qcom,qcs615-gcc.h>
    #include <dt-bindings/gpio/gpio.h>
    #include <dt-bindings/interconnect/qcom,qcs615-rpmh.h>
    #include <dt-bindings/interrupt-controller/arm-gic.h>

    soc {
        #address-cells = <2>;
        #size-cells = <2>;

        pcie@1c08000 {
            compatible = "qcom,qcs615-pcie";
            reg = <0 0x01c08000 0 0x3000>,
                  <0 0x40000000 0 0xf1d>,
                  <0 0x40000f20 0 0xa8>,
                  <0 0x40001000 0 0x1000>,
                  <0 0x40100000 0 0x100000>,
                  <0 0x01c0b000 0 0x1000>;
            reg-names = "parf", "dbi", "elbi", "atu", "config", "mhi";
            ranges = <0x01000000 0x0 0x00000000 0x0 0x40200000 0x0 0x100000>,
                     <0x02000000 0x0 0x40300000 0x0 0x40300000 0x0 0x3d00000>;

            bus-range = <0x00 0xff>;
            device_type = "pci";
            linux,pci-domain = <0>;
            num-lanes = <1>;

            #address-cells = <3>;
            #size-cells = <2>;

            clocks = <&gcc GCC_PCIE_0_AUX_CLK>,
                     <&gcc GCC_PCIE_0_CFG_AHB_CLK>,
                     <&gcc GCC_PCIE_0_MSTR_AXI_CLK>,
                     <&gcc GCC_PCIE_0_SLV_AXI_CLK>,
                     <&gcc GCC_PCIE_0_SLV_Q2A_AXI_CLK>,
                     <&rpmhcc RPMH_CXO_CLK>;
            clock-names = "aux",
                          "cfg",
                          "bus_master",
                          "bus_slave",
                          "slave_q2a",
                          "ref";

            dma-coherent;

            interrupts = <GIC_SPI 141 IRQ_TYPE_LEVEL_HIGH>,
                         <GIC_SPI 142 IRQ_TYPE_LEVEL_HIGH>,
                         <GIC_SPI 143 IRQ_TYPE_LEVEL_HIGH>,
                         <GIC_SPI 144 IRQ_TYPE_LEVEL_HIGH>,
                         <GIC_SPI 145 IRQ_TYPE_LEVEL_HIGH>,
                         <GIC_SPI 146 IRQ_TYPE_LEVEL_HIGH>,
                         <GIC_SPI 147 IRQ_TYPE_LEVEL_HIGH>,
                         <GIC_SPI 148 IRQ_TYPE_LEVEL_HIGH>,
                         <GIC_SPI 140 IRQ_TYPE_LEVEL_HIGH>;
            interrupt-names = "msi0", "msi1", "msi2", "msi3",
                              "msi4", "msi5", "msi6", "msi7", "global";
            #interrupt-cells = <1>;
            interrupt-map-mask = <0 0 0 0x7>;
            interrupt-map = <0 0 0 1 &intc 0 0 0 149 IRQ_TYPE_LEVEL_HIGH>, /* int_a */
                            <0 0 0 2 &intc 0 0 0 150 IRQ_TYPE_LEVEL_HIGH>, /* int_b */
                            <0 0 0 3 &intc 0 0 0 151 IRQ_TYPE_LEVEL_HIGH>, /* int_c */
                            <0 0 0 4 &intc 0 0 0 152 IRQ_TYPE_LEVEL_HIGH>; /* int_d */

            interconnects = <&agree1_noc MASTER_PCIE 0 &mc_virt SLAVE_EBI1 0>,
                            <&gem_noc MASTER_APPSS_PROC 0 &cnoc_main SLAVE_PCIE_0 0>;
            interconnect-names = "pcie-mem", "cpu-pcie";

            iommu-map = <0x0 &apps_smmu 0x400 0x1>,
                        <0x100 &apps_smmu 0x401 0x1>;

            phys = <&pcie_phy>;
            phy-names = "pciephy";

            pinctrl-0 = <&pcie_default_state>;
            pinctrl-names = "default";

            power-domains = <&gcc PCIE_0_GDSC>;

            resets = <&gcc GCC_PCIE_0_BCR>;
            reset-names = "pci";

            perst-gpios = <&tlmm 101 GPIO_ACTIVE_LOW>;
            wake-gpios = <&tlmm 100 GPIO_ACTIVE_HIGH>;
        };
    };
```

## Documentation/devicetree/bindings/pci/renesas,pci-sh7751.yaml
```yaml
# SPDX-License-Identifier: (GPL-2.0-only OR BSD-2-Clause)
%YAML 1.2
---
$id: http://devicetree.org/schemas/pci/renesas,pci-sh7751.yaml#
$schema: http://devicetree.org/meta-schemas/core.yaml#

title: Renesas SH7751 PCI Host controller

maintainers:
  - Yoshinori Sato <ysato@users.sourceforge.jp>

allOf:
  - $ref: /schemas/pci/pci-bus.yaml#

properties:
  compatible:
    items:
      - enum:
          - renesas,pci-sh7751

  reg:
    minItems: 3

  "#interrupt-cells":
    const: 1

  "#address-cells":
    const: 3

  "#size-cells":
    const: 2

  ranges:
    description: |
      The PCI bus memory area and I/O area.

  interrupt-controller: true

  renesas,bcr1:
    $ref: /schemas/types.yaml#/definitions/uint32
    description: |
      SH7751 PCIC PCIBCR1 value. This value makes add the value of BSC's BCR1.

  renesas,mcrmask:
    $ref: /schemas/types.yaml#/definitions/uint32
    description: |
      SH7751 PCIC PCIMCR value. This value makes clear bit in the value of BSC's MCR.

  renesas,intm:
    $ref: /schemas/types.yaml#/definitions/uint32
    description: |
      SH7751 PCIC PCIINTM value.

  renesas,aintm:
    $ref: /schemas/types.yaml#/definitions/uint32
    description: |
      SH7751 PCIC PCIIANTM value.

  renesas,lsr:
    $ref: /schemas/types.yaml#/definitions/uint32
    description: |
      SH7751 PCIC PCILSR0 and PCILSR1 values.
      First word is PCILSR0, Second word is PCILSR1.

  renesas,lar:
    $ref: /schemas/types.yaml#/definitions/uint32
    description: |
      SH7751 PCIC PCILSA0 and PCILAR1 values.
      First word is PCILAR0, Second word is PCILAR1.

  renesas,dmabt:
    $ref: /schemas/types.yaml#/definitions/uint32
    description: |
      SH7751 PCIC PCIDMABT value.

  renesas,pintm:
    $ref: /schemas/types.yaml#/definitions/uint32
    description: |
      SH7751 PCIC PCIPINTM value.

  renesas,config:
    $ref: /schemas/types.yaml#/definitions/uint32-array
    description: |
      SH7751 PCIC PCICONFIG values array. Register Number and value pair list.

required:
  - compatible
  - reg
  - "#interrupt-cells"
  - "#address-cells"
  - "#size-cells"
  - ranges
  - interrupt-map
  - interrupt-map-mask

unevaluatedProperties: false

examples:
  - |
        pci@fe200000 {
                compatible = "renesas,pci-sh7751";
                #address-cells = <3>;
                #size-cells = <2>;
                ranges = <0x02000000 0 0xfd000000 0xfd000000 0 0x01000000>,
                         <0x01000000 0 0x00000000 0xfe240000 0 0x00040000>;
                reg = <0xfe200000 0x0400>,
                      <0x0c000000 0x04000000>,
                      <0xff800000 0x0030>;
                #interrupt-cells = <1>;
                interrupt-map = <0x0000 0 0 1 &julianintc 5>,
                                <0x0000 0 0 2 &julianintc 6>,
                                <0x0000 0 0 3 &julianintc 7>,
                                <0x0000 0 0 4 &julianintc 8>,
                                <0x0800 0 0 1 &julianintc 6>,
                                <0x0800 0 0 2 &julianintc 7>,
                                <0x0800 0 0 3 &julianintc 8>,
                                <0x0800 0 0 4 &julianintc 5>,
                                <0x1000 0 0 1 &julianintc 7>,
                                <0x1000 0 0 2 &julianintc 8>,
                                <0x1000 0 0 3 &julianintc 5>,
                                <0x1000 0 0 4 &julianintc 6>;
                interrupt-map-mask = <0x1800 0 0 7>;
        };
```
