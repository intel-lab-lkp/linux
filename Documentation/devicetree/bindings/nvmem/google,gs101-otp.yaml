## Documentation/devicetree/bindings/opp/ti,omap-opp-supply.yaml
```yaml
# SPDX-License-Identifier: (GPL-2.0-only OR BSD-2-Clause)
%YAML 1.2
---
$id: http://devicetree.org/schemas/opp/ti,omap-opp-supply.yaml#
$schema: http://devicetree.org/meta-schemas/core.yaml#

title: Texas Instruments OMAP compatible OPP supply

description:
  OMAP5, DRA7, and AM57 family of SoCs have Class0 AVS eFuse registers which
  contain data that can be used to adjust voltages programmed for some of their
  supplies for more efficient operation. This binding provides the information
  needed to read these values and use them to program the main regulator during
  an OPP transitions.

  Also, some supplies may have an associated vbb-supply which is an Adaptive Body
  Bias regulator which much be transitioned in a specific sequence with regards
  to the vdd-supply and clk when making an OPP transition. By supplying two
  regulators to the device that will undergo OPP transitions we can make use
  of the multi regulator binding that is part of the OPP core described
  to describe both regulators needed by the platform.

maintainers:
  - Nishanth Menon <nm@ti.com>

properties:
  $nodename:
    pattern: '^opp-supply(@[0-9a-f]+)?$'

  compatible:
    oneOf:
      - description: Basic OPP supply controlling VDD and VBB
        items:
          - const: ti,omap-opp-supply
      - description: OMAP5+ optimized voltages in efuse(Class 0) VDD along with
          VBB.
        items:
          - const: ti,omap5-opp-supply
      - description: OMAP5+ optimized voltages in efuse(class0) VDD but no VBB
        items:
          - const: ti,omap5-core-opp-supply

  reg:
    maxItems: 1

  ti,absolute-max-voltage-uv:
    $ref: /schemas/types.yaml#/definitions/uint32
    description: Absolute maximum voltage for the OPP supply in micro-volts.
    minimum: 750000
    maximum: 1500000

  ti,efuse-settings:
    description: An array of u32 tuple items providing information about
      optimized efuse configuration.
    minItems: 1
    $ref: /schemas/types.yaml#/definitions/uint32-matrix
    items:
      items:
        -
          description: Reference voltage in micro-volts (OPP Voltage)
          minimum: 750000
          maximum: 1500000
          multipleOf: 10000
        -
          description: efuse offset where the optimized voltage is located
          multipleOf: 4
          maximum: 256

required:
  - compatible
  - ti,absolute-max-voltage-uv

allOf:
  - if:
      not:
        properties:
          compatible:
            contains:
              const: ti,omap-opp-supply
    then:
      required:
        - reg
        - ti,efuse-settings

additionalProperties: false

examples:
  - |
    opp-supply {
        compatible = "ti,omap-opp-supply";
        ti,absolute-max-voltage-uv = <1375000>;
    };
  - |
    opp-supply@4a003b20 {
        compatible = "ti,omap5-opp-supply";
        reg = <0x4a003b20 0x8>;
        ti,efuse-settings =
            /* uV   offset */
            <1060000 0x0>,
            <1160000 0x4>,
            <1210000 0x8>;
        ti,absolute-max-voltage-uv = <1500000>;
    };
```

## Documentation/devicetree/bindings/pci/andestech,qilai-pcie.yaml
```yaml
# SPDX-License-Identifier: (GPL-2.0-only OR BSD-2-Clause)
%YAML 1.2
---
$id: http://devicetree.org/schemas/pci/andestech,qilai-pcie.yaml#
$schema: http://devicetree.org/meta-schemas/core.yaml#

title: Andes QiLai PCIe host controller

description: |+
  Andes QiLai PCIe host controller is based on the Synopsys DesignWare
  PCI core. It shares common features with the PCIe DesignWare core and
  inherits common properties defined in
  Documentation/devicetree/bindings/pci/snps,dw-pcie.yaml.

maintainers:
  - Randolph Lin <randolph@andestech.com>

allOf:
  - $ref: /schemas/pci/snps,dw-pcie.yaml#

properties:
  compatible:
    const: andestech,qilai-pcie

  reg:
    items:
      - description: Data Bus Interface (DBI) registers.
      - description: APB registers.
      - description: PCIe configuration space region.

  reg-names:
    items:
      - const: dbi
      - const: apb
      - const: config

  ranges:
    maxItems: 2

  interrupts:
    maxItems: 1

  "#interrupt-cells":
    const: 1

  interrupt-map: true

required:
  - reg
  - reg-names
  - "#interrupt-cells"
  - interrupts
  - interrupt-names
  - interrupt-map-mask
  - interrupt-map

unevaluatedProperties: false

examples:
  - |
    #include <dt-bindings/interrupt-controller/irq.h>

    soc {
      #address-cells = <2>;
      #size-cells = <2>;

      bus@80000000 {
        compatible = "simple-bus";
        #address-cells = <2>;
        #size-cells = <2>;
        dma-ranges = <0x44 0x00000000 0x04 0x00000000 0x04 0x00000000>;
        ranges = <0x00 0x80000000 0x00 0x80000000 0x00 0x20000000>,
                 <0x00 0x04000000 0x00 0x04000000 0x00 0x00001000>,
                 <0x00 0x00000000 0x20 0x00000000 0x20 0x00000000>;

        pci@80000000 {
          compatible = "andestech,qilai-pcie";
          device_type = "pci";
          reg = <0x0 0x80000000 0x0 0x20000000>,
                <0x0 0x04000000 0x0 0x00001000>,
                <0x0 0x00000000 0x0 0x00010000>;
          reg-names = "dbi", "apb", "config";

          bus-range = <0x0 0xff>;
          num-viewport = <4>;
          #address-cells = <3>;
          #size-cells = <2>;
          ranges = <0x02000000 0x00 0x10000000 0x00 0x10000000 0x0 0xf0000000>,
                   <0x43000000 0x01 0x00000000 0x01 0x0000000 0x1f 0x00000000>;

          #interrupt-cells = <1>;
          interrupts = <0xf>;
          interrupt-names = "msi";
          interrupt-parent = <&plic0>;
          interrupt-map-mask = <0 0 0 7>;
          interrupt-map = <0 0 0 1 &plic0 0xf IRQ_TYPE_LEVEL_HIGH>,
                          <0 0 0 2 &plic0 0xf IRQ_TYPE_LEVEL_HIGH>,
                          <0 0 0 3 &plic0 0xf IRQ_TYPE_LEVEL_HIGH>,
                          <0 0 0 4 &plic0 0xf IRQ_TYPE_LEVEL_HIGH>;
        };
      };
    };
```

## Documentation/devicetree/bindings/pci/aspeed,ast2600-pcie.yaml
```yaml
# SPDX-License-Identifier: (GPL-2.0-only OR BSD-2-Clause)
%YAML 1.2
---
$id: http://devicetree.org/schemas/pci/aspeed,ast2600-pcie.yaml#
$schema: http://devicetree.org/meta-schemas/core.yaml#

title: ASPEED PCIe Root Complex Controller

maintainers:
  - Jacky Chou <jacky_chou@aspeedtech.com>

description:
  The ASPEED PCIe Root Complex controller provides PCI Express Root Complex
  functionality for ASPEED SoCs, such as the AST2600 and AST2700.
  This controller enables connectivity to PCIe endpoint devices, supporting
  memory and I/O windows, MSI and legacy interrupts, and integration with
  the SoC's clock, reset, and pinctrl subsystems.

properties:
  compatible:
    enum:
      - aspeed,ast2600-pcie
      - aspeed,ast2700-pcie

  reg:
    maxItems: 1

  ranges:
    minItems: 2
    maxItems: 2

  interrupts:
    maxItems: 1
    description: IntX and MSI interrupt

  resets:
    items:
      - description: PCIe controller reset

  reset-names:
    items:
      - const: h2x

  msi-parent: true

  aspeed,ahbc:
    $ref: /schemas/types.yaml#/definitions/phandle
    description:
      Phandle to the ASPEED AHB Controller (AHBC) syscon node.
      This reference is used by the PCIe controller to access
      system-level configuration registers related to the AHB bus.
      To enable AHB access for the PCIe controller.

  aspeed,pciecfg:
    $ref: /schemas/types.yaml#/definitions/phandle
    description:
      Phandle to the ASPEED PCIe configuration syscon node.
      This reference allows the PCIe controller to access
      SoC-specific PCIe configuration registers. There are the others
      functions such PCIe RC and PCIe EP will use this common register
      to configure the SoC interfaces.

  aspeed,pciephy:
    $ref: /schemas/types.yaml#/definitions/phandle
    description:
      Phandle to the ASPEED PCIe PHY syscon node.
      This property provides access to the PCIe PHY control
      registers required for link initialization and management.
      The other functions such PCIe RC and PCIe EP will use this
      common register to configure the PHY interfaces and get some
      information from the PHY.

  interrupt-controller:
    description: Interrupt controller node for handling legacy PCI interrupts.
    type: object
    properties:
      '#address-cells':
        const: 0
      '#interrupt-cells':
        const: 1
      interrupt-controller: true

    required:
      - '#address-cells'
      - '#interrupt-cells'
      - interrupt-controller

    additionalProperties: false

allOf:
  - $ref: /schemas/pci/pci-bus-common.yaml#
  - $ref: /schemas/pci/pci-host-bridge.yaml#
  - $ref: /schemas/interrupt-controller/msi-controller.yaml#
  - if:
      properties:
        compatible:
          contains:
            const: aspeed,ast2600-pcie
    then:
      required:
        - aspeed,ahbc
    else:
      properties:
        aspeed,ahbc: false

required:
  - reg
  - interrupts
  - bus-range
  - ranges
  - resets
  - reset-names
  - msi-parent
  - msi-controller
  - aspeed,pciecfg
  - interrupt-map-mask
  - interrupt-map
  - interrupt-controller

unevaluatedProperties: false

patternProperties:
  "^pcie@[0-9a-f,]+$":
    type: object
    properties:
      resets:
        items:
          - description: PCIe PERST
      reset-names:
        items:
          - const: perst
      clocks:
        maxItems: 1
        description: PCIe BUS clock
    required:
      - resets
      - reset-names
      - clocks
      - aspeed,pciephy

examples:
  - |
    #include <dt-bindings/interrupt-controller/arm-gic.h>
    #include <dt-bindings/clock/ast2600-clock.h>

    apb {
      #address-cells = <1>;
      #size-cells = <1>;

      pcie0: pcie@1e7700c0 {
        compatible = "aspeed,ast2600-pcie";
        device_type = "pci";
        reg = <0x1e7700c0 0x40>;
        linux,pci-domain = <0>;
        #address-cells = <3>;
        #size-cells = <2>;
        interrupts = <GIC_SPI 168 IRQ_TYPE_LEVEL_HIGH>;
        bus-range = <0x80 0xff>;

        ranges = <0x01000000 0x0 0x00018000 0x00018000 0x0 0x00008000
                  0x02000000 0x0 0x70000000 0x70000000 0x0 0x10000000>;

        resets = <&syscon ASPEED_RESET_H2X>;
        reset-names = "h2x";

        #interrupt-cells = <1>;
        msi-parent = <&pcie0>;
        msi-controller;

        aspeed,ahbc = <&ahbc>;
        aspeed,pciecfg = <&pcie_cfg>;

        interrupt-map-mask = <0 0 0 7>;
        interrupt-map = <0 0 0 1 &pcie_intc0 0>,
                        <0 0 0 2 &pcie_intc0 1>,
                        <0 0 0 3 &pcie_intc0 2>,
                        <0 0 0 4 &pcie_intc0 3>;
        pcie_intc0: interrupt-controller {
          interrupt-controller;
          #address-cells = <0>;
          #interrupt-cells = <1>;
        };

        pcie@8,0 {
          reg = <0x804000 0 0 0 0>;
          #address-cells = <3>;
          #size-cells = <2>;
          device_type = "pci";
          resets = <&syscon ASPEED_RESET_PCIE_RC_O>;
          reset-names = "perst";
          clocks = <&syscon ASPEED_CLK_GATE_BCLK>;
          pinctrl-names = "default";
          pinctrl-0 = <&pinctrl_pcierc1_default>;
          aspeed,pciephy = <&pcie_phy1>;
          ranges;
        };
      };
    };
```

## Documentation/devicetree/bindings/pci/cix,sky1-pcie-host.yaml
```yaml
# SPDX-License-Identifier: (GPL-2.0 OR BSD-2-Clause)
%YAML 1.2
---
$id: http://devicetree.org/schemas/pci/cix,sky1-pcie-host.yaml#
$schema: http://devicetree.org/meta-schemas/core.yaml#

title: CIX Sky1 PCIe Root Complex

maintainers:
  - Hans Zhang <hans.zhang@cixtech.com>

description:
  PCIe root complex controller based on the Cadence PCIe core.

allOf:
  - $ref: /schemas/pci/pci-host-bridge.yaml#
  - $ref: /schemas/pci/cdns-pcie.yaml#

properties:
  compatible:
    oneOf:
      - const: cix,sky1-pcie-host

  reg:
    items:
      - description: PCIe controller registers.
      - description: Remote CIX System Unit registers.
      - description: ECAM registers.
      - description: Region for sending messages registers.

  reg-names:
    items:
      - const: reg
      - const: rcsu
      - const: cfg
      - const: msg

  "#interrupt-cells":
    const: 1

  interrupt-map-mask:
    items:
      - const: 0
      - const: 0
      - const: 0
      - const: 7

  interrupt-map:
    maxItems: 4

  max-link-speed:
    maximum: 4

  num-lanes:
    maximum: 8

  ranges:
    maxItems: 3

  msi-map:
    maxItems: 1

  vendor-id:
    const: 0x1f6c

  device-id:
    enum:
      - 0x0001

  cdns,no-inbound-bar:
    description: |
      Indicates the PCIe controller does not require an inbound BAR region.
    type: boolean

  sky1,pcie-ctrl-id:
    description: |
      Specifies the PCIe controller instance identifier (0-4).
    $ref: /schemas/types.yaml#/definitions/uint32
    minimum: 0
    maximum: 4

required:
  - compatible
  - reg
  - reg-names
  - "#interrupt-cells"
  - interrupt-map-mask
  - interrupt-map
  - max-link-speed
  - num-lanes
  - bus-range
  - device_type
  - ranges
  - msi-map
  - vendor-id
  - device-id
  - cdns,no-inbound-bar
  - sky1,pcie-ctrl-id

unevaluatedProperties: false

examples:
  - |
    #include <dt-bindings/gpio/gpio.h>

    pcie_x8_rc: pcie@a010000 {
        compatible = "cix,sky1-pcie-host";
        reg = <0x00 0x0a010000 0x00 0x10000>,
              <0x00 0x0a000000 0x00 0x10000>,
              <0x00 0x2c000000 0x00 0x4000000>,
              <0x00 0x60000000 0x00 0x00100000>;
        reg-names = "reg", "rcsu", "cfg", "msg";
        #interrupt-cells = <1>;
        interrupt-map-mask = <0 0 0 0x7>;
        interrupt-map = <0 0 0 1 &gic 0 0 GIC_SPI 407 IRQ_TYPE_LEVEL_HIGH 0>,
                        <0 0 0 2 &gic 0 0 GIC_SPI 408 IRQ_TYPE_LEVEL_HIGH 0>,
                        <0 0 0 3 &gic 0 0 GIC_SPI 409 IRQ_TYPE_LEVEL_HIGH 0>,
                        <0 0 0 4 &gic 0 0 GIC_SPI 410 IRQ_TYPE_LEVEL_HIGH 0>;
        max-link-speed = <4>;
        num-lanes = <8>;
        #address-cells = <3>;
        #size-cells = <2>;
        bus-range = <0xc0 0xff>;
        device_type = "pci";
        ranges = <0x01000000 0x00 0x60100000 0x00 0x60100000 0x00 0x00100000>,
                 <0x02000000 0x00 0x60200000 0x00 0x60200000 0x00 0x1fe00000>,
                 <0x43000000 0x18 0x00000000 0x18 0x00000000 0x04 0x00000000>;
        msi-map = <0xc000 &gic_its 0xc000 0x4000>;
        vendor-id = <0x1f6c>;
        device-id = <0x0001>;
        sky1,pcie-ctrl-id = <0x0>;
        cdns,no-inbound-bar;
    };
```
