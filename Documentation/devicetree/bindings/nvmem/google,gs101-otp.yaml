## Documentation/devicetree/bindings/pci/eswin,eic7700-pcie.yaml
```yaml
# SPDX-License-Identifier: (GPL-2.0-only OR BSD-2-Clause)
%YAML 1.2
---
$id: http://devicetree.org/schemas/pci/eswin,eic7700-pcie.yaml#
$schema: http://devicetree.org/meta-schemas/core.yaml#

title: Eswin EIC7700 PCIe host controller

maintainers:
  - Yu Ning <ningyu@eswincomputing.com>
  - Senchuan Zhang <zhangsenchuan@eswincomputing.com>
  - Yanghui Ou <ouyanghui@eswincomputing.com>

description:
  The PCIe controller on EIC7700 SoC.

allOf:
  - $ref: /schemas/pci/pci-host-bridge.yaml#

properties:
  compatible:
    const: eswin,eic7700-pcie

  reg:
    maxItems: 3

  reg-names:
    items:
      - const: dbi
      - const: config
      - const: mgmt

  ranges:
    maxItems: 3

  num-lanes:
    maximum: 4

  '#interrupt-cells':
    const: 1

  interrupts:
    maxItems: 9

  interrupt-names:
    items:
      - const: msi
      - const: inta # Assert_INTA
      - const: intb # Assert_INTB
      - const: intc # Assert_INTC
      - const: intd # Assert_INTD
      - const: inte # Desassert_INTA
      - const: intf # Desassert_INTB
      - const: intg # Desassert_INTC
      - const: inth # Desassert_INTD

  interrupt-map:
    maxItems: 4

  interrupt-map-mask:
    items:
      - const: 0
      - const: 0
      - const: 0
      - const: 7

  clocks:
    maxItems: 4

  clock-names:
    items:
      - const: mstr
      - const: dbi
      - const: pclk
      - const: aux

  resets:
    maxItems: 2

  reset-names:
    items:
      - const: cfg
      - const: powerup

patternProperties:
  "^pcie@":
    type: object
    $ref: /schemas/pci/pci-pci-bridge.yaml#

    properties:
      reg:
        maxItems: 1

      resets:
        maxItems: 1

      reset-names:
        items:
          - const: perst

    required:
      - reg
      - ranges
      - resets
      - reset-names

    unevaluatedProperties: false

required:
  - compatible
  - reg
  - ranges
  - interrupts
  - interrupt-names
  - interrupt-map-mask
  - interrupt-map
  - '#interrupt-cells'
  - clocks
  - clock-names
  - resets
  - reset-names

unevaluatedProperties: false

examples:
  - |
    soc {
        #address-cells = <2>;
        #size-cells = <2>;

        pcie@54000000 {
            compatible = "eswin,eic7700-pcie";
            reg = <0x0 0x54000000 0x0 0x4000000>,
                  <0x0 0x40000000 0x0 0x800000>,
                  <0x0 0x50000000 0x0 0x100000>;
            reg-names = "dbi", "config", "mgmt";
            #address-cells = <3>;
            #size-cells = <2>;
            #interrupt-cells = <1>;
            ranges = <0x01000000 0x0 0x40800000 0x0 0x40800000 0x0 0x800000>,
                     <0x02000000 0x0 0x41000000 0x0 0x41000000 0x0 0xf000000>,
                     <0x43000000 0x80 0x00000000 0x80 0x00000000 0x2 0x00000000>;
            bus-range = <0x00 0xff>;
            clocks = <&clock 203>,
                     <&clock 204>,
                     <&clock 205>,
                     <&clock 206>;
            clock-names = "mstr", "dbi", "pclk", "aux";
            resets = <&reset 97>,
                     <&reset 98>;
            reset-names = "cfg", "powerup";
            interrupts = <220>, <179>, <180>, <181>, <182>, <183>, <184>, <185>, <186>;
            interrupt-names = "msi", "inta", "intb", "intc", "intd",
                              "inte", "intf", "intg", "inth";
            interrupt-parent = <&plic>;
            interrupt-map-mask = <0x0 0x0 0x0 0x7>;
            interrupt-map = <0x0 0x0 0x0 0x1 &plic 179>,
                            <0x0 0x0 0x0 0x2 &plic 180>,
                            <0x0 0x0 0x0 0x3 &plic 181>,
                            <0x0 0x0 0x0 0x4 &plic 182>;
            device_type = "pci";
            pcie@0 {
                reg = <0x0 0x0 0x0 0x0 0x0>;
                #address-cells = <3>;
                #size-cells = <2>;
                ranges;
                device_type = "pci";
                num-lanes = <4>;
                resets = <&reset 99>;
                reset-names = "perst";
            };
        };
    };
```

## Documentation/devicetree/bindings/pci/fsl,mpc8xxx-pci.yaml
```yaml
# SPDX-License-Identifier: (GPL-2.0-only OR BSD-2-Clause)
%YAML 1.2
---

$id: http://devicetree.org/schemas/pci/fsl,mpc8xxx-pci.yaml#
$schema: http://devicetree.org/meta-schemas/core.yaml#

title: Freescale MPC83xx PCI/PCI-X/PCIe controllers

description: |
  Binding for the PCI/PCI-X/PCIe host bridges on MPC8xxx SoCs.
  See also: Documentation/devicetree/bindings/pci/fsl,pci.txt

maintainers:
  - J. Neuschäfer <j.neuschaefer@gmx.net>

allOf:
  - $ref: /schemas/pci/pci-host-bridge.yaml#

properties:
  compatible:
    oneOf:
      - items:
          - enum:
              - fsl,mpc8308-pcie
              - fsl,mpc8315-pcie
              - fsl,mpc8377-pcie
              - fsl,mpc8378-pcie
          - const: fsl,mpc8314-pcie
      - const: fsl,mpc8314-pcie
      - items:
          - const: fsl,mpc8360-pci
          - const: fsl,mpc8349-pci
      - const: fsl,mpc8349-pci
      - items:
          - const: fsl,mpc8540-pcix
          - const: fsl,mpc8540-pci
      - const: fsl,mpc8540-pci
      - items:
          - const: fsl,mpc8540-pcix
          - const: fsl,mpc8540-pci
      - const: fsl,mpc8548-pcie
      - const: fsl,mpc8548-pcie
      - const: fsl,mpc8641-pcie

  reg:
    minItems: 1
    items:
      - description: internal registers
      - description: config space access registers

  clock-frequency:
    $ref: /schemas/types.yaml#/definitions/uint32

required:
  - reg
  - compatible

unevaluatedProperties: false

examples:
  - |
    #include <dt-bindings/interrupt-controller/irq.h>

    pci1: pcie@e0009000 {
        #address-cells = <3>;
        #size-cells = <2>;
        #interrupt-cells = <1>;
        device_type = "pci";
        compatible = "fsl,mpc8315-pcie", "fsl,mpc8314-pcie";
        reg = <0xe0009000 0x00001000>;
        ranges = <0x02000000 0 0xa0000000 0xa0000000 0 0x10000000
                  0x01000000 0 0x00000000 0xb1000000 0 0x00800000>;
        bus-range = <0 255>;
        interrupt-map-mask = <0xf800 0 0 7>;
        interrupt-map = <0 0 0 1 &ipic 1 IRQ_TYPE_LEVEL_LOW
                         0 0 0 2 &ipic 1 IRQ_TYPE_LEVEL_LOW
                         0 0 0 3 &ipic 1 IRQ_TYPE_LEVEL_LOW
                         0 0 0 4 &ipic 1 IRQ_TYPE_LEVEL_LOW>;
        clock-frequency = <0>;
    };

...
```
