## Documentation/devicetree/bindings/pci/renesas,r9a08g045s33-pcie.yaml
```yaml
# SPDX-License-Identifier: (GPL-2.0-only OR BSD-2-Clause)
%YAML 1.2
---
$id: http://devicetree.org/schemas/pci/renesas,r9a08g045s33-pcie.yaml#
$schema: http://devicetree.org/meta-schemas/core.yaml#

title: Renesas RZ/G3S PCIe host controller

maintainers:
  - Claudiu Beznea <claudiu.beznea.uj@bp.renesas.com>

description:
  Renesas RZ/G3S PCIe host controller complies with PCIe Base Specification
  4.0 and supports up to 5 GT/s (Gen2).

properties:
  compatible:
    const: renesas,r9a08g045s33-pcie # RZ/G3S

  reg:
    maxItems: 1

  interrupts:
    items:
      - description: System error interrupt
      - description: System error on correctable error interrupt
      - description: System error on non-fatal error interrupt
      - description: System error on fatal error interrupt
      - description: AXI error interrupt
      - description: INTA interrupt
      - description: INTB interrupt
      - description: INTC interrupt
      - description: INTD interrupt
      - description: MSI interrupt
      - description: Link bandwidth interrupt
      - description: PME interrupt
      - description: DMA interrupt
      - description: PCIe event interrupt
      - description: Message interrupt
      - description: All interrupts

  interrupt-names:
    items:
      - description: int_serr
      - description: int_ser_cor
      - description: int_serr_nonfatal
      - description: int_serr_fatal
      - description: axi_err_int
      - description: inta_rc
      - description: intb_rc
      - description: intc_rc
      - description: intd_rc
      - description: intmsi_rc
      - description: int_link_bandwidth
      - description: int_pm_pme
      - description: dma_int
      - description: pcie_evt_int
      - description: msg_int
      - description: int_all

  clocks:
    items:
      - description: System clock
      - description: PM control clock

  clock-names:
    items:
      - description: aclk
      - description: clkl1pm

  resets:
    items:
      - description: AXI2PCIe Bridge reset
      - description: Data link layer/transaction layer reset
      - description: Transaction layer (ACLK domain) reset
      - description: Transaction layer (PCLK domain) reset
      - description: Physical layer reset
      - description: Configuration register reset
      - description: Configuration register reset

  reset-names:
    items:
      - description: aresetn
      - description: rst_b
      - description: rst_gp_b
      - description: rst_ps_b
      - description: rst_rsm_b
      - description: rst_cfg_b
      - description: rst_load_b

  power-domains:
    maxItems: 1

  dma-ranges:
    description:
      A single range for the inbound memory region.
    maxItems: 1

  renesas,sysc:
    description: System controller phandle
    $ref: /schemas/types.yaml#/definitions/phandle

  vendor-id:
    const: 0x1912

  device-id:
    const: 0x0033

  legacy-interrupt-controller:
    description: Interrupt controller node for handling legacy PCI interrupts
    type: object

    properties:
      "#address-cells":
        const: 0

      "#interrupt-cells":
        const: 1

      interrupt-controller: true

      interrupts:
        items:
          - description: INTA interrupt
          - description: INTB interrupt
          - description: INTC interrupt
          - description: INTD interrupt

    required:
      - "#address-cells"
      - "#interrupt-cells"
      - interrupt-controller
      - interrupts

    additionalProperties: false

required:
  - compatible
  - reg
  - clocks
  - resets
  - reset-names
  - interrupts
  - interrupt-names
  - interrupt-map
  - interrupt-map-mask
  - power-domains
  - "#address-cells"
  - "#size-cells"
  - "#interrupt-cells"
  - renesas,sysc
  - vendor-id
  - device-id

allOf:
  - $ref: /schemas/pci/pci-host-bridge.yaml#

unevaluatedProperties: false

examples:
  - |
    #include <dt-bindings/clock/r9a08g045-cpg.h>
    #include <dt-bindings/interrupt-controller/arm-gic.h>

    bus {
        #address-cells = <2>;
        #size-cells = <2>;

        gic: interrupt-controller {
            interrupt-controller;
            #interrupt-cells = <3>;
        };

        pcie@11e40000 {
            compatible = "renesas,r9a08g045s33-pcie";
            reg = <0 0x11e40000 0 0x10000>;
            ranges = <0x03000000 0 0x30000000 0 0x30000000 0 0x8000000>;
            dma-ranges = <0x42000000 0 0x48000000 0 0x48000000 0 0x8000000>;
            bus-range = <0x0 0xff>;
            clocks = <&cpg CPG_MOD R9A08G045_PCI_ACLK>,
                     <&cpg CPG_MOD R9A08G045_PCI_CLKL1PM>;
            clock-names = "aclk", "clkl1pm";
            resets = <&cpg R9A08G045_PCI_ARESETN>,
                     <&cpg R9A08G045_PCI_RST_B>,
                     <&cpg R9A08G045_PCI_RST_GP_B>,
                     <&cpg R9A08G045_PCI_RST_PS_B>,
                     <&cpg R9A08G045_PCI_RST_RSM_B>,
                     <&cpg R9A08G045_PCI_RST_CFG_B>,
                     <&cpg R9A08G045_PCI_RST_LOAD_B>;
            reset-names = "aresetn", "rst_b", "rst_gp_b", "rst_ps_b",
                          "rst_rsm_b", "rst_cfg_b", "rst_load_b";
            interrupts = <GIC_SPI 395 IRQ_TYPE_LEVEL_HIGH>,
                         <GIC_SPI 396 IRQ_TYPE_LEVEL_HIGH>,
                         <GIC_SPI 397 IRQ_TYPE_LEVEL_HIGH>,
                         <GIC_SPI 398 IRQ_TYPE_LEVEL_HIGH>,
                         <GIC_SPI 399 IRQ_TYPE_LEVEL_HIGH>,
                         <GIC_SPI 400 IRQ_TYPE_LEVEL_HIGH>,
                         <GIC_SPI 401 IRQ_TYPE_LEVEL_HIGH>,
                         <GIC_SPI 402 IRQ_TYPE_LEVEL_HIGH>,
                         <GIC_SPI 403 IRQ_TYPE_LEVEL_HIGH>,
                         <GIC_SPI 404 IRQ_TYPE_LEVEL_HIGH>,
                         <GIC_SPI 405 IRQ_TYPE_LEVEL_HIGH>,
                         <GIC_SPI 406 IRQ_TYPE_LEVEL_HIGH>,
                         <GIC_SPI 407 IRQ_TYPE_LEVEL_HIGH>,
                         <GIC_SPI 408 IRQ_TYPE_LEVEL_HIGH>,
                         <GIC_SPI 409 IRQ_TYPE_LEVEL_HIGH>,
                         <GIC_SPI 410 IRQ_TYPE_LEVEL_HIGH>;
            interrupt-names = "int_serr", "int_serr_cor", "int_serr_nonfatal",
                              "int_serr_fatal", "axi_err_int", "inta_rc",
                              "intb_rc", "intc_rc", "intd_rc",
                              "intmsi_rc", "int_link_bandwidth", "int_pm_pme",
                              "dma_int", "pcie_evt_int", "msg_int",
                              "int_all";
            #interrupt-cells = <1>;
            interrupt-map-mask = <0 0 0 7>;
            interrupt-map = <0 0 0 1 &pcie_intx 0>, /* INT A */
                            <0 0 0 2 &pcie_intx 1>, /* INT B */
                            <0 0 0 3 &pcie_intx 2>, /* INT C */
                            <0 0 0 4 &pcie_intx 3>; /* INT D */
            device_type = "pci";
            num-lanes = <1>;
            #address-cells = <3>;
            #size-cells = <2>;
            power-domains = <&cpg>;
            renesas,sysc = <&sysc>;
            vendor-id = <0x1912>;
            device-id = <0x0033>;

            pcie_intx: legacy-interrupt-controller {
                interrupt-controller;
                #interrupt-cells = <1>;
                #address-cells = <0>;
                interrupt-parent = <&gic>;
                interrupts = <GIC_SPI 400 IRQ_TYPE_LEVEL_HIGH>,
                             <GIC_SPI 401 IRQ_TYPE_LEVEL_HIGH>,
                             <GIC_SPI 402 IRQ_TYPE_LEVEL_HIGH>,
                             <GIC_SPI 403 IRQ_TYPE_LEVEL_HIGH>;
            };
        };
    };

...
```

## Documentation/devicetree/bindings/pci/samsung,exynos-pcie-ep.yaml
```yaml
# SPDX-License-Identifier: (GPL-2.0-only OR BSD-2-Clause)
%YAML 1.2
---
$id: http://devicetree.org/schemas/pci/samsung,exynos-pcie-ep.yaml#
$schema: http://devicetree.org/meta-schemas/core.yaml#

title: Samsung SoC series PCIe Endpoint Controller

maintainers:
  - Shradha Todi <shradha.t@samsung.co>

description: |+
  Samsung SoCs PCIe endpoint controller is based on the Synopsys DesignWare
  PCIe IP and thus inherits all the common properties defined in
  snps,dw-pcie-ep.yaml.

properties:
  compatible:
    oneOf:
      - enum:
          - tesla,fsd-pcie-ep

allOf:
  - $ref: /schemas/pci/snps,dw-pcie-ep.yaml#
  - if:
      properties:
        compatible:
          contains:
            enum:
              - tesla,fsd-pcie-ep
    then:
      properties:
        samsung,syscon-pcie:
          description: phandle for system control registers, used to
                       control signals at system level

      required:
        - samsung,syscon-pcie

unevaluatedProperties: false

examples:
  - |
    #include <dt-bindings/clock/fsd-clk.h>
    #include <dt-bindings/interrupt-controller/arm-gic.h>
    bus {
        #address-cells = <2>;
        #size-cells = <2>;
        pcieep0: pcie-ep@16a00000 {
            compatible = "tesla,fsd-pcie-ep";
            reg = <0x0 0x168b0000 0x0 0x1000>,
                  <0x0 0x16a00000 0x0 0x2000>,
                  <0x0 0x16a01000 0x0 0x80>,
                  <0x0 0x17000000 0x0 0xff0000>;
            reg-names = "elbi", "dbi", "dbi2", "addr_space";
            clocks = <&clock_fsys1 PCIE_LINK0_IPCLKPORT_AUX_ACLK>,
                     <&clock_fsys1 PCIE_LINK0_IPCLKPORT_DBI_ACLK>,
                     <&clock_fsys1 PCIE_LINK0_IPCLKPORT_MSTR_ACLK>,
                     <&clock_fsys1 PCIE_LINK0_IPCLKPORT_SLV_ACLK>;
            clock-names = "aux", "dbi", "mstr", "slv";
            num-lanes = <4>;
            samsung,syscon-pcie = <&sysreg_fsys1 0x50c>;
            phys = <&pciephy1>;
        };
    };
...
```

## Documentation/devicetree/bindings/pci/samsung,exynos-pcie.yaml
```yaml
# SPDX-License-Identifier: (GPL-2.0-only OR BSD-2-Clause)
%YAML 1.2
---
$id: http://devicetree.org/schemas/pci/samsung,exynos-pcie.yaml#
$schema: http://devicetree.org/meta-schemas/core.yaml#

title: Samsung SoC series PCIe Host Controller

maintainers:
  - Marek Szyprowski <m.szyprowski@samsung.com>
  - Jaehoon Chung <jh80.chung@samsung.com>

description: |+
  Samsung SoCs PCIe host controller is based on the Synopsys DesignWare
  PCIe IP and thus inherits all the common properties defined in
  snps,dw-pcie.yaml.

allOf:
  - $ref: /schemas/pci/snps,dw-pcie.yaml#

properties:
  reg:
    items:
      - description: Data Bus Interface (DBI) registers.
      - description: External Local Bus interface (ELBI) registers.
      - description: PCIe configuration space region.

  reg-names:
    items:
      - const: dbi
      - const: elbi
      - const: config

  interrupts:
    maxItems: 1

  phys:
    maxItems: 1

required:
  - reg
  - reg-names
  - interrupts
  - "#address-cells"
  - "#size-cells"
  - ranges
  - device_type
  - num-lanes
  - clocks
  - clock-names
  - phys

additionalProperties: true
```

## Documentation/devicetree/bindings/pci/samsung,exynos5433-pcie.yaml
```yaml
# SPDX-License-Identifier: (GPL-2.0-only OR BSD-2-Clause)
%YAML 1.2
---
$id: http://devicetree.org/schemas/pci/samsung,exynos5433-pcie.yaml#
$schema: http://devicetree.org/meta-schemas/core.yaml#

title: Samsung Exynos5433 SoC PCIe Host Controller

maintainers:
  - Marek Szyprowski <m.szyprowski@samsung.com>
  - Jaehoon Chung <jh80.chung@samsung.com>

description:
  Exynos5433 SoCs PCIe host controller inherits all the
  common properties defined in samsung,exynos-pcie.yaml

allOf:
  - $ref: /schemas/pci/samsung,exynos-pcie.yaml#

properties:
  compatible:
    const: samsung,exynos5433-pcie

  clocks:
    items:
      - description: PCIe bridge clock
      - description: PCIe bus clock

  clock-names:
    items:
      - const: pcie
      - const: pcie_bus

  num-lanes:
    const: 1

  num-viewport:
    const: 3

  vdd10-supply:
    description:
      phandle to a regulator that provides 1.0v power to the pcie block

  vdd18-supply:
    description:
      phandle to a regulator that provides 1.8v power to the pcie block

required:
  - "#interrupt-cells"
  - interrupt-map
  - interrupt-map-mask
  - bus-range
  - num-viewport
  - vdd10-supply
  - vdd18-supply

unevaluatedProperties: false

examples:
  - |
    #include <dt-bindings/interrupt-controller/irq.h>
    #include <dt-bindings/interrupt-controller/arm-gic.h>
    #include <dt-bindings/clock/exynos5433.h>

    pcie: pcie@15700000 {
        compatible = "samsung,exynos5433-pcie";
        reg = <0x15700000 0x1000>, <0x156b0000 0x1000>, <0x0c000000 0x1000>;
        reg-names = "dbi", "elbi", "config";
        #address-cells = <3>;
        #size-cells = <2>;
        #interrupt-cells = <1>;
        device_type = "pci";
        interrupts = <GIC_SPI 245 IRQ_TYPE_LEVEL_HIGH>;
        clocks = <&cmu_fsys CLK_PCIE>, <&cmu_fsys CLK_PCLK_PCIE_PHY>;
        clock-names = "pcie", "pcie_bus";
        phys = <&pcie_phy>;
        pinctrl-0 = <&pcie_bus &pcie_wlanen>;
        pinctrl-names = "default";
        num-lanes = <1>;
        num-viewport = <3>;
        bus-range = <0x00 0xff>;
        ranges = <0x81000000 0 0	  0x0c001000 0 0x00010000>,
                 <0x82000000 0 0x0c011000 0x0c011000 0 0x03feefff>;
        vdd10-supply = <&ldo6_reg>;
        vdd18-supply = <&ldo7_reg>;
        interrupt-map-mask = <0 0 0 0>;
        interrupt-map = <0 0 0 0 &gic GIC_SPI 245 IRQ_TYPE_LEVEL_HIGH>;
    };
...
```
