## Documentation/devicetree/bindings/pwm/pwm-sprd.yaml
```yaml
# SPDX-License-Identifier: (GPL-2.0-only OR BSD-2-Clause)
# Copyright 2023 Unisoc Inc.
%YAML 1.2
---
$id: http://devicetree.org/schemas/pwm/pwm-sprd.yaml#
$schema: http://devicetree.org/meta-schemas/core.yaml#

title: Spreadtrum PWM controller

maintainers:
  - Orson Zhai <orsonzhai@gmail.com>
  - Baolin Wang <baolin.wang7@gmail.com>
  - Chunyan Zhang <zhang.lyra@gmail.com>

description: |
  Spreadtrum SoCs PWM controller provides 4 PWM channels.

allOf:
  - $ref: pwm.yaml#

properties:
  compatible:
    items:
      - enum:
          - sprd,ums512-pwm

  reg:
    maxItems: 1

  clocks:
    minItems: 8
    maxItems: 8

  clock-names:
    items:
      - const: pwm0
      - const: enable0
      - const: pwm1
      - const: enable1
      - const: pwm2
      - const: enable2
      - const: pwm3
      - const: enable3
    description: |
      Should contain following entries:
      "pwmn": used to derive the functional clock for PWM channel n (n range: 0 ~ 3).
      "enablen": for PWM channel n enable clock (n range: 0 ~ 3).

  assigned-clocks:
    minItems: 4
    maxItems: 4

  assigned-clock-parents:
    minItems: 4
    maxItems: 4

  "#pwm-cells":
    const: 2

required:
  - compatible
  - reg
  - clocks
  - clock-names

additionalProperties: false

examples:
  - |
    #include <dt-bindings/clock/sprd,ums512-clk.h>
    pwms: pwm@32260000 {
        compatible = "sprd,ums512-pwm";
        reg = <0x32260000 0x10000>;
        clock-names = "pwm0", "enable0",
                      "pwm1", "enable1",
                      "pwm2", "enable2",
                      "pwm3", "enable3";
        clocks = <&aon_clk CLK_PWM0>, <&aonapb_gate CLK_PWM0_EB>,
                 <&aon_clk CLK_PWM1>, <&aonapb_gate CLK_PWM1_EB>,
                 <&aon_clk CLK_PWM2>, <&aonapb_gate CLK_PWM2_EB>,
                 <&aon_clk CLK_PWM3>, <&aonapb_gate CLK_PWM3_EB>;
        assigned-clocks = <&aon_clk CLK_PWM0>,
                          <&aon_clk CLK_PWM1>,
                          <&aon_clk CLK_PWM2>,
                          <&aon_clk CLK_PWM3>;
        assigned-clock-parents = <&ext_26m>,
                                 <&ext_26m>,
                                 <&ext_26m>,
                                 <&ext_26m>;
        #pwm-cells = <2>;
    };

...
```

## Documentation/devicetree/bindings/pwm/raspberrypi,rp1-pwm.yaml
```yaml
# SPDX-License-Identifier: (GPL-2.0-only OR BSD-2-Clause)
%YAML 1.2
---
$id: http://devicetree.org/schemas/pwm/raspberrypi,rp1-pwm.yaml#
$schema: http://devicetree.org/meta-schemas/core.yaml#

title: Raspberry Pi RP1 PWM controller

maintainers:
  - Naushir Patuck <naush@raspberrypi.com>

allOf:
  - $ref: pwm.yaml#

description: |
  The PWM peripheral is a flexible waveform generator with a
  variety of operational modes. It has the following features:
   - four independent output channels
   - 32-bit counter widths
   - Seven output generation modes
   - Optional per-channel output inversion
   - Optional duty-cycle data FIFO with DMA support
   - Optional sigma-delta noise shaping engine

properties:
  compatible:
    const: raspberrypi,rp1-pwm

  reg:
    maxItems: 1

  clocks:
    maxItems: 1

  "#pwm-cells":
    const: 3

required:
  - compatible
  - reg
  - clocks

additionalProperties: false

examples:
  - |
    pwm@98000 {
      compatible = "raspberrypi,rp1-pwm";
      reg = <0x98000 0x100>;
      clocks = <&rp1_clocks 17>;
      #pwm-cells = <3>;
    };
```
