## Documentation/devicetree/bindings/pwm/snps,dw-apb-timers-pwm2.yaml
```yaml
# SPDX-License-Identifier: (GPL-2.0-only OR BSD-2-Clause)
# Copyright (C) 2022 SiFive, Inc.
%YAML 1.2
---
$id: http://devicetree.org/schemas/pwm/snps,dw-apb-timers-pwm2.yaml#
$schema: http://devicetree.org/meta-schemas/core.yaml#

title: Synopsys DW-APB timers PWM controller

maintainers:
  - Ben Dooks <ben.dooks@sifive.com>

description:
  This describes the DesignWare APB timers module when used in the PWM
  mode. The IP core can be generated with various options which can
  control the functionality, the number of PWMs available and other
  internal controls the designer requires.

  The IP block has a version register so this can be used for detection
  instead of having to encode the IP version number in the device tree
  compatible.

properties:
  compatible:
    enum:
      - snps,dw-apb-timers-pwm2
      - eswin,eic7700-pwm

  reg:
    maxItems: 1

  "#pwm-cells":
    const: 3

  clocks:
    items:
      - description: Interface bus clock
      - description: PWM reference clock

  clock-names:
    items:
      - const: bus
      - const: timer

  resets:
    minItems: 1
    items:
      - description: Interface bus (presetn) reset
      - description: PWM timer logic (timer_N_resetn) reset

  snps,pwm-number:
    $ref: /schemas/types.yaml#/definitions/uint32
    description: The number of PWM channels configured for this instance
    enum: [1, 2, 3, 4, 5, 6, 7, 8]

required:
  - compatible
  - reg
  - clocks
  - clock-names

allOf:
  - $ref: pwm.yaml#

  - if:
      properties:
        compatible:
          contains:
            const: eswin,eic7700-pwm
    then:
      properties:
        resets:
          maxItems: 1
      required:
        - resets

additionalProperties: false

examples:
  - |
    pwm: pwm@180000 {
      compatible = "snps,dw-apb-timers-pwm2";
      reg = <0x180000 0x200>;
      #pwm-cells = <3>;
      clocks = <&bus>, <&timer>;
      clock-names = "bus", "timer";
    };
  - |
    pwm@50818000 {
      compatible = "eswin,eic7700-pwm";
      reg = <0x50818000 0x4000>;
      #pwm-cells = <3>;
      clocks = <&bus>, <&timer>;
      clock-names = "bus", "timer";
      resets = <&reset>;
    };
```

## Documentation/devicetree/bindings/pwm/st,sti-pwm.yaml
```yaml
# SPDX-License-Identifier: (GPL-2.0-only OR BSD-2-Clause)
%YAML 1.2
---
$id: http://devicetree.org/schemas/pwm/st,sti-pwm.yaml#
$schema: http://devicetree.org/meta-schemas/core.yaml#

title: STMicroelectronics STiH41x PWM/Capture controller

maintainers:
  - Lee Jones <lee.jones@linaro.org>

description:
  The STiH41x PWM controller supports both PWM output and input capture
  functionality. It provides multiple PWM output channels for generating
  variable duty-cycle waveforms, and multiple input capture channels for
  measuring external signal periods and pulse widths. PWM output channels
  and input capture channels are configured independently via
  st,pwm-num-chan and st,capture-num-chan respectively.

allOf:
  - $ref: pwm.yaml#

properties:
  compatible:
    const: st,sti-pwm

  reg:
    maxItems: 1

  "#pwm-cells":
    const: 2

  pinctrl-names:
    const: default

  clock-names:
    minItems: 1
    items:
      - const: pwm
      - const: capture

  clocks:
    minItems: 1
    maxItems: 2

  interrupts:
    description: IRQ line for the capture device.
    maxItems: 1

  st,pwm-num-chan:
    $ref: /schemas/types.yaml#/definitions/uint32
    description: Number of available PWM output channels.
    minimum: 0
    maximum: 4
    default: 0

  st,capture-num-chan:
    $ref: /schemas/types.yaml#/definitions/uint32
    description: Number of available input capture channels.
    minimum: 0
    maximum: 4
    default: 0

required:
  - reg
  - compatible
  - "#pwm-cells"
  - clock-names
  - clocks
  - interrupts

unevaluatedProperties: false

examples:
  - |
    #include <dt-bindings/interrupt-controller/arm-gic.h>
    pwm@fe510000 {
        compatible = "st,sti-pwm";
        reg = <0xfe510000 0x68>;
        interrupts = <GIC_SPI 128 IRQ_TYPE_LEVEL_HIGH>;
        #pwm-cells = <2>;
        pinctrl-names = "default";
        pinctrl-0 = <&pinctrl_pwm1_chan0_default
                     &pinctrl_pwm1_chan1_default
                     &pinctrl_pwm1_chan2_default
                     &pinctrl_pwm1_chan3_default>;
        clocks = <&clk_sysin>;
        clock-names = "pwm";
        st,pwm-num-chan = <4>;
        st,capture-num-chan = <2>;
    };
...
```

## Documentation/devicetree/bindings/pwm/st,stmpe-pwm.yaml
```yaml
# SPDX-License-Identifier: (GPL-2.0-only OR BSD-2-Clause)
%YAML 1.2
---
$id: http://devicetree.org/schemas/pwm/st,stmpe-pwm.yaml#
$schema: http://devicetree.org/meta-schemas/core.yaml#

title: STMicroelectronics STMPE PWM controller

maintainers:
  - Linus Walleij <linus.walleij@linaro.org>
  - Thierry Reding <thierry.reding@gmail.com>

description:
  This is a PWM block embedded in the STMicroelectronics STMPE
  (ST Multi-Purpose Expander) chips. The PWM is registered as a
  subdevice of the STMPE MFD device.

allOf:
  - $ref: pwm.yaml#

properties:
  compatible:
    const: st,stmpe-pwm

  "#pwm-cells":
    const: 2

required:
  - compatible
  - "#pwm-cells"

additionalProperties: false

examples:
  - |
    stmpe {
        pwm {
            compatible = "st,stmpe-pwm";
            #pwm-cells = <2>;
        };
    };
```

## Documentation/devicetree/bindings/pwm/ti,pwmss.yaml
```yaml
# SPDX-License-Identifier: (GPL-2.0-only OR BSD-2-Clause)
%YAML 1.2
---
$id: http://devicetree.org/schemas/pwm/ti,pwmss.yaml#
$schema: http://devicetree.org/meta-schemas/core.yaml#

title: Texas Instruments SoC PWM Subsystem

maintainers:
  - Eduard Bostina <egbostina@gmail.com>

properties:
  compatible:
    oneOf:
      - const: ti,am33xx-pwmss
      - items:
          - enum:
              - ti,am4372-pwmss
              - ti,dra746-pwmss
          - const: ti,am33xx-pwmss

  reg:
    maxItems: 1

  "#address-cells":
    const: 1

  "#size-cells":
    const: 1

  ranges: true

patternProperties:
  "^(ecap|eqep|pwm|counter)@[0-9a-f]+$":
    type: object
    description: Child nodes for ECAP, EQEP (counter), and EHRPWM

required:
  - compatible
  - reg
  - "#address-cells"
  - "#size-cells"
  - ranges

additionalProperties: false

examples:
  - |
    pwm@48300000 { /* PWMSS for am33xx */
        compatible = "ti,am33xx-pwmss";
        reg = <0x48300000 0x10>;
        #address-cells = <1>;
        #size-cells = <1>;
        ranges = <0x48300100 0x48300100 0x80>,   /* ECAP */
                 <0x48300180 0x48300180 0x80>,   /* EQEP */
                 <0x48300200 0x48300200 0x80>;   /* EHRPWM */
    };

  - |
    pwm@48300000 { /* PWMSS for am4372 */
        compatible = "ti,am4372-pwmss", "ti,am33xx-pwmss";
        reg = <0x48300000 0x10>;
        #address-cells = <1>;
        #size-cells = <1>;
        ranges = <0x48300100 0x48300100 0x80>,   /* ECAP */
                 <0x48300180 0x48300180 0x80>,   /* EQEP */
                 <0x48300200 0x48300200 0x80>;   /* EHRPWM */
    };

  - |
    pwm@4843e000 { /* PWMSS for DRA7xx */
        compatible = "ti,dra746-pwmss", "ti,am33xx-pwmss";
        reg = <0x4843e000 0x30>;
        #address-cells = <1>;
        #size-cells = <1>;
        ranges;
    };
```
