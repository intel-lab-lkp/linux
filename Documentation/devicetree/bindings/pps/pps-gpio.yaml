## Documentation/devicetree/bindings/pwm/allwinner,sun50i-h616-pwm.yaml
```yaml
# SPDX-License-Identifier: (GPL-2.0-only OR BSD-2-Clause)
%YAML 1.2
---
$id: http://devicetree.org/schemas/pwm/allwinner,sun50i-h616-pwm.yaml#
$schema: http://devicetree.org/meta-schemas/core.yaml#

title: Allwinner H616 PWM

maintainers:
  - Richard Genoud <richard.genoud@bootlin.com>

description: |
  Allwinner H616 PWM can generate standard PWM signals with variable pulse width
  and period.
  Also, instead of a PWM signal, a channel can be used to provide a clock.

properties:
  compatible:
    const: allwinner,sun50i-h616-pwm

  reg:
    maxItems: 1

  clocks:
    items:
      - description: Bus Clock

  clock-names:
    items:
      - const: bus

  resets:
    maxItems: 1

  "#clock-cells":
    const: 1

  "#pwm-cells":
    const: 3

required:
  - compatible
  - reg
  - clocks
  - clock-names
  - resets

allOf:
  - $ref: pwm.yaml#

additionalProperties: false

examples:
  - |
    #include <dt-bindings/clock/sun50i-h616-ccu.h>
    #include <dt-bindings/reset/sun50i-h616-ccu.h>

    pwm@300a000 {
      compatible = "allwinner,sun50i-h616-pwm";
      reg = <0x0300a000 0x400>;
      clocks = <&ccu CLK_BUS_PWM>;
      clock-names = "bus";
      resets = <&ccu RST_BUS_PWM>;
      #pwm-cells = <3>;
      #clock-cells = <1>;
    };
...
```

## Documentation/devicetree/bindings/pwm/andestech,ae350-pwm.yaml
```yaml
# SPDX-License-Identifier: (GPL-2.0 OR BSD-2-Clause)
%YAML 1.2
---
$id: http://devicetree.org/schemas/pwm/andestech,ae350-pwm.yaml#
$schema: http://devicetree.org/meta-schemas/core.yaml#

title: Andes PWM controller on AE350 platform

description:
  This controller has 4 channels and two clock sources. Each channel can
  switch the clock source by programming the corresponding register.

maintainers:
  - Ben Zong-You Xie <ben717@andestech.com>

allOf:
  - $ref: pwm.yaml#

properties:
  compatible:
    oneOf:
      - items:
          - enum:
              - andestech,qilai-pwm
          - const: andestech,ae350-pwm
      - const: andestech,ae350-pwm

  reg:
    maxItems: 1

  "#pwm-cells":
    const: 3

  clocks:
    items:
      - description: APB bus clock
      - description: External clock

  clock-names:
    items:
      - const: pclk
      - const: extclk

required:
  - compatible
  - reg
  - "#pwm-cells"
  - clocks
  - clock-names

unevaluatedProperties: false

examples:
  - |
    pwm@f0400000 {
        compatible = "andestech,ae350-pwm";
        reg = <0xf0400000 0x100000>;
        #pwm-cells = <3>;
        clocks = <&pclk>, <&extclk>;
        clock-names = "pclk", "extclk";
    };
```

## Documentation/devicetree/bindings/pwm/andestech,atcpit100-pwm.yaml
```yaml
# SPDX-License-Identifier: (GPL-2.0-only OR BSD-2-Clause)
%YAML 1.2
---
$id: http://devicetree.org/schemas/pwm/andestech,atcpit100-pwm.yaml#
$schema: http://devicetree.org/meta-schemas/core.yaml#

title: Andes atcpit100 PWM

maintainers:
  - Ben Zong-You Xie <ben717@andestech.com>

allOf:
  - $ref: pwm.yaml#

properties:
  compatible:
    const: andestech,atcpit100-pwm

  reg:
    maxItems: 1

  "#pwm-cells":
    const: 3

  clocks:
    maxItems: 2

  clock-names:
    items:
      - const: ext
      - const: apb


required:
  - compatible
  - reg
  - "#pwm-cells"
  - clocks
  - clock-names

unevaluatedProperties: false

examples:
  - |
    pwm@f0400000 {
        compatible = "andestech,atcpit100-pwm";
        reg = <0xf0400000 0x1000>;
        #pwm-cells = <3>;
        clocks = <&smu 1>, <&smu 7>;
        clock-names = "ext", "apb";
    };
```

## Documentation/devicetree/bindings/pwm/argon40,fan-hat.yaml
```yaml
# SPDX-License-Identifier: (GPL-2.0 OR BSD-2-Clause)
%YAML 1.2
---
$id: http://devicetree.org/schemas/pwm/argon40,fan-hat.yaml#
$schema: http://devicetree.org/meta-schemas/core.yaml#

title: Argon40 Fan HAT PWM controller

maintainers:
  - Marek Vasut <marek.vasut+renesas@mailbox.org>

description: |
  The trivial PWM on Argon40 Fan HAT, which is a RaspberryPi blower fan
  hat which can be controlled over I2C, generates a fixed duty cycle PWM
  signal with configurable period to control the fan speed.

allOf:
  - $ref: pwm.yaml#

properties:
  compatible:
    const: argon40,fan-hat

  reg:
    maxItems: 1

  "#pwm-cells":
    const: 2

required:
  - compatible
  - reg

additionalProperties: false

examples:
  - |
    i2c {
      #address-cells = <1>;
      #size-cells = <0>;

      pwm@1a {
        compatible = "argon40,fan-hat";
        reg = <0x1a>;
        #pwm-cells = <2>;
      };
    };
```

## Documentation/devicetree/bindings/pwm/atmel,hlcdc-pwm.yaml
```yaml
# SPDX-License-Identifier: (GPL-2.0-only OR BSD-2-Clause)
# Copyright (C) 2024 Microchip Technology, Inc. and its subsidiaries
%YAML 1.2
---
$id: http://devicetree.org/schemas/pwm/atmel,hlcdc-pwm.yaml#
$schema: http://devicetree.org/meta-schemas/core.yaml#

title: Atmel's HLCDC (High-end LCD Controller) PWM driver

maintainers:
  - Nicolas Ferre <nicolas.ferre@microchip.com>
  - Alexandre Belloni <alexandre.belloni@bootlin.com>
  - Claudiu Beznea <claudiu.beznea@tuxon.dev>

description: |
  Device-Tree bindings for Atmel's HLCDC PWM driver. The Atmel HLCDC PWM is a
  subdevice of the HLCDC MFD device.
  # See ../mfd/atmel,hlcdc.yaml for more details.

properties:
  compatible:
    const: atmel,hlcdc-pwm

  pinctrl-names:
    const: default

  pinctrl-0: true

  "#pwm-cells":
    const: 3
    description: |
      This PWM chip uses the default 3 cells bindings defined in pwm.yaml in
      this directory.

required:
  - compatible
  - pinctrl-names
  - pinctrl-0
  - "#pwm-cells"

additionalProperties: false

examples:
  - |
    #include <dt-bindings/clock/at91.h>
    #include <dt-bindings/pwm/pwm.h>
    #include <dt-bindings/interrupt-controller/arm-gic.h>

    hlcdc: hlcdc@f0030000 {
      compatible = "atmel,sama5d3-hlcdc";
      reg = <0xf0030000 0x2000>;
      clocks = <&lcdc_clk>, <&lcdck>, <&clk32k>;
      clock-names = "periph_clk","sys_clk", "slow_clk";
      interrupts = <36 IRQ_TYPE_LEVEL_HIGH 0>;

      hlcdc_pwm: hlcdc-pwm {
        compatible = "atmel,hlcdc-pwm";
        pinctrl-names = "default";
        pinctrl-0 = <&pinctrl_lcd_pwm>;
        #pwm-cells = <3>;
      };
    };
```

## Documentation/devicetree/bindings/pwm/axiado,ax3000-pwm.yaml
```yaml
# SPDX-License-Identifier: (GPL-2.0-only OR BSD-2-Clause)
%YAML 1.2
---
$id: http://devicetree.org/schemas/pwm/axiado,ax3000-pwm.yaml#
$schema: http://devicetree.org/meta-schemas/core.yaml#

title: Axiado AX3000 PWM controller

maintainers:
  - Petar Stepanovic <pstepanovic@axiado.com>
  - Akhila Kavi <akavi@axiado.com>
  - Prasad Bolisetty <pbolisetty@axiado.com>

description:
  The Axiado PWM controller found on the AX3000 and AX3005 SoCs.

allOf:
  - $ref: pwm.yaml#

properties:
  compatible:
    oneOf:
      - const: axiado,ax3000-pwm
      - items:
          - const: axiado,ax3000-pwm
          - const: axiado,ax3005-pwm

  reg:
    maxItems: 1

  clocks:
    maxItems: 1

  "#pwm-cells":
    const: 2

required:
  - compatible
  - reg
  - clocks
  - "#pwm-cells"

additionalProperties: false

examples:
  - |
    pwm@80801c00 {
      compatible = "axiado,ax3000-pwm";
      reg = <0x80801c00 0x1000>;
      #pwm-cells = <2>;
      clocks = <&clk>;
    };
```

## Documentation/devicetree/bindings/pwm/eswin,eic7700-pwm.yaml
```yaml
# SPDX-License-Identifier: (GPL-2.0-only OR BSD-2-Clause)
%YAML 1.2
---
$id: http://devicetree.org/schemas/pwm/eswin,eic7700-pwm.yaml#
$schema: http://devicetree.org/meta-schemas/core.yaml#

title: ESWIN EIC7700 PWM controller

maintainers:
  - Xiang Xu <xuxiang@eswincomputing.com>
  - Guosheng Wang <wangguosheng@eswincomputing.com>
  - Xuyang Dong <dongxuyang@eswincomputing.com>

description: |
  The EIC7700 PWM used the DesignWare APB timers module. The PWM driver
  supports a duty cycle range from 0% to 100%, with explicit support for
  both 0% and 100% duty cycles.

allOf:
  - $ref: pwm.yaml#

properties:
  compatible:
    const: eswin,eic7700-pwm

  reg:
    maxItems: 1

  clocks:
    maxItems: 1

  resets:
    maxItems: 1

  "#pwm-cells":
    const: 3

  pinctrl-0: true
  pinctrl-1: true

  pinctrl-names:
    minItems: 1
    items:
      - const: default
      - const: sleep

  snps,pwm-full-range-enable:
    type: boolean
    description: |
      Enable support for 0% and 100% duty cycle.
      When present, the PWM controller can output 0% and 100% duty cycles.

required:
  - compatible
  - reg
  - clocks
  - resets
  - snps,pwm-full-range-enable

additionalProperties: false

examples:
  - |
    pwm@50818000 {
        compatible = "eswin,eic7700-pwm";
        reg = <0x50818000 0x4000>;
        clocks = <&clock 242>;
        resets = <&reset 136>;
        #pwm-cells = <3>;
        pinctrl-names = "default";
        pinctrl-0 = <&fan_pwm>;
        snps,pwm-full-range-enable;
    };
```

## Documentation/devicetree/bindings/pwm/lpc32xx-pwm.yaml
```yaml
# SPDX-License-Identifier: (GPL-2.0-only OR BSD-2-Clause)
%YAML 1.2
---
$id: http://devicetree.org/schemas/pwm/nxp,lpc32xx-pwm.yaml#
$schema: http://devicetree.org/meta-schemas/core.yaml#

title: LPC32XX PWM controller

maintainers:
  - "Uwe Kleine-König <ukleinek@kernel.org>"
  - "Vladimir Zapolskiy <vz@mleia.com>"
  - "Piotr Wojtaszczyk <piotr.wojtaszczyk@timesys.com>"

allOf:
  - $ref: pwm.yaml#

properties:
  compatible:
    const: nxp,lpc3220-pwm

  reg:
    maxItems: 1

  "#pwm-cells":
    const: 3

required:
  - compatible
  - reg

unevaluatedProperties: false

examples:
  - |
    pwm@4005c000 {
        compatible = "nxp,lpc3220-pwm";
        reg = <0x4005c000 0x4>;
        #pwm-cells = <3>;
    };
  - |
    pwm@4005c004 {
        compatible = "nxp,lpc3220-pwm";
        reg = <0x4005c004 0x4>;
        #pwm-cells = <3>;
    };
```

## Documentation/devicetree/bindings/pwm/marvell,pxa-pwm.yaml
```yaml
# SPDX-License-Identifier: (GPL-2.0-only OR BSD-2-Clause)
%YAML 1.2
---
$id: http://devicetree.org/schemas/pwm/marvell,pxa-pwm.yaml#
$schema: http://devicetree.org/meta-schemas/core.yaml#

title: Marvell PXA PWM

maintainers:
  - Duje Mihanović <duje.mihanovic@skole.hr>

allOf:
  - $ref: pwm.yaml#

properties:
  compatible:
    enum:
      - marvell,pxa250-pwm
      - marvell,pxa270-pwm
      - marvell,pxa168-pwm
      - marvell,pxa910-pwm

  reg:
    # Length should be 0x10
    maxItems: 1

  "#pwm-cells":
    const: 3

  clocks:
    maxItems: 1

required:
  - compatible
  - reg
  - clocks

additionalProperties: false

examples:
  - |
    #include <dt-bindings/clock/pxa-clock.h>

    pwm0: pwm@40b00000 {
      compatible = "marvell,pxa250-pwm";
      reg = <0x40b00000 0x10>;
      #pwm-cells = <3>;
      clocks = <&clks CLK_PWM0>;
    };
```

## Documentation/devicetree/bindings/pwm/max7360-pwm.yaml
```yaml
# SPDX-License-Identifier: (GPL-2.0-only OR BSD-2-Clause)
%YAML 1.2
---
$id: http://devicetree.org/schemas/pwm/max7360-pwm.yaml#
$schema: http://devicetree.org/meta-schemas/core.yaml#

title: Maxim MAX7360 PWM controller

maintainers:
  - Kamel Bouhara <kamel.bouhara@bootlin.com>

description: |
  Maxim MAX7360 PWM controller, in MAX7360 MFD
  https://www.analog.com/en/products/max7360.html

properties:
  compatible:
    enum:
      - maxim,max7360-pwm

  "#pwm-cells":
    const: 2


required:
  - compatible

additionalProperties: false

examples:
  - |
    max7360_pwm: max7360_pwm {
      compatible = "maxim,max7360-pwm";
      #pwm-cells = <2>;
    };
```

## Documentation/devicetree/bindings/pwm/nuvoton,ma35d1-pwm.yaml
```yaml
# SPDX-License-Identifier: GPL-2.0-only OR BSD-2-Clause
%YAML 1.2
---
$id: http://devicetree.org/schemas/pwm/nuvoton,ma35d1-pwm.yaml#
$schema: http://devicetree.org/meta-schemas/core.yaml#

title: Nuvoton MA35D1 PWM controller

maintainers:
  - Chi-Wen Weng <cwweng@nuvoton.com>

allOf:
  - $ref: pwm.yaml#

properties:
  compatible:
    enum:
      - nuvoton,ma35d1-pwm

  reg:
    maxItems: 1

  clocks:
    maxItems: 1

  "#pwm-cells":
    const: 2

required:
  - compatible
  - reg
  - clocks

additionalProperties: false

examples:
  - |
    #include <dt-bindings/clock/nuvoton,ma35d1-clk.h>

    pwm@40580000 {
      compatible = "nuvoton,ma35d1-pwm";
      reg = <0x40580000 0x400>;
      clocks = <&clk EPWM0_GATE>;
      #pwm-cells = <2>;
    };
```

## Documentation/devicetree/bindings/pwm/pwm-loongson.yaml
```yaml
# SPDX-License-Identifier: (GPL-2.0-only OR BSD-2-Clause)
%YAML 1.2
---
$id: http://devicetree.org/schemas/pwm/pwm-loongson.yaml#
$schema: http://devicetree.org/meta-schemas/core.yaml#

title: Loongson PWM Controller

maintainers:
  - Binbin Zhou <zhoubinbin@loongson.cn>

description:
  It is the generic PWM framework driver for Loongson family.
  Each PWM has one pulse width output signal and one pulse input
  signal to be measured.
  It can be found on Loongson-2K series cpus and Loongson LS7A bridge chips.

allOf:
  - $ref: pwm.yaml#

properties:
  compatible:
    oneOf:
      - const: loongson,ls7a-pwm
      - items:
          - enum:
              - loongson,ls2k0500-pwm
              - loongson,ls2k1000-pwm
              - loongson,ls2k2000-pwm
          - const: loongson,ls7a-pwm

  reg:
    maxItems: 1

  interrupts:
    maxItems: 1

  clocks:
    maxItems: 1

  '#pwm-cells':
    const: 3

required:
  - compatible
  - reg
  - interrupts
  - clocks
  - '#pwm-cells'

additionalProperties: false

examples:
  - |
    #include <dt-bindings/interrupt-controller/irq.h>
    #include <dt-bindings/clock/loongson,ls2k-clk.h>
    pwm@1fe22000 {
        compatible = "loongson,ls2k1000-pwm", "loongson,ls7a-pwm";
        reg = <0x1fe22000 0x10>;
        interrupt-parent = <&liointc0>;
        interrupts = <24 IRQ_TYPE_LEVEL_HIGH>;
        clocks = <&clk LOONGSON2_APB_CLK>;
        #pwm-cells = <3>;
    };
```
