## Documentation/devicetree/bindings/pps/pps-gpio.yaml
```yaml
# SPDX-License-Identifier: (GPL-2.0-only OR BSD-2-Clause)
%YAML 1.2
---
$id: http://devicetree.org/schemas/pps/pps-gpio.yaml#
$schema: http://devicetree.org/meta-schemas/core.yaml#

title: PPS Signal via GPIO

maintainers:
  - Fabio Estevam <festevam@gmail.com>

properties:
  compatible:
    const: pps-gpio

  gpios:
    description: The GPIO that provides the PPS signal.
    maxItems: 1

  echo-gpios:
    description: The GPIO that provides the PPS ECHO signal.
    maxItems: 1

  echo-active-ms:
    description: Duration in ms of the active portion of the echo pulse.

  assert-falling-edge:
    description: Indicates a falling edge assert, when present. Rising edge if absent.
    type: boolean

  pinctrl-names:
    description:
      When the PPS input is muxed through a pin controller, name the "default"
      state to select the PPS/GPIO function while the driver is bound. An
      optional "idle" state, if present, is selected when the driver is
      unbound or the system is shut down, handing the pins back to their
      alternate function.
    minItems: 1
    items:
      - const: default
      - const: idle

required:
  - compatible
  - gpios

additionalProperties: false

examples:
  - |
    #include <dt-bindings/gpio/gpio.h>

    pps {
        compatible = "pps-gpio";
        pinctrl-names = "default", "idle";
        pinctrl-0 = <&pinctrl_pps>;
        pinctrl-1 = <&pinctrl_pps_idle>;
        gpios = <&gpio1 26 GPIO_ACTIVE_HIGH>;
        assert-falling-edge;
        echo-gpios = <&gpio1 27 GPIO_ACTIVE_HIGH>;
        echo-active-ms = <100>;
    };
```

## Documentation/devicetree/bindings/probe-control/linux,probe-controller.yaml
```yaml
# SPDX-License-Identifier: (GPL-2.0-only OR BSD-2-Clause)
# Copyright (c) 2024 Sony Group Corporation
%YAML 1.2
---
$id: http://devicetree.org/schemas/linux,probe-controller.yaml#
$schema: http://devicetree.org/meta-schemas/core.yaml#

title: Probe control device

maintainers:
  - Nayeemahmed Badebade <nayeemahmed.badebade@sony.com>
  - Toyama Yoshihiro <yoshihiro.toyama@sony.com>

description: |
  This binding is for controlling the probes of a set of devices in the system.
  Probe control device is a dummy device that can be used to control the probe
  of a group of devices. To have finer control, the devices can further be
  divided into multiple groups and for each group a probe control device can
  be assigned. This way, individual groups can be managed independently.
  For example, one group can be for pcie based devices and other can be
  scsi or usb devices.
  Probe control device is provider node and the devices whose probes need to be
  controlled, are consumer nodes. To establish control over consumer device
  probes, each consumer device node need to refer the probe control provider
  node by the phandle.

properties:
  compatible:
    const: linux,probe-control

  probe-control-supply:
    description:
      Phandle to the probe control provider node.

required:
  - compatible

additionalProperties: false

examples:
  - |
    // The node below defines a probe control device/provider node
    prb_ctrl_dev_0: prb_ctrl_dev_0 {
        compatible = "linux,probe-control";
    };

    // The node below is the consumer device node that refers to provider
    // node by its phandle and a result will not be probed until provider
    // node is probed.
    pcie@1ffc000 {
        reg = <0x01ffc000 0x04000>, <0x01f00000 0x80000>;
        #address-cells = <3>;
        #size-cells = <2>;
        device_type = "pci";
        ranges = <0x81000000 0 0          0x01f80000 0 0x00010000>,
                 <0x82000000 0 0x01000000 0x01000000 0 0x00f00000>;

        probe-control-supply = <&prb_ctrl_dev_0>;
    };
```

## Documentation/devicetree/bindings/ptp/nxp,ptp-netc.yaml
```yaml
# SPDX-License-Identifier: (GPL-2.0-only OR BSD-2-Clause)
%YAML 1.2
---
$id: http://devicetree.org/schemas/ptp/nxp,ptp-netc.yaml#
$schema: http://devicetree.org/meta-schemas/core.yaml#

title: NXP NETC Timer PTP clock

description:
  NETC Timer provides current time with nanosecond resolution, precise
  periodic pulse, pulse on timeout (alarm), and time capture on external
  pulse support. And it supports time synchronization as required for
  IEEE 1588 and IEEE 802.1AS-2020.

maintainers:
  - Wei Fang <wei.fang@nxp.com>
  - Clark Wang <xiaoning.wang@nxp.com>

properties:
  compatible:
    enum:
      - pci1131,ee02

  reg:
    maxItems: 1

  clocks:
    maxItems: 1
    description:
      The reference clock of NETC Timer, if not present, indicates that
      the system clock of NETC IP is selected as the reference clock.

  clock-names:
    description:
      NETC Timer has three reference clock sources, set TMR_CTRL[CK_SEL]
      by parsing clock name to select one of them as the reference clock.
      The "system" means that the system clock of NETC IP is used as the
      reference clock.
      The "ccm_timer" means another clock from CCM as the reference clock.
      The "ext_1588" means the reference clock comes from external IO pins.
    enum:
      - system
      - ccm_timer
      - ext_1588

required:
  - compatible
  - reg

allOf:
  - $ref: /schemas/pci/pci-device.yaml

unevaluatedProperties: false

examples:
  - |
    pcie {
        #address-cells = <3>;
        #size-cells = <2>;

        ethernet@18,0 {
            compatible = "pci1131,ee02";
            reg = <0x00c000 0 0 0 0>;
            clocks = <&scmi_clk 18>;
            clock-names = "ccm_timer";
        };
    };
```

## Documentation/devicetree/bindings/ptp/qcom,lemans-tscss.yaml
```yaml
# SPDX-License-Identifier: GPL-2.0-only OR BSD-2-Clause
%YAML 1.2
---
$id: http://devicetree.org/schemas/ptp/qcom,lemans-tscss.yaml#
$schema: http://devicetree.org/meta-schemas/core.yaml#

title: Timestamp Counter Subsystem (TSCSS) on Qualcomm Lemans and Monaco SoCs

maintainers:
  - Imran Shaik <imran.shaik@oss.qualcomm.com>
  - Taniya Das <taniya.das@oss.qualcomm.com>

description: |
  Qualcomm TSCSS is a time synchronization subsystem composed of two main
  blocks - the Time Stamp Counter (TSC) and the Event Timestamp Unit (ETU).

  The TSC block is a timestamp generator that maintains a running counter used
  for system timekeeping, and is functional with just the AHB and counter
  clocks.
  The ETU block is optional and captures TSC timestamps for external
  hardware events, each ETU slice binding a slice identifier to an external
  event selector. Support for the ETU block requires the additional ETU
  clock along with the summary interrupt and slice subnodes.

properties:
  compatible:
    oneOf:
      - const: qcom,lemans-tscss
      - items:
          - const: qcom,monaco-tscss
          - const: qcom,lemans-tscss

  reg:
    maxItems: 1

  reg-names:
    items:
      - const: tsc

  clocks:
    minItems: 2
    items:
      - description: TSC AHB configuration clock.
      - description: TSC global counter clock.
      - description: TSC ETU clock.

  clock-names:
    minItems: 2
    items:
      - const: ahb
      - const: cntr
      - const: etu

  interrupts:
    description: Summary interrupt raised based on external event for any of the ETU slices.
    maxItems: 1

  interrupt-names:
    items:
      - const: etu_summary

  assigned-clocks: true
  assigned-clock-rates: true

  "#address-cells":
    const: 2

  "#size-cells":
    const: 2

  ranges: true

patternProperties:
  "^etu-slice@[0-9a-f]+$":
    type: object
    description: ETU slice configuration
    properties:
      reg:
        maxItems: 1

      pinctrl-0: true

      pinctrl-names:
        items:
          - const: default

      qcom,etu-event-sel:
        description: Event selection value for this slice.
        $ref: /schemas/types.yaml#/definitions/uint32

      qcom,etu-slice:
        description: ETU slice identifier.
        $ref: /schemas/types.yaml#/definitions/uint32

    required:
      - reg
      - qcom,etu-event-sel
      - qcom,etu-slice
      - pinctrl-0
      - pinctrl-names
    unevaluatedProperties: false

required:
  - compatible
  - reg
  - reg-names
  - clocks
  - clock-names

allOf:
  - if:
      properties:
        clock-names:
          contains:
            const: etu
    then:
      properties:
        clocks:
          minItems: 3
        clock-names:
          minItems: 3
      required:
        - interrupts
        - interrupt-names
        - "#address-cells"
        - "#size-cells"
        - ranges

unevaluatedProperties: false

examples:
  - |
    #include <dt-bindings/clock/qcom,sa8775p-gcc.h>

    soc {
      #address-cells = <2>;
      #size-cells = <2>;

      tscss@1c80000 {
        compatible = "qcom,lemans-tscss";
        reg = <0x0 0x01c80000 0x0 0x2000>;
        reg-names = "tsc";

        clocks = <&gcc GCC_TSCSS_AHB_CLK>,
                 <&gcc GCC_TSCSS_GLOBAL_CNTR_CLK>;
        clock-names = "ahb", "cntr";

        assigned-clocks = <&gcc GCC_TSCSS_GLOBAL_CNTR_CLK>;
        assigned-clock-rates = <15625000>;
      };
    };

  - |
    #include <dt-bindings/clock/qcom,sa8775p-gcc.h>
    #include <dt-bindings/interrupt-controller/arm-gic.h>

    soc {
      #address-cells = <2>;
      #size-cells = <2>;

      tscss@1c80000 {
        compatible = "qcom,lemans-tscss";
        reg = <0x0 0x01c80000 0x0 0x2000>;
        reg-names = "tsc";
        #address-cells = <2>;
        #size-cells = <2>;
        ranges;

        clocks = <&gcc GCC_TSCSS_AHB_CLK>,
                 <&gcc GCC_TSCSS_GLOBAL_CNTR_CLK>,
                 <&gcc GCC_TSCSS_ETU_CLK>;
        clock-names = "ahb", "cntr", "etu";

        assigned-clocks = <&gcc GCC_TSCSS_GLOBAL_CNTR_CLK>,
                          <&gcc GCC_TSCSS_ETU_CLK>;
        assigned-clock-rates = <15625000>, <15625000>;

        interrupts = <GIC_SPI 604 IRQ_TYPE_LEVEL_HIGH>;
        interrupt-names = "etu_summary";

        etu-slice@1c91000 {
          reg = <0x0 0x01c91000 0x0 0x1000>;
          pinctrl-0 = <&cci_timer0>;
          pinctrl-names = "default";
          qcom,etu-event-sel = <1>;
          qcom,etu-slice = <1>;
        };

        etu-slice@1c92000 {
          reg = <0x0 0x01c92000 0x0 0x1000>;
          pinctrl-0 = <&cci_timer1>;
          pinctrl-names = "default";
          qcom,etu-event-sel = <2>;
          qcom,etu-slice = <2>;
        };
      };
    };
...
```

## Documentation/devicetree/bindings/ptp/qcom,qdu1000-tscss.yaml
```yaml
# SPDX-License-Identifier: GPL-2.0-only OR BSD-2-Clause
%YAML 1.2
---
$id: http://devicetree.org/schemas/ptp/qcom,qdu1000-tscss.yaml#
$schema: http://devicetree.org/meta-schemas/core.yaml#

title: Timestamp Counter Subsystem (TSCSS) on Qualcomm QDU1000 SoC

maintainers:
  - Imran Shaik <imran.shaik@oss.qualcomm.com>
  - Taniya Das <taniya.das@oss.qualcomm.com>

description: |
  Qualcomm TSCSS is a time synchronization subsystem composed of two main
  blocks - the Time Stamp Counter (TSC) and the Event Timestamp Unit (ETU).

  The TSC block is a timestamp generator that maintains a running counter used
  for system timekeeping, and is functional with just the AHB and counter
  clocks.
  The ETU block is optional and captures TSC timestamps for external
  hardware events, each ETU slice binding a slice identifier to an external
  event selector. Support for the ETU block requires the additional ETU
  clock along with the per slice interrupt and slice subnodes.

properties:
  compatible:
    const: qcom,qdu1000-tscss

  reg:
    maxItems: 1

  reg-names:
    items:
      - const: tsc

  clocks:
    minItems: 2
    items:
      - description: TSC AHB configuration clock.
      - description: TSC global counter clock.
      - description: TSC ETU clock.

  clock-names:
    minItems: 2
    items:
      - const: ahb
      - const: cntr
      - const: etu

  assigned-clocks: true
  assigned-clock-rates: true

  "#address-cells":
    const: 2

  "#size-cells":
    const: 2

  ranges: true

patternProperties:
  "^etu-slice@[0-9a-f]+$":
    type: object
    description: ETU slice configuration
    properties:
      reg:
        maxItems: 1

      pinctrl-0: true

      pinctrl-names:
        items:
          - const: default

      interrupts:
        description: Per slice interrupt generated by ETU based on external event trigger.
        maxItems: 1

      qcom,etu-event-sel:
        description: Event selection value for this slice.
        $ref: /schemas/types.yaml#/definitions/uint32

      qcom,etu-slice:
        description: ETU slice identifier.
        $ref: /schemas/types.yaml#/definitions/uint32

    required:
      - reg
      - interrupts
      - qcom,etu-event-sel
      - qcom,etu-slice
      - pinctrl-0
      - pinctrl-names
    unevaluatedProperties: false

required:
  - compatible
  - reg
  - reg-names
  - clocks
  - clock-names

allOf:
  - if:
      properties:
        clock-names:
          contains:
            const: etu
    then:
      properties:
        clocks:
          minItems: 3
        clock-names:
          minItems: 3
      required:
        - "#address-cells"
        - "#size-cells"
        - ranges

unevaluatedProperties: false

examples:
  - |
    #include <dt-bindings/clock/qcom,qdu1000-gcc.h>

    soc {
      #address-cells = <2>;
      #size-cells = <2>;

      tscss@1da0000 {
        compatible = "qcom,qdu1000-tscss";
        reg = <0x0 0x01da0000 0x0 0x2000>;
        reg-names = "tsc";

        clocks = <&gcc GCC_TSC_CFG_AHB_CLK>,
                 <&gcc GCC_TSC_CNTR_CLK>;
        clock-names = "ahb", "cntr";
        assigned-clocks = <&gcc GCC_TSC_CNTR_CLK>;
        assigned-clock-rates = <500000000>;
      };
    };

  - |
    #include <dt-bindings/clock/qcom,qdu1000-gcc.h>
    #include <dt-bindings/interrupt-controller/arm-gic.h>

    soc {
      #address-cells = <2>;
      #size-cells = <2>;

      tscss@1da0000 {
        compatible = "qcom,qdu1000-tscss";
        reg = <0x0 0x01da0000 0x0 0x2000>;
        reg-names = "tsc";
        #address-cells = <2>;
        #size-cells = <2>;
        ranges;

        clocks = <&gcc GCC_TSC_CFG_AHB_CLK>,
                 <&gcc GCC_TSC_CNTR_CLK>,
                 <&gcc GCC_TSC_ETU_CLK>;
        clock-names = "ahb", "cntr", "etu";

        assigned-clocks = <&gcc GCC_TSC_CNTR_CLK>,
                          <&gcc GCC_TSC_ETU_CLK>;
        assigned-clock-rates = <500000000>, <500000000>;

        etu-slice@1db1000 {
          reg = <0x0 0x01db1000 0x0 0x1000>;
          interrupts = <GIC_SPI 329 IRQ_TYPE_EDGE_RISING>;
          pinctrl-0 = <&cci_timer0>;
          pinctrl-names = "default";
          qcom,etu-event-sel = <1>;
          qcom,etu-slice = <1>;
        };

        etu-slice@1db2000 {
          reg = <0x0 0x01db2000 0x0 0x1000>;
          interrupts = <GIC_SPI 330 IRQ_TYPE_EDGE_RISING>;
          pinctrl-0 = <&cci_timer1>;
          pinctrl-names = "default";
          qcom,etu-event-sel = <2>;
          qcom,etu-slice = <2>;
        };
      };
    };
...
```

## Documentation/devicetree/bindings/pwm/adi,adp5585-pwm.yaml
```yaml
# SPDX-License-Identifier: (GPL-2.0 OR BSD-2-Clause)
%YAML 1.2
---
$id: http://devicetree.org/schemas/pwm/adi,adp5585-pwm.yaml#
$schema: http://devicetree.org/meta-schemas/core.yaml#

title: Analog Devices ADP5585 PWM Generator

maintainers:
  - Laurent Pinchart <laurent.pinchart@ideasonboard.com>

description: |
  The Analog Devices ADP5585 generates a PWM output with configurable frequency
  and duty cycle represented by a "pwm" child node of the parent MFD device.
  See Documentation/devicetree/bindings/mfd/adi,adp5585.yaml for further
  details as well as an example.

allOf:
  - $ref: /schemas/pwm/pwm.yaml#

properties:
  compatible:
    enum:
      - adi,adp5585-pwm

  "#pwm-cells":
    const: 3

required:
  - compatible
  - "#pwm-cells"

additionalProperties: false

...
```
