## Documentation/devicetree/bindings/hwmon/pmbus/infineon,tda38740a.yaml
```yaml
# SPDX-License-Identifier: (GPL-2.0 OR BSD-2-Clause)
%YAML 1.2
---

$id: http://devicetree.org/schemas/hwmon/pmbus/infineon,tda38740a.yaml#
$schema: http://devicetree.org/meta-schemas/core.yaml#

title: Infineon TDA38740A and TDA38725A Synchronous Buck Regulator with I2C

maintainers:
  - ASHISH YADAV <Ashish.Yadav@infineon.com>

description: |
  The Infineon TDA38740A/TDA38725A is a 40A/25A Single-voltage Synchronous
  Buck Regulator with I2C designed for Industrial use.

  Datasheet:
  https://www.infineon.com/assets/row/public/documents/24/49/infineon-tda38740a-tda38725a-datasheet-en.pdf

properties:
  compatible:
    enum:
      - infineon,tda38725a
      - infineon,tda38740a

  reg:
    maxItems: 1

  infineon,vout-voltage-multiplier:
    description: |
      TDA38740/25 pin strap parts are available in two flavors of 1:1 & 1:2
      vout scale loop.
      For the 1:1 vout_scale_loop version, there is no need for any resistor
      divider as output voltage sense pins are directly connected to
      the output.

      For a 1:2 scale loop version, it is recommended to use 499 ohms each for
      top and bottom across the feedback path.
      However, in some applications customers tend to use an intentional
      resistor divider across the output with a different divider ratio other
      than 1:1 or 1:2 to alter the actual output voltage.

      For example, if pin strap part is set to Vboot of 0.7V,they use a
      resistor divider to generate 0.75V using the equation provided in
      Section 13.3 of the datasheet.In this case, as there are only two
      vout_scale_loop options of 1:1 and 1:2 that the IC can identify,
      Read_Vout would still read as 0.7V in the telemetry and the baseboard
      management controllers would use this telemetry data to monitor the
      rail parameters leading to false tripping of the system.
      This multiplier is used to offset the telemetry output voltage Read_Vout
      so that the telemetry data is reported correctly to the monitoring
      controller,in this example the multiplier would be 0.75/0.7 = 1.071.

      This multiplier is required only for any external monitoring of the rail
      output voltage. All the other Vout related parameters are used
      internally by the IC and there is only a slight impact on the fault
      thresholds.The impact can be calculated using equations in Section 13.3
      of the datasheet.
    $ref: /schemas/types.yaml#/definitions/uint32-array
    minItems: 2
    maxItems: 2

required:
  - compatible
  - reg

additionalProperties: false

examples:
  - |
    #include <dt-bindings/interrupt-controller/irq.h>
    i2c {
        #address-cells = <1>;
        #size-cells = <0>;

        hwmon@40 {
            compatible = "infineon,tda38740a";
            reg = <0x40>;
            infineon,vout-voltage-multiplier = <75 70>;
        };
    };
```

## Documentation/devicetree/bindings/hwmon/pmbus/infineon,xdp720.yaml
```yaml
# SPDX-License-Identifier: (GPL-2.0 OR BSD-2-Clause)
%YAML 1.2
---

$id: http://devicetree.org/schemas/hwmon/pmbus/infineon,xdp720.yaml#
$schema: http://devicetree.org/meta-schemas/core.yaml#

title: Infineon XDP720 Digital eFuse Controller

maintainers:
  - Ashish Yadav <ashish.yadav@infineon.com>

description: |
  The XDP720 is an eFuse with integrated  current sensor and digital
  controller. It provides accurate system telemetry (V, I, P, T) and
  reports analog current at the IMON pin for post-processing.

   Datasheet:
     https://www.infineon.com/assets/row/public/documents/24/49/infineon-xdp720-001-datasheet-en.pdf

properties:
  compatible:
    enum:
      - infineon,xdp720

  reg:
    maxItems: 1

  infineon,rimon-micro-ohms:
    description: |
      The value of the RIMON resistor, in micro‑ohms, required to enable
      the system’s over‑current protection.
    $ref: /schemas/types.yaml#/definitions/uint32

required:
  - compatible
  - reg

additionalProperties: false

examples:
  - |
    i2c {
        #address-cells = <1>;
        #size-cells = <0>;

        hwmon@11 {
            compatible = "infineon,xdp720";
            reg = <0x11>;
            infineon,rimon-micro-ohms = <1098000000>;  /* 1.098k ohm */
        };
    };
```

## Documentation/devicetree/bindings/hwmon/pmbus/infineon,xdp730.yaml
```yaml
# SPDX-License-Identifier: (GPL-2.0 OR BSD-2-Clause)
%YAML 1.2
---

$id: http://devicetree.org/schemas/hwmon/pmbus/infineon,xdp730.yaml#
$schema: http://devicetree.org/meta-schemas/core.yaml#

title: Infineon XDP730 Digital eFuse Controller

maintainers:
  - Ashish Yadav <ashish.yadav@infineon.com>

description: |
  The XDP730 is an eFuse with integrated current sensor and digital
  controller. It provides accurate system telemetry (V, I, P, T) and
  reports analog current at the IMON pin for post-processing.

  Datasheet:
     https://www.infineon.com/assets/row/public/documents/24/49/infineon-xdp730-001-datasheet-en.pdf

properties:
  compatible:
    enum:
      - infineon,xdp730

  reg:
    maxItems: 1

  infineon,rimon-micro-ohms:
    description:
      The value of the RIMON resistor, in micro ohms, required to enable
      the system overcurrent protection.

  vdd-vin-supply:
    description:
      Supply for the VDD_VIN pin (pin 20), the IC controller power supply.
      Typically connected to the input bus (VIN) through a 100 ohm / 100 nF
      RC filter.

required:
  - compatible
  - reg
  - vdd-vin-supply

additionalProperties: false

examples:
  - |
    i2c {
        #address-cells = <1>;
        #size-cells = <0>;

        hwmon@11 {
            compatible = "infineon,xdp730";
            reg = <0x11>;
            vdd-vin-supply = <&vdd_vin>;
            infineon,rimon-micro-ohms = <1098000000>;  /* 1.098k ohm */
        };
    };
```

## Documentation/devicetree/bindings/hwmon/pmbus/luxshare,lx1308.yaml
```yaml
# SPDX-License-Identifier: (GPL-2.0-only OR BSD-2-Clause)
%YAML 1.2
---

$id: http://devicetree.org/schemas/hwmon/pmbus/luxshare,lx1308.yaml#
$schema: http://devicetree.org/meta-schemas/core.yaml#

title: Luxshare LX1308 Digital DC/DC Power Module

maintainers:
  - Brian Chiang <chiang.brian@inventec.com>

description: |
  The LX1308 is a high-efficiency, non-isolated, regulated 12V, 860W,
  digital DC/DC power module. The module operates from a 40V to 60V DC
  primary bus and provides a 12V regulated output voltage. It can deliver
  up to 860W continuous and 1300W in transient.

properties:
  compatible:
    enum:
      - luxshare,lx1308lch
      - luxshare,lx1308nch
      - luxshare,lx1308sch
      - luxshare,lx1308ldh
      - luxshare,lx1308ndh
      - luxshare,lx1308sdh
      - luxshare,lx1308

  reg:
    maxItems: 1

required:
  - compatible
  - reg

additionalProperties: false

examples:
  - |
    i2c {
      #address-cells = <1>;
      #size-cells = <0>;

      power-module@60 {
        compatible = "luxshare,lx1308";
        reg = <0x60>;
      };
    };
```

## Documentation/devicetree/bindings/hwmon/pmbus/mps,mpq8646.yaml
```yaml
# SPDX-License-Identifier: (GPL-2.0 OR BSD-2-Clause)
# Copyright (c) 2026 Free Mobile - Vincent Jardin <vjardin@free.fr>
%YAML 1.2
---
$id: http://devicetree.org/schemas/hwmon/pmbus/mps,mpq8646.yaml#
$schema: http://devicetree.org/meta-schemas/core.yaml#

title: Monolithic Power Systems MPQ8646 PMBus Step-Down Converter (extended)

maintainers:
  - Vincent Jardin <vjardin@free.fr>

description: |
  PMBus driver for the MPS MPQ8646 step-down converter.

properties:
  compatible:
    const: mps,mpq8646

  reg:
    maxItems: 1

  mps,vout-fb-divider-ratio-permille:
    description:
      The feedback resistor divider ratio, expressed in permille
      (Vfb / Vout * 1000). This value is written to the
      PMBUS_VOUT_SCALE_LOOP register and is required for correct output
      voltage presentation.
    $ref: /schemas/types.yaml#/definitions/uint32
    minimum: 1
    maximum: 2047
    default: 706

required:
  - compatible
  - reg

additionalProperties: false

examples:
  - |
    i2c {
      #address-cells = <1>;
      #size-cells = <0>;

      regulator@10 {
        compatible = "mps,mpq8646";
        reg = <0x10>;
      };
    };
```

## Documentation/devicetree/bindings/hwmon/pmbus/mps,mpq8785.yaml
```yaml
# SPDX-License-Identifier: (GPL-2.0 OR BSD-2-Clause)
%YAML 1.2
---

$id: http://devicetree.org/schemas/hwmon/pmbus/mps,mpq8785.yaml#
$schema: http://devicetree.org/meta-schemas/core.yaml#

allOf:
  - $ref: /schemas/i2c/i2c-device.yaml#

title: Monolithic Power Systems Multiphase Voltage Regulators with PMBus

maintainers:
  - Charles Hsu <ythsu0511@gmail.com>

description: |
  Monolithic Power Systems digital multiphase voltage regulators with PMBus.

properties:
  compatible:
    enum:
      - mps,mpq8785
      - mps,mpm82504
      - mps,mpm3695-10

  reg:
    maxItems: 1

  voltage-scale-loop:
    description:
      Voltage scale factor for the VOUT_SCALE_LOOP register.
      Value expressed in mili-units (1/1000th of a unit).
      The simplest way to calculate it is
      VOUT_SCALE_LOOP = VFB / VOUT * 1000
    $ref: /schemas/types.yaml#/definitions/uint32

required:
  - compatible
  - reg

additionalProperties: false

examples:
  - |
    i2c {
      #address-cells = <1>;
      #size-cells = <0>;

      pmic@30 {
        compatible = "mps,mpm82504";
        reg = <0x30>;
        voltage-scale-loop = <600>;
      };
    };
```

## Documentation/devicetree/bindings/hwmon/pmbus/murata,d1u74t.yaml
```yaml
# SPDX-License-Identifier: (GPL-2.0 OR BSD-2-Clause)
%YAML 1.2
---
$id: http://devicetree.org/schemas/hwmon/pmbus/murata,d1u74t.yaml#
$schema: http://devicetree.org/meta-schemas/core.yaml#

title: Murata D1U74T-W power supply unit

maintainers:
  - Abdurrahman Hussain <abdurrahman@nexthop.ai>

description:
  The Murata D1U74T-W is a PMBus-compliant AC/DC power supply unit that
  exposes input/output voltage, current and power telemetry, three
  temperature sensors and dual fan monitoring over an I2C interface.

properties:
  compatible:
    enum:
      - murata,d1u74t

  reg:
    maxItems: 1

required:
  - compatible
  - reg

additionalProperties: false

examples:
  - |
    i2c {
        #address-cells = <1>;
        #size-cells = <0>;

        psu@58 {
            compatible = "murata,d1u74t";
            reg = <0x58>;
        };
    };
```

## Documentation/devicetree/bindings/hwmon/pmbus/onnn,fd5121.yaml
```yaml
# SPDX-License-Identifier: (GPL-2.0 OR BSD-2-Clause)
%YAML 1.2
---
$id: http://devicetree.org/schemas/hwmon/pmbus/onnn,fd5121.yaml#
$schema: http://devicetree.org/meta-schemas/core.yaml#

title: onsemi's multi-phase digital controllers

maintainers:
  - Selvamani Rajagopal <selvamani.rajagopal@onsemi.com>

description:
  onsemi multi-phase digital controllers with PMBus.

properties:
  compatible:
    enum:
      - onnn,fd5121
      - onnn,fd5123
      - onnn,fd5125

  reg:
    maxItems: 1

required:
  - compatible
  - reg

additionalProperties: false

examples:
  - |
    i2c {
      #address-cells = <1>;
      #size-cells = <0>;

      fd5121@50 {
        compatible = "onnn,fd5121";
        reg = <0x50>;
      };
    };
```

## Documentation/devicetree/bindings/hwmon/pmbus/st,stef48h28.yaml
```yaml
# SPDX-License-Identifier: (GPL-2.0-only OR BSD-2-Clause)
%YAML 1.2
---
$id: http://devicetree.org/schemas/hwmon/pmbus/st,stef48h28.yaml#
$schema: http://devicetree.org/meta-schemas/core.yaml#

title: STMicroelectronics hot-swap controller with PMBus interface

maintainers:
  - Charles Hsu <hsu.yungteng@gmail.com>

description: |
  The STEF48H28 is an advanced 30A integrated electronic fuse for
  the 9-80V DC power lines.

  Datasheet:
    https://www.st.com/resource/en/data_brief/stef48h28.pdf

properties:
  compatible:
    enum:
      - st,stef48h28

  reg:
    maxItems: 1

required:
  - compatible
  - reg

unevaluatedProperties: false

examples:
  - |
    i2c {
        #address-cells = <1>;
        #size-cells = <0>;

        pmic@11 {
            compatible = "st,stef48h28";
            reg = <0x11>;
        };
    };
```
