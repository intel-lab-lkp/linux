## Documentation/devicetree/bindings/hwmon/max31790.yaml
```yaml
# SPDX-License-Identifier: (GPL-2.0 OR BSD-2-Clause)
%YAML 1.2
---
$id: http://devicetree.org/schemas/hwmon/max31790.yaml#
$schema: http://devicetree.org/meta-schemas/core.yaml#

title: The Maxim MAX31790 Fan Controller

maintainers:
  - Jean Delvare <jdelvare@suse.com>
  - Guenter Roeck <linux@roeck-us.net>

description: >
  The MAX31790 controls the speeds of up to six fans using six
  independent PWM outputs. The desired fan speeds (or PWM duty cycles)
  are written through the I2C interface.

  Datasheets:
    https://datasheets.maximintegrated.com/en/ds/MAX31790.pdf

properties:
  compatible:
    const: maxim,max31790

  reg:
    maxItems: 1

  pwmout-pin-as-tach-input:
    description: |
      An array of six integers responds to six PWM channels for
      configuring the pwm to tach mode.
      When set to 0, the associated PWMOUT produces a PWM waveform for
      control of fan speed. When set to 1, PWMOUT becomes a TACH input
    $ref: /schemas/types.yaml#/definitions/uint8-array
    maxItems: 6
    minItems: 6

required:
  - compatible
  - reg

additionalProperties: false

examples:
  - |
    i2c {
      #address-cells = <1>;
      #size-cells = <0>;

      max31790@20 {
        compatible = "maxim,max31790";
        reg = <0x20>;
        pwmout-pin-as-tach-input = /bits/ 8 <0 0 0 0 1 1>;
      };
    };
```

## Documentation/devicetree/bindings/hwmon/maxim,max31790.yaml
```yaml
# SPDX-License-Identifier: (GPL-2.0 OR BSD-2-Clause)
%YAML 1.2
---
$id: http://devicetree.org/schemas/hwmon/maxim,max31790.yaml#
$schema: http://devicetree.org/meta-schemas/core.yaml#

title: The Maxim MAX31790 Fan Controller

maintainers:
  - Guenter Roeck <linux@roeck-us.net>

description: >
  The MAX31790 controls the speeds of up to six fans using six
  independent PWM outputs. The desired fan speeds (or PWM duty cycles)
  are written through the I2C interface.

  Datasheets:
    https://datasheets.maximintegrated.com/en/ds/MAX31790.pdf

properties:
  compatible:
    const: maxim,max31790

  reg:
    maxItems: 1

  clocks:
    maxItems: 1

  resets:
    maxItems: 1

  maxim,pwmout-pin-as-tach-input:
    description: |
      An array of six integers responds to six PWM channels for
      configuring the pwm to tach mode.
      When set to 0, the associated PWMOUT produces a PWM waveform for
      control of fan speed. When set to 1, PWMOUT becomes a TACH input
    $ref: /schemas/types.yaml#/definitions/uint8-array
    maxItems: 6
    minItems: 6

required:
  - compatible
  - reg

allOf:
  - $ref: fan-common.yaml#

unevaluatedProperties: false

examples:
  - |
    i2c {
      #address-cells = <1>;
      #size-cells = <0>;

      fan-controller@20 {
        compatible = "maxim,max31790";
        reg = <0x20>;
        maxim,pwmout-pin-as-tach-input = /bits/ 8 <0 0 0 0 1 1>;
      };
    };
```

## Documentation/devicetree/bindings/hwmon/maxim,max6639.yaml
```yaml
# SPDX-License-Identifier: (GPL-2.0 OR BSD-2-Clause)
%YAML 1.2
---
$id: http://devicetree.org/schemas/hwmon/maxim,max6639.yaml#
$schema: http://devicetree.org/meta-schemas/core.yaml#

title: Maxim MAX6639 Fan Controller

maintainers:
  - Naresh Solanki <Naresh.Solanki@9elements.com>

description: |
  The MAX6639 is a 2-channel temperature monitor with dual, automatic, PWM
  fan-speed controller.  It monitors its own temperature and one external
  diode-connected transistor or the temperatures of two external diode-connected
  transistors, typically available in CPUs, FPGAs, or GPUs.

  Datasheets:
    https://datasheets.maximintegrated.com/en/ds/MAX6639-MAX6639F.pdf

properties:
  compatible:
    enum:
      - maxim,max6639

  reg:
    maxItems: 1

  fan-supply:
    description: Phandle to the regulator that provides power to the fan.

  interrupts:
    maxItems: 1

required:
  - compatible
  - reg

additionalProperties: false

examples:
  - |
    i2c {
      #address-cells = <1>;
      #size-cells = <0>;

      fan-controller@10 {
        compatible = "maxim,max6639";
        reg = <0x10>;
      };
    };
...
```

## Documentation/devicetree/bindings/hwmon/microchip,emc1812.yaml
```yaml
# SPDX-License-Identifier: (GPL-2.0 OR BSD-2-Clause)
%YAML 1.2
---
$id: http://devicetree.org/schemas/hwmon/microchip,emc1812.yaml#
$schema: http://devicetree.org/meta-schemas/core.yaml#

title: Microchip EMC1812/13/14/15/33 multichannel temperature sensor

maintainers:
  - Marius Cristea <marius.cristea@microchip.com>

description: |
  The Microchip EMC1812/13/14/15/33 is a high-accuracy 2-wire multichannel
  low-voltage remote diode temperature monitor.

  The datasheet can be found here:
    https://ww1.microchip.com/downloads/aemDocuments/documents/MSLD/ProductDocuments/DataSheets/EMC1812-3-4-5-33-Data-Sheet-DS20005751.pdf

properties:
  compatible:
    enum:
      - microchip,emc1812
      - microchip,emc1813
      - microchip,emc1814
      - microchip,emc1815
      - microchip,emc1833

  reg:
    maxItems: 1

  interrupts:
    maxItems: 2

  interrupt-names:
    description:
      -alert-therm2 asserts when a diode temperature exceeds the ALERT
      threshold.
      -therm-addr asserts low when the hardware-set THERM limit threshold is
      exceeded by one of the temperature sensors.
    items:
      - const: alert-therm2
      - const: therm-addr

  "#address-cells":
    const: 1

  "#size-cells":
    const: 0

  microchip,parasitic-res-on-channel1-2:
    description:
      Indicates that the chip and the diodes/transistors are sufficiently
      far apart that a parasitic resistance is added to the wires, which can
      affect the measurements. Due to the anti-parallel diode connections,
      channels 1 and 2 are affected together.
    type: boolean

  microchip,parasitic-res-on-channel3-4:
    description:
      Indicates that the chip and the diodes/transistors are sufficiently far
      apart that a parasitic resistance is added to the wires, which can affect
      the measurements. Due to the anti-parallel diode connections, channels
      3 and 4 are affected together.
    type: boolean

  vdd-supply: true

patternProperties:
  "^channel@[1-4]$":
    description:
      Represents the external temperature channels to which
      a remote diode is connected.
    type: object

    properties:
      reg:
        items:
          minimum: 1
          maximum: 4

      label:
        description: Unique name to identify which channel this is.

    required:
      - reg

    additionalProperties: false

required:
  - compatible
  - reg
  - vdd-supply

allOf:
  - if:
      properties:
        compatible:
          contains:
            enum:
              - microchip,emc1812
              - microchip,emc1813
              - microchip,emc1833
    then:
      properties:
        microchip,parasitic-res-on-channel3-4: false
  - if:
      properties:
        compatible:
          contains:
            enum:
              - microchip,emc1812
    then:
      properties:
        channel@1:
          properties:
            reg:
              items:
                const: 1
      patternProperties:
        "^channel@[2-4]$": false
  - if:
      properties:
        compatible:
          pattern: "^microchip,emc18[13]3"
    then:
      patternProperties:
        "^channel@[12]$":
          properties:
            reg:
              items:
                maximum: 2
        "^channel@[34]$": false
  - if:
      properties:
        compatible:
          pattern: "^microchip,emc1814"
    then:
      patternProperties:
        "^channel@[1-3]$":
          properties:
            reg:
              items:
                maximum: 3
      properties:
        channel@4: false

additionalProperties: false

examples:
  - |
    i2c {
        #address-cells = <1>;
        #size-cells = <0>;

        temperature-sensor@4c {
            compatible = "microchip,emc1813";
            reg = <0x4c>;

            #address-cells = <1>;
            #size-cells = <0>;

            microchip,parasitic-res-on-channel1-2;

            vdd-supply = <&vdd>;

            channel@1 {
                reg = <1>;
                label = "External CH1 Temperature";
            };

            channel@2 {
                reg = <2>;
                label = "External CH2 Temperature";
            };
        };
    };
```

## Documentation/devicetree/bindings/hwmon/microchip,emc181x.yaml
```yaml
# SPDX-License-Identifier: (GPL-2.0 OR BSD-2-Clause)
%YAML 1.2
---

$id: http://devicetree.org/schemas/hwmon/microchip,emc181x.yaml#
$schema: http://devicetree.org/meta-schemas/core.yaml#

title: Microchip EMC1812/EMC1813/EMC1814/EMC1815/EMC1833 temperature sensors

maintainers:
  - Mark Tomlinson <mark.tomlinson@alliedtelesis.co.nz>

properties:
  compatible:
    enum:
      - microchip,emc1812
      - microchip,emc1813
      - microchip,emc1814
      - microchip,emc1815
      - microchip,emc1833

  reg:
    maxItems: 1

  emc181x,extended-range:
    description: Allow for reading of extended temperature range (-64-192C)


required:
  - compatible
  - reg

additionalProperties: false

examples:
  - |
    i2c {
        #address-cells = <1>;
        #size-cells = <0>;

        temperature-sensor@7c {
            compatible = "microchip,emc1812";
            reg = <0x7c>;
        };
    };
```

## Documentation/devicetree/bindings/hwmon/microchip,emc2101.yaml
```yaml
# SPDX-License-Identifier: (GPL-2.0-only OR BSD-2-Clause)
%YAML 1.2
---
$id: http://devicetree.org/schemas/hwmon/microchip,emc2101.yaml#
$schema: http://devicetree.org/meta-schemas/core.yaml#

title: Microchip EMC2101 SMBus compliant PWM fan controller

maintainers:
  - Álvaro Fernández Rojas <noltari@gmail.com>

description:
  Microchip EMC2101 pwm controller which supports up to 1 fan, 1 internal
  temperature sensor, 1 external temperature sensor and an 8 entry look
  up table to create a programmable temperature response.

properties:
  compatible:
    enum:
      - microchip,emc2101

  reg:
    maxItems: 1

  fan:
    $ref: fan-common.yaml#
    unevaluatedProperties: false

  '#pwm-cells':
    const: 2
    description: |
      Number of cells in a PWM specifier.
      - cell 0: The PWM frequency
      - cell 1: The PWM polarity: 0 or PWM_POLARITY_INVERTED

required:
  - compatible
  - reg

additionalProperties: false

examples:
  - |
    i2c {
        #address-cells = <1>;
        #size-cells = <0>;

        fan_controller: fan-controller@4c {
            compatible = "microchip,emc2101";
            reg = <0x4c>;

            #pwm-cells = <2>;

            fan {
                pwms = <&fan_controller 5806 0>;
            };
        };
    };
...
```

## Documentation/devicetree/bindings/hwmon/microchip,emc2305.yaml
```yaml
# SPDX-License-Identifier: (GPL-2.0-only OR BSD-2-Clause)
%YAML 1.2
---
$id: http://devicetree.org/schemas/hwmon/microchip,emc2305.yaml#
$schema: http://devicetree.org/meta-schemas/core.yaml#

title: Microchip EMC2305 SMBus compliant PWM fan controller

maintainers:
  - Michael Shych <michaelsh@nvidia.com>

description: |
  Microchip EMC2301/2/3/5 pwm controller which supports up
  to five programmable fan control circuits

properties:
  compatible:
    enum:
      - microchip,emc2301
      - microchip,emc2302
      - microchip,emc2303
      - microchip,emc2305

  reg:
    maxItems: 1

required:
  - compatible
  - reg

additionalProperties: false

examples:
  - |
    i2c {
        #address-cells = <1>;
        #size-cells = <0>;

        emc2301: pwm@2f {
            compatible = "microchip,emc2301";
            reg = <0x2f>;
        };
    };
```
