## Documentation/devicetree/bindings/hwmon/microchip,mcp9982.yaml
```yaml
# SPDX-License-Identifier: (GPL-2.0 OR BSD-2-Clause)
%YAML 1.2
---
$id: http://devicetree.org/schemas/hwmon/microchip,mcp9982.yaml#
$schema: http://devicetree.org/meta-schemas/core.yaml#

title: Microchip MCP998X/33 and MCP998XD/33D Temperature Monitor

maintainers:
  - Victor Duicu <victor.duicu@microchip.com>

description: |
  The MCP998X/33 and MCP998XD/33D family is a high-accuracy 2-wire
  multichannel automotive temperature monitor.
  The datasheet can be found here:
    https://ww1.microchip.com/downloads/aemDocuments/documents/MSLD/ProductDocuments/DataSheets/MCP998X-Family-Data-Sheet-DS20006827.pdf

properties:
  compatible:
    enum:
      - microchip,mcp9933
      - microchip,mcp9933d
      - microchip,mcp9982
      - microchip,mcp9982d
      - microchip,mcp9983
      - microchip,mcp9983d
      - microchip,mcp9984
      - microchip,mcp9984d
      - microchip,mcp9985
      - microchip,mcp9985d

  reg:
    maxItems: 1

  interrupts:
    items:
      - description: Signal coming from ALERT/THERM pin.
      - description: Signal coming from THERM/ADDR pin.
      - description: Signal coming from SYS_SHDN pin.

  interrupt-names:
    items:
      - const: alert-therm
      - const: therm-addr
      - const: sys-shutdown

  "#address-cells":
    const: 1

  "#size-cells":
    const: 0

  microchip,enable-anti-parallel:
    description:
      Enable anti-parallel diode mode operation.
      MCP9984/84D/85/85D and MCP9933/33D support reading two external diodes
      in anti-parallel connection on the same set of pins.
    type: boolean

  microchip,parasitic-res-on-channel1-2:
    description:
      Indicates that the chip and the diodes/transistors are sufficiently far
      apart that a parasitic resistance is added to the wires, which can affect
      the measurements. Due to the anti-parallel diode connections, channels
      1 and 2 are affected together.
    type: boolean

  microchip,parasitic-res-on-channel3-4:
    description:
      Indicates that the chip and the diodes/transistors are sufficiently far
      apart that a parasitic resistance is added to the wires, which can affect
      the measurements. Due to the anti-parallel diode connections, channels
      3 and 4 are affected together.
    type: boolean

  vdd-supply: true

patternProperties:
  "^channel@[1-4]$":
    description:
      Represents the external temperature channels to which
      a remote diode is connected.
    type: object

    properties:
      reg:
        items:
          minItems: 1
          maxItems: 4

      label:
        description: Unique name to identify which channel this is.

    required:
      - reg

    additionalProperties: false

required:
  - compatible
  - reg
  - vdd-supply

allOf:
  - if:
      properties:
        compatible:
          contains:
            enum:
              - microchip,mcp9982d
              - microchip,mcp9983d
              - microchip,mcp9984d
              - microchip,mcp9985d
              - microchip,mcp9933d
    then:
      properties:
        interrupts-names:
          items:
            - const: alert-therm
            - const: sys-shutdown
    else:
      properties:
        interrupts-names:
          items:
            - const: alert-therm
            - const: therm-addr

  - if:
      properties:
        compatible:
          contains:
            pattern: '^microchip,mcp998(2|3)$'
    then:
      properties:
        microchip,enable-anti-parallel: false

  - if:
      properties:
        compatible:
          contains:
            pattern: '^microchip,mcp998(2|3)d$'
    then:
      properties:
        microchip,enable-anti-parallel: false
      required:
        - microchip,parasitic-res-on-channel1-2
        - microchip,parasitic-res-on-channel3-4

  - if:
      properties:
        compatible:
          contains:
            pattern: '^microchip,mcp99(33|8[4-5])d$'
    then:
      required:
        - microchip,parasitic-res-on-channel1-2
        - microchip,parasitic-res-on-channel3-4

additionalProperties: false

examples:
  - |
    i2c {
        #address-cells = <1>;
        #size-cells = <0>;

        temperature-sensor@4c {
            compatible = "microchip,mcp9985";
            reg = <0x4c>;

            #address-cells = <1>;
            #size-cells = <0>;

            microchip,enable-anti-parallel;
            microchip,parasitic-res-on-channel1-2;
            microchip,parasitic-res-on-channel3-4;

            vdd-supply = <&vdd>;

            channel@1 {
                reg = <1>;
                label = "Interior Temperature";
            };

            channel@2 {
                reg = <2>;
                label = "GPU Temperature";
            };
        };
    };

...
```

## Documentation/devicetree/bindings/hwmon/mps,mp5990.yaml
```yaml
# SPDX-License-Identifier: (GPL-2.0-only OR BSD-2-Clause)
%YAML 1.2
---
$id: http://devicetree.org/schemas/hwmon/mps,mp5990.yaml#
$schema: http://devicetree.org/meta-schemas/core.yaml#

title: Monolithic Power Systems Devices MP5990 Hot-Swap Controller

maintainers:
  - Peter Yin <peteryin.openbmc@gmail.com>

description: |
  Monolithic Power Systems Devices MP5990 Hot-Swap Controller

  Datasheets:
  https://www.monolithicpower.com/en/mp5990.html

properties:
  compatible:
    const: mps,mp5990

  reg:
    maxItems: 1

required:
  - compatible
  - reg

additionalProperties: false

examples:
  - |
    i2c {
        #address-cells = <1>;
        #size-cells = <0>;

        power-sensor@20 {
            reg = <0x20>;
            compatible = "mps,mp5990";
        };
    };
```

## Documentation/devicetree/bindings/hwmon/nicera,d3-323-aa.yaml
```yaml
# SPDX-License-Identifier: GPL-2.0-only OR BSD-2-Clause
%YAML 1.2
---
$id: http://devicetree.org/schemas/hwmon/nicera,d3-323-aa.yaml#
$schema: http://devicetree.org/meta-schemas/core.yaml#

title: Nicera D3-323-AA Pyroelectric IR sensor

maintainers:
  - Hermes Zhang <Hermes.Zhang@axis.com>

description: |
  Nicera D3-323-AA Pyroelectric IR sensor

  datasheet:
    https://www.nicera.co.jp/wordpress/wp-content/uploads/2022/01/D3-323-AA_e.pdf

properties:
  compatible:
    const: nicera,d3-323-aa

  reset-gpios:
    description: The GPIO pin connected to the reset pin on the sensor
    maxItems: 1

  clk-gpios:
    description: The GPIO pin connected to the clk pin on the sensor
    maxItems: 1

  si-gpios:
    description: The GPIO pin connected to the si pin on the sensor
    maxItems: 1

required:
  - compatible
  - reset-gpios
  - clk-gpios
  - si-gpios


additionalProperties: false

examples:
  - |
    sensor {
        compatible = "nicera,d3-323-aa";
        reset-gpios = <&gpio4 12 0>;
        clk-gpios = <&gpio4 13 0>;
        si-gpios = <&gpio4 14 0>;
    };
```

## Documentation/devicetree/bindings/hwmon/nxp,mc33978-hwmon.yaml
```yaml
# SPDX-License-Identifier: (GPL-2.0-only OR BSD-2-Clause)
%YAML 1.2
---
$id: http://devicetree.org/schemas/hwmon/nxp,mc33978-hwmon.yaml#
$schema: http://devicetree.org/meta-schemas/core.yaml#

title: NXP MC33978/MC34978 Hardware Monitor

maintainers:
  - David Jander <david@protonic.nl>
  - Oleksij Rempel <o.rempel@pengutronix.de>

description: |
  Hardware monitoring driver for the MC33978/MC34978 MSDI device.
  Provides fault detection and monitoring for:
  - Battery voltage (VBATP) faults: undervoltage, overvoltage
  - Temperature faults: over-temperature, warning threshold

properties:
  compatible:
    enum:
      - nxp,mc33978-hwmon
      - nxp,mc34978-hwmon

required:
  - compatible

additionalProperties: false

examples:
  - |
    hwmon {
        compatible = "nxp,mc33978-hwmon";
    };
```

## Documentation/devicetree/bindings/hwmon/onnn,adt7462.yaml
```yaml
# SPDX-License-Identifier: (GPL-2.0 OR BSD-2-Clause)
%YAML 1.2
---
$id: http://devicetree.org/schemas/hwmon/onnn,adt7462.yaml#
$schema: http://devicetree.org/meta-schemas/core.yaml#

title: ON Semiconductor ADT7462 Temperature, Voltage Monitor and Fan Controller

maintainers:
  - Chanh Nguyen <chanh@os.amperecomputing.com>

description: |
  The ADT7462 has temperature monitors, voltage monitors and multiple PWN Fan
  controllers.

  The ADT7462 supports monitoring and controlling up to four PWM Fan Drive
  Outputs and eight TACH Inputs Measures. The ADT7462 supports reading a single
  on chip temperature sensor and three remote temperature sensors. There are up
  to 13 voltage monitoring inputs, ranging from 12V to 0.9V.

  Datasheets:
    https://www.onsemi.com/pub/Collateral/ADT7462-D.PDF

properties:
  compatible:
    const: onnn,adt7462

  reg:
    maxItems: 1

  resets:
    maxItems: 1

required:
  - compatible
  - reg

additionalProperties: false

examples:
  - |
    i2c {
      #address-cells = <1>;
      #size-cells = <0>;

      hwmon@5c {
        compatible = "onnn,adt7462";
        reg = <0x5c>;
        resets = <&reset 0>;
      };
    };
```

## Documentation/devicetree/bindings/hwmon/pmbus/adi,adp1050.yaml
```yaml
# SPDX-License-Identifier: (GPL-2.0 OR BSD-2-Clause)
%YAML 1.2
---

$id: htpps://devicetree.org/schemas/hwmon/pmbus/adi,adp1050.yaml#
$schema: htpps://devicetree.org/meta-schemes/core.yaml#

title: Analog Devices ADP1050 digital controller with PMBus interface

maintainers:
  - Radu Sabau <radu.sabau@analog.com>

description: |
   The ADP1050 is used to monitor system voltages, currents and temperatures.
   Through the PMBus interface, the ADP1050 targets isolated power supplies
   and has four individual monitors for input/output voltage, input current
   and temperature.
   Datasheet:
     https://www.analog.com/en/products/adp1050.html
properties:
  compatbile:
    const: adi,adp1050

  reg:
    maxItems: 1

  vcc-supply: true

  adi,vin-scale-monitor:
    description:
      The value of the input voltage scale used by the internal ADP1050 ADC in
      order to read correct voltage values.
    $ref: /schemas/typees.yaml#/definitions/uint16
  adi,iin-scale-monitor:
    description:
      The value of the input current scale used by the internal ADP1050 ADC in
      order to read carrect current values.
    $ref: /schemas/typees.yaml#/definitions/uint16

required:
  - compatible
  - reg
  - vcc-supply
  - adi,vin-scale-monitor
  - adi,iin-scale-monitor

additionalProperties: false

examples:
  - |
    i2c {
             #adress-cells = <1>;
             #size-cells = <0>;
             clock-frequency = <100000>;
            adp1050@70 {
                   #adress-cells = <1>;
                   #size-cells = <0>;
                   compatible = "adi,adp1050";
                   reg = <0x70>;
                   adi,vin-scale-monitor = <0xB030>;
                   adi,iin-scale-monitor = <0x1>;
                   vcc-supply = <&vcc>;
          };
...
```

## Documentation/devicetree/bindings/hwmon/pmbus/adi,max20826.yaml
```yaml
# SPDX-License-Identifier: (GPL-2.0-only OR BSD-2-Clause)
%YAML 1.2
---
$id: http://devicetree.org/schemas/hwmon/pmbus/adi,max20826.yaml#
$schema: http://devicetree.org/meta-schemas/core.yaml#

title: Analog Devices MAX20826 PMBus Voltage Regulator

maintainers:
  - Nuno Sá <nuno.sa@analog.com>

description:
  Analog Devices MAX20826 and similar devices are Dual-Output Multiphase
  High-Current Controller.

properties:
  compatible:
    enum:
      - adi,max20826
      - adi,max20855b
      - adi,max20908
      - adi,max20912
      - adi,max20916

  reg:
    maxItems: 1

  avren-gpios:
    description: GPIO pin to enable/disable the output voltage on Rail A.
    maxItems: 1

  bvren-gpios:
    description: GPIO pin to enable/disable the output voltage on Rail B.
    maxItems: 1

required:
  - compatible
  - reg

additionalProperties: false

examples:
  - |
    #include <dt-bindings/gpio/gpio.h>
    i2c {
        #address-cells = <1>;
        #size-cells = <0>;

        regulator@64 {
            compatible = "adi,max20826";
            reg = <0x64>;

            avren-gpios = <&gpio 0 GPIO_ACTIVE_HIGH>;
            bvren-gpios = <&gpio 1 GPIO_ACTIVE_HIGH>;
        };
    };
```

## Documentation/devicetree/bindings/hwmon/pmbus/infineon,ir38060.yaml
```yaml
# SPDX-License-Identifier: GPL-2.0-only OR BSD-2-Clause
%YAML 1.2
---
$id: http://devicetree.org/schemas/hwmon/pmbus/infineon,ir38060.yaml#
$schema: http://devicetree.org/meta-schemas/core.yaml#

title: Infineon Buck Regulators with PMBUS interfaces

maintainers:
  - Not Me.

properties:
  compatible:
    enum:
      - infineon,ir38060
      - infineon,ir38064
      - infineon,ir38164
      - infineon,ir38263

  reg:
    maxItems: 1

  regulators:
    type: object
    description:
      list of regulators provided by this controller.

    properties:
      vout:
        $ref: /schemas/regulator/regulator.yaml#
        type: object

        unevaluatedProperties: false

    additionalProperties: false

required:
  - compatible
  - reg

unevaluatedProperties: false

examples:
  - |
    i2c {
        #address-cells = <1>;
        #size-cells = <0>;

        regulator@34 {
            compatible = "infineon,ir38060";
            reg = <0x34>;

            regulators {
                vout {
                    regulator-name = "p5v_aux";
                    regulator-min-microvolt = <437500>;
                    regulator-max-microvolt = <1387500>;
                };
            };
        };
    };
```

## Documentation/devicetree/bindings/hwmon/pmbus/infineon,tda38740.yaml
```yaml
# SPDX-License-Identifier: (GPL-2.0 OR BSD-2-Clause)
%YAML 1.2
---

$id: https://devicetree.org/schemas/hwmon/pmbus/infineon,tda38740.yaml#
$schema: https://devicetree.org/meta-schemas/core.yaml#

title: Infineon TDA38740 and TDA38725 PMBus Synchronous Buck Regulator

description: |
  The Infineon TDA38740/TDA38725 is a 40A/25A single-voltage synchronous
  buck regulator with a PMBus interface designed for industrial use.

  Datasheet:
  https://www.infineon.com/row/public/documents/24/49/infineon-tda38740-tda38725-datasheet-en.pdf

properties:
  compatible:
    enum:
      - infineon,tda38725
      - infineon,tda38740

  reg:
    maxItems: 1

  infineon,vout-scale-micro:
    description: |
      Scaling factor applied to READ_VOUT telemetry.

      TDA38740/25 pin strap parts are available in two flavors of
      VOUT_SCALE_LOOP: 1:1 and 1:2.

      For the 1:1 VOUT_SCALE_LOOP version, output voltage sense pins are
      directly connected to the output, and no resistor divider is used.

      For the 1:2 version, a resistor divider is typically used (for example,
      499 ohms for both top and bottom resistors).

      In some designs, users intentionally modify the feedback divider ratio
      to obtain an output voltage different from the internally configured
      VBOOT or VOUT value.

      In such cases, the device telemetry (READ_VOUT) continues to report
      the internally programmed voltage and does not reflect the actual
      externally adjusted output voltage.

      This property provides a multiplier to scale the reported telemetry
      value so that the monitoring system reflects the actual output voltage.

      The value shall be expressed in micro units where 1,000,000 represents
      a scaling factor of 1.0.

      Example:
        If actual Vout = 0.75V and READ_VOUT reports 0.7V:
        scaling factor = 0.75 / 0.7 = 1.071
        value = 1071000
    $ref: /schemas/types.yaml#/definitions/uint32
    minimum: 100000
    maximum: 2000000

required:
  - compatible
  - reg

additionalProperties: false

examples:
  - |
    i2c {
        #address-cells = <1>;
        #size-cells = <0>;

        sensor@40 {
            compatible = "infineon,tda38740";
            reg = <0x40>;
            infineon,vout-scale-micro = <1071000>;
        };
    };
```
