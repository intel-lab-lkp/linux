## Documentation/devicetree/bindings/hwmon/pmbus/ti,ina233.yaml
```yaml
# SPDX-License-Identifier: (GPL-2.0 OR BSD-2-Clause)
%YAML 1.2
---

$id: http://devicetree.org/schemas/hwmon/pmbus/ti,ina233.yaml#
$schema: http://devicetree.org/meta-schemas/core.yaml#

title: Texas Instruments INA233 of power/voltage/current monitors

maintainers:
  - Leo Yang <Leo-Yang@quantatw.com>

description: |
  INA233 High-Side or Low-Side Measurement, Bidirectional Current
  and Power Monitor With I2C-, SMBus-, and PMBus-Compatible Interface.

  Datasheet: https://www.ti.com/lit/ds/symlink/ina233.pdf

properties:
  compatible:
    enum:
      - ti,ina233

  reg:
    maxItems: 1

  shunt-resistor:
    description:
      Shunt resistor value in micro-Ohms, Please refer to the actual circuit
      resistor used.
    default: 2000

  current-lsb:
    description:
	    Calculate the Maximum Expected Current(A) / 2^15 in micro ampere (uA/bit).
	    e.g. 30A / 2^15 = 915 uA/bit
    default: 1000

required:
  - compatible
  - reg

additionalProperties: false

examples:
  - |
    i2c {
        #address-cells = <1>;
        #size-cells = <0>;

        power-sensor@40 {
            compatible = "ti,ina233";
            reg = <0x40>;
            shunt-resistor = /bits/ 32 <5000>;
            current-lsb = /bits/ 16 <1000>;
        };
    };
```

## Documentation/devicetree/bindings/hwmon/sensirion,sht30.yaml
```yaml
# SPDX-License-Identifier: (GPL-2.0-only OR BSD-2-Clause)
%YAML 1.2
---
$id: http://devicetree.org/schemas/hwmon/sensirion,sht30.yaml#
$schema: http://devicetree.org/meta-schema.yaml#

title: Sensirion SHT30 Humidity and Temperature Sensor

maintainers:
  - Zaixiang Xu <zaixiang.xu.dev@gmail.com>

description: |
  The SHT30 series is a family of humidity and temperature sensors by Sensirion.
  Compatible sensors like the GXCAS GXHT30 are also supported.

properties:
  compatible:
    enum:
      - gxcas,gxht30
      - sensirion,sht30
      - sensirion,sht31
      - sensirion,sht35
      - sensirion,sht85
      - sensirion,sts30
      - sensirion,sts31
      - sensirion,sts32
      - sensirion,sts35

  reg:
    maxItems: 1
    description: I2C address (usually 0x44 or 0x45)

required:
  - compatible
  - reg

additionalProperties: false

examples:
  - |
    i2c {
        #address-cells = <1>;
        #size-cells = <0>;

        sensor@44 {
            compatible = "gxcas,gxht30";
            reg = <0x44>;
        };
    };
```

## Documentation/devicetree/bindings/hwmon/sensirion,sht3x.yaml
```yaml
# SPDX-License-Identifier: (GPL-2.0-only OR BSD-2-Clause)
%YAML 1.2
---
$id: http://devicetree.org/schemas/hwmon/sensirion,sht3x.yaml#
$schema: http://devicetree.org/meta-schema.yaml#

title: Sensirion SHT3x Humidity and Temperature Sensor

maintainers:
  - Zaixiang Xu <zaixiang.xu.dev@gmail.com>

description: |
  The SHT3x series is a family of humidity and temperature sensors by Sensirion.
  It also includes compatible sensors like GXCAS GXHT30.

properties:
  compatible:
    enum:
      - sensirion,sht3x
      - sensirion,sts3x
      - sensirion,sht85
      - gxcas,gxht30

  reg:
    maxItems: 1
    description: I2C address (usually 0x44 or 0x45)

required:
  - compatible
  - reg

additionalProperties: false

examples:
  - |
    i2c {
        #address-cells = <1>;
        #size-cells = <0>;

        sensor@44 {
            compatible = "gxcas,gxht30";
            reg = <0x44>;
        };
    };
```

## Documentation/devicetree/bindings/hwmon/st,tsc1641.yaml
```yaml
# SPDX-License-Identifier: (GPL-2.0 OR BSD-2-Clause)
%YAML 1.2
---
$id: http://devicetree.org/schemas/hwmon/st,tsc1641.yaml#
$schema: http://devicetree.org/meta-schemas/core.yaml#

title: ST Microelectronics TSC1641 I2C power monitor

maintainers:
  - Igor Reznichenko <igor@reznichenko.net>

description: |
  TSC1641 is a 60 V, 16-bit high-precision power monitor with I2C and MIPI I3C interface

  Datasheets:
    https://www.st.com/resource/en/datasheet/tsc1641.pdf

properties:
  compatible:
    const: st,tsc1641

  reg:
    maxItems: 1

  shunt-resistor:
    description:
      Shunt resistor value in micro-ohms.
    $ref: /schemas/types.yaml#/definitions/uint32

  st,alert-polarity-active-high:
    description: Default value is 0 which configures the normal polarity of the ALERT pin, being active low open-drain.
      Setting this to 1 configures the polarity of the ALERT pin to be inverted and active high open-drain.
      Specify this property to set the alert polarity to active-high.
    $ref: /schemas/types.yaml#/definitions/flag

required:
  - compatible
  - reg

additionalProperties: false

examples:
  - |
    i2c {
        #address-cells = <1>;
        #size-cells = <0>;

        power-sensor@40 {
            compatible = "st,tsc1641";
            reg = <0x40>;
            shunt-resistor = <5000>;
            st,alert-polarity-active-high;
        };
    };
```

## Documentation/devicetree/bindings/hwmon/starfive,jhb100-fan-tach.yaml
```yaml
# SPDX-License-Identifier: GPL-2.0-only OR BSD-2-Clause
%YAML 1.2
---
$id: http://devicetree.org/schemas/hwmon/starfive,jhb100-fan-tach.yaml#
$schema: http://devicetree.org/meta-schemas/core.yaml#

title: StarFive JHB100 Fan-Tach controller

maintainers:
  - Changhuang Liang <changhuang.liang@starfivetech.com>

description:
  The StarFive Fan-Tach controller can support up to 16 fan tach input.

properties:
  compatible:
    enum:
      - starfive,jhb100-fan-tach

  reg:
    maxItems: 1

  clocks:
    maxItems: 1

  resets:
    maxItems: 1

  interrupts:
    maxItems: 1

  "#address-cells":
    const: 1

  "#size-cells":
    const: 0

patternProperties:
  "^fan@[0-9a-f]+$":
    $ref: fan-common.yaml#
    unevaluatedProperties: false

    properties:
      reg:
        description:
          PWM channel index. The driver allows two fans to share the same
          PWM channel, or each fan to use a dedicated channel.
        maximum: 15

      tach-ch:
        description:
          The tachometer channel(s) wired to the fan(s) driven by this PWM
          channel. Integer values in the range 0-15.
        minItems: 1
        maxItems: 2
        items:
          maximum: 15

    required:
      - reg
      - tach-ch

required:
  - compatible
  - reg
  - clocks
  - resets
  - interrupts

additionalProperties: false

examples:
  - |
    fan-controller@11be0000 {
        compatible = "starfive,jhb100-fan-tach";
        reg = <0x11be0000 0x400>;
        interrupts = <128>;
        clocks = <&per2crg 33>;
        resets = <&per2crg 5>;
        #address-cells = <1>;
        #size-cells = <0>;

        fan@0 {
            reg = <0x0>;
            tach-ch = /bits/ 8 <0x0 0x8>;
            pulses-per-revolution = <2>;
        };
        fan@1 {
            reg = <0x1>;
            tach-ch = /bits/ 8 <0x1>;
            pulses-per-revolution = <2>;
        };
    };
```

## Documentation/devicetree/bindings/hwmon/ti,ads71x8.yaml
```yaml
# SPDX-License-Identifier: (GPL-2.0 OR BSD-2-Clause)
%YAML 1.2
---

$id: http://devicetree.org/schemas/hwmon/ti,ads71x8.yaml#
$schema: http://devicetree.org/meta-schemas/core.yaml#

title: Texas Instruments ADS7128/ADS7138 Analog to Digital Converter (ADC)

maintainers:
  - None

description: |
  The ADS7128 is 12-Bit, 8-Channel Sampling Analog to Digital Converter (ADC)
  with an I2C interface.

  Datasheets:
    https://www.ti.com/product/ADS7128
    https://www.ti.com/product/ADS7138

properties:
  compatible:
    enum:
      - ti,ads7128
      - ti,ads7138

  reg:
    maxItems: 1

  avdd-supply:
    description:
      The regulator used as analog supply voltage as well as reference voltage.

  ti,mode:
    $ref: /schemas/types.yaml#/definitions/uint8
    description: |
      Operation mode
      Mode 0 - Manual mode. A channel is only sampled when the according input
        in the sysfs is read.
      Mode 1 - Auto mode. All channels are automatically sampled sequentially.
        Reading an input returns the last valid sample. In this mode further
        features like statistics and interrupts are available.
    default: 0

  ti,interval:
    $ref: /schemas/types.yaml#/definitions/uint16
    description: |
      Only considered in mode 1!
      Interval in microseconds a new sample is triggered. Is set to closest
      possible interval, see datasheet.
    default: 1

  interrupts:
    description: |
      Only considered in mode 1!
      Interrupt specifier the device's ALERT pin is connected to. Level must be
      IRQ_TYPE_LEVEL_LOW. If not configured the digital window comparator (DWC)
      is not available.
    maxItems: 1

required:
  - compatible
  - reg
  - avdd-supply

additionalProperties: false

examples:
  - |
    #include <dt-bindings/interrupt-controller/irq.h>
    i2c {
        #address-cells = <1>;
        #size-cells = <0>;

        ads7138@10 {
            compatible = "ti,ads7138";
            reg = <0x10>;
            avdd-supply = <&reg_stb_3v3>;
            ti,mode = /bits/ 8 <1>;
            ti,interval = /bits/ 16 <1000>;
            interrupt-parent = <&gpio2>;
            interrupts = <12 IRQ_TYPE_LEVEL_LOW>;
            status = "okay";
        };
    };
```

## Documentation/devicetree/bindings/hwmon/ti,ina238.yaml
```yaml
# SPDX-License-Identifier: (GPL-2.0 OR BSD-2-Clause)
%YAML 1.2
---

$id: http://devicetree.org/schemas/hwmon/ti,ina238.yaml#
$schema: http://devicetree.org/meta-schemas/core.yaml#

title: Texas Instruments INA238 power/voltage monitors

maintainers:
  - Jean Delvare <jdelvare@suse.com>
  - Guenter Roeck <linux@roeck-us.net>

description: |
  The INA238 is an ultra-precise digital power monitor with a
  16-bit delta-sigma ADC specifically designed for current-sensing
  applications.

  Datasheets:
    https://www.ti.com/lit/ds/symlink/ina238.pdf

properties:
  compatible:
    enum:
      - ti,ina237
      - ti,ina238

  reg:
    maxItems: 1

required:
  - compatible
  - reg

additionalProperties: false

examples:
  - |
    i2c {
        #address-cells = <1>;
        #size-cells = <0>;

        power-sensor@40 {
            compatible = "ti,ina238";
            reg = <0x40>;
        };
    };
```

## Documentation/devicetree/bindings/hwmon/ti,ina780a.yaml
```yaml
# SPDX-License-Identifier: (GPL-2.0 OR BSD-2-Clause)
%YAML 1.2
---
$id: http://devicetree.org/schemas/hwmon/ti,ina780a.yaml#
$schema: http://devicetree.org/meta-schemas/core.yaml#

title: Texas Instruments INA780 Digital Power Monitor

maintainers:
  - Chris Packham <chris.packham@alliedtelesis.co.nz>

description: |
  The INA780x is a digital power monitor with an integrated current sensing
  element.

  Datasheets:
    https://www.ti.com/lit/gpn/ina780a

properties:
  compatible:
    enum:
      - ti,ina780a
      - ti,ina780b

  reg:
    maxItems: 1

required:
  - compatible
  - reg

allOf:
  - $ref: hwmon-common.yaml#

unevaluatedProperties: false

examples:
  - |
    i2c {
        #address-cells = <1>;
        #size-cells = <0>;

        hwmon@40 {
          compatible = "ti,ina780a";
          reg = <0x40>;
        };
    };
```

## Documentation/devicetree/bindings/hwmon/ti,tmp401.yaml
```yaml
# SPDX-License-Identifier: (GPL-2.0 OR BSD-2-Clause)
%YAML 1.2
---
$id: http://devicetree.org/schemas/hwmon/ti,tmp401.yaml#
$schema: http://devicetree.org/meta-schemas/core.yaml#

title: TMP401, TPM411 and TMP43x temperature sensor

maintainers:
  - Guenter Roeck <linux@roeck-us.net>

description: |
  ±1°C Remote and Local temperature sensor

  Datasheets:
  https://www.ti.com/lit/ds/symlink/tmp401.pdf
  https://www.ti.com/lit/ds/symlink/tmp411.pdf
  https://www.ti.com/lit/ds/symlink/tmp431.pdf
  https://www.ti.com/lit/ds/symlink/tmp435.pdf

properties:
  compatible:
    enum:
      - ti,tmp401
      - ti,tmp411
      - ti,tmp431
      - ti,tmp432
      - ti,tmp435

  reg:
    maxItems: 1

  '#address-cells':
    const: 1

  '#size-cells':
    const: 0

  ti,extended-range-enable:
    description:
      When set, this sensor measures over extended temperature range.
    type: boolean

  ti,n-factor:
    description:
      value to be used for converting remote channel measurements to
      temperature.
    $ref: /schemas/types.yaml#/definitions/int32
    minimum: -128
    maximum: 127

  ti,beta-compensation:
    description:
      value to select beta correction range.
    $ref: /schemas/types.yaml#/definitions/uint32
    minimum: 0
    maximum: 15

patternProperties:
  "^channel@([0-2])$":
    type: object
    description: Represents channels of the device and their specific configuration.

    properties:
      reg:
        description: The channel number. 0 is local channel, 1-2 are remote channels.
        items:
          minimum: 0
          maximum: 2

      label:
        description: A descriptive name for this channel, like "ambient" or "psu".

    required:
      - reg

    additionalProperties: false

allOf:
  - if:
      properties:
        compatible:
          contains:
            enum:
              - ti,tmp401
    then:
      properties:
        ti,n-factor: false

  - if:
      properties:
        compatible:
          contains:
            enum:
              - ti,tmp401
              - ti,tmp411
    then:
      properties:
        ti,beta-compensation: false

  - if:
      not:
        properties:
          compatible:
            contains:
              const: ti,tmp432
    then:
      properties:
        channel@2: false

required:
  - compatible
  - reg

additionalProperties: false

examples:
  - |
    i2c {
      #address-cells = <1>;
      #size-cells = <0>;

      sensor@4c {
        compatible = "ti,tmp401";
        reg = <0x4c>;
      };
    };
  - |
    i2c {
      #address-cells = <1>;
      #size-cells = <0>;

      sensor@4c {
        compatible = "ti,tmp431";
        reg = <0x4c>;
        ti,extended-range-enable;
        ti,n-factor = <0x3b>;
        ti,beta-compensation = <0x7>;
      };
    };
  - |
    i2c {
      #address-cells = <1>;
      #size-cells = <0>;

      sensor@4c {
        compatible = "ti,tmp431";
        reg = <0x4c>;
        #address-cells = <1>;
        #size-cells = <0>;

        channel@0 {
          reg = <0x0>;
          label = "front";
        };

        channel@1 {
          reg = <0x1>;
          label = "back";
        };
      };
    };
```
