## Documentation/devicetree/bindings/i2c/i2c-gpio-shared.yaml
```yaml
# SPDX-License-Identifier: (GPL-2.0-only OR BSD-2-Clause)
%YAML 1.2
---
$id: http://devicetree.org/schemas/i2c/i2c-gpio-shared.yaml#
$schema: http://devicetree.org/meta-schemas/core.yaml#

title: Multiple GPIO bitbanged I2C buses with shared SCL

maintainers:
  - Markus Stockhausen <markus.stockhausen@gmx.de>

description:
  Bitbanging I2C bus driver that supports multiple independent I2C buses
  sharing a single SCL line. Each child node represents one I2C bus with
  its own SDA line. The shared SCL line is driven by the parent node.
  A mutex serializes access so that only one bus transfers at a time.

select:
  properties:
    compatible:
      contains:
        const: i2c-gpio-shared
  required:
    - compatible

properties:
  compatible:
    const: i2c-gpio-shared

  scl-gpios:
    maxItems: 1
    description:
      GPIO used for the shared SCL signal. Must be configured as
      open-drain. All child buses share this single clock line.

  i2c-gpio-shared,scl-output-only:
    type: boolean
    description:
      If present, SCL is treated as output only and clock stretching
      by devices is not supported.

  i2c-gpio-shared,timeout-ms:
    description:
      Bus timeout in milliseconds. If not specified, defaults to 100 ms.

  "#address-cells":
    const: 1

  "#size-cells":
    const: 0

patternProperties:
  "^i2c@[0-9a-f]+$":
    $ref: /schemas/i2c/i2c-controller.yaml#
    unevaluatedProperties: false

    properties:
      reg:
        maxItems: 1
        description:
          Bus index used to identify this child bus. Must be unique among
          siblings and match the node unit address.

      sda-gpios:
        maxItems: 1
        description:
          GPIO used for the SDA signal of this I2C bus. Must be
          configured as open-drain.

      i2c-gpio-shared,delay-us:
        default: 5
        description:
          Delay in microseconds between signal transitions for this bus.
          Controls the I2C clock frequency. Defaults to 5 us (~100 kHz).

      i2c-gpio-shared,sda-output-only:
        type: boolean
        description:
          If present, SDA is treated as output only. No acknowledgment
          or read data from devices can be received on this bus.

    required:
      - reg
      - sda-gpios

required:
  - compatible
  - scl-gpios
  - "#address-cells"
  - "#size-cells"

additionalProperties: false

examples:
  - |
    #include <dt-bindings/gpio/gpio.h>

    i2c-gpio-shared {
        compatible = "i2c-gpio-shared";
        scl-gpios = <&gpio1 31 (GPIO_ACTIVE_HIGH | GPIO_OPEN_DRAIN)>;
        #address-cells = <1>;
        #size-cells = <0>;

        i2c@0 {
            reg = <0>;
            sda-gpios = <&gpio1 6 (GPIO_ACTIVE_HIGH | GPIO_OPEN_DRAIN)>;
            i2c-gpio-shared,delay-us = <2>;
        };

        i2c@1 {
            reg = <1>;
            sda-gpios = <&gpio1 7 (GPIO_ACTIVE_HIGH | GPIO_OPEN_DRAIN)>;
            i2c-gpio-shared,delay-us = <2>;
        };
    };
```

## Documentation/devicetree/bindings/i2c/i2c-hotplug-gpio.yaml
```yaml
# SPDX-License-Identifier: (GPL-2.0 OR BSD-2-Clause)
%YAML 1.2
---
$id: http://devicetree.org/schemas/i2c/i2c-hotplug-gpio.yaml#
$schema: http://devicetree.org/meta-schemas/core.yaml#

title: GPIO detected hot-plugged I2C bus

maintainers:
  - Michał Mirosław <mirq-linux@rere.qmqm.pl>
  - Svyatoslav Ryhel <clamor95@gmail.com>

description: An I2C bus, where some devices on the bus are hot-pluggable
  and their presence is indicated by GPIO line.

properties:
  compatible:
    const: i2c-hotplug-gpio

  '#address-cells':
    const: 1

  '#size-cells':
    const: 0

  interrupts:
    maxItems: 1

  detect-gpios:
    description: usually the same GPIO used as an interrupt. In the active
      state should indicate that detachable devices are plugged in.
    maxItems: 1

  i2c-parent:
    maxItems: 1

required:
  - compatible
  - '#address-cells'
  - '#size-cells'
  - interrupts
  - detect-gpios
  - i2c-parent

additionalProperties: false

examples:
  - |
    #include <dt-bindings/gpio/gpio.h>
    #include <dt-bindings/interrupt-controller/irq.h>

    i2c-dock {
        compatible = "i2c-hotplug-gpio";

        interrupt-parent = <&gpio>;
        interrupts = <164 IRQ_TYPE_EDGE_BOTH>;

        detect-gpios = <&gpio 164 GPIO_ACTIVE_LOW>;

        i2c-parent = <&gen2_i2c>;

        #address-cells = <1>;
        #size-cells = <0>;
    };
...
```

## Documentation/devicetree/bindings/i2c/i2c-mux-mule.yaml
```yaml
# SPDX-License-Identifier: (GPL-2.0-only OR BSD-2-Clause)
%YAML 1.2
---
$id: http://devicetree.org/schemas/i2c/i2c-mux-mule.yaml#
$schema: http://devicetree.org/meta-schemas/core.yaml#

title: Mule I2C multiplexer

maintainers:
  - Farouk Bouabid <farouk.bouabid@theobroma-systems.com>
  - Quentin Schulz <quentin.schulz@theobroma-systems.com>

description: |
  Mule is an mcu that emulates a set of i2c devices which are reacheable
  through an i2c-mux.

  The emulated devices share a single i2c address with the mux itself where
  the requested register is what determines which logic is executed (mux or
  device)

      +--------------------------------------------------+
      | Mule                                             |
      |    +---------------+                             |
  ------+->|Config register|----+                        |
      | |  +---------------+    |                        |
      | |                       V_                       |
      | |                      |  \          +--------+  |
      | |                      |   \-------->| dev #0 |  |
      | |                      |   |         +--------+  |
      | |                      | M |-------->| dev #1 |  |
      | +--------------------->| U |         +--------+  |
      |                        | X |-------->| dev #2 |  |
      |                        |   |         +--------+  |
      |                        |   /-------->| dev #3 |  |
      |                        |__/          +--------+  |
      +--------------------------------------------------+


allOf:
  - $ref: /schemas/i2c/i2c-mux.yaml#

properties:
  compatible:
    const: tsd,mule-i2c-mux

  reg:
    maxItems: 1

required:
  - compatible
  - reg

unevaluatedProperties: false

examples:
  - |
    i2c {
        #address-cells = <1>;
        #size-cells = <0>;

        i2c-mux@18 {
            compatible = "tsd,mule-i2c-mux";
            reg = <0x18>;
            #address-cells = <1>;
            #size-cells = <0>;

            i2c@0 {
                reg = <0x0>;
                #address-cells = <1>;
                #size-cells = <0>;

                fan: fan@18 {
                  compatible = "ti,amc6821";
                  reg = <0x18>;
                  #cooling-cells = <2>;
                };
            };
        };
    };
...
```

## Documentation/devicetree/bindings/i2c/loongson,ls2x-i2c.yaml
```yaml
# SPDX-License-Identifier: (GPL-2.0-only OR BSD-2-Clause)
%YAML 1.2
---
$id: http://devicetree.org/schemas/i2c/loongson,ls2x-i2c.yaml#
$schema: http://devicetree.org/meta-schemas/core.yaml#

title: Loongson LS2X I2C Controller

maintainers:
  - Binbin Zhou <zhoubinbin@loongson.cn>

allOf:
  - $ref: /schemas/i2c/i2c-controller.yaml#

properties:
  compatible:
    enum:
      - loongson,ls2k-i2c
      - loongson,ls7a-i2c

  reg:
    maxItems: 1

  interrupts:
    maxItems: 1

  clock-input:
    $ref: /schemas/types.yaml#/definitions/uint32
    description:
      Describes the input clock of i2c controller in HZ.

  clock-div:
    $ref: /schemas/types.yaml#/definitions/uint32
    description:
      Describes the divisor of the input clock of i2c controller.

required:
  - compatible
  - reg
  - interrupts

unevaluatedProperties: false

examples:
  - |
    #include <dt-bindings/interrupt-controller/irq.h>

    i2c0: i2c@1fe21000 {
        compatible = "loongson,ls2k-i2c";
        reg = <0x1fe21000 0x8>;
        interrupt-parent = <&extioiic>;
        interrupts = <22 IRQ_TYPE_LEVEL_LOW>;
        clock-frequency = <100000>;
        clock-input = <100000000>;
        clock-div = <40>;
        #address-cells = <1>;
        #size-cells = <0>;

        eeprom@57 {
            compatible = "atmel,24c16";
            reg = <0x57>;
            pagesize = <16>;
        };
    };
```

## Documentation/devicetree/bindings/i2c/novatek,nt72676-i2c.yaml
```yaml
# SPDX-License-Identifier: (GPL-2.0-only OR BSD-2-Clause)
%YAML 1.2
---
$id: http://devicetree.org/schemas/i2c/novatek,nt72676-i2c.yaml#
$schema: http://devicetree.org/meta-schemas/core.yaml#

title: Novatek NT72676 I2C Controller

maintainers:
  - Ben Huang <ben_huang@novatek.com.tw>
  - Jason JJ Wu <jason_jj_wu@novatek.com.tw>

description:
  Novatek NT72676 SoC provides two I2C controller variants, generic I2C and
  STBC I2C.
  The generic I2C controllers are accessible only by the host CPU and driven
  by a 96 MHz AHB clock.
  On the other hand, the STBC I2C controllers can be controlled by either the
  host CPU or STBC (Standby Controller, an 8051-based microcontroller) and
  driven by a 12 MHz STBC clock. Authentication with STBC is required before
  the host CPU can access the STBC I2C controller registers.

properties:
  compatible:
    enum:
      - novatek,nt72676-i2c
      - novatek,nt72676-stbc-i2c

  reg:
    maxItems: 1

  interrupts:
    maxItems: 1

  clocks:
    maxItems: 1

  clock-frequency:
    default: 100000
    enum: [ 100000, 400000 ]

  novatek,stbc-syscon:
    $ref: /schemas/types.yaml#/definitions/phandle
    description:
      Phandle to the STBC system controller registers used to authenticate
      host access and switch ownership of the STBC I2C controller.

required:
  - compatible
  - reg
  - interrupts

allOf:
  - $ref: /schemas/i2c/i2c-controller.yaml#
  - if:
      properties:
        compatible:
          contains:
            const: novatek,nt72676-stbc-i2c
    then:
      required:
        - novatek,stbc-syscon
    else:
      properties:
        novatek,stbc-syscon: false

unevaluatedProperties: false

examples:
  - |
    #include <dt-bindings/interrupt-controller/arm-gic.h>
    #include <dt-bindings/interrupt-controller/irq.h>

    i2c@fd000000 {
      compatible = "novatek,nt72676-i2c";
      reg = <0xfd000000 0x100>;
      interrupts = <GIC_SPI 67 IRQ_TYPE_LEVEL_HIGH>;
      clock-frequency = <400000>;
      #address-cells = <1>;
      #size-cells = <0>;
    };

    i2c@fc040a00 {
      compatible = "novatek,nt72676-stbc-i2c";
      reg = <0xfc040a00 0x40>;
      interrupts = <GIC_SPI 77 IRQ_TYPE_LEVEL_HIGH>;
      novatek,stbc-syscon = <&sysreg_system_controller>;
      #address-cells = <1>;
      #size-cells = <0>;
    };
```

## Documentation/devicetree/bindings/i2c/nuvoton,ma35d1-i2c.yaml
```yaml
# SPDX-License-Identifier: (GPL-2.0-only OR BSD-2-Clause)
%YAML 1.2
---
$id: http://devicetree.org/schemas/i2c/nuvoton,ma35d1-i2c.yaml#
$schema: http://devicetree.org/meta-schemas/core.yaml#

title: Nuvoton MA35D1 I2C Controller

maintainers:
  - Zi-Yu Chen <zychennvt@gmail.com>

description:
  The Nuvoton MA35D1 I2C controller supports controller and optional target mode.

allOf:
  - $ref: /schemas/i2c/i2c-controller.yaml#

properties:
  compatible:
    const: nuvoton,ma35d1-i2c

  reg:
    maxItems: 1

  interrupts:
    maxItems: 1

  clocks:
    maxItems: 1

  clock-frequency:
    description:
      Desired I2C bus clock frequency in Hz. The absence of this property
      indicates the default frequency 100 kHz.

  resets:
    maxItems: 1

required:
  - compatible
  - reg
  - interrupts
  - clocks
  - resets

unevaluatedProperties: false

examples:
  - |
    #include <dt-bindings/interrupt-controller/arm-gic.h>
    #include <dt-bindings/clock/nuvoton,ma35d1-clk.h>
    #include <dt-bindings/reset/nuvoton,ma35d1-reset.h>

    i2c0: i2c@40800000 {
      compatible = "nuvoton,ma35d1-i2c";
      reg = <0x40800000 0x1000>;
      interrupts = <GIC_SPI 68 IRQ_TYPE_LEVEL_HIGH>;
      clocks = <&clk I2C0_GATE>;
      clock-frequency = <100000>;
      resets = <&sys MA35D1_RESET_I2C0>;
      #address-cells = <1>;
      #size-cells = <0>;
    };
```

## Documentation/devicetree/bindings/i2c/nvidia,lstp-i2c.yaml
```yaml
# SPDX-License-Identifier: (GPL-2.0-only OR BSD-2-Clause)
# SPDX-FileCopyrightText: Copyright (c) 2026 NVIDIA CORPORATION & AFFILIATES. All rights reserved.
%YAML 1.2
---
$id: http://devicetree.org/schemas/i2c/nvidia,lstp-i2c.yaml#
$schema: http://devicetree.org/meta-schemas/core.yaml#

title: NVIDIA LSTP I2C Channel

maintainers:
  - Adrian Ambrozewicz <aambrozewicz@nvidia.com>
  - Donald Shannon <donalds@nvidia.com>

description: |
  I2C controller channel on an NVIDIA LSTP USB device.

  Peripherals on the bus are described as child nodes.  An i2c alias
  gives the bus a fixed number.

  The bus speed is set by the device.  The LSTP protocol has no way to
  change it, so clock-frequency is not supported and is ignored.

allOf:
  - $ref: /schemas/i2c/i2c-controller.yaml#

properties:
  compatible:
    const: nvidia,lstp-i2c

  reg:
    description: Channel ID reported by the device firmware.
    maxItems: 1

  nvidia,retries:
    description: |
      Number of times the host re-issues a transfer that fails on
      arbitration loss or a busy bus before giving up.

      Ignored when the channel config reports non-zero bus arbitration
      retries.  Such a device is expected to retry both arbitration loss and
      a busy bus itself before reporting failure, so the host adds no
      attempts on top.
    $ref: /schemas/types.yaml#/definitions/uint32
    maximum: 255
    default: 3

required:
  - compatible
  - reg

unevaluatedProperties: false

examples:
  - |
    interface {
        #address-cells = <1>;
        #size-cells = <0>;

        i2c@2 {
            compatible = "nvidia,lstp-i2c";
            reg = <2>;
            #address-cells = <1>;
            #size-cells = <0>;
            nvidia,retries = <5>;

            temperature-sensor@48 {
                compatible = "ti,tmp102";
                reg = <0x48>;
            };
        };
    };
```
