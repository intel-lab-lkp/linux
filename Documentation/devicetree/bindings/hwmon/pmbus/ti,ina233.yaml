## Documentation/devicetree/bindings/hwmon/ti,tps23861.yaml
```yaml
# SPDX-License-Identifier: (GPL-2.0 OR BSD-2-Clause)
%YAML 1.2
---
$id: http://devicetree.org/schemas/hwmon/ti,tps23861.yaml#
$schema: http://devicetree.org/meta-schemas/core.yaml#

title: TI TPS23861 PoE PSE

maintainers:
  - Robert Marko <robert.marko@sartura.hr>

description: |
  The TPS23861 is a IEEE 802.3at Quad Port Power-over-Ethernet PSE Controller.

  Datasheets:
  https://www.ti.com/lit/gpn/tps23861


properties:
  compatible:
    enum:
      - ti,tps23861

  reg:
    maxItems: 1

  '#address-cells':
    const: 1

  '#size-cells':
    const: 0

  shunt-resistor-micro-ohms:
    description: The value of current sense resistor in microohms.
    default: 255000
    minimum: 250000
    maximum: 255000

  reset-gpios:
    description: GPIO for the reset pin.
    maxItems: 1

  ti,ports-shutdown-gpios:
    description:
      GPIO for the shutdown pin. Used to prevent PoE activity before the driver
      had a chance to configure the chip.
    maxItems: 1

  interrupts:
    description:
      Only required if PoE class is restricted to less than class 4 in the
      device tree.
    maxItems: 1

patternProperties:
  "^poe-port@[0-3]$":
    type: object
    description: Port specific nodes.
    unevaluatedProperties: false
    properties:
      reg:
        description: Port index.
        items:
          maximum: 3

      ti,class:
        description: The maximum power class a port should accept.
        $ref: /schemas/types.yaml#/definitions/uint32
        maximum: 4

      ti,off-by-default:
        description: Indicates the port is off by default.
        type: boolean

      label:
        description: Port label.

    required:
      - reg

required:
  - compatible
  - reg

allOf:
  - $ref: hwmon-common.yaml#

unevaluatedProperties: false

examples:
  - |
    i2c {
        #address-cells = <1>;
        #size-cells = <0>;

        poe_controller@30 {
            compatible = "ti,tps23861";
            reg = <0x30>;
            shunt-resistor-micro-ohms = <255000>;
        };
    };
  - |
    #include <dt-bindings/gpio/gpio.h>
    #include <dt-bindings/interrupt-controller/irq.h>

    i2c {
        #address-cells = <1>;
        #size-cells = <0>;

        poe_controller@28 {
            compatible = "ti,tps23861";
            reg = <0x28>;
            #address-cells = <1>;
            #size-cells = <0>;
            shunt-resistor-micro-ohms = <255000>;
            interrupt-parent = <&gpio1>;
            interrupts = <14 IRQ_TYPE_EDGE_FALLING>;
            label = "cabinet_poe_controller";
            reset-gpios = <&gpio1 13 GPIO_ACTIVE_LOW>;
            ti,ports-shutdown-gpios = <&gpio1 12 GPIO_ACTIVE_LOW>;

            poe-port@0 {
                    reg = <0>;
                    ti,class = <2>; // Max PoE class allowed.
                    ti,off-by-default;
                    label = "cabinet_port_a";
            };

            poe-port@1 {
                    reg = <1>;
                    status = "disabled";
            };

            poe-port@2 {
                    reg = <2>;
                    status = "disabled";
            };

            poe-port@3 {
                    reg = <3>;
                    status = "disabled";
            };
        };
    };
```

## Documentation/devicetree/bindings/hwmon/ti,tps38900x.yaml
```yaml
# SPDX-License-Identifier: (GPL-2.0-only OR BSD-2-Clause)
%YAML 1.2
---
$id: http://devicetree.org/schemas/hwmon/ti,tps38900x.yaml#
$schema: http://devicetree.org/meta-schemas/core.yaml#

title: TPS38900x voltage monitor

maintainers:
  - Luna Hart <lhart.opensource@witekio.com>

description: |
  Voltage monitor from TI (TPS389008, TPS389006, TPS389004) on I2C bus.

  Datasheets:
    https://www.ti.com/lit/ds/symlink/tps389006.pdf
    https://www.ti.com/lit/ds/symlink/tps389006-q1.pdf

properties:
  compatible:
    enum:
      - ti,tps389004
      - ti,tps389006
      - ti,tps389008

  reg:
    maxItems: 1

  "#address-cells":
    description: Required only if a child node is present.
    const: 1

  "#size-cells":
    description: Required only if a child node is present.
    const: 0

patternProperties:
  "^vmon@[0-7]$":
    description: |
      The node may have optional child nodes for each voltage channel.
      There are either 4, 6, or 8 available depending on the specific part
      being used.
      If no child nodes are present, all channels will be exposed for
      monitoring. Otherwise, only the provided nodes will be created.
    type: object
    additionalProperties: false
    properties:
      reg:
        description: |
          Must be 0 to 7, corresponding to respective
          ports of the TPS38900x.
        enum: [ 0, 1, 2, 3, 4, 5, 6, 7 ]

      label:
        description: Name of the input source.

      ti,4x-scaling:
        description: |
          Enables the high range ADC voltage monitoring range. Default ADC
          settings will read from 0.2V to 1.475V using 5mV steps. In the 4x
          mode, the valid range is 0.8V to 5.9V using 20mV steps.
        type: boolean

    required:
      - reg

required:
  - compatible
  - reg

allOf:
  - if:
      properties:
        compatible:
          const: ti,tps389004
    then:
      patternProperties:
        "^vmon@[4-7]$": false

  - if:
      properties:
        compatible:
          const: ti,tps389006
    then:
      patternProperties:
        "^vmon@[67]$": false

additionalProperties: false

examples:
  - |
    i2c {
        #address-cells = <1>;
        #size-cells = <0>;

        voltage-monitor@30 {
            compatible = "ti,tps389008";
            reg = <0x30>;
            #address-cells = <1>;
            #size-cells = <0>;

            vmon@0 {
                reg = <0x0>;
                label = "input0";
                ti,4x-scaling;
            };
            vmon@1 {
                reg = <0x1>;
                label = "input1";
                ti,4x-scaling;
            };
            vmon@2 {
                reg = <0x2>;
                label = "input2";
            };
            vmon@3 {
                reg = <0x3>;
                label = "input3";
            };
            vmon@4 {
                reg = <0x4>;
                label = "input4";
            };
            vmon@5 {
                reg = <0x5>;
                label = "input5";
            };
            vmon@6 {
                reg = <0x6>;
                label = "input6";
            };
            vmon@7 {
                reg = <0x7>;
                label = "input7";
            };
        };
    };
```

## Documentation/devicetree/bindings/i2c/andestech,ae350-i2c.yaml
```yaml
# SPDX-License-Identifier: (GPL-2.0 OR BSD-2-Clause)
%YAML 1.2
---
$id: http://devicetree.org/schemas/i2c/andestech,ae350-i2c.yaml#
$schema: http://devicetree.org/meta-schemas/core.yaml#

title: Andes I2C controller on AE350 platform

maintainers:
  - Ben Zong-You Xie <ben717@andestech.com>

allOf:
  - $ref: /schemas/i2c/i2c-controller.yaml#

properties:
  compatible:
    oneOf:
      - items:
          - enum:
              - andestech,qilai-i2c
          - const: andestech,ae350-i2c
      - const: andestech,ae350-i2c

  reg:
    maxItems: 1

  interrupts:
    maxItems: 1

required:
  - compatible
  - reg
  - interrupts

unevaluatedProperties: false

examples:
  - |
    #include <dt-bindings/interrupt-controller/irq.h>

    i2c@f0a00000 {
        compatible = "andestech,ae350-i2c";
        reg = <0xf0a00000 0x100000>;
        interrupts = <6 IRQ_TYPE_LEVEL_HIGH>;
    };
```

## Documentation/devicetree/bindings/i2c/andestech,atciic100.yaml
```yaml
# SPDX-License-Identifier: (GPL-2.0 OR BSD-2-Clause)
%YAML 1.2
---
$id: http://devicetree.org/schemas/i2c/andestech,atciic100.yaml#
$schema: http://devicetree.org/meta-schemas/core.yaml#

title: Andes I2C controller on QiLai SoC and AE350 platform

maintainers:
  - Ben Zong-You Xie <ben717@andestech.com>

allOf:
  - $ref: /schemas/i2c/i2c-controller.yaml#

properties:
  compatible:
    items:
      - enum:
          - andestech,qilai-i2c
          - andestech,ae350-i2c
      - const: andestech,atciic100

  reg:
    maxItems: 1

  interrupts:
    maxItems: 1

required:
  - compatible
  - reg
  - interrupts

unevaluatedProperties: false

examples:
  - |
    #include <dt-bindings/interrupt-controller/irq.h>

    i2c@30800000 {
        compatible = "andestech,qilai-i2c","andestech,atciic100";
        reg = <0x30800000 0x100000>;
        interrupts = <6 IRQ_TYPE_LEVEL_HIGH>;
    };
```

## Documentation/devicetree/bindings/i2c/aspeed,ast2600-i2c.yaml
```yaml
# SPDX-License-Identifier: (GPL-2.0-only OR BSD-2-Clause)
%YAML 1.2
---
$id: http://devicetree.org/schemas/i2c/aspeed,ast2600-i2c.yaml#
$schema: http://devicetree.org/meta-schemas/core.yaml#

title: ASPEED I2C on the AST2600 SoCs

maintainers:
  - Ryan Chen <ryan_chen@aspeedtech.com>

allOf:
  - $ref: /schemas/i2c/i2c-controller.yaml#

properties:
  compatible:
    enum:
      - aspeed,ast2600-i2c-bus

  reg:
    items:
      - description: controller registers
      - description: controller buffer space

  interrupts:
    maxItems: 1

  clocks:
    maxItems: 1

  clock-frequency:
    description: Desired operating frequency of the I2C bus in Hz.
    minimum: 500
    maximum: 4000000
    default: 100000

  resets:
    maxItems: 1

required:
  - reg
  - compatible
  - clocks
  - resets
  - interrupts

unevaluatedProperties: false

examples:
  - |
    #include <dt-bindings/clock/aspeed-clock.h>
    #include <dt-bindings/interrupt-controller/arm-gic.h>
    i2c@80 {
        compatible = "aspeed,ast2600-i2c-bus";
        reg = <0x80 0x80>, <0xc00 0x20>;
        #address-cells = <1>;
        #size-cells = <0>;
        clocks = <&syscon ASPEED_CLK_APB>;
        resets = <&syscon ASPEED_RESET_I2C>;
        clock-frequency = <100000>;
        interrupts = <GIC_SPI 110 IRQ_TYPE_LEVEL_HIGH>;
    };
```

## Documentation/devicetree/bindings/i2c/aspeed,i2c.yaml
```yaml
# SPDX-License-Identifier: (GPL-2.0-only OR BSD-2-Clause)
%YAML 1.2
---
$id: http://devicetree.org/schemas/i2c/aspeed,i2c.yaml#
$schema: http://devicetree.org/meta-schemas/core.yaml#

title: ASPEED I2C on the AST24XX, AST25XX, and AST26XX SoCs

maintainers:
  - Rayn Chen <rayn_chen@aspeedtech.com>

allOf:
  - $ref: /schemas/i2c/i2c-controller.yaml#

properties:
  compatible:
    enum:
      - aspeed,ast2400-i2c-bus
      - aspeed,ast2500-i2c-bus
      - aspeed,ast2600-i2c-bus

  reg:
    minItems: 1
    items:
      - description: address offset and range of bus
      - description: address offset and range of bus buffer

  interrupts:
    maxItems: 1

  clocks:
    maxItems: 1
    description:
      root clock of bus, should reference the APB
      clock in the second cell

  resets:
    maxItems: 1

  bus-frequency:
    minimum: 500
    maximum: 4000000
    default: 100000
    description: frequency of the bus clock in Hz defaults to 100 kHz when not
      specified

  aspeed,transfer-mode:
    description: |
      ASPEED ast2600 platform equipped with 16 I2C controllers each i2c controller
      have 1 byte transfer buffer(byte mode), 32 bytes buffer(buffer mode), and
      share a DMA engine.
      Select I2C transfer mode for this controller. Supported values are:
        - "byte": Use 1 byte for i2c transmit (1-byte buffer).
        - "buffer": Use buffer (32-byte buffer) for i2c transmit. (default)
                    Better performance then byte mode.
        - "dma": Each controller DMA mode is shared DMA engine. The AST2600 SoC
                 provides a single DMA engine shared for 16 I2C controllers,
                 so only a limited number of controllers can use DMA simultaneously.
                 Therefore, the DTS must explicitly assign which controllers are
                 configured to use DMA.
      Only one mode can be selected per controller.
      On AST2600, each controller supports all three modes.
      If not specified, buffer mode is used by default.
    enum:
      - byte
      - buffer
      - dma

  aspeed,global-regs:
    $ref: /schemas/types.yaml#/definitions/phandle
    description:
      The phandle of i2c global register node, For control the i2c register
      define selection, clock divider mode selection and clock divider control.

required:
  - reg
  - compatible
  - clocks
  - resets

unevaluatedProperties: false

examples:
  - |
    #include <dt-bindings/clock/aspeed-clock.h>
    i2c@40 {
      #address-cells = <1>;
      #size-cells = <0>;
      compatible = "aspeed,ast2500-i2c-bus";
      reg = <0x40 0x40>;
      clocks = <&syscon ASPEED_CLK_APB>;
      resets = <&syscon ASPEED_RESET_I2C>;
      bus-frequency = <100000>;
      interrupts = <0>;
      interrupt-parent = <&i2c_ic>;
    };
  - |
    #include <dt-bindings/interrupt-controller/arm-gic.h>
    i2c1: i2c@80 {
      compatible = "aspeed,ast2600-i2c-bus";
      reg = <0x80 0x80>, <0xc00 0x20>;
      aspeed,global-regs = <&i2c_global>;
      clocks = <&syscon ASPEED_CLK_APB>;
      resets = <&syscon ASPEED_RESET_I2C>;
      interrupts = <GIC_SPI 110 IRQ_TYPE_LEVEL_HIGH>;
      aspeed,transfer-mode = "buffer";
    };
```

## Documentation/devicetree/bindings/i2c/i2c-controller-common.yaml
```yaml
# SPDX-License-Identifier: (GPL-2.0-only OR BSD-2-Clause)
%YAML 1.2
---
$id: http://devicetree.org/schemas/i2c/i2c-controller-common.yaml#
$schema: http://devicetree.org/meta-schemas/core.yaml#

title: I2C Controller Common Properties

maintainers:
  - Thierry Reding <thierry.reding@gmail.com>
  - Krishna Yarlagadda <kyarlagadda@nvidia.com>
  - Rajesh Gumasta <rgumasta@nvidia.com>
  - Jon Hunter <jonathanh@nvidia.com>

description:
  These properties are common to multiple I2C controllers.

definitions:
  reg-settings:
    properties:
      scl-low-period-cycles:
        $ref: /schemas/types.yaml#/definitions/uint8
        description: Low period of the SCL clock in parent clock cycles.
      scl-high-period-cycles:
        $ref: /schemas/types.yaml#/definitions/uint8
        description: High period of the SCL clock in parent clock cycles.
      bus-free-time-cycles:
        $ref: /schemas/types.yaml#/definitions/uint8
        description: Bus free time between STOP and START conditions in parent
          clock cycles.
      start-setup-time-cycles:
        $ref: /schemas/types.yaml#/definitions/uint8
        description: Set-up time for START condition in parent clock cycles.
      stop-setup-time-cycles:
        $ref: /schemas/types.yaml#/definitions/uint8
        description: Set-up time for STOP condition in parent clock cycles.
      start-hold-time-cycles:
        $ref: /schemas/types.yaml#/definitions/uint8
        description: Hold time for STOP condition in parent clock cycles.

properties:
  reg-settings:
    $ref: /schemas/regset/register-settings.yaml

    properties:
      default-setting:
        type: object
        $ref: "#/definitions/reg-settings"
        description:
          Default register settings.

      fast:
        type: object
        $ref: "#/definitions/reg-settings"
        description:
          Register settings for I2C fast operating mode.

      fastplus:
        type: object
        $ref: "#/definitions/reg-settings"
        description:
          Register settings for I2C fastplus operating mode.

      standard:
        type: object
        $ref: "#/definitions/reg-settings"
        description:
          Register settings for I2C standard operating mode.

allOf:
  - $ref: /schemas/i2c/i2c-controller.yaml

additionalProperties: true
```
