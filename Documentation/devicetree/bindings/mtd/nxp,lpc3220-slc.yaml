## Documentation/devicetree/bindings/net/allwinner,sun50i-h618-ac300-ephy.yaml
```yaml
# SPDX-License-Identifier: (GPL-2.0-only OR BSD-2-Clause)
%YAML 1.2
---
$id: http://devicetree.org/schemas/net/allwinner,sun50i-h618-ac300-ephy.yaml#
$schema: http://devicetree.org/meta-schemas/core.yaml#

title: Allwinner AC300 Ethernet PHY

maintainers:
  - Alastair D'Silva <alastair@d-silva.org>

description:
  The AC300 is an integrated Fast Ethernet Physical Layer (EPHY) co-packaged
  with Allwinner H616 and H618 SoCs, communicated with over MDIO.

allOf:
  - $ref: ethernet-phy.yaml#

select:
  properties:
    compatible:
      contains:
        const: allwinner,sun50i-h618-ac300-ephy
  required:
    - compatible

properties:
  compatible:
    items:
      - const: ethernet-phy-id0044.1400
      - const: allwinner,sun50i-h618-ac300-ephy
      - const: ethernet-phy-ieee802.3-c22

  reg:
    maxItems: 1

  clocks:
    minItems: 1
    items:
      - description: 25MHz reference clock from CCU
      - description: 2MHz reference clock from PWM

  clock-names:
    minItems: 1
    items:
      - const: ephy
      - const: pwm

  nvmem-cells:
    items:
      - description: Calibration data from SID

  nvmem-cell-names:
    items:
      - const: calibration

required:
  - compatible
  - reg

unevaluatedProperties: false

examples:
  - |
    mdio {
        #address-cells = <1>;
        #size-cells = <0>;

        ethernet-phy@0 {
            compatible = "ethernet-phy-id0044.1400",
                         "allwinner,sun50i-h618-ac300-ephy",
                         "ethernet-phy-ieee802.3-c22";
            reg = <0>;
            clocks = <&ccu 81>, <&ac300_pwm_clk>;
            clock-names = "ephy", "pwm";
            nvmem-cells = <&ephy_calibration>;
            nvmem-cell-names = "calibration";
        };
    };
```

## Documentation/devicetree/bindings/net/altr,dwmac-socfpga.yaml
```yaml
# SPDX-License-Identifier: (GPL-2.0-only OR BSD-2-Clause)
%YAML 1.2
---
$id: http://devicetree.org/schemas/net/altr,dwmac-socfpga.yaml#
$schema: http://devicetree.org/meta-schemas/core.yaml#

title: Intel/Altera SoCFPGA DWMAC controller

maintainers:
  - Dinh Nguyen <dinguyen@kernel.org>

select:
  properties:
    compatible:
      contains:
        enum:
          - altr,socfpga-stmmac
          - altr,socfpga-stmmac-a10-s10
  required:
    - compatible

allOf:
  - $ref: snps,dwmac.yaml#

properties:
  compatible:
    oneOf:
      - items:
          - const: altr,socfpga-stmmac
          - const: snps,dwmac-3.70a
          - const: snps,dwmac
      - items:
          - const: altr,socfpga-stmmac-a10-s10
          - const: snps,dwmac-3.72a
          - const: snps,dwmac
      - items:
          - const: altr,socfpga-stmmac-a10-s10
          - const: snps,dwmac-3.74a
          - const: snps,dwmac

  reg:
    maxItems: 1

  iommus:
    minItems: 1
    maxItems: 2

  clocks:
    minItems: 1
    items:
      - description: GMAC main clock
      - description: PTP clock

  clock-names:
    minItems: 1
    maxItems: 2
    items:
      - const: stmmaceth
      - const: ptp_ref

  resets:
    minItems: 1
    items:
      - description: GMAC stmmaceth reset
      - description: AHB reset

  reset-names:
    minItems: 1
    items:
      - const: stmmaceth
      - const: ahb

  interrupts:
    items:
      - description: DWMAC interrupt

  interrupt-names:
    items:
      - const: macirq

  phy-mode:
    maxItems: 1
    items:
      enum:
        - rgmii
        - gmii
        - mii

  altr,sysmgr-syscon:
    $ref: /schemas/types.yaml#/definitions/phandle-array
    items:
      - items:
          - description: phandle to the sysmgr node
          - description: register offset that controls the SDMMC clock phase
          - description: register shift for the smplsel(drive in) setting
    description:
      Should be the phandle to the system manager node that
      encompasses the glue register, the register offset, and the register shift.
      On Cyclone5/Arria5, the register shift represents the PHY mode bits, while
      on the Arria10/Stratix10/Agilex platforms, the register shift represents
      bit for each emac to enable/disable signals from the FPGA fabric to the
      EMAC modules.

  altr,emac-splitter:
    $ref: /schemas/types.yaml#/definitions/phandle
    description:
      Should be the phandle to the emac splitter soft IP node if DWMAC
      controller is connected emac splitter.

  altr,sgmii-to-sgmii-converter:
    $ref: /schemas/types.yaml#/definitions/phandle
    description:
      Phandle to the TSE SGMII converter.

required:
  - compatible
  - reg
  - interrupts
  - clocks
  - clock-names
  - phy-mode

unevaluatedProperties: false

examples:
  - |
    gmac0: ethernet@ff700000 {
            compatible = "altr,socfpga-stmmac", "snps,dwmac-3.70a", "snps,dwmac";
            altr,sysmgr-syscon = <&sysmgr 0x60 0>;
            reg = <0xff700000 0x2000>;
            interrupts = <0 115 4>;
            interrupt-names = "macirq";
            mac-address = [00 00 00 00 00 00];/* Filled in by U-Boot */
            clocks = <&emac_0_clk>;
            clock-names = "stmmaceth";
            phy-mode = "rgmii";
            tx-fifo-depth = <16384>;
            rx-fifo-depth = <16384>;
    };
```

## Documentation/devicetree/bindings/net/beagle,play-cc1352.yaml
```yaml
# SPDX-License-Identifier: GPL-2.0-only OR BSD-2-Clause
%YAML 1.2
---
$id: http://devicetree.org/schemas/net/beagle,play-cc1352.yaml#
$schema: http://devicetree.org/meta-schemas/core.yaml#

title: BeaglePlay CC1352 co-processor

maintainers:
  - Ayush Singh <ayushdevel1325@gmail.com>

properties:
  compatible:
    const: beagle,play-cc1352

required:
  - compatible

additionalProperties: false

examples:
  - |
    mcu {
      compatible = "beagle,play-cc1352";
    };
```

## Documentation/devicetree/bindings/net/bluetooth/mediatek,mt7921s-bluetooth.yaml
```yaml
# SPDX-License-Identifier: (GPL-2.0 OR BSD-2-Clause)
%YAML 1.2
---
$id: http://devicetree.org/schemas/net/bluetooth/mediatek,mt7921s-bluetooth.yaml#
$schema: http://devicetree.org/meta-schemas/core.yaml#

title: MediaTek MT7921S Bluetooth

description:
  This binding describes the Bluetooth side of the SDIO-attached MT7921S
  WiFi+Bluetooth combo chips. These chips are dual-radio chips supporting
  WiFi and Bluetooth. Bluetooth works over SDIO just like WiFi. Bluetooth
  has its own reset line, separate from WiFi, which can be used to reset
  the Bluetooth core.

maintainers:
  - Sean Wang <sean.wang@mediatek.com>

properties:
  compatible:
    enum:
      - mediatek,mt7921s-bluetooth
  reg:
    const: 2

  reset-gpios:
    maxItems: 1
    description: A GPIO line connected to the Bluetooth subsystem reset line.
      Typically the W_DISABLE2# pin on M.2 E-key modules. If present this
      shall be flagged as active low.

required:
  - compatible
  - reg

additionalProperties: false

examples:
  - |
    mmc {
        #address-cells = <1>;
        #size-cells = <0>;

        bluetooth@2 {
            compatible = "mediatek,mt7921s-bluetooth";
            reg = <2>;
            reset-gpios = <&pio 8 GPIO_ACTIVE_LOW>;
        };
    };
```

## Documentation/devicetree/bindings/net/brcm,bcm54xx.yaml
```yaml
# SPDX-License-Identifier: GPL-2.0-only OR BSD-2-Clause
%YAML 1.2
---
$id: http://devicetree.org/schemas/net/brcm,bcm54xx.yaml#
$schema: http://devicetree.org/meta-schemas/core.yaml#

title: Broadcom Ethernet PHYs

maintainers:
  - Rafał Miłecki <rafal@milecki.pl>

allOf:
  - $ref: ethernet-phy.yaml#

properties:
  compatible:
    enum:
      - ethernet-phy-id600d.84a6

  brcm,master-mode:
    description: PHY requires setting into master mode
    type: boolean

unevaluatedProperties: false

examples:
  - |
    mdio {
        #address-cells = <1>;
        #size-cells = <0>;

        ethernet-phy@0 {
            compatible = "ethernet-phy-id600d.84a6";
            reg = <0>;
            brcm,master-mode;
        };
    };
```

## Documentation/devicetree/bindings/net/brcm,bcm63268-gphy.yaml
```yaml
# SPDX-License-Identifier: GPL-2.0-only OR BSD-2-Clause
%YAML 1.2
---
$id: http://devicetree.org/schemas/net/brcm,bcm63268-gphy.yaml#
$schema: http://devicetree.org/meta-schemas/core.yaml#

title: Broadcom BCM63268 GPHY

description: Broadcom's internal gigabit ethernet PHY on BCM63268 SoC

maintainers:
  - TBD

allOf:
  - $ref: ethernet-phy.yaml#

properties:
  compatible:
    const: ethernet-phy-id0362.5f50

  reg:
    maxItems: 1

  brcm,gpio-ctrl:
    $ref: /schemas/types.yaml#/definitions/phandle
    description: Phandle to the SoC GPIO controller
      which contains PHY control registers

required:
  - reg
  - brcm,gpio-ctrl
  - resets

unevaluatedProperties: false

examples:
  - |
    #include <dt-bindings/reset/bcm63268-reset.h>

    mdio {
        #address-cells = <1>;
        #size-cells = <0>;

        ethernet-phy@4 {
            compatible = "ethernet-phy-id0362.5f50";
            reg = <4>;

            resets = <&periph_rst BCM63268_RST_GPHY>;

            brcm,gpio-ctrl = <&gpio_cntl>;
        };
    };
```

## Documentation/devicetree/bindings/net/can/arasan,canfd.yaml
```yaml
# SPDX-License-Identifier: (GPL-2.0-only OR BSD-2-Clause)
%YAML 1.2
---
$id: http://devicetree.org/schemas/net/can/arasan,canfd.yaml#
$schema: http://devicetree.org/meta-schemas/core.yaml#

title:
  Arasan CAN-FD controller

maintainers:
  - Jisheng Zhang <jszhang@kernel.org>

allOf:
  - $ref: can-controller.yaml#

properties:
  compatible:
    const: arasan,canfd

  reg:
    maxItems: 1

  interrupts:
    maxItems: 1

  clocks:
    maxItems: 2

  clock-names:
    items:
      - const: can
      - const: sys

  resets:
    maxItems: 2

  reset-names:
    items:
      - const: can
      - const: sys

required:
  - compatible
  - reg
  - interrupts
  - clocks
  - resets

additionalProperties: false

examples:
  - |
    #include <dt-bindings/interrupt-controller/arm-gic.h>
    #include <dt-bindings/interrupt-controller/irq.h>
    can@e5060000 {
        compatible = "arasan,canfd";
        reg = <0xe5060000 0x1000>;
        interrupts = <GIC_SPI 163 IRQ_TYPE_LEVEL_HIGH>;
        clocks = <&clk 32>, <&clk 16>;
        clock-names = "can", "sys";
        resets = <&rst 3>, <&rst 2>;
        reset-names = "can", "sys";
    };
```

## Documentation/devicetree/bindings/net/can/atmel,at91sam9263-can.yaml
```yaml
# SPDX-License-Identifier: (GPL-2.0-only OR BSD-2-Clause)
%YAML 1.2
---
$id: http://devicetree.org/schemas/net/can/atmel,at91sam9263-can.yaml#
$schema: http://devicetree.org/meta-schemas/core.yaml#

title: Atmel CAN Controller

maintainers:
  - Nicolas Ferre <nicolas.ferre@microchip.com>

properties:
  compatible:
    oneOf:
      - enum:
          - atmel,at91sam9263-can
          - atmel,at91sam9x5-can
          - microchip,sam9x60-can
      - items:
          - enum:
              - microchip,sam9x60-can
          - const: atmel,at91sam9x5-can

  reg:
    maxItems: 1

  interrupts:
    maxItems: 1

  clocks:
    maxItems: 1

  clock-names:
    items:
      - const: can_clk

required:
  - compatible
  - reg
  - interrupts

allOf:
  - $ref: can-controller.yaml#
  - if:
      properties:
        compatible:
          contains:
            enum:
              - microchip,sam9x60-can
    then:
      required:
        - compatible
        - reg
        - interrupts
        - clocks
        - clock-names

unevaluatedProperties: false

examples:
  - |
    #include <dt-bindings/interrupt-controller/irq.h>
    can0: can@f000c000 {
          compatible = "atmel,at91sam9x5-can";
          reg = <0xf000c000 0x300>;
          interrupts = <30 IRQ_TYPE_LEVEL_HIGH 3>;
    };
```

## Documentation/devicetree/bindings/net/can/fsl,mpc5xxx-mscan.yaml
```yaml
# SPDX-License-Identifier: (GPL-2.0-only OR BSD-2-Clause)
%YAML 1.2
---
$id: http://devicetree.org/schemas/net/can/fsl,mpc5xxx-mscan.yaml#
$schema: http://devicetree.org/meta-schemas/core.yaml#

title: Freescale MPC5xxx MSCAN controller

maintainers:
  - Marc Kleine-Budde <mkl@pengutronix.de>

description:
  The MSCAN controller found on the Freescale MPC5200 and MPC5121 SoCs. The
  MPC5121 Rev. 1 processor is not supported.

properties:
  compatible:
    oneOf:
      - items:
          - enum:
              - fsl,mpc5200b-mscan
          - const: fsl,mpc5200-mscan
      - enum:
          - fsl,mpc5200-mscan
          - fsl,mpc5121-mscan

  reg:
    maxItems: 1

  interrupts:
    maxItems: 1

  clocks:
    description:
      Clocks feeding the controller. On MPC5121 the driver looks up the
      "ipg", "ips", "sys", "ref" and "mclk" clocks by name.
    maxItems: 5

  clock-names:
    items:
      - const: ipg
      - const: ips
      - const: sys
      - const: ref
      - const: mclk

  fsl,mscan-clock-source:
    description:
      Clock source used for the controller.
    enum: [ip, ref, sys]

  fsl,mscan-clock-divider:
    description: Additional clock divider for the reference and system clocks.
    $ref: /schemas/types.yaml#/definitions/uint32
    default: 1

required:
  - compatible
  - reg
  - interrupts

allOf:
  - $ref: can-controller.yaml#

  - if:
      properties:
        compatible:
          contains:
            const: fsl,mpc5200-mscan
    then:
      properties:
        fsl,mscan-clock-source:
          description:
            Clock source used for the controller. "ref" is the default when
            the property is not present.
          enum: [ip, ref]

  - if:
      properties:
        compatible:
          contains:
            const: fsl,mpc5121-mscan
    then:
      properties:
        fsl,mscan-clock-source:
          description:
            Clock source used for the controller. When the property is not
            present, an optimal clock source and frequency based on the
            system clock is selected. If this is not possible, the reference
            clock is used.
          enum: [ip, ref, sys]

unevaluatedProperties: false

examples:
  - |
    #include <dt-bindings/interrupt-controller/irq.h>

    can@1300 {
        compatible = "fsl,mpc5121-mscan";
        reg = <0x1300 0x80>;
        interrupts = <12 IRQ_TYPE_LEVEL_LOW>;
        interrupt-parent = <&ipic>;
    };

    can@1380 {
        compatible = "fsl,mpc5121-mscan";
        reg = <0x1380 0x80>;
        interrupts = <13 IRQ_TYPE_LEVEL_LOW>;
        interrupt-parent = <&ipic>;
        fsl,mscan-clock-source = "ref";
        fsl,mscan-clock-divider = <3>;
    };
...
```
