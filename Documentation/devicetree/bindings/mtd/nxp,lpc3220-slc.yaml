## Documentation/devicetree/bindings/mtd/nxp,lpc3220-slc.yaml
```yaml
# SPDX-License-Identifier: (GPL-2.0-only OR BSD-2-Clause)
%YAML 1.2
---
$id: http://devicetree.org/schemas/mtd/nxp,lpc3220-slc.yaml#
$schema: http://devicetree.org/meta-schemas/core.yaml#

title: NXP LPC32xx SoC NAND SLC controller

maintainers:
  - Frank Li <Frank.Li@nxp.com>

properties:
  compatible:
    const: nxp,lpc3220-slc

  reg:
    maxItems: 1

  clocks:
    maxItems: 1

  gpios:
    maxItems: 1
    description:
      GPIO specification for NAND write protect

  nand-on-flash-bbt: true

  partitions:
    type: object
    $ref: partitions/partitions.yaml
    unevaluatedProperties: false

  nxp,wdr-clks:
    $ref: /schemas/types.yaml#/definitions/uint32
    description:
      Delay before Ready signal is tested on write (W_RDY)

  nxp,rdr-clks:
    $ref: /schemas/types.yaml#/definitions/uint32
    description:
      Delay before Ready signal is tested on read (R_RDY)

  nxp,wwidth:
    $ref: /schemas/types.yaml#/definitions/uint32
    description:
      Write pulse width (W_WIDTH) in Hz

  nxp,whold:
    $ref: /schemas/types.yaml#/definitions/uint32
    description:
      Write hold time (W_HOLD) in Hz

  nxp,wsetup:
    $ref: /schemas/types.yaml#/definitions/uint32
    description:
      Write setup time (W_SETUP) in Hz

  nxp,rwidth:
    $ref: /schemas/types.yaml#/definitions/uint32
    description:
      Read pulse width (R_WIDTH) in Hz

  nxp,rhold:
    $ref: /schemas/types.yaml#/definitions/uint32
    description:
      Read hold time (R_HOLD) in Hz

  nxp,rsetup:
    $ref: /schemas/types.yaml#/definitions/uint32
    description:
      Read setup time (R_SETUP) in Hz

required:
  - compatible
  - reg
  - gpios

additionalProperties: false

examples:
  - |
    nand-controller@20020000 {
        compatible = "nxp,lpc3220-slc";
        reg = <0x20020000 0x1000>;
        nxp,wdr-clks = <14>;
        nxp,wwidth = <40000000>;
        nxp,whold = <100000000>;
        nxp,wsetup = <100000000>;
        nxp,rdr-clks = <14>;
        nxp,rwidth = <40000000>;
        nxp,rhold = <66666666>;
        nxp,rsetup = <100000000>;
        nand-on-flash-bbt;
        gpios = <&gpio 5 19 1>; /* GPO_P3 19, active low */
    };
```

## Documentation/devicetree/bindings/mtd/partitions/airoha,fixed-partitions.yaml
```yaml
# SPDX-License-Identifier: GPL-2.0-only OR BSD-2-Clause
%YAML 1.2
---
$id: http://devicetree.org/schemas/mtd/partitions/airoha,fixed-partitions.yaml#
$schema: http://devicetree.org/meta-schemas/core.yaml#

title: Airoha SoC partitioning

description: |
  Airoha based SoC declare a dedicated partition at the end of the flash to
  store calibration and device specific data, in addition to fixed partitions.

  The offset of this special partition is not well defined as a custom bad block
  management driver is used that reserve space at the end of the flash.

  This binding allows defining all fixed partitions and marking the last one to
  detect the correct offset from the new end of the flash.

maintainers:
  - Christian Marangi <ansuelsmth@gmail.com>

select: false

properties:
  compatible:
    const: airoha,fixed-partitions

  "#address-cells":
    enum: [ 1, 2 ]

  "#size-cells":
    enum: [ 1, 2 ]

patternProperties:
  "^partition@[0-9a-f]+$":
    $ref: partition.yaml#
    properties:
      compatible:
        const: airoha,dynamic-art
    unevaluatedProperties: false

required:
  - "#address-cells"
  - "#size-cells"

additionalProperties: false

examples:
  - |
    partitions {
        compatible = "airoha,fixed-partitions";
        #address-cells = <1>;
        #size-cells = <1>;

        partition@0 {
          label = "bootloader";
          reg = <0x00000000 0x00080000>;
        };

        partition@80000 {
          label = "tclinux";
          reg = <0x00080000 0x02800000>;
        };

        partition@2880000 {
          label = "tclinux_slave";
          reg = <0x02880000 0x02800000>;
        };

        partition@5080000 {
          label = "rootfs_data";
          reg = <0x5080000 0x00800000>;
        };

        partition@ffffffff {
          compatible = "airoha,dynamic-art";
          label = "art";
          reg = <0xffffffff 0x00300000>;
        };
    };
```

## Documentation/devicetree/bindings/mtd/partitions/binman/atf-bl31.yaml
```yaml
# SPDX-License-Identifier: (GPL-2.0 OR BSD-2-Clause)
# Copyright 2023 Google LLC

%YAML 1.2
---
$id: http://devicetree.org/schemas/mtd/partitions/binman/atf-bl31.yaml#
$schema: http://devicetree.org/meta-schemas/core.yaml#

title: ARM Trusted Firmware BL31

maintainers:
  - Simon Glass <sjg@chromium.org>

description:
  Holds a BL31 binary file from the ARM Trusted Firmware project.

allOf:
  - $ref: entry.yaml#

properties:
  compatible:
    const: binman,atf-bl31

unevaluatedProperties: false

examples:
  - |
    binman {
        compatible = "binman";
        #address-cells = <1>;
        #size-cells = <1>;

        partition@0 {
            reg = <0x0 0xa0000>;
            compatible = "binman,entry";
        };

        partition@100000 {
            reg = <0x100000 0x200000>;
            compatible = "binman,atf-bl31";
            compression = "lz4";
        };
    };
```

## Documentation/devicetree/bindings/mtd/partitions/binman/entry.yaml
```yaml
# SPDX-License-Identifier: (GPL-2.0 OR BSD-2-Clause)
# Copyright 2023 Google LLC

%YAML 1.2
---
$id: http://devicetree.org/schemas/mtd/partitions/binman/entry.yaml#
$schema: http://devicetree.org/meta-schemas/core.yaml#

title: Binman entry

maintainers:
  - Simon Glass <sjg@chromium.org>

description: |
  This node specifies a single, generic entry in the firmware.

  Entries have a specific type, indicated by the compatible string.

properties:
  reg:
    description: partition's offset and size within the flash
    maxItems: 1

  compression:
    $ref: /schemas/types.yaml#/definitions/string
    description:
      Compression algorithm to use, chosen from a list of well-known algorithms.
      The contents are compressed using this algorithm.

    enum:
      - none
      - bzip2
      - gzip
      - lzop
      - lz4
      - lzma
      - xz
      - zstd

required:
  - compatible

additionalProperties: true

examples:
  - |
    binman {
        compatible = "binman";
        #address-cells = <1>;
        #size-cells = <1>;

        partition@0 {
            reg = <0x0 0xa0000>;
            compatible = "binman,entry";
        };

        partition@100000 {
            reg = <0x100000 0x200000>;
            compatible = "binman,entry";
            compression = "lz4";
        };
    };
```

## Documentation/devicetree/bindings/mtd/partitions/binman/u-boot.yaml
```yaml
# SPDX-License-Identifier: (GPL-2.0 OR BSD-2-Clause)
# Copyright 2023 Google LLC

%YAML 1.2
---
$id: http://devicetree.org/schemas/mtd/partitions/binman/u-boot.yaml#
$schema: http://devicetree.org/meta-schemas/core.yaml#

title: U-Boot

maintainers:
  - Simon Glass <sjg@chromium.org>

description:
  Holds a binary file (u-boot.bin) from the U-Boot project.

allOf:
  - $ref: entry.yaml#

properties:
  compatible:
    const: binman,u-boot

unevaluatedProperties: false

examples:
  - |
    binman {
        compatible = "binman";
        #address-cells = <1>;
        #size-cells = <1>;

        partition@0 {
            reg = <0x0 0xa0000>;
            compatible = "binman,u-boot";
        };

        partition@100000 {
            reg = <0x100000 0x200000>;
            compatible = "binman,atf-bl31";
            compression = "lz4";
        };
    };
```

## Documentation/devicetree/bindings/mtd/ti,davinci-nand.yaml
```yaml
# SPDX-License-Identifier: (GPL-2.0-only OR BSD-2-Clause)
%YAML 1.2
---
$id: http://devicetree.org/schemas/mtd/ti,davinci-nand.yaml#
$schema: http://devicetree.org/meta-schemas/core.yaml#

title: TI DaVinci NAND controller

maintainers:
  - Marcus Folkesson <marcus.folkesson@gmail.com>

allOf:
  - $ref: nand-controller.yaml#

properties:
  compatible:
    enum:
      - ti,davinci-nand
      - ti,keystone-nand

  reg:
    maxItems: 1

  ti,davinci-chipselect:
    description: |
      Number of chipselect. Indicate on the davinci_nand
      driver which chipselect is used for accessing
      the nand.
    $ref: /schemas/types.yaml#/definitions/uint32
    enum: [0, 1, 2, 3]

  ti,davinci-mask-ale:
    description: |
      Mask for ALE. Needed for executing address
      phase. These offset will be added to the base
      address for the chip select space the NAND Flash
      device is connected to.
    $ref: /schemas/types.yaml#/definitions/uint32
    default: 0x08

  ti,davinci-mask-cle:
    description: |
      Mask for CLE. Needed for executing command
      phase. These offset will be added to the base
      address for the chip select space the NAND Flash
      device is connected to.
    $ref: /schemas/types.yaml#/definitions/uint32
    default: 0x10

  ti,davinci-mask-chipsel:
    description: |
      Mask for chipselect address. Needed to mask
      addresses for given chipselect.
    $ref: /schemas/types.yaml#/definitions/uint32
    default: 0

  ti,davinci-ecc-bits:
    description: Used ECC bits.
    $ref: /schemas/types.yaml#/definitions/uint32
    enum: [1, 4]

  ti,davinci-ecc-mode:
    description: Operation mode of the NAND ECC mode.
    $ref: /schemas/types.yaml#/definitions/string
    enum: [none, soft, hw, on-die]
    deprecated: true

  ti,davinci-nand-buswidth:
    description: Bus width to the NAND chip
    $ref: /schemas/types.yaml#/definitions/uint32
    enum: [8, 16]
    default: 8
    deprecated: true

  ti,davinci-nand-use-bbt:
    type: boolean
    description: |
      Use flash based bad block table support. OOB
      identifier is saved in OOB area.
    deprecated: true

required:
  - compatible
  - reg
  - ti,davinci-chipselect

examples:
  - |
    nand_cs3@62000000 {
    compatible = "ti,davinci-nand";
    reg = <0x62000000 0x807ff
    0x68000000 0x8000>;
    ti,davinci-chipselect = <1>;
    ti,davinci-mask-ale = <0>;
    ti,davinci-mask-cle = <0>;
    ti,davinci-mask-chipsel = <0>;
    nand-ecc-mode = "hw";
    ti,davinci-ecc-bits = <4>;
    nand-on-flash-bbt;

        partition@180000 {
            label = "ubifs";
            reg = <0x180000 0x7e80000>;
        };
    };
```

## Documentation/devicetree/bindings/mux/adi,adg1736.yaml
```yaml
# SPDX-License-Identifier: (GPL-2.0-only OR BSD-2-Clause)
%YAML 1.2
---
$id: http://devicetree.org/schemas/mux/adi,adg1736.yaml#
$schema: http://devicetree.org/meta-schemas/core.yaml#

title: Analog Devices ADG1736 Dual SPDT Switch Multiplexer

maintainers:
  - Antoniu Miclaus <antoniu.miclaus@analog.com>

description: |
  Analog Devices ADG1736 dual single-pole, double-throw (SPDT)
  switch. The device features two independent SPDT switches, each functioning
  as a 2:1 multiplexer. Each switch can connect its common drain terminal (D)
  to one of two source terminals (SA or SB).

  The device has two independent mux controllers (mux 0 and mux 1), each with
  two states:
    * 0: SxB to Dx (control GPIO low)
    * 1: SxA to Dx (control GPIO high)

  The EN pin is shared between both switches and can disable all channels when
  set low (inactive).

allOf:
  - $ref: mux-controller.yaml#

properties:
  compatible:
    const: adi,adg1736

  mux-gpios:
    description:
      GPIO pins connected to the control inputs IN1 and IN2.
    items:
      - description: Control GPIO for switch 1 (S1A/S1B to D1)
      - description: Control GPIO for switch 2 (S2A/S2B to D2)

  enable-gpios:
    description:
      GPIO connected to the EN (enable) pin. Active high.
    maxItems: 1

  '#mux-control-cells':
    const: 1
    description:
      Mux controller index (0 or 1) to select which SPDT switch to control.

required:
  - compatible
  - mux-gpios
  - enable-gpios
  - '#mux-control-cells'

unevaluatedProperties: false

examples:
  - |
    #include <dt-bindings/gpio/gpio.h>
    #include <dt-bindings/mux/mux.h>

    mux-controller {
        compatible = "adi,adg1736";
        #mux-control-cells = <1>;

        mux-gpios = <&gpio 10 GPIO_ACTIVE_HIGH>,
                    <&gpio 11 GPIO_ACTIVE_HIGH>;
        enable-gpios = <&gpio 12 GPIO_ACTIVE_HIGH>;

        /* Disconnect both switches when idle */
        idle-states = <MUX_IDLE_DISCONNECT MUX_IDLE_DISCONNECT>;
    };

...
```

## Documentation/devicetree/bindings/mux/adi,adg2404.yaml
```yaml
# SPDX-License-Identifier: (GPL-2.0-only OR BSD-2-Clause)
%YAML 1.2
---
$id: http://devicetree.org/schemas/mux/adi,adg2404.yaml#
$schema: http://devicetree.org/meta-schemas/core.yaml#

title: Analog Devices ADG2404 4:1 multiplexer

maintainers:
  - Antoniu Miclaus <antoniu.miclaus@analog.com>

description: |
  Bindings for Analog Devices ADG2404 4:1 single-ended analog multiplexer

  The multiplexer state corresponds to the selected input channel:
  * 0: Channel S1 selected
  * 1: Channel S2 selected
  * 2: Channel S3 selected
  * 3: Channel S4 selected

allOf:
  - $ref: mux-controller.yaml#

properties:
  compatible:
    const: adi,adg2404

  mux-gpios:
    description:
      GPIO pins connected to the address inputs.
    items:
      - description: A0 address pin
      - description: A1 address pin

  enable-gpios:
    description:
      GPIO connected to the EN (enable) pin. Active high.
    maxItems: 1

  '#mux-control-cells':
    const: 0

required:
  - compatible
  - mux-gpios
  - enable-gpios
  - '#mux-control-cells'

unevaluatedProperties: false

examples:
  - |
    #include <dt-bindings/gpio/gpio.h>

    mux-controller {
        compatible = "adi,adg2404";
        #mux-control-cells = <0>;

        mux-gpios = <&gpio 1 GPIO_ACTIVE_HIGH>,
                    <&gpio 2 GPIO_ACTIVE_HIGH>;
        enable-gpios = <&gpio 3 GPIO_ACTIVE_HIGH>;

        idle-state = <0>; /* Select channel S1 when idle */
    };

...
```
