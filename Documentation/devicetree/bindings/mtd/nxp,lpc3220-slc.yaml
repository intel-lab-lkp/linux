## Documentation/devicetree/bindings/mux/gpio-mux.yaml
```yaml
# SPDX-License-Identifier: GPL-2.0
%YAML 1.2
---
$id: http://devicetree.org/schemas/mux/gpio-mux.yaml#
$schema: http://devicetree.org/meta-schemas/core.yaml#

title: GPIO-based multiplexer controller

maintainers:
  - Peter Rosin <peda@axentia.se>

description: |+
  Define what GPIO pins are used to control a multiplexer. Or several
  multiplexers, if the same pins control more than one multiplexer.

  The multiplexer state is defined as the number represented by the
  multiplexer GPIO pins, where the first pin is the least significant
  bit. An active pin is a binary 1, an inactive pin is a binary 0.

properties:
  compatible:
    const: gpio-mux

  mux-gpios:
    description:
      List of gpios used to control the multiplexer, least significant bit first.

  mux-supply:
    description:
      Regulator to power on the multiplexer.

  '#mux-control-cells':
    enum: [ 0, 1 ]

  '#mux-state-cells':
    enum: [ 1, 2 ]

  idle-state:
    default: -1

required:
  - compatible
  - mux-gpios
anyOf:
  - required:
      - "#mux-control-cells"
  - required:
      - "#mux-state-cells"

additionalProperties: false

examples:
  - |
    #include <dt-bindings/gpio/gpio.h>

    mux: mux-controller {
        compatible = "gpio-mux";
        #mux-control-cells = <0>;

        mux-gpios = <&pioA 0 GPIO_ACTIVE_HIGH>,
              <&pioA 1 GPIO_ACTIVE_HIGH>;
    };

    adc-mux {
        compatible = "io-channel-mux";
        io-channels = <&adc 0>;
        io-channel-names = "parent";

        mux-controls = <&mux>;

        channels = "sync-1", "in", "out", "sync-2";
    };

    i2c-mux {
        compatible = "i2c-mux";
        i2c-parent = <&i2c1>;

        mux-controls = <&mux>;

        #address-cells = <1>;
        #size-cells = <0>;

        i2c@0 {
            reg = <0>;
            #address-cells = <1>;
            #size-cells = <0>;

            ssd1307: oled@3c {
                reg = <0x3c>;
            };
        };

        i2c@3 {
            reg = <3>;
            #address-cells = <1>;
            #size-cells = <0>;

            pca9555: pca9555@20 {
                reg = <0x20>;
            };
        };
    };
  - |
    #include <dt-bindings/gpio/gpio.h>

    sfp_mux: mux-controller {
        compatible = "gpio-mux";
        #mux-control-cells = <0>;

        mux-gpios = <&gpio0 0 GPIO_ACTIVE_HIGH>,
                    <&gpio0 1 GPIO_ACTIVE_HIGH>;
    };

    sfp_gpio: sfp-gpio-1 {
        compatible = "gpio-line-mux";
        gpio-controller;
        #gpio-cells = <2>;

        mux-controls = <&sfp_mux>;
        shared-gpio = <&gpio0 2 GPIO_ACTIVE_HIGH>;

        gpio-line-names = "SFP_LOS", "SFP_MOD_ABS", "SFP_TX_F";
        gpio-line-mux-states = <0>, <1>, <2>;
    };

    sfp0: sfp-p0 {
        compatible = "sff,sfp";

        los-gpios = <&sfp_gpio 0 GPIO_ACTIVE_HIGH>;
        mod-def0-gpios = <&sfp_gpio 1 GPIO_ACTIVE_LOW>;
        tx-fault-gpios = <&sfp_gpio 2 GPIO_ACTIVE_HIGH>;
    };
...
```

## Documentation/devicetree/bindings/mux/nxp,mc33978-mux.yaml
```yaml
# SPDX-License-Identifier: (GPL-2.0-only OR BSD-2-Clause)
%YAML 1.2
---
$id: http://devicetree.org/schemas/mux/nxp,mc33978-mux.yaml#
$schema: http://devicetree.org/meta-schemas/core.yaml#

title: NXP MC33978/MC34978 Analog Multiplexer

maintainers:
  - David Jander <david@protonic.nl>
  - Oleksij Rempel <o.rempel@pengutronix.de>

description: |
  The MC33978 and MC34978 include a 24-to-1 analog multiplexer (AMUX) that
  routes one of the following signals to an external AMUX pin for measurement
  by an external ADC:

  - Channels 0-13: SG0-SG13 switch input voltages
  - Channels 14-21: SP0-SP7 switch input voltages
  - Channel 22: Internal temperature diode
  - Channel 23: Battery voltage (VBATP)

  The AMUX requires a settling time of up to 200 us for full-scale voltage
  steps. Consumers (e.g., io-channel-mux) must configure this delay.

properties:
  compatible:
    enum:
      - nxp,mc33978-mux
      - nxp,mc34978-mux

  '#mux-control-cells':
    const: 0

required:
  - compatible
  - '#mux-control-cells'

additionalProperties: false

examples:
  - |
    amux: mux-controller {
        compatible = "nxp,mc33978-mux";
        #mux-control-cells = <0>;
    };

    iio-mux {
        compatible = "io-channel-mux";
        io-channels = <&adc 0>;
        io-channel-names = "parent";
        mux-controls = <&amux>;
        settle-time-us = <200>;
        channels = "sg0", "sg1", "sg2"; /* ... */
    };
```

## Documentation/devicetree/bindings/mux/ti,am62l-event-mux-router.yaml
```yaml
# SPDX-License-Identifier: (GPL-2.0-only OR BSD-2-Clause)
%YAML 1.2
---
$id: http://devicetree.org/schemas/mux/ti,am62l-event-mux-router.yaml#
$schema: http://devicetree.org/meta-schemas/core.yaml#

title: TI Event Multiplexer on K3 SoCs

maintainers:
  - Rahul Sharma <r-sharma3@ti.com>

description:
  The TI K3 mux routers routes the GPIO input events or Time
  Sync events between peripherals instead of routing to a CPU.

allOf:
  - $ref: mux-controller.yaml#

properties:
  compatible:
    const: ti,am62l-event-mux-router

  reg:
    description: Register base address and size.
    maxItems: 1

  '#mux-control-cells':
    const: 1
    description:
      Number of cells in a mux control specifier. This should be 1.
      The cell specifies which mux control to use (0-based index).

  ti,reg-mask-val:
    $ref: /schemas/types.yaml#/definitions/uint32-matrix
    items:
      items:
        - description: Register offset (relative to reg base)
        - description: Bit mask for the mux control bits
        - description: Value to write when mux is active (state 1)
    minItems: 1
    description: |
      Array of triplets specifying register offset, mask, and value for each
      mux control. Each triplet contains:
      - register offset (relative to reg base)
      - bit mask for the mux control bits
      - value to write when mux is active (state 1)

  idle-states:
    $ref: /schemas/types.yaml#/definitions/uint32-array
    description: |
      Idle state for each mux control. Each entry corresponds to a mux control:
      - 0: clear masked bits when idle, also refers to inactive state
      - 1: set configured value when idle, also refers to active state
      - MUX_IDLE_AS_IS (-1): keep current state when idle

required:
  - compatible
  - reg
  - '#mux-control-cells'
  - ti,reg-mask-val
  - idle-states

additionalProperties: false

examples:
  - |
    #include <dt-bindings/mux/mux.h>

    // Example 1: TI AM62L GPIO Mux Router
    mux-controller@a00000 {
        compatible = "ti,am62l-event-mux-router";
        reg = <0xa00000 0x400>;
        #mux-control-cells = <1>;

        /* Mux Register addresses: 0xa00004 + (J × 4) */
        /* GPIO0_40 -> BCDMA trigger 15 */
        ti,reg-mask-val = <0x40 0x000ff 0x00028>;
        idle-states = <0>;
    };
```

## Documentation/devicetree/bindings/net/airoha,an7583-mdio.yaml
```yaml
# SPDX-License-Identifier: GPL-2.0-only OR BSD-2-Clause
%YAML 1.2
---
$id: http://devicetree.org/schemas/net/airoha,an7583-mdio.yaml#
$schema: http://devicetree.org/meta-schemas/core.yaml#

title: Airoha AN7583 Dedicated MDIO Controller

maintainers:
  - Christian Marangi <ansuelsmth@gmail.com>

description:
  Airoha AN7583 SoC have 3 different MDIO Controller.

  One comes from the intergated Switch based on MT7530.

  The other 2 (that this schema describe) live under the SCU
  register supporting both C22 and C45 PHYs.

properties:
  compatible:
    const: airoha,an7583-mdio

  "#address-cells":
    const: 1

  "#size-cells":
    const: 0

patternProperties:
  '^mdio(-(bus|external))@[0-1]$':
    type: object

    $ref: mdio.yaml#

    properties:
      reg:
        minimum: 0
        maximum: 1

      resets:
        maxItems: 1

    required:
      - reg

    unevaluatedProperties: false

required:
  - compatible
  - "#address-cells"
  - "#size-cells"

additionalProperties: false

examples:
  - |
    mdio-controller {
        compatible = "airoha,an7583-mdio";
        #address-cells = <1>;
        #size-cells = <0>;

        mdio-bus@0 {
            reg = <0>;
            #address-cells = <1>;
            #size-cells = <0>;

            ethernet-phy@1f {
                reg = <31>;
            };
        };

        mdio-bus@1 {
            reg = <1>;
            #address-cells = <1>;
            #size-cells = <0>;
        };
    };
```

## Documentation/devicetree/bindings/net/airoha,an8855-mdio.yaml
```yaml
# SPDX-License-Identifier: (GPL-2.0-only OR BSD-2-Clause)
%YAML 1.2
---
$id: http://devicetree.org/schemas/net/airoha,an8855-mdio.yaml#
$schema: http://devicetree.org/meta-schemas/core.yaml#

title: Airoha AN8855 PBUS MDIO

maintainers:
  - Christian Marangi <ansuelsmth@gmail.com>

description:
  Airoha AN8855 Switch expose a way to access internal PHYs via
  Switch register. This is named internally PBUS and does the function
  of an MDIO bus for the internal PHYs.

  It does support a maximum of 5 PHYs (matching the number of port
  the Switch support)

$ref: /schemas/net/mdio.yaml#

properties:
  compatible:
    const: airoha,an8855-mdio

required:
  - compatible

unevaluatedProperties: false

examples:
  - |
    mdio {
        compatible = "airoha,an8855-mdio";
        #address-cells = <1>;
        #size-cells = <0>;

        internal_phy1: phy@1 {
            reg = <1>;
        };

        internal_phy2: phy@2 {
            reg = <2>;
        };

        internal_phy3: phy@3 {
            reg = <3>;
        };

        internal_phy4: phy@4 {
            reg = <4>;
        };

        internal_phy5: phy@5 {
            reg = <5>;
        };
    };
```

## Documentation/devicetree/bindings/net/airoha,en7581-soe.yaml
```yaml
# SPDX-License-Identifier: (GPL-2.0-only OR BSD-2-Clause)
%YAML 1.2
---
$id: http://devicetree.org/schemas/net/airoha,en7581-soe.yaml#
$schema: http://devicetree.org/meta-schemas/core.yaml#

title: Airoha EN7581 Secure Offload Engine

maintainers:
  - Lorenzo Bianconi <lorenzo@kernel.org>

description:
  The Secure Offload Engine provides inline ESP packet offload resources used
  by the Airoha Ethernet controller.

properties:
  compatible:
    const: airoha,en7581-soe

  reg:
    maxItems: 1

  interrupts:
    maxItems: 1

required:
  - compatible
  - reg
  - interrupts

additionalProperties: false

examples:
  - |
    #include <dt-bindings/interrupt-controller/arm-gic.h>
    #include <dt-bindings/interrupt-controller/irq.h>

    soc {
      #address-cells = <2>;
      #size-cells = <2>;

      soe@1fbfa000 {
        compatible = "airoha,en7581-soe";
        reg = <0 0x1fbfa000 0 0x268>;
        interrupts = <GIC_SPI 79 IRQ_TYPE_LEVEL_HIGH>;
      };
    };
...
```

## Documentation/devicetree/bindings/net/airoha,en8811h-mcu.yaml
```yaml
# SPDX-License-Identifier: (GPL-2.0-only OR BSD-2-Clause)
%YAML 1.2
---
$id: http://devicetree.org/schemas/net/airoha,en8811h-mcu.yaml#
$schema: http://devicetree.org/meta-schemas/core.yaml#

title: Airoha EN8811H PHY MCU

maintainers:
  - Aleksei Sviridkin <f@lex.la>

description: |
  The Airoha EN8811H 2.5G PHY is built around an MD32 core that executes
  firmware from volatile RAM. The chip answers an MDIO address from
  power-on, but the PHY function does not exist until firmware has been
  loaded over MDIO, and it disappears again if that RAM is cleared.

  This node describes the MD32 core. The PHY function answers on a child
  MDIO bus below it, at the same address the core occupies on the parent
  bus, and only while firmware is running.

  The reset line is wired to the core, and asserting it clears the
  firmware RAM. It therefore belongs to this node: a reset described on
  the PHY node would be pulsed by that node's own lifecycle, whatever
  the core is doing.

  A board that has firmware in hand while its MDIO bus is enumerated can
  describe the PHY on its own, as airoha,en8811h.yaml does, and that form
  stays valid. This binding is for the boards where firmware arrives
  later, so that there is no PHY to describe until the core has it.

properties:
  $nodename:
    pattern: "^mcu@[0-9a-f]+$"

  compatible:
    const: airoha,en8811h-mcu

  reg:
    maxItems: 1

  reset-gpios:
    maxItems: 1
    description:
      The GPIO phandle and specifier for the reset signal wired to the
      MD32 core.

  reset-assert-us:
    description:
      Delay after the reset was asserted in microseconds. If this
      property is missing the delay will be skipped.

  reset-deassert-us:
    description:
      Delay after the reset was deasserted in microseconds. If this
      property is missing the delay will be skipped.

  mdio:
    $ref: mdio.yaml#
    description:
      The bus the PHY function answers on while firmware is running, at
      the same address this node occupies on the parent bus. Only that
      one address is passed through. The bus-level reset properties
      mdio.yaml allows are refused here, because the MDIO core asserts
      such a line when the bus registers, and that erases the firmware
      this PHY is made of.

    properties:
      reset-gpios: false
      reset-delay-us: false
      reset-post-delay-us: false

    patternProperties:
      '^ethernet-phy@[0-9a-f]+$':
        type: object
        $ref: airoha,en8811h.yaml#
        unevaluatedProperties: false

        properties:
          reset-gpios: false
          reset-assert-us: false
          reset-deassert-us: false
          resets: false
          reset-names: false

        description:
          The reset line belongs to the MCU node above. A reset described
          here would be pulsed by this node's own lifecycle, and that erases
          the firmware that created this PHY.

    unevaluatedProperties: false

required:
  - compatible
  - reg
  - mdio

additionalProperties: false

examples:
  - |
    #include <dt-bindings/gpio/gpio.h>
    #include <dt-bindings/interrupt-controller/irq.h>

    mdio {
        #address-cells = <1>;
        #size-cells = <0>;

        mcu@d {
            compatible = "airoha,en8811h-mcu";
            reg = <0xd>;
            reset-gpios = <&pio 14 GPIO_ACTIVE_LOW>;
            reset-assert-us = <10000>;
            reset-deassert-us = <20000>;

            mdio {
                #address-cells = <1>;
                #size-cells = <0>;

                ethernet-phy@d {
                    compatible = "ethernet-phy-id03a2.a411";
                    reg = <0xd>;
                    interrupts-extended = <&pio 15 IRQ_TYPE_LEVEL_LOW>;
                };
            };
        };
    };
```

## Documentation/devicetree/bindings/net/airoha,en8811h.yaml
```yaml
# SPDX-License-Identifier: (GPL-2.0 OR BSD-2-Clause)
%YAML 1.2
---
$id: http://devicetree.org/schemas/net/airoha,en8811h.yaml#
$schema: http://devicetree.org/meta-schemas/core.yaml#

title: Airoha EN8811H PHY

maintainers:
  - Someone <someone@somemail.com>

description:
  Bindings for Airoha EN8811H PHY

allOf:
  - $ref: ethernet-phy.yaml#

properties:
  airoha,rx-pol-reverse:
    type: boolean
    description:
      Reverse rx polarity of SERDES.


  airoha,tx-pol-reverse:
    type: boolean
    description:
      Reverse tx polarity of SERDES.

unevaluatedProperties: false

examples:
  - |
    mdio {
        #address-cells = <1>;
        #size-cells = <0>;

        ethphy1: ethernet-phy@1 {
                reg = <1>;
                airoha,rx-pol-reverse;
        };
    };
```
