## Documentation/devicetree/bindings/mmc/histb-dw-mshc.yaml
```yaml
# SPDX-License-Identifier: GPL-2.0-only OR BSD-2-Clause
%YAML 1.2
---
$id: http://devicetree.org/schemas/mmc/histb-dw-mshc.yaml#
$schema: http://devicetree.org/meta-schemas/core.yaml#

title:
  Hisilicon HiSTB SoCs specific extensions to the Synopsys DWMMC controller

maintainers:
  - Yang Xiwen <forbidden405@outlook.com>

description:
  The Synopsys designware mobile storage host controller is used to interface
  a SoC with storage medium such as eMMC or SD/MMC cards. This file documents
  differences between the core Synopsys dw mshc controller properties described
  by synopsys-dw-mshc.txt and the properties used by the Hisilicon HiSTB specific
  extensions to the Synopsys Designware Mobile Storage Host Controller.

properties:
  compatible:
    enum:
      - hisilicon,hi3798cv200-dw-mshc
      - hisilicon,hi3798mv200-dw-mshc

  reg:
    maxItems: 1

  interrupts:
    maxItems: 1

  clocks:
    minItems: 4
    maxItems: 4
    description: A list of phandles for the clocks listed in clock-names

  clock-names:
    items:
      - const: ciu
      - const: biu
      - const: ciu-sample
      - const: ciu-drive
    description:
      Apart from the clock-names "biu" and "ciu" two more clocks
      "ciu-drive" and "ciu-sample" are added. They are used to
      control the clock phases, "ciu-sample" is required for tuning
      high speed modes.

  hisilicon,sap-dll-reg:
    $ref: /schemas/types.yaml#/definitions/phandle
    description:
      A phandle points to the sample delay-locked-loop(DLL)
      syscon node, used for tuning.

required:
  - compatible
  - reg
  - interrupts
  - clocks
  - clock-names

allOf:
  - $ref: synopsys-dw-mshc-common.yaml#

  - if:
      properties:
        compatible:
          contains:
            const: hisilicon,hi3798mv200-dw-mshc
    then:
      required:
        - hisilicon,sap-dll-reg

unevaluatedProperties: false

examples:
  - |
    #include <dt-bindings/clock/histb-clock.h>
    #include <dt-bindings/interrupt-controller/arm-gic.h>
    mmc@9830000 {
      compatible = "hisilicon,hi3798cv200-dw-mshc";
      reg = <0x9830000 0x10000>;
      interrupts = <GIC_SPI 35 IRQ_TYPE_LEVEL_HIGH>;
      clocks = <&crg HISTB_MMC_CIU_CLK>,
               <&crg HISTB_MMC_BIU_CLK>,
               <&crg HISTB_MMC_SAMPLE_CLK>,
               <&crg HISTB_MMC_DRV_CLK>;
      clock-names = "ciu", "biu", "ciu-sample", "ciu-drive";
      resets = <&crg 0xa0 4>;
      reset-names = "reset";
      pinctrl-names = "default";
      pinctrl-0 = <&emmc_pins_1 &emmc_pins_2
                   &emmc_pins_3 &emmc_pins_4>;
      fifo-depth = <256>;
      clock-frequency = <200000000>;
      cap-mmc-highspeed;
      mmc-ddr-1_8v;
      mmc-hs200-1_8v;
      non-removable;
      bus-width = <8>;
      status = "okay";
    };
  - |
    #include <dt-bindings/clock/histb-clock.h>
    #include <dt-bindings/interrupt-controller/arm-gic.h>
    mmc@9830000 {
      compatible = "hisilicon,hi3798mv200-dw-mshc";
      reg = <0x9830000 0x10000>;
      interrupts = <GIC_SPI 35 IRQ_TYPE_LEVEL_HIGH>;
      clocks = <&crg HISTB_MMC_CIU_CLK>,
               <&crg HISTB_MMC_BIU_CLK>,
               <&crg HISTB_MMC_SAMPLE_CLK>,
               <&crg HISTB_MMC_DRV_CLK>;
      clock-names = "ciu", "biu", "ciu-sample", "ciu-drive";
      resets = <&crg 0xa0 4>;
      reset-names = "reset";
      pinctrl-names = "default";
      pinctrl-0 = <&emmc_pins>;
      fifo-depth = <256>;
      clock-frequency = <50000000>;
      max-frequency = <150000000>;
      cap-mmc-highspeed;
      mmc-ddr-1_8v;
      mmc-hs200-1_8v;
      mmc-hs400-1_8v;
      non-removable;
      bus-width = <8>;
      hisilicon,sap-dll-reg = <&emmc_sap_dll_reg>;
      status = "okay";
    };
```

## Documentation/devicetree/bindings/mmc/mellanox,bluefield-dw-mshc.yaml
```yaml
# SPDX-License-Identifier: (GPL-2.0-only OR BSD-2-Clause)
%YAML 1.2
---
$id: http://devicetree.org/schemas/mmc/mellanox,bluefield-dw-mshc.yaml#
$schema: http://devicetree.org/meta-schemas/core.yaml#

title: Mellanox BlueField SoC extensions for Synopsys DesignWare MSHC

maintainers:
  - Khalil Blaiech <kblaiech@nvidia.com>

description:
  The Synopsys Designware Mobile Storage Host Controller (MSHC) on Mellanox
  BlueField SoCs is used to interface with storage media such as eMMC or
  SD/MMC cards. This binding documents the BlueField-specific extensions
  and the differences from the core Synopsys DW MSHC schema.

allOf:
  - $ref: synopsys-dw-mshc-common.yaml#

properties:
  compatible:
    const: mellanox,bluefield-dw-mshc

  reg:
    maxItems: 1

  interrupts:
    maxItems: 1

required:
  - compatible
  - reg
  - interrupts

unevaluatedProperties: false

examples:
  - |
    /* Mellanox BlueField SoC MMC */
    mmc@2804000 {
        compatible = "mellanox,bluefield-dw-mshc";
        reg = <0x6008000 0x400>;
        interrupts = <32>;
        fifo-depth = <0x100>;
        clock-frequency = <24000000>;
        bus-width = <8>;
        cap-mmc-highspeed;
    };
```

## Documentation/devicetree/bindings/mmc/mmc-slot.yaml
```yaml
# SPDX-License-Identifier: (GPL-2.0-only OR BSD-2-Clause)
%YAML 1.2
---
$id: http://devicetree.org/schemas/mmc/mmc-slot.yaml#
$schema: http://devicetree.org/meta-schemas/core.yaml#

title: MMC/SD/SDIO slot of a multi-slot controller

maintainers:
  - Ulf Hansson <ulf.hansson@linaro.org>

allOf:
  - $ref: mmc-controller.yaml

properties:
  compatible:
    const: mmc-slot

  reg:
    maxItems: 1

required:
  - compatible
  - reg

unevaluatedProperties: false

examples:
  - |
    mmc-controller {
      #address-cells = <1>;
      #size-cells = <0>;
      slot@0 {
        compatible = "mmc-slot";
        reg = <0>;
        bus-width = <4>;
      };
    };

...
```

## Documentation/devicetree/bindings/mmc/rda,mmc.yaml
```yaml
# SPDX-License-Identifier: (GPL-2.0-only OR BSD-2-Clause)
%YAML 1.2
---
$id: http://devicetree.org/schemas/mmc/rda,mmc.yaml#
$schema: http://devicetree.org/meta-schemas/core.yaml#

title: RDA Micro SD/MMC Controller

allOf:
  - $ref: mmc-controller.yaml

maintainers:
  - Dang Huynh <dang.huynh@mainlining.org>

properties:
  compatible:
    const: rda,8810pl-mmc

  reg:
    maxItems: 1

  interrupts:
    maxItems: 1

  clocks:
    maxItems: 1

  clock-names:
    const: apb

  resets:
    maxItems: 1

  dmas:
    minItems: 2
    maxItems: 2

  dma-names:
    items:
      - const: tx
      - const: rx

  rda,mclk-adj:
    $ref: /schemas/types.yaml#/definitions/uint8
    description:
      Some board need MCLK to be adjusted for the card to work.
      If not present, MCLK will be handled by an external PCLK.
    minimum: 0
    maximum: 255

  rda,mclk-inv:
    $ref: /schemas/types.yaml#/definitions/flag
    description:
      Some board need MCLK to be inverted for the card to work.
      If not present, MCLK is not inverted.

required:
  - compatible
  - reg
  - interrupts
  - clocks
  - clock-names
  - resets
  - dmas
  - dma-names
  - vmmc-supply

unevaluatedProperties: false

examples:
  - |
    #include <dt-bindings/interrupt-controller/arm-gic.h>
    #include <dt-bindings/interrupt-controller/irq.h>
    #include <dt-bindings/clock/rda,8810pl-apclk.h>
    #include <dt-bindings/dma/rda-ifc.h>
    mmc1: mmc@20950000 {
      compatible = "rda,8810pl-mmc";
      reg = <0x20950000 0x1000>;
      interrupts = <3 IRQ_TYPE_LEVEL_HIGH>;
      clocks = <&ap_syscon CLK_APB2>;
      clock-names = "apb";
      resets = <&ap_syscon RST_APB2_SDMMC1>;
      dmas = <&ifc IFC_SDMMC1_TX>, <&ifc IFC_SDMMC1_RX>;
      dma-names = "tx", "rx";
      vmmc-supply = <&vdd_sdmmc>;
      rda,mclk-adj = /bits/ 8 <1>;
      rda,mclk-inv;
      status = "disabled";
    };

...
```

## Documentation/devicetree/bindings/mmc/realtek,rtd-dw-cqe-emmc.yaml
```yaml
# SPDX-License-Identifier: (GPL-2.0-only OR BSD-2-Clause)
%YAML 1.2
---
$id: http://devicetree.org/schemas/mmc/realtek,rtd-dw-cqe-emmc.yaml#
$schema: http://devicetree.org/meta-schemas/core.yaml#

title: Realtek DesignWare mobile storage host controller

description:
  Realtek uses the Synopsys DesignWare mobile storage host controller
  to interface a SoC with storage medium. This file documents the Realtek
  specific extensions.

maintainers:
  - Jyan Chou <jyanchou@realtek.com>

allOf:
  - $ref: synopsys-dw-mshc-common.yaml#

properties:
  compatible:
    enum:
      - realtek,rtd1325-dw-cqe-emmc
      - realtek,rtd1319-dw-cqe-emmc
      - realtek,rtd1315e-dw-cqe-emmc
      - realtek,rtd1619b-dw-cqe-emmc

  reg:
    items:
      - description: emmc base address
      - description: cqhci base address

  reg-names:
    items:
      - const: emmc
      - const: cqhci

  interrupts:
    maxItems: 1

  clocks:
    maxItems: 4

  clock-names:
    items:
      - const: biu
      - const: ciu
      - const: vp0
      - const: vp1

  resets:
    maxItems: 1

  pinctrl-0:
    description:
      should contain default/high speed pin ctrl.
    maxItems: 1

  pinctrl-1:
    description:
      should contain sdr50 pin ctrl.
    maxItems: 1

  pinctrl-2:
    description:
      should contain ddr50 mode pin ctrl.
    maxItems: 1

  pinctrl-3:
    description:
      should contain hs200 speed pin ctrl.
    maxItems: 1

  pinctrl-4:
    description:
      should contain hs400 speed pin ctrl.
    maxItems: 1

  pinctrl-5:
    description:
      should contain tune0 pin ctrl.
    maxItems: 1

  pinctrl-6:
    description:
      should contain tune1 pin ctrl.
    maxItems: 1

  pinctrl-7:
    description:
      should contain tune2 pin ctrl.
    maxItems: 1

  pinctrl-8:
    description:
      should contain tune3 pin ctrl.
    maxItems: 1

  pinctrl-9:
    description:
      should contain tune4 pin ctrl.
    maxItems: 1

  pinctrl-names:
    maxItems: 10

required:
  - compatible
  - reg
  - reg-names
  - interrupts
  - clocks
  - clock-names
  - vmmc-supply
  - pinctrl-names
  - pinctrl-0
  - pinctrl-1
  - pinctrl-3
  - pinctrl-4
  - pinctrl-5
  - pinctrl-6
  - pinctrl-7
  - pinctrl-8
  - pinctrl-9

unevaluatedProperties: false

examples:
  - |
    emmc: mmc@12000 {
      compatible = "realtek,rtd1315e-dw-cqe-emmc";
      reg = <0x00012000 0x00600>,
            <0x00012180 0x00060>;
      reg-names = "emmc", "cqhci";
      interrupts = <0 42 4>;
      clocks = <&cc 22>, <&cc 26>, <&cc 121>, <&cc 122>;
      clock-names = "biu", "ciu", "vp0", "vp1";
      resets = <&rst 20>;
      vmmc-supply = <&reg_vcc1v8>;
      pinctrl-names = "default", "sdr50", "ddr50", "hs200", "hs400",
                      "tune0","tune1", "tune2","tune3", "tune4";
      pinctrl-0 = <&emmc_pins_sdr50>;
      pinctrl-1 = <&emmc_pins_sdr50>;
      pinctrl-2 = <&emmc_pins_ddr50>;
      pinctrl-3 = <&emmc_pins_hs200>;
      pinctrl-4 = <&emmc_pins_hs400>;
      pinctrl-5 = <&emmc_pins_tune0>;
      pinctrl-6 = <&emmc_pins_tune1>;
      pinctrl-7 = <&emmc_pins_tune2>;
      pinctrl-8 = <&emmc_pins_tune3>;
      pinctrl-9 = <&emmc_pins_tune4>;
      supports-cqe;
    };
```

## Documentation/devicetree/bindings/mmc/realtek-dw-mshc.yaml
```yaml
# SPDX-License-Identifier: (GPL-2.0-only OR BSD-2-Clause)
%YAML 1.2
---
$id: http://devicetree.org/schemas/mmc/realtek-dw-mshc.yaml#
$schema: http://devicetree.org/meta-schemas/core.yaml#

title: Realtek designware mobile storage host controller

description:
  Realtek uses the Synopsys designware mobile storage host controller
  to interface a SoC with storage medium. This file documents the Realtek
  specific extensions.

allOf:
  - $ref: synopsys-dw-mshc-common.yaml#

maintainers:
  - Jyan Chou <jyanchou@realtek.com>

properties:
  compatible:
    enum:
      - realtek,rtd-dw-cqe-emmc
  reg:
    maxItems: 2

  reg-names:
    maxItems: 2

  interrupts:
    maxItems: 1

  cqe:
    maxItems: 1

  clocks:
    minItems: 2
    maxItems: 4

  clock-names:
    minItems: 2
    maxItems: 4

  clock-freq-min-max:
    description:
      Clk frequency should be in the interval.

  resets:
    maxItems: 1

  reset-names:
    const: reset

  speed-step:
    maxItems: 1

  pinctrl-0:
    description:
      should contain default/high speed pin ctrl.
    maxItems: 1

  pinctrl-1:
    description:
      should contain sdr50 mode pin ctrl.
    maxItems: 1

  pinctrl-2:
    description:
      should contain ddr50 mode pin ctrl.
    maxItems: 1

  pinctrl-3:
    description:
      should contain hs200 speed pin ctrl.
    maxItems: 1

  pinctrl-4:
    description:
      should contain hs400 speed pin ctrl.
    maxItems: 1

  pinctrl-5:
    description:
      should contain tune0 pin ctrl.
    maxItems: 1

  pinctrl-6:
    description:
      should contain tune1 pin ctrl.
    maxItems: 1

  pinctrl-7:
    description:
      should contain tune2 pin ctrl.
    maxItems: 1

  pinctrl-8:
    description:
      should contain tune3 pin ctrl.
    maxItems: 1

  pinctrl-9:
    description:
      should contain tune4 pin ctrl.
    maxItems: 1

  pinctrl-names:
    maxItems: 10

required:
  - compatible
  - reg
  - reg-names
  - interrupts
  - clocks
  - clock-names
  - pinctrl-names

unevaluatedProperties: false

examples:
  - |
    emmc: mmc@12000 {
        compatible = "realtek,rtd-dw-cqe-emmc";
        reg = <0x00012000 0x00600>,
              <0x00012180 0x00060>;
        reg-names = "emmc", "cqhci";
        interrupts = <0 42 4>;
        clocks = <&cc 22>, <&cc 26>, <&cc 121>, <&cc 122>;
        clock-names = "biu", "ciu", "vp0", "vp1";
        clock-freq-min-max = <300000 400000000>;
        clock-frequency = <400000>;
        vmmc-supply = <&reg_vcc1v8>;
        resets = <&rst 20>;
        reset-names = "reset";
        speed-step = <3>;
        cqe = <1>;
        pinctrl-names = "default", "sdr50", "ddr50", "hs200", "hs400",
                        "tune0", "tune1", "tune2", "tune3", "tune4";
        pinctrl-0 = <&emmc_pins_sdr50>;
        pinctrl-1 = <&emmc_pins_sdr50>;
        pinctrl-2 = <&emmc_pins_ddr50>;
        pinctrl-3 = <&emmc_pins_hs200>;
        pinctrl-4 = <&emmc_pins_hs400>;
        pinctrl-5 = <&emmc_pins_tune0>;
        pinctrl-6 = <&emmc_pins_tune1>;
        pinctrl-7 = <&emmc_pins_tune2>;
        pinctrl-8 = <&emmc_pins_tune3>;
        pinctrl-9 = <&emmc_pins_tune4>;
        };
```
