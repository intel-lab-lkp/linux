## Documentation/devicetree/bindings/mmc/sdhci-omap.yaml
```yaml
# SPDX-License-Identifier: (GPL-2.0-only OR BSD-2-Clause)
%YAML 1.2
---
$id: http://devicetree.org/schemas/mmc/sdhci-omap.yaml#
$schema: http://devicetree.org/meta-schemas/core.yaml#

title: TI OMAP SDHCI Controller

maintainers:
  - Ulf Hansson <ulf.hansson@linaro.org>

description:
  For UHS devices which require tuning, the device tree should have a
  cpu_thermal node which maps to the appropriate thermal zone. This
  is used to get the temperature of the zone during tuning.

allOf:
  - $ref: sdhci-common.yaml#

properties:
  compatible:
    enum:
      - ti,omap2430-sdhci
      - ti,omap3-sdhci
      - ti,omap4-sdhci
      - ti,omap5-sdhci
      - ti,dra7-sdhci
      - ti,k2g-sdhci
      - ti,am335-sdhci
      - ti,am437-sdhci

  reg:
    maxItems: 1

  interrupts:
    maxItems: 1

  pinctrl-names:
    $ref: /schemas/types.yaml#/definitions/string-array
    minItems: 1
    maxItems: 19
    items:
      enum:
        - default
        - default-rev11
        - hs
        - sdr12
        - sdr12-rev11
        - sdr25
        - sdr25-rev11
        - sdr50
        - ddr50-rev11
        - sdr104-rev11
        - ddr50
        - sdr104
        - ddr_1_8v-rev11
        - ddr_1_8v
        - ddr_3_3v
        - hs-rev11
        - hs200_1_8v-rev11
        - hs200_1_8v
        - sleep

  dmas:
    maxItems: 2

  dma-names:
    items:
      - const: tx
      - const: rx

  ti,hwmods:
    $ref: /schemas/types.yaml#/definitions/string
    description:
      This field is used to fetch the information such as
      address range, irq lines, dma lines, interconnect, PRCM register,
      clock domain, input clocks associated with MMC.
    pattern: "^mmc[0-9]+$"

  ti,needs-special-reset:
    description:
      It indicates that a specific soft reset sequence is required for
      certain Texas Instruments devices, particularly those with
      HSMMC (High-Speed MultiMediaCard) controllers.
    type: boolean

  ti,needs-special-hs-handling:
    description:
      It's presence in an MMC controller's DT node signals to the Linux kernel's
      omap_hsmmc driver that this particular IP block requires special software
      handling or workarounds to correctly manage High-Speed (HS) modes like
      SDR25, SDR50, SDR104, DDR50.
    type: boolean

  pbias-supply:
    description:
      It is used to specify the voltage regulator that provides the bias
      voltage for certain analog or I/O pads.

  cap-mmc-dual-data-rate:
    description:
      A characteristic or capability associated with MultiMediaCard (MMC)
      interfaces, specifically indicating that the MMC controller
      supports Dual Data Rate (DDR) mode
    type: boolean

  ti,non-removable:
    description:
      It indicates that a component is not meant to be easily removed or
      replaced by the user, such as an embedded battery or a non-removable
      storage slot like eMMC.
    type: boolean
    deprecated: true

  vmmmc-supply:
    description:
      It is used to specify the power supply (regulator) for the MMC/SD card's
      main operating voltage (VCC/VDD).

  clock-frequency:
    $ref: /schemas/types.yaml#/definitions/uint32
    description:
      It is used to specify the frequency of a clock in Hertz (Hz). It's a
      fundamental property for communicating hardware clocking information from
      the Device Tree to the Linux kernel.

patternProperties:
  "^pinctrl-[0-9]+$":
    $ref: /schemas/types.yaml#/definitions/phandle-array
    description:
      Phandles to pinctrl states. The numeric suffix determines the
      state index corresponding to entries in the pinctrl-names array.
    minItems: 1

required:
  - compatible
  - reg
  - interrupts

unevaluatedProperties: false

examples:
  - |
    #include <dt-bindings/interrupt-controller/arm-gic.h>
    mmc@4809c000 {
        compatible = "ti,omap2430-sdhci";
        reg = <0x4809c000 0x400>;
        interrupts = <GIC_SPI 64 IRQ_TYPE_LEVEL_HIGH>;
        ti,hwmods = "mmc1";
        bus-width = <4>;
        vmmc-supply = <&vmmc>; /* phandle to regulator node */
        dmas = <&sdma 61>, <&sdma 62>;
        dma-names = "tx", "rx";
    };
...
```

## Documentation/devicetree/bindings/mmc/st,sdhci.yaml
```yaml
# SPDX-License-Identifier: (GPL-2.0-only OR BSD-2-Clause)
%YAML 1.2
---
$id: http://devicetree.org/schemas/mmc/st,sdhci.yaml#
$schema: http://devicetree.org/meta-schemas/core.yaml#

title: STMicroelectronics SDHCI-ST MMC/SD Controller

description:
  The STMicroelectronics SDHCI-ST MMC/SD host controller, which is
  compliant with the SD Host Controller Interface (SDHCI) specification and
  is used to interface with MMC, SD and SDIO cards. The ST SDHCI controller
  extends the standard SDHCI capabilities with platform-specific
  configurations such as additional register regions,clock inputs, and delay
  control mechanisms required for signal timing adjustments which are
  necessary to support high-speed modes and ensure reliable data transfer
  across different ST SoCs.

maintainers:
  - Peter Griffin <peter.griffin@linaro.org>

properties:
  compatible:
    oneOf:
      - const: st,sdhci
      - items:
          - const: st,sdhci-stih407
          - const: st,sdhci

  reg:
    minItems: 1
    maxItems: 2

  reg-names:
    minItems: 1
    maxItems: 2
    items:
      enum:
        - mmc
        - top-mmc-delay

  clocks:
    minItems: 1
    maxItems: 2

  clock-names:
    minItems: 1
    maxItems: 2
    items:
      enum:
        - mmc
        - icn

  interrupts:
    maxItems: 1

  interrupt-names:
    const: mmcirq

  pinctrl-names:
    const: default

  resets:
    maxItems: 1
    description: Phandle to reset line of host controller.

  vqmmc-supply:
    description: Regulator supplying I/O voltage (Vcc/Vdd for SD/eMMC).

  non-removable:
    type: boolean
    description:
      Indicates a non-removable device (e.g., eMMC). Also used for mmcss config.

  bus-width:
    description: Number of data lines.
    enum: [1, 4, 8]

  max-frequency:
    enum: [50000000, 100000000, 200000000]
    default: 50000000
    description:
      Maximum bus frequency. Used to configure CCONFIG3 in mmcss.

  sd-uhs-sdr50:
    type: boolean

  sd-uhs-sdr104:
    type: boolean

  sd-uhs-ddr50:
    type: boolean

required:
  - compatible
  - reg
  - clocks
  - clock-names
  - interrupts
  - interrupt-names
  - pinctrl-names

additionalProperties: false

examples:
  - |
    #include <dt-bindings/interrupt-controller/arm-gic.h>
    #include <dt-bindings/clock/stih407-clks.h>
    sdhci@9060000 {
        compatible = "st,sdhci-stih407", "st,sdhci";
        reg = <0x09060000 0x7ff>, <0x9061008 0x20>;
        reg-names = "mmc", "top-mmc-delay";
        interrupts = <GIC_SPI 92 IRQ_TYPE_LEVEL_HIGH>;
        interrupt-names = "mmcirq";
        pinctrl-names = "default";
        pinctrl-0 = <&pinctrl_mmc0>;
        clock-names = "mmc", "icn";
        clocks = <&clk_s_c0_flexgen CLK_MMC_0>,
                 <&clk_s_c0_flexgen CLK_RX_ICN_HVA>;
        bus-width = <8>;
    };
...
```

## Documentation/devicetree/bindings/mmc/starfive,jh7110-mmc.yaml
```yaml
# SPDX-License-Identifier: GPL-2.0-only OR BSD-2-Clause
%YAML 1.2
---
$id: http://devicetree.org/schemas/mmc/starfive,jh7110-mmc.yaml#
$schema: http://devicetree.org/meta-schemas/core.yaml#

title: StarFive Designware Mobile Storage Host Controller

description:
  StarFive uses the Synopsys designware mobile storage host controller
  to interface a SoC with storage medium such as eMMC or SD/MMC cards.

allOf:
  - $ref: synopsys-dw-mshc-common.yaml#

maintainers:
  - William Qiu <william.qiu@starfivetech.com>

properties:
  compatible:
    const: starfive,jh7110-mmc

  reg:
    maxItems: 1

  clocks:
    items:
      - description: biu clock
      - description: ciu clock

  clock-names:
    items:
      - const: biu
      - const: ciu

  interrupts:
    maxItems: 1

required:
  - compatible
  - reg
  - clocks
  - clock-names
  - interrupts

unevaluatedProperties: false

examples:
  - |
    mmc@16010000 {
        compatible = "starfive,jh7110-mmc";
        reg = <0x16010000 0x10000>;
        clocks = <&syscrg 91>,
                 <&syscrg 93>;
        clock-names = "biu","ciu";
        resets = <&syscrg 64>;
        reset-names = "reset";
        interrupts = <74>;
        fifo-depth = <32>;
        fifo-watermark-aligned;
        data-addr = <0>;
    };
```

## Documentation/devicetree/bindings/mmc/ti,omap2420-mmc.yaml
```yaml
# SPDX-License-Identifier: (GPL-2.0-only OR BSD-2-Clause)
%YAML 1.2
---
$id: http://devicetree.org/schemas/mmc/ti,omap2420-mmc.yaml#
$schema: http://devicetree.org/meta-schemas/core.yaml#

title: TI MMC host controller for OMAP1 and 2420

description:
  The MMC Host controller for TI OMAP1 and 2420 family provides
  an interface for MMC, SD and SDIO types of memory cards.

allOf:
  - $ref: mmc-controller.yaml

maintainers:
  - Rob Herring <robh@kernel.org>

properties:
  compatible:
    const: ti,omap2420-mmc

  reg:
    maxItems: 1

  interrupts:
    maxItems: 1

  dmas:
    maxItems: 2

  dma-names:
    items:
      - const: tx
      - const: rx

  ti,hwmods:
    maxItems: 1
    items:
      type: string
      pattern: "^msdi[0-9]+$"

required:
  - compatible
  - reg
  - interrupts
  - dmas
  - dma-names
  - ti,hwmods

unevaluatedProperties: false

examples:
  - |
    #include <dt-bindings/interrupt-controller/irq.h>
    mmc@4809c000 {
        compatible = "ti,omap2420-mmc";
        ti,hwmods = "msdi1";
        reg = <0x4809c000 0x80>;
        interrupts = <83 IRQ_TYPE_LEVEL_HIGH>;
        dmas = <&sdma 61>, <&sdma 62>;
        dma-names = "tx", "rx";
    };
...
```

## Documentation/devicetree/bindings/mmc/ti,omap2430-sdhci.yaml
```yaml
# SPDX-License-Identifier: (GPL-2.0-only OR BSD-2-Clause)
%YAML 1.2
---
$id: http://devicetree.org/schemas/mmc/ti,omap2430-sdhci.yaml#
$schema: http://devicetree.org/meta-schemas/core.yaml#

title: TI OMAP SDHCI Controller

maintainers:
  - Kishon Vijay Abraham I <kishon@ti.com>

description:
  For UHS devices which require tuning, the device tree should have a
  cpu_thermal node which maps to the appropriate thermal zone. This
  is used to get the temperature of the zone during tuning.

allOf:
  - $ref: sdhci-common.yaml#

properties:
  compatible:
    enum:
      - ti,omap2430-sdhci
      - ti,omap3-sdhci
      - ti,omap4-sdhci
      - ti,omap5-sdhci
      - ti,dra7-sdhci
      - ti,k2g-sdhci
      - ti,am335-sdhci
      - ti,am437-sdhci

  reg:
    maxItems: 1

  interrupts:
    maxItems: 1

  pinctrl-names:
    $ref: /schemas/types.yaml#/definitions/string-array
    minItems: 1
    maxItems: 19
    items:
      enum:
        - default
        - default-rev11
        - hs
        - sdr12
        - sdr12-rev11
        - sdr25
        - sdr25-rev11
        - sdr50
        - ddr50-rev11
        - sdr104-rev11
        - ddr50
        - sdr104
        - ddr_1_8v-rev11
        - ddr_1_8v
        - ddr_3_3v
        - hs-rev11
        - hs200_1_8v-rev11
        - hs200_1_8v
        - sleep

  pinctrl-0:
    maxItems: 1

  pinctrl-1:
    maxItems: 1

  pinctrl-2:
    maxItems: 1

  pinctrl-3:
    maxItems: 1

  pinctrl-4:
    maxItems: 1

  pinctrl-5:
    maxItems: 1

  pinctrl-6:
    maxItems: 1

  pinctrl-7:
    maxItems: 1

  pinctrl-8:
    maxItems: 1

  dmas:
    maxItems: 2

  dma-names:
    items:
      - const: tx
      - const: rx

  ti,hwmods:
    $ref: /schemas/types.yaml#/definitions/string
    description:
      This field is used to fetch the information such as
      address range, irq lines, dma lines, interconnect, PRCM register,
      clock domain, input clocks associated with MMC.
    pattern: "^mmc[0-9]+$"

  pbias-supply:
    description:
      It is used to specify the voltage regulator that provides the bias
      voltage for certain analog or I/O pads.

  ti,non-removable:
    description:
      It indicates that a component is not meant to be easily removed or
      replaced by the user, such as an embedded battery or a non-removable
      storage slot like eMMC.
    type: boolean
    deprecated: true

  vmmmc-supply:
    description:
      It is used to specify the power supply (regulator) for the MMC/SD card's
      main operating voltage (VCC/VDD).

  clock-frequency:
    $ref: /schemas/types.yaml#/definitions/uint32
    description:
      It represents the speed at which a clock signal associated with a device
      or bus operates, measured in Hertz (Hz). This value is crucial for configuring
      hardware components that require a specific clock speed.

required:
  - compatible
  - reg
  - interrupts

unevaluatedProperties: false

examples:
  - |
    #include <dt-bindings/interrupt-controller/arm-gic.h>
    mmc@4809c000 {
        compatible = "ti,omap2430-sdhci";
        reg = <0x4809c000 0x400>;
        interrupts = <GIC_SPI 64 IRQ_TYPE_LEVEL_HIGH>;
        ti,hwmods = "mmc1";
        bus-width = <4>;
        vmmc-supply = <&vmmc>; /* phandle to regulator node */
        dmas = <&sdma 61>, <&sdma 62>;
        dma-names = "tx", "rx";
    };
...
```

## Documentation/devicetree/bindings/motion/adi,tmc5240.yaml
```yaml
# SPDX-License-Identifier: (GPL-2.0 OR BSD-2-Clause)
%YAML 1.2
---
$id: http://devicetree.org/schemas/motion/adi,tmc5240.yaml#
$schema: http://devicetree.org/meta-schemas/core.yaml#

title: Analog Devices TMC5240 Stepper Motor controller

maintainers:
  - David Jander <david@protonic>

description: |
   Stepper motor controller with motion engine and SPI interface.

properties:
  compatible:
    enum:
      - adi,tmc5240

  reg:
    maxItems: 1

  interrupts:
    maxItems: 1

  enable-supply:
    description: Optional external enable supply to control SLEEPn pin. Can
      be shared between several controllers.

  clocks:
    maxItems: 1

required:
  - compatible
  - reg
  - interrupts
  - clocks

allOf:
  - $ref: /schemas/spi/spi-peripheral-props.yaml#
  - $ref: /schemas/motion/common.yaml#

unevaluatedProperties: false

examples:
  - |
    spi {
        #address-cells = <1>;
        #size-cells = <0>;

        motor@0 {
            compatible = "adi,tmc5240";
            reg = <0>;
            interrupts-extended = <&gpiok 7 0>;
            clocks = <&clock_tmc5240>;
            enable-supply = <&stpsleepn>;
            spi-max-frequency = <1000000>;
        };
    };
```
