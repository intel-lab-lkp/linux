## Documentation/devicetree/bindings/motion/common.yaml
```yaml
# SPDX-License-Identifier: (GPL-2.0 OR BSD-2-Clause)
%YAML 1.2
---
$id: http://devicetree.org/schemas/motion/common.yaml#
$schema: http://devicetree.org/meta-schemas/core.yaml#

title: Common properties for motion control devices

maintainers:
  - David Jander <david@protonic.nl>

description: |
  This document defines device tree properties common to several motion control
  devices. It doesn't constitute a device tree binding specification by itself but
  is meant to be referenced by device tree bindings.

  When referenced from motion device tree bindings the properties defined in this
  document are defined as follows. The motion device tree bindings are responsible
  for defining whether each property is required or optional.

properties:
  motion,speed-conv-mul:
    $ref: /schemas/types.yaml#/definitions/uint32
    default: 1
    description: |
      Numerator of a fractional representation of a speed conversion factor.
      The speed conversion factor (represented by numerator and denominator)
      is multiplied with the internal speed unit to obtain the physical speed
      unit of the controller. For example, for a stepper motor controller, the
      physical speed unit is microsteps/second (Hz).

  motion,speed-conv-div:
    $ref: /schemas/types.yaml#/definitions/uint32
    default: 1
    description: |
      Denominator of fractional representation of a speed conversion factor.

  motion,acceleration-conv-mul:
    $ref: /schemas/types.yaml#/definitions/uint32
    default: 1
    description: |
      Numerator of a fractional representation of an acceleration conversion
      factor.

  motion,acceleration-conv-div:
    $ref: /schemas/types.yaml#/definitions/uint32
    default: 1
    description: |
      Denominator of fractional representation of an acceleration conversion
      factor.

additionalProperties: true
```

## Documentation/devicetree/bindings/motion/motion-simple-pwm.yaml
```yaml
# SPDX-License-Identifier: (GPL-2.0 OR BSD-2-Clause)
%YAML 1.2
---
$id: http://devicetree.org/schemas/motion/motion-simple-pwm.yaml#
$schema: http://devicetree.org/meta-schemas/core.yaml#

title: Simple PWM based motor controller

maintainers:
  - David Jander <david@protonic>

description: |
   Simple motor control device based on 1 or 2 PWM outputs

properties:
  compatible:
    enum:
      - motion-simple-pwm

  pwms:
    maxItems: 2

  pwm-names:
    maxItems: 2

  motion,pwm-inverted:
    $ref: /schemas/types.yaml#/definitions/flag
    description:
      If present, this flag indicates that the PWM signal should be inverted.
      The duty-cycle will be scaled from 100% down to 0% instead 0% to 100%.

required:
  - compatible
  - pwms

allOf:
  - $ref: /schemas/motion/common.yaml#

unevaluatedProperties: false

examples:
  - |
    // This example shows how to use the TI DRV8873 or similar motor controllers
    // with this driver
    motion-simple-pwm0 {
      compatible = "motion-simple-pwm";
      pwms = <&hpdcm0_pwm 0 50000 0>,
             <&hpdcm0_pwm 1 50000 0>;
      pwm-names = "left", "right";
      motion,pwm-inverted;
      motion,speed-conv-mul = <3600>;
      motion,speed-conv-div = <100000>;
      motion,acceleration-conv-mul = <3600>;
      motion,acceleration-conv-div = <100000>;
    };
```

## Documentation/devicetree/bindings/mtd/atmel-nand.yaml
```yaml
# SPDX-License-Identifier: (GPL-2.0 OR BSD-2-Clause)
%YAML 1.2
---
$id: http://devicetree.org/schemas/mtd/atmel-nand.yaml#
$schema: http://devicetree.org/meta-schemas/core.yaml#

title: Atmel NAND flash controller

maintainers:
  - Balamanikandan Gunasundar <balamanikandan.gunasundar@microchip.com>

description:
  Atmel nand flash controller. These are legacy bindings and
  deprecated. Find the latest in microchip,nand-controller.yaml

properties:
  $nodename:
    pattern: "^nand(@.*)?"

  compatible:
    enum:
      - atmel,at91rm9200-nand
      - atmel,sama5d2-nand
      - atmel,sama5d4-nand

  reg:
    description:
      The localbus address and size used for the chip, and hardware ECC
      controller if available. If the hardware ECC is PMECC, it should
      contain address and size for PMECC and PMECC Error Location
      controller. The PMECC lookup table address and size in ROM is
      optional. If not specified, driver will build it in runtime.

  nand-on-flash-bbt:
    description:
      enable on flash bbt option if not present false
    $ref: /schemas/types.yaml#/definitions/flag

  nand-ecc-mode:
    description:
      operation mode of the NAND ecc
    enum:
      [none, soft, hw, hw_syndrome, hw_oob_first, soft_bch]
    default: soft
    $ref: /schemas/types.yaml#/definitions/string

  nand-bus-width:
    description:
      nand bus width
    enum:
      [8, 16]
    default: 8
    $ref: /schemas/types.yaml#/definitions/uint32

  '#address-cells':
    const: 1

  '#size-cells':
    const: 1

  gpios:
    minItems: 2
    items:
      - description: Ready/Busy
      - description: Chip Enable
      - description: Optional Card detect GPIO; can be 0 if unused

  atmel,nand-addr-offset:
    description:
      offset for the address latch.
    $ref: /schemas/types.yaml#/definitions/uint32
    minimum: 0
    maximum: 31

  atmel,nand-cmd-offset:
    description:
      offset for the command latch.
    $ref: /schemas/types.yaml#/definitions/uint32
    minimum: 0
    maximum: 31

  atmel,nand-has-dma:
    description:
      support dma transfer for nand read/write.
    $ref: /schemas/types.yaml#/definitions/flag

  atmel,has-pmecc:
    description:
      enable Programmable Multibit ECC hardware, capable of BCH encoding
      and decoding, on devices where it is present.
    $ref: /schemas/types.yaml#/definitions/flag

  atmel,pmecc-cap:
    description:
      error correct capability for Programmable Multibit ECC Controller.
    enum:
      [2, 4, 8, 12, 24, 32]
    $ref: /schemas/types.yaml#/definitions/uint32

  atmel,pmecc-sector-size:
    description:
      sector size for ECC computation.
    enum:
      [512, 1024]
    default: 512
    $ref: /schemas/types.yaml#/definitions/uint32


  atmel,pmecc-lookup-table-offset:
    description:
      Two offsets of lookup table in ROM for different sector size. First
      one is for sector size 512, the next is for sector size 1024. If not
      specified, driver will build the table in runtime.
    $ref: /schemas/types.yaml#/definitions/uint32-array
    default: 512

required:
  - compatible
  - reg
  - atmel,nand-addr-offset
  - atmel,nand-cmd-offset
  - "#address-cells"
  - "#size-cells"

unevaluatedProperties: false

examples:
  - |
    nand@40000000 {
        compatible = "atmel,at91rm9200-nand";
        #address-cells = <1>;
        #size-cells = <1>;
        reg = <0x40000000 0x10000000
               0xffffe800 0x200>;
        atmel,nand-addr-offset = <21>;	/* ale */
        atmel,nand-cmd-offset = <22>;	/* cle */
        nand-on-flash-bbt;
        nand-ecc-mode = "soft";
        gpios = <&pioC 13 0	/* rdy */
                 &pioC 14 0     /* nce */
                 0		/* cd */
                >;
    };
  - |
    /* for PMECC supported chips */
    nand@40000000 {
        compatible = "atmel,at91rm9200-nand";
        #address-cells = <1>;
        #size-cells = <1>;
        reg = <0x40000000 0x10000000	/* bus addr & size */
               0xffffe000 0x00000600	/* PMECC addr & size */
               0xffffe600 0x00000200	/* PMECC ERRLOC addr & size */
               0x00100000 0x00100000>;	/* ROM addr & size */

        atmel,nand-addr-offset = <21>;	/* ale */
        atmel,nand-cmd-offset = <22>;	/* cle */
        nand-on-flash-bbt;
        nand-ecc-mode = "hw";
        atmel,has-pmecc;	/* enable PMECC */
        atmel,pmecc-cap = <2>;
        atmel,pmecc-sector-size = <512>;
        atmel,pmecc-lookup-table-offset = <0x8000 0x10000>;
        gpios = <&pioD 5 0	/* rdy */
                 &pioD 4 0	/* nce */
                 0		/* cd */
                >;
    };
```

## Documentation/devicetree/bindings/mtd/cadence,nand.yaml
```yaml
# SPDX-License-Identifier: GPL-2.0-only OR BSD-2-Clause
%YAML 1.2
---
$id: http://devicetree.org/schemas/mtd/cadence,nand.yaml#
$schema: http://devicetree.org/meta-schemas/core.yaml#

title: Cadence NAND controller

maintainers:
  - Niravkumar L Rabara <niravkumar.l.rabara@intel.com>

allOf:
  - $ref: nand-controller.yaml

properties:
  compatible:
    items:
      - const: cdns,hp-nfc

  reg:
    items:
      - description: Address and length of the controller register set
      - description: Address and length of the Slave DMA data port

  reg-names:
    items:
      - const: reg
      - const: sdma

  interrupts:
    maxItems: 1

  clocks:
    maxItems: 1

  dmas:
    maxItems: 1

  cdns,board-delay-ps:
    description: |
      Estimated Board delay. The value includes the total round trip
      delay for the signals and is used for deciding on values associated
      with data read capture. The example formula for SDR mode is the
      following.
      board delay = RE#PAD delay + PCB trace to device + PCB trace from device
      + DQ PAD delay

required:
  - compatible
  - reg
  - reg-names
  - interrupts
  - clocks

unevaluatedProperties: false

examples:
  - |
      nand-controller@10b80000 {
        compatible = "cdns,hp-nfc";
        reg = <0x10b80000 0x10000>,
            <0x10840000 0x10000>;
        reg-names = "reg", "sdma";
        #address-cells = <1>;
        #size-cells = <0>;
        interrupts = <0 97 4>;
        clocks = <&nf_clk>;
        cdns,board-delay-ps = <4830>;

        nand@0 {
            reg = <0>;
        };
      };
```

## Documentation/devicetree/bindings/mtd/fsl,elbc-fcm-nand.yaml
```yaml
# SPDX-License-Identifier: (GPL-2.0-only OR BSD-2-Clause)
%YAML 1.2
---
$id: http://devicetree.org/schemas/mtd/fsl,elbc-fcm-nand.yaml#
$schema: http://devicetree.org/meta-schemas/core.yaml#

title: NAND flash attached to Freescale eLBC

maintainers:
  - J. Neuschäfer <j.ne@posteo.net>

allOf:
  - $ref: nand-chip.yaml#

properties:
  compatible:
    oneOf:
      - items:
          - enum:
              - fsl,mpc8313-fcm-nand
              - fsl,mpc8315-fcm-nand
              - fsl,mpc8377-fcm-nand
              - fsl,mpc8378-fcm-nand
              - fsl,mpc8379-fcm-nand
              - fsl,mpc8536-fcm-nand
              - fsl,mpc8569-fcm-nand
              - fsl,mpc8572-fcm-nand
              - fsl,p1020-fcm-nand
              - fsl,p1021-fcm-nand
              - fsl,p1025-fcm-nand
              - fsl,p2020-fcm-nand
          - const: fsl,elbc-fcm-nand
      - const: fsl,elbc-fcm-nand

  reg:
    maxItems: 1

  "#address-cells": true

  "#size-cells": true

required:
  - compatible
  - reg

additionalProperties: false

examples:
  - |
    localbus {
        #address-cells = <2>;
        #size-cells = <1>;

        nand@1,0 {
            #address-cells = <1>;
            #size-cells = <1>;
            compatible = "fsl,mpc8315-fcm-nand",
                         "fsl,elbc-fcm-nand";
            reg = <0x1 0x0 0x2000>;
        };
    };
```

## Documentation/devicetree/bindings/mtd/hisilicon,504-nfc.yaml
```yaml
# SPDX-License-Identifier: (GPL-2.0-only OR BSD-2-Clause)
%YAML 1.2
---
$id: http://devicetree.org/schemas/mtd/hisilicon,504-nfc.yaml#
$schema: http://devicetree.org/meta-schemas/core.yaml#

title: HiSilicon Hip04 NAND Flash Controller

maintainers:
  - Miquel Raynal <miquel.raynal@bootlin.com>
  - Richard Weinberger <richard@nod.at>

description:
  The HiSilicon 504 NFC is a NAND flash memory controller used in the
  Hip04 SoC. It supports hardware ECC for NAND devices and provides
  register and buffer regions for NAND operations.

allOf:
  - $ref: nand-controller.yaml#

properties:
  compatible:
    const: hisilicon,504-nfc

  reg:
    minItems: 2
    maxItems: 2

  interrupts:
    maxItems: 1

  nand-bus-width:
    enum: [8, 16]

  nand-ecc-mode:
    enum:
      - none
      - hw

  nand-ecc-strength:
    const: 16

  nand-ecc-step-size:
    const: 1024

  "#address-cells":
    const: 1

  "#size-cells":
    const: 0

  partitions:
    $ref: /schemas/mtd/partitions/fixed-partitions.yaml#

required:
  - compatible
  - reg
  - interrupts
  - nand-bus-width
  - nand-ecc-mode
  - "#address-cells"
  - "#size-cells"

unevaluatedProperties: false

examples:
  - |
    nand-controller@4020000 {
        compatible = "hisilicon,504-nfc";
        reg = <0x04020000 0x10000>, <0x05000000 0x1000>;
        interrupts = <0 379 4>;
        nand-bus-width = <8>;
        nand-ecc-mode = "hw";
        nand-ecc-strength = <16>;
        nand-ecc-step-size = <1024>;
        #address-cells = <1>;
        #size-cells = <0>;

        partitions {
             compatible = "fixed-partitions";
             #address-cells = <1>;
             #size-cells = <1>;

             partition@0 {
                 label = "nand_text";
                 reg = <0x0 0x400000>;
            };
        };
    };
...
```

## Documentation/devicetree/bindings/mtd/loongson,ls1b-nand-controller.yaml
```yaml
# SPDX-License-Identifier: (GPL-2.0-only OR BSD-2-Clause)
%YAML 1.2
---
$id: http://devicetree.org/schemas/mtd/loongson,ls1b-nand-controller.yaml#
$schema: http://devicetree.org/meta-schemas/core.yaml#

title: Loongson-1 NAND Controller

maintainers:
  - Keguang Zhang <keguang.zhang@gmail.com>

description:
  The Loongson-1 NAND controller abstracts all supported operations,
  meaning it does not support low-level access to raw NAND flash chips.
  Moreover, the controller is paired with the DMA engine to perform
  READ and PROGRAM functions.

allOf:
  - $ref: nand-controller.yaml

properties:
  compatible:
    oneOf:
      - enum:
          - loongson,ls1b-nand-controller
          - loongson,ls1c-nand-controller
      - items:
          - enum:
              - loongson,ls1a-nand-controller
          - const: loongson,ls1b-nand-controller

  reg:
    maxItems: 1

  dmas:
    maxItems: 1

  dma-names:
    const: rxtx

patternProperties:
  "^nand@[0-3]$":
    type: object
    $ref: raw-nand-chip.yaml

    required:
      - nand-use-soft-ecc-engine
      - nand-ecc-algo

    unevaluatedProperties: false

required:
  - compatible
  - reg
  - dmas
  - dma-names

unevaluatedProperties: false

examples:
  - |
    nand-controller@1fe78000 {
        compatible = "loongson,ls1b-nand-controller";
        reg = <0x1fe78000 0x40>;
        dmas = <&dma 0>;
        dma-names = "rxtx";
        #address-cells = <1>;
        #size-cells = <0>;

        nand@0 {
            reg = <0>;
            nand-use-soft-ecc-engine;
            nand-ecc-algo = "hamming";
        };
    };
```

## Documentation/devicetree/bindings/mtd/microchip,mchp23k256.yaml
```yaml
# SPDX-License-Identifier: (GPL-2.0-only OR BSD-2-Clause)
%YAML 1.2
---
$id: http://devicetree.org/schemas/mtd/microchip,mchp23k256.yaml#
$schema: http://devicetree.org/meta-schemas/core.yaml#

title: Microchip 23K256 (and similar) SPI SRAM MTD driver

maintainers:
  - Richard Weinberger <richard@nod.at>

description: |
  Driver for Microchip 23K256 and compatible (e.g. 23LCV1024) serial SRAM devices
  accessed via SPI. The device exposes the SRAM as an MTD device and supports
  optional partitioning via child nodes.

allOf:
  - $ref: /schemas/spi/spi-peripheral-props.yaml#

properties:
  compatible:
    enum:
      - microchip,mchp23k256
      - microchip,mchp23lcv1024

  reg:
    maxItems: 1

  "#address-cells":
    const: 1

  "#size-cells":
    const: 1

required:
  - reg
  - compatible
  - "#address-cells"
  - "#size-cells"
  - spi-max-frequency

unevaluatedProperties: false

examples:
  - |
    spi {
        #address-cells = <1>;
        #size-cells = <0>;

        sram@0 {
            #address-cells = <1>;
            #size-cells = <1>;
            compatible = "microchip,mchp23k256";
            reg = <0>;
            spi-max-frequency = <20000000>;
        };
    };
...
```
