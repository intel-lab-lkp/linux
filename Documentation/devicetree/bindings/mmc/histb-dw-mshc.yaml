## Documentation/devicetree/bindings/mtd/microchip,nand-controller.yaml
```yaml
# SPDX-License-Identifier: (GPL-2.0 OR BSD-2-Clause)
%YAML 1.2
---
$id: http://devicetree.org/schemas/mtd/microchip,nand-controller.yaml#
$schema: http://devicetree.org/meta-schemas/core.yaml#

title: Microchip NAND flash controller

maintainers:
  - Balamanikandan Gunasundar <balamanikandan.gunasundar@microchip.com>

description: |
  The NAND flash controller node should be defined under the EBI bus (see
  Documentation/devicetree/bindings/memory-controllers/atmel,ebi.txt).
  One or several NAND devices can be defined under this NAND controller.
  The NAND controller might be connected to an ECC engine.

properties:
  compatible:
    enum:
      - atmel,at91rm9200-nand-controller
      - atmel,at91sam9260-nand-controller
      - atmel,at91sam9261-nand-controller
      - atmel,at91sam9g45-nand-controller
      - atmel,sama5d3-nand-controller
      - microchip,sam9x60-nand-controller

  ranges:
    description: empty ranges property to forward EBI ranges definitions.

  ecc-engine:
    description:
      phandle to the PMECC block. Only meaningful if the SoC embeds a PMECC
      engine. Refer microchip,pmecc.yaml

  "#address-cells":
    const: 2

  "#size-cells":
    const: 1

  atmel,nfc-io:
    $ref: /schemas/types.yaml#/definitions/phandle
    description: phandle to the NFC IO block. Only applicable for atmel,sama5d3-nand-controller

  atmel,nfc-sram:
    $ref: /schemas/types.yaml#/definitions/phandle
    description: phandle to the NFC SRAM block. Only applicable for atmel,sama5d3-nand-controller

required:
  - compatible
  - ranges
  - "#address-cells"
  - "#size-cells"

patternProperties:
  "^nand@[a-f0-9]$":
    type: object
    $ref: raw-nand-chip.yaml#
    description:
      NAND chip bindings.

    additionalProperties: false

    properties:
      reg:
        items:
          - items:
              - description: describes the CS lines assigned to the NAND device.
              - description: the base offset of the memory region assigned to this device (always 0)
              - description: the memory region size (always 0x800000)
      rb-gpios:
        description:
          the GPIO(s) used to check the Ready/Busy status of the NAND.

      cs-gpios:
        description:
          the GPIO(s) used to control the CS line.

      det-gpios:
        description:
          the GPIO used to detect if a Smartmedia Card is present.

      atmel,rb:
        description: |
          an integer identifying the native Ready/Busy pin.
        $ref: /schemas/types.yaml#/definitions/uint32

      nand-ecc-step-size:
        const: 512

      nand-ecc-strength:
        enum: [2, 4, 8]

      nand-ecc-mode:
        enum: [soft, hw]

      nand-bus-width:
        const: 8

      nand-on-flash-bbt: true

      partitions:
        $ref: /schemas/mtd/partitions/partitions.yaml

      label:
        description: Name or Label of the device

    allOf:
      - if:
          properties:
            compatible:
              contains:
                const: atmel,sama5d3-nand-controller
        then:
          properties:
            "atmel,rb":
              description: an integer identifying the native Ready/Busy pin.

unevaluatedProperties: false

examples:
  - |
    nfc_io: nfc-io@70000000 {
        compatible = "atmel,sama5d3-nfc-io", "syscon";
        reg = <0x70000000 0x8000000>;
    };

    nfc_sram: sram@200000 {
        compatible = "mmio-sram";
        no-memory-wc;
        reg = <0x200000 0x2400>;
        #address-cells = <1>;
        #size-cells = <1>;
        ranges = <0 0x200000 0x2400>;
    };

    ebi@10000000 {
        compatible = "atmel,sama5d3-ebi";
        #address-cells = <2>;
        #size-cells = <1>;
        atmel,smc = <&hsmc>;
        reg = <0x10000000 0x10000000
               0x40000000 0x30000000>;
        ranges = <0x0 0x0 0x10000000 0x10000000
                  0x1 0x0 0x40000000 0x10000000
                  0x2 0x0 0x50000000 0x10000000
                  0x3 0x0 0x60000000 0x10000000>;
        clocks = <&mck>;

        nand_controller: nand-controller {
            compatible = "atmel,sama5d3-nand-controller";
            atmel,nfc-sram = <&nfc_sram>;
            atmel,nfc-io = <&nfc_io>;
            ecc-engine = <&pmecc>;
            #address-cells = <2>;
            #size-cells = <1>;
            ranges;

            nand@3 {
                reg = <0x3 0x0 0x800000>;
                atmel,rb = <0>;
                /*
                 * Put generic NAND/MTD properties and
                 * subnodes here.
                 */
            };
        };
    };
```

## Documentation/devicetree/bindings/mtd/microchip,pmecc.yaml
```yaml
# SPDX-License-Identifier: (GPL-2.0 OR BSD-2-Clause)
%YAML 1.2
---
$id: http://devicetree.org/schemas/mtd/microchip,pmecc.yaml#
$schema: http://devicetree.org/meta-schemas/core.yaml#

title: Microchip pmecc controller

maintainers:
  - Balamanikandan Gunasundar <balamanikandan.gunasundar@microchip.com>

description:
  Bindings for microchip Programmable Multibit Error Correction Code
  Controller (PMECC). pmecc is a programmable BCH encoder/decoder. This
  block is passed as the value to the "ecc-engine" property of microchip
  nand flash controller node.

properties:
  compatible:
    oneOf:
      - enum:
          - atmel,at91sam9g45-pmecc
          - atmel,sama5d2-pmecc
          - atmel,sama5d4-pmecc
      - items:
          - enum:
              - microchip,sam9x7-pmecc
              - microchip,sam9x60-pmecc
          - const: atmel,at91sam9g45-pmecc

  reg:
    items:
      - description: PMECC controller registers
      - description: PMECC_ERRLOC controller

  clocks:
    maxItems: 1

required:
  - compatible
  - reg

allOf:
  - if:
      properties:
        compatible:
          contains:
            const: microchip,sam9x7-pmecc
    then:
      required:
        - clocks

unevaluatedProperties: false

examples:
  - |
    ecc-engine@ffffc070 {
        compatible = "microchip,sam9x7-pmecc", "atmel,at91sam9g45-pmecc";
        reg = <0xffffe000 0x300>,
              <0xffffe600 0x100>;
        clocks = <&pmc 2 48>;
    };
```

## Documentation/devicetree/bindings/mtd/nand-macronix.yaml
```yaml
# SPDX-License-Identifier: GPL-2.0-only OR BSD-2-Clause
%YAML 1.2
---
$id: http://devicetree.org/schemas/mtd/nand-macronix.yaml#
$schema: http://devicetree.org/meta-schemas/core.yaml#

title: Macronix NAND Randomizer OTP Enable Property

maintainers:
  - Miquel Raynal <miquel.raynal@bootlin.com>
  - Richard Weinberger <richard@nod.at>

description:
  Macronix NAND chips support an optional one-time programmable (OTP)
  data randomizer that scrambles user data to improve reliability.
  Enabling it is irreversible, prohibits subpage accesses, and slightly
  increases program time. This property requests the driver to enable
  the randomizer if not already set.

properties:
  mxic,enable-randomizer-otp:
    type: boolean
    description:
      Presence of this property indicates that the data randomizer should
      be enabled in OTP mode on the NAND chip.

unevaluatedProperties: false

examples:
  - |
    nand-controller {
        #address-cells = <1>;
        #size-cells = <0>;

        nand@0 {
            reg = <0>;
            mxic,enable-randomizer-otp;
        };
    };

...
```

## Documentation/devicetree/bindings/mtd/nvidia,tegra20-nand.yaml
```yaml
# SPDX-License-Identifier: (GPL-2.0-only OR BSD-2-Clause)
%YAML 1.2
---
$id: http://devicetree.org/schemas/mtd/nvidia,tegra20-nand.yaml#
$schema: http://devicetree.org/meta-schemas/core.yaml#

title: NVIDIA Tegra NAND Flash Controller

maintainers:
  - Jonathan Hunter <jonathanh@nvidia.com>

description:
  Device tree bindings for the NVIDIA Tegra NAND Flash Controller (NFC).
  The controller supports a single NAND chip with specific properties.

properties:
  compatible:
    const: nvidia,tegra20-nand

  reg:
    maxItems: 1

  interrupts:
    maxItems: 1

  clocks:
    maxItems: 1

  clock-names:
    items:
      - const: nand

  resets:
    maxItems: 1

  reset-names:
    items:
      - const: nand

  '#address-cells':
    const: 1

  '#size-cells':
    const: 0

  power-domains:
    maxItems: 1

  operating-points-v2:
    maxItems: 1

patternProperties:
  "^nand@[0-5]$":
    type: object
    description: Individual NAND chip connected to the NAND controller
    properties:
      reg:
        maxItems: 1

      nand-ecc-mode:
        description:
          Operation mode of the NAND ECC, currently only hardware
          mode supported
        const: hw

      nand-ecc-algo:
        description: Algorithm for NAND ECC when using hw ECC mode
        enum:
          - rs
          - bch

      nand-bus-width:
        description: Width of the NAND flash bus in bits
        enum: [8, 16]
        default: 8

      nand-on-flash-bbt:
        description: Use an on-flash bad block table to track bad blocks
        type: boolean

      nand-ecc-maximize:
        description:
          Maximize ECC strength for the NAND chip, overriding
          default strength selection
        type: boolean

      nand-ecc-strength:
        description: Number of bits to correct per ECC step (512 bytes)
        enum: [4, 6, 8, 14, 16]

      nand-is-boot-medium:
        description: Ensures ECC strengths are compatible with the boot ROM
        type: boolean

      wp-gpios:
        description: GPIO specifier for the write protect pin
        maxItems: 1

      '#address-cells':
        const: 1

      '#size-cells':
        const: 1

    patternProperties:
      "^partition@[0-9a-f]+$":
        $ref: /schemas/mtd/mtd.yaml#
        description:
          Optional MTD partitions for the NAND chip, as defined in mtd.yaml

    required:
      - reg

    unevaluatedProperties: false

required:
  - compatible
  - reg
  - interrupts
  - clocks
  - clock-names
  - resets
  - reset-names
  - '#address-cells'
  - '#size-cells'

unevaluatedProperties: false

examples:
  - |
    #include <dt-bindings/interrupt-controller/arm-gic.h>
    #include <dt-bindings/clock/tegra20-car.h>
    #include <dt-bindings/gpio/tegra-gpio.h>

    nand-controller@70008000 {
        compatible = "nvidia,tegra20-nand";
        reg = <0x70008000 0x100>;
        interrupts = <GIC_SPI 24 IRQ_TYPE_LEVEL_HIGH>;
        clocks = <&tegra_car TEGRA20_CLK_NDFLASH>;
        clock-names = "nand";
        resets = <&tegra_car 13>;
        reset-names = "nand";
        #address-cells = <1>;
        #size-cells = <0>;

        nand@0 {
            reg = <0>;
            #address-cells = <1>;
            #size-cells = <1>;
            nand-bus-width = <8>;
            nand-on-flash-bbt;
            nand-ecc-algo = "bch";
            nand-ecc-strength = <8>;
            wp-gpios = <&gpio TEGRA_GPIO(S, 0) GPIO_ACTIVE_LOW>;
        };
    };
...
```

## Documentation/devicetree/bindings/mtd/nxp,lpc3220-mlc.yaml
```yaml
# SPDX-License-Identifier: (GPL-2.0-only OR BSD-2-Clause)
%YAML 1.2
---
$id: http://devicetree.org/schemas/mtd/nxp,lpc3220-mlc.yaml#
$schema: http://devicetree.org/meta-schemas/core.yaml#

title: NXP LPC32xx SoC NAND MLC controller

maintainers:
  - Frank Li <Frank.Li@nxp.com>

properties:
  compatible:
    const: nxp,lpc3220-mlc

  reg:
    maxItems: 1

  interrupts:
    maxItems: 1

  gpios:
    maxItems: 1
    description: GPIO specification for NAND write protect

  nxp,tcea-delay:
    $ref: /schemas/types.yaml#/definitions/uint32
    description: TCEA_DELAY in Hz

  nxp,busy-delay:
    $ref: /schemas/types.yaml#/definitions/uint32
    description: BUSY_DELAY in Hz

  nxp,nand-ta:
    $ref: /schemas/types.yaml#/definitions/uint32
    description: NAND_TA in Hz

  nxp,rd-high:
    $ref: /schemas/types.yaml#/definitions/uint32
    description: RD_HIGH in Hz

  nxp,rd-low:
    $ref: /schemas/types.yaml#/definitions/uint32
    description: RD_LOW in Hz

  nxp,wr-high:
    $ref: /schemas/types.yaml#/definitions/uint32
    description: WR_HIGH in Hz

  nxp,wr-low:
    $ref: /schemas/types.yaml#/definitions/uint32
    description: WR_LOW in Hz

required:
  - compatible
  - reg
  - interrupts
  - gpios

allOf:
  - $ref: nand-controller.yaml

unevaluatedProperties: false

examples:
  - |
    nand-controller@200a8000 {
        compatible = "nxp,lpc3220-mlc";
        reg = <0x200A8000 0x11000>;
        interrupts = <11 0>;
        #address-cells = <1>;
        #size-cells = <0>;
        nxp,tcea-delay = <333333333>;
        nxp,busy-delay = <10000000>;
        nxp,nand-ta = <18181818>;
        nxp,rd-high = <31250000>;
        nxp,rd-low = <45454545>;
        nxp,wr-high = <40000000>;
        nxp,wr-low = <83333333>;
        gpios = <&gpio 5 19 1>; /* GPO_P3 19, active low */
    };
```
