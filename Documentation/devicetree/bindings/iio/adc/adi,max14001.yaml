## Documentation/devicetree/bindings/iio/adc/adi,max14001.yaml
```yaml
# SPDX-License-Identifier: (GPL-2.0 OR BSD-2-Clause)
# Copyright 2023-2025 Analog Devices Inc.
# Copyright 2023 Kim Seer Paller
# Copyright 2025 Marilene Andrade Garcia
%YAML 1.2
---
$id: http://devicetree.org/schemas/iio/adc/adi,max14001.yaml#
$schema: http://devicetree.org/meta-schemas/core.yaml#

title: Analog Devices MAX14001-MAX14002 ADC

maintainers:
  - Kim Seer Paller <kimseer.paller@analog.com>
  - Marilene Andrade Garcia <marilene.agarcia@gmail.com>

description: |
    Single channel 10 bit ADC with SPI interface.
    Datasheet can be found here
      https://www.analog.com/media/en/technical-documentation/data-sheets/MAX14001-MAX14002.pdf

$ref: /schemas/spi/spi-peripheral-props.yaml#

properties:
  compatible:
    enum:
      - adi,max14001
      - adi,max14002

  reg:
    maxItems: 1

  spi-max-frequency:
    maximum: 5000000

  vdd-supply:
    description:
      Isolated DC-DC power supply input voltage.

  vddl-supply:
    description:
      Logic power supply.

  vrefin-supply:
    description:
      ADC voltage reference supply.

  interrupts:
    items:
      - description: |
          Interrupt for signaling when conversion results exceed the configured
          upper threshold for ADC readings or fall below the lower threshold for
          them. Interrupt source must be attached to COUT pin.
      - description: |
          Alert output that asserts low during a number of different error
          conditions. The interrupt source must be attached to FAULT pin.

required:
  - compatible
  - reg
  - vdd-supply
  - vddl-supply

unevaluatedProperties: false

examples:
  - |
    spi {
      #address-cells = <1>;
      #size-cells = <0>;

      max14001: adc@0 {
        compatible = "adi,max14001";
        reg = <0>;
        spi-max-frequency = <5000000>;
        vdd-supply = <&vdd>;
        vddl-supply = <&vddl>;
      };
    };
...
```

## Documentation/devicetree/bindings/iio/adc/avia-hx711.yaml
```yaml
# SPDX-License-Identifier: GPL-2.0
%YAML 1.2
---
$id: http://devicetree.org/schemas/iio/adc/avia-hx711.yaml#
$schema: http://devicetree.org/meta-schemas/core.yaml#

title: AVIA HX711 and HX710B ADCs

maintainers:
  - Andreas Klinger <ak@it-klinger.de>

description: |
  Bit-banging driver using two GPIOs:
  - sck-gpio gives a clock to the sensor with 24 cycles for data retrieval
    and 1 to 3 additional cycles for selection of the input channel and gain
    for the next measurement
  - dout-gpio is the sensor data output the sensor drives in response to
    the clock

  HX711: 24-bit ADC with selectable gain (32/64/128) and two differential
  input channels. Channel A supports gain 64 and 128; channel B supports
  gain 32.

  HX710B: 24-bit ADC with fixed gain of 128. Channel 0 is the differential
  input and channel 1 measures the DVDD-AVDD supply voltage difference.
  Channel selection for the next conversion is controlled by the number of
  trailing PD_SCK pulses.

  Specifications about the driver can be found at:
  http://www.aviaic.com/ENProducts.aspx

properties:
  compatible:
    enum:
      - avia,hx711
      - avia,hx710b

  sck-gpios:
    description:
      Definition of the GPIO for the clock (output). In the datasheet it is
      named PD_SCK.
    maxItems: 1

  dout-gpios:
    description:
      Definition of the GPIO for the data-out sent by the sensor in
      response to the clock (input).
      See Documentation/devicetree/bindings/gpio/gpio.txt for information
      on how to specify a consumer gpio.
    maxItems: 1

  avdd-supply:
    description:
      Definition of the regulator used as analog supply

  clock-frequency:
    description:
      Bit-bang clock frequency on PD_SCK. Keep the PD_SCK high time below
      the chip power-down threshold.
    minimum: 20000
    maximum: 2500000
    default: 400000

required:
  - compatible
  - sck-gpios
  - dout-gpios
  - avdd-supply

additionalProperties: false

examples:
  - |
    #include <dt-bindings/gpio/gpio.h>
    /* HX711 example */
    weight0 {
        compatible = "avia,hx711";
        sck-gpios = <&gpio3 10 GPIO_ACTIVE_HIGH>;
        dout-gpios = <&gpio0 7 GPIO_ACTIVE_HIGH>;
        avdd-supply = <&avdd>;
        clock-frequency = <100000>;
    };
  - |
    #include <dt-bindings/gpio/gpio.h>
    /* HX710B example */
    weight1 {
        compatible = "avia,hx710b";
        sck-gpios = <&gpio3 11 GPIO_ACTIVE_HIGH>;
        dout-gpios = <&gpio0 8 GPIO_ACTIVE_HIGH>;
        avdd-supply = <&avdd>;
    };
```

## Documentation/devicetree/bindings/iio/adc/lltc,ltc2309.yaml
```yaml
# SPDX-License-Identifier: GPL-2.0
%YAML 1.2
---
$id: http://devicetree.org/schemas/iio/adc/lltc,ltc2309.yaml#
$schema: http://devicetree.org/meta-schemas/core.yaml#

title: Linear Technology / Analog Devices LTC2309 ADC

maintainers:
  - Liam Beguin <liambeguin@gmail.com>

properties:
  compatible:
    enum:
      - lltc,ltc2309

  refcomp-supply:
    description: Power supply for the reference voltage

  reg:
    enum:
      - 0x08
      - 0x09
      - 0x0a
      - 0x0b
      - 0x18
      - 0x19
      - 0x1a
      - 0x1b
      - 0x28

  "#io-channel-cells":
    const: 1

required:
  - compatible
  - reg

unevaluatedProperties: false

examples:
  - |
    i2c {
        #address-cells = <1>;
        #size-cells = <0>;

        adc@28 {
            #io-channel-cells = <1>;
            compatible = "lltc,ltc2309";
            reg = <0x28>;
        };
    };
```

## Documentation/devicetree/bindings/iio/adc/maxim,max34408.yaml
```yaml
# SPDX-License-Identifier: (GPL-2.0 OR BSD-2-Clause)
%YAML 1.2
---
$id: http://devicetree.org/schemas/iio/adc/maxim,max34408.yaml#
$schema: http://devicetree.org/meta-schemas/core.yaml#

title: Two- and four-channel current monitors with overcurrent control

maintainers:
  - Ivan Mikhaylov <fr0st61te@gmail.com>

description: |
  The MAX34408/MAX34409 are two- and four-channel current monitors that are
  configured and monitored with a standard I2C/SMBus serial interface. Each
  unidirectional current sensor offers precision high-side operation with a
  low full-scale sense voltage. The devices automatically sequence through
  two or four channels and collect the current-sense samples and average them
  to reduce the effect of impulse noise. The raw ADC samples are compared to
  user-programmable digital thresholds to indicate overcurrent conditions.
  Overcurrent conditions trigger a hardware output to provide an immediate
  indication to shut down any necessary external circuitry.

  Specifications about the devices can be found at:
  https://www.analog.com/media/en/technical-documentation/data-sheets/MAX34408-MAX34409.pdf

properties:
  compatible:
    enum:
      - maxim,max34408
      - maxim,max34409

  reg:
    maxItems: 1

  interrupts:
    maxItems: 1

  maxim,input1-rsense-val-micro-ohms:
    description:
      Adjust the Rsense value to monitor higher or lower current levels for
      input 1.
    enum: [250, 500, 1000, 5000, 10000, 50000, 100000, 200000, 500000]
    default: 1000

  maxim,input2-rsense-val-micro-ohms:
    description:
      Adjust the Rsense value to monitor higher or lower current levels for
      input 2.
    enum: [250, 500, 1000, 5000, 10000, 50000, 100000, 200000, 500000]
    default: 1000

  maxim,input3-rsense-val-micro-ohms:
    description:
      Adjust the Rsense value to monitor higher or lower current levels for
      input 3.
    enum: [250, 500, 1000, 5000, 10000, 50000, 100000, 200000, 500000]
    default: 1000

  maxim,input4-rsense-val-micro-ohms:
    description:
      Adjust the Rsense value to monitor higher or lower current levels for
      input 4.
    enum: [250, 500, 1000, 5000, 10000, 50000, 100000, 200000, 500000]
    default: 1000

  maxim,shtdn:
    description:
      Shutdown Output. Open-drain output. This output transitions to high impedance
      when any of the digital comparator thresholds are exceeded as long as the ENA
      pin is high.
    type: boolean

  maxim,ena:
    description:
      SHTDN Enable Input. CMOS digital input. Connect to GND to clear the latch and
      unconditionally deassert (force low) the SHTDN output and reset the shutdown
      delay. Connect to VDD to enable normal latch operation of the SHTDN output.
    type: boolean

  supply-vdd: true

required:
  - compatible
  - reg

additionalProperties: false

examples:
  - |
    i2c {

        #address-cells = <1>;
        #size-cells = <0>;

        adc@1e {
              compatible = "maxim,max34409";
              reg = <0x1e>;
              maxim,input1-rsense-val-micro-ohms = <5000>;
              maxim,input2-rsense-val-micro-ohms = <10000>;
        };
    };
```

## Documentation/devicetree/bindings/iio/adc/mediatek,mt6323-auxadc.yaml
```yaml
# SPDX-License-Identifier: (GPL-2.0-only OR BSD-2-Clause)
%YAML 1.2
---
$id: http://devicetree.org/schemas/iio/adc/mediatek,mt6323-auxadc.yaml#
$schema: http://devicetree.org/meta-schemas/core.yaml#

title: MediaTek MT6323 PMIC AUXADC

maintainers:
  - Roman Vivchar <rva333@protonmail.com>

description: >
  The Auxiliary Analog/Digital Converter (AUXADC) is an ADC found
  in the MediaTek MT6323 PMIC, performing various PMIC related measurements
  such as battery and PMIC internal voltage regulators temperatures,
  accessory detection resistance (usually, for a 3.5mm audio jack)
  other than voltages for various PMIC internal components.

properties:
  compatible:
    const: mediatek,mt6323-auxadc

  "#io-channel-cells":
    const: 1

required:
  - compatible
  - "#io-channel-cells"

additionalProperties: false

examples:
  - |
    #include <dt-bindings/iio/adc/mediatek,mt6323-auxadc.h>

    adc {
        compatible = "mediatek,mt6323-auxadc";
        #io-channel-cells = <1>;
    };
```
