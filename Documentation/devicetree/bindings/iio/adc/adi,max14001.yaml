## Documentation/devicetree/bindings/iio/adc/ti,ads1262.yaml
```yaml
# SPDX-License-Identifier: (GPL-2.0-only OR BSD-2-Clause)
%YAML 1.2
---
$id: http://devicetree.org/schemas/iio/adc/ti,ads1262.yaml#
$schema: http://devicetree.org/meta-schemas/core.yaml#

title: TI ADS1262/ADS1263 analog to digital converter

maintainers:
  - Kurt Borja <kuurtb@gmail.com>

description: |
  The ADS1262 and ADS1263 are 38.4-kSPS, delta-sigma (ΔΣ) ADCs with an
  integrated PGA, reference, and internal fault monitors. The ADS1263 integrates
  an auxiliary, 24-bit, ΔΣ ADC intended for background measurements.

  Datasheets:
    - ADS126x: https://www.ti.com/lit/ds/symlink/ads1262.pdf

properties:
  compatible:
    oneOf:
      - const: ti,ads1262
      - items:
          - const: ti,ads1263
          - const: ti,ads1262

  reg:
    maxItems: 1

  '#address-cells':
    const: 1

  '#size-cells':
    const: 0

  spi-max-frequency:
    maximum: 8000000

  spi-cpha: true

  interrupts:
    description: Data Ready (DRDY) interrupt line.
    maxItems: 1

  interrupt-names:
    description:
      Specify which pin should be configured as Data Ready interrupt.
    enum: [drdy, dout-drdy]

  start-gpios:
    description: Start conversion control.
    maxItems: 1

  reset-gpios:
    maxItems: 1

  dvdd-supply:
    description: Digital power supply.

  avdd-supply:
    description:
      Analog power supply. In bipolar supply configurations, the reported
      voltage should be in reference to DGND.

  avss-supply:
    description:
      Negative analog power supply for bipolar configurations. AVSS can only be
      at or below the ground reference (DGND). If not described, AVSS is assumed
      to be connected to ground (0V).

  clocks:
    maxItems: 1

  '#io-channel-cells':
    minimum: 1
    maximum: 2
    description:
      The first cell selects the channel by it's reg. The second cell selects
      between ADC1 (0) and ADC2 (1).

  '#gpio-cells':
    const: 2

  gpio-controller: true

  regulators:
    type: object
    description:
      List of regulators provided by this chip.

    properties:
      vbias:
        $ref: /schemas/regulator/regulator.yaml#
        type: object
        description:
          Level-shift voltage output on the AINCOM pin. Its output is the
          mid-voltage of the analog supply, (AVDD + AVSS) / 2, and is used to
          shift floating sensors to within the ADC input range.
        unevaluatedProperties: false

      refout:
        $ref: /schemas/regulator/regulator.yaml#
        type: object
        description:
          Buffered internal voltage reference output on the REFOUT pin.
        unevaluatedProperties: false

    additionalProperties: false

patternProperties:
  "^ain([0-9]|com)-supply$":
    description:
      Common-mode voltage supply connected to AIN<N> or AINCOM.

  "^refp[1-3]-supply$":
    description:
      Positive voltage reference connected to REFP1 (AIN0), REFP2 (AIN2) or
      REFP3 (AIN4). If not described, its assumed to be connected to ground
      (0V).

  "^refn[1-3]-supply$":
    description:
      Negative voltage reference connected to REFN1 (AIN1), REFN2 (AIN3) or
      REFN3 (AIN5). If not described, its assumed to be connected to ground
      (0V).

  "^ti,refp[1-3]-refn[1-3]-resistor-ohms$":
    description:
      Magnitude of the external reference resistor connected between REFP<N>
      and REFN<M>. In ratiometric configurations, such as RTD measurements, the
      IDAC excitation current returns through this resistor, generating the
      reference voltage for the conversion.

  "^channel@[0-9]+$":
    $ref: /schemas/iio/adc/adc.yaml#
    unevaluatedProperties: false

    properties:
      reg:
        maxItems: 1

      single-channel:
        minimum: 0
        maximum: 10

      common-mode-channel:
        minimum: 0
        maximum: 10
        default: 10

      diff-channels:
        description: |
          In addition to the analog input pins 0 (AIN0) - 10 (AINCOM), there are
          special inputs that can be selected from the following values:
          11: Temperature sensor monitor
          12: Analog power supply monitor
          13: Digital power supply monitor
          14: TDAC test signal
        items:
          minimum: 0
          maximum: 14

      reference-sources:
        minItems: 2
        description:
          Indicates the reference sources for this channel. The first and second
          items are the positive (REFP) and negative (REFN) sources of the main
          ADC (ADC1). The third item is the reference source of the secondary
          ADC (ADC2) and must always have a positive differential voltage.
        items:
          - enum: [internal, refp1, refp2, refp3, avdd]
          - enum: [internal, refn1, refn2, refn3, avss]
          - enum: [internal, refp1-refn1, refp2-refn2, refp3-refn3, avdd-avss]

      ti,reference-reversal:
        $ref: /schemas/types.yaml#/definitions/flag
        description:
          Indicates that the ADC1 (this has no effect on ADC2) reference voltage
          for this channel has negative polarity and thus should be internally
          reversed.

      excitation-channels:
        minItems: 1
        maxItems: 2
        description:
          Selects the pins for the IDAC sources from 0 (AIN0) to 10 (AINCOM).
          The first value corresponds to IDAC1 and the second to IDAC2.
        items:
          minimum: 0
          maximum: 10

      excitation-current-nanoamp:
        minItems: 1
        maxItems: 2
        description:
          The first value corresponds to IDAC1 and the second to IDAC2.
        items:
          enum: [50000, 100000, 250000, 500000, 750000, 1000000, 1500000,
                 2000000, 2500000, 3000000]

      burn-out-current-nanoamp:
        description:
          Selects current magnitude for the sensor bias current source.
        enum: [500, 2000, 10000, 50000, 200000]

      ti,burn-out-resistor:
        $ref: /schemas/types.yaml#/definitions/flag
        description:
          Instead of a fixed current, the sensor bias (burn-out) current source
          can be pulled using an internal 10 MΩ resistor.

      ti,burn-out-polarity:
        $ref: /schemas/types.yaml#/definitions/string
        description:
          The sensor bias can be configured to either pull-up or pull-down mode.
          In pull-up mode, the current flows into the positive input and flows
          out of the negative input. In pull-down mode, the polarities are
          reversed.
        enum: [pull-up, pull-down]
        default: pull-up

      input-chopping: true

      ti,idac-rotation:
        $ref: /schemas/types.yaml#/definitions/flag
        description:
          Automatically swap the IDAC1 and IDAC2 connections of alternate
          conversions. The ADC averages the alternate conversions to eliminate
          IDAC mismatch.

    dependencies:
      excitation-channels: [excitation-current-nanoamp]
      excitation-current-nanoamp: [excitation-channels]
      burn-out-current-nanoamp:
        not:
          required:
            - ti,burn-out-resistor

    required:
      - reg

    allOf:
      - if:
          properties:
            excitation-channels:
              maxItems: 1
          required:
            - excitation-channels
        then:
          properties:
            excitation-current-nanoamp:
              maxItems: 1
        else:
          properties:
            excitation-current-nanoamp:
              minItems: 2

    oneOf:
      - required: [single-channel]
      - required: [diff-channels]

dependencies:
  interrupts: [interrupt-names]
  interrupts-extended: [interrupt-names]

required:
  - compatible
  - reg
  - spi-cpha
  - avdd-supply
  - dvdd-supply
  - '#address-cells'
  - '#size-cells'

allOf:
  - $ref: /schemas/spi/spi-peripheral-props.yaml#
  - if:
      properties:
        compatible:
          contains:
            const: ti,ads1263
    then:
      properties:
        '#io-channel-cells':
          const: 2
      patternProperties:
        "^channel@[0-9]+$":
          properties:
            reference-sources:
              minItems: 3
              maxItems: 3
              default: [internal, internal, internal]
    else:
      properties:
        '#io-channel-cells':
          const: 1
      patternProperties:
        "^channel@[0-9]+$":
          properties:
            reference-sources:
              minItems: 2
              maxItems: 2
              default: [internal, internal]

unevaluatedProperties: false

examples:
  - |
    #include <dt-bindings/gpio/gpio.h>
    #include <dt-bindings/interrupt-controller/irq.h>

    spi {
        #address-cells = <1>;
        #size-cells = <0>;

        adc@0 {
            compatible = "ti,ads1262";
            reg = <0>;
            spi-max-frequency = <8000000>;
            spi-cpha;
            avdd-supply = <&avdd>;
            dvdd-supply = <&dvdd>;
            #address-cells = <1>;
            #size-cells = <0>;

            interrupts-extended = <&gpio 0 IRQ_TYPE_EDGE_FALLING>;
            interrupt-names = "drdy";

            /* Typical common mode voltage configuration */
            aincom-supply = <&ads1262_vbias>;

            regulators {
                ads1262_vbias: vbias {
                    regulator-name = "vbias";
                };
            };

            channel@0 {
                reg = <0>;
                single-channel = <0>;
                /* The VBIAS is enabled on pin 10 (AINCOM) */
                common-mode-channel = <10>;
            };
        };
    };

  - |
    #include <dt-bindings/gpio/gpio.h>
    #include <dt-bindings/interrupt-controller/irq.h>

    spi {
        #address-cells = <1>;
        #size-cells = <0>;

        adc@0 {
            compatible = "ti,ads1263", "ti,ads1262";
            reg = <0>;
            spi-max-frequency = <8000000>;
            spi-cpha;
            avdd-supply = <&avdd>;
            dvdd-supply = <&dvdd>;
            #address-cells = <1>;
            #size-cells = <0>;

            interrupts-extended = <&gpio 0 IRQ_TYPE_EDGE_FALLING>;
            interrupt-names = "drdy";

            ti,refp2-refn2-resistor-ohms = <3520>;

            channel@0 {
                reg = <0>;
                diff-channels = <4 5>;
                reference-sources = "refp2", "refn2", "refp2-refn2";
                excitation-channels = <1 6>;
                excitation-current-nanoamp = <500000 500000>;
            };
        };
    };
```

## Documentation/devicetree/bindings/iio/adc/ti,ads1263-adc2.yaml
```yaml
# SPDX-License-Identifier: (GPL-2.0-only OR BSD-2-Clause)
%YAML 1.2
---
$id: http://devicetree.org/schemas/iio/adc/ti,ads1263-adc2.yaml#
$schema: http://devicetree.org/meta-schemas/core.yaml#

title: TI ADS1263 ADC2 analog-to-digital converter

maintainers:
  - Kurt Borja <kuurtb@gmail.com>

description:
  The ADS1263 includes an auxiliary, 24-bit, delta-sigma ADC (ADC2). ADC2
  operation is independent of ADC1, with independent selections of input
  channel, reference voltage, sample rate, and channel gain.

properties:
  compatible:
    enum:
      - ti,ads1263-adc2
  vref-supply:
    description: Optional external voltage reference.

  ti,refmux:
    $ref: /schemas/types.yaml#/definitions/uint32
    description: |
      Selects the positive voltage reference input:
      0: Internal 2.5 V reference
      1: AIN0-AIN1 pins
      2: AIN2-AIN3 pins
      3: AIN4-AIN5 pins
      4: AVDD-AVSS pins
    minimum: 0
    maximum: 4
    default: 0

  '#address-cells':
    const: 1

  '#size-cells':
    const: 0

  '#io-channel-cells':
    const: 1

required:
  - compatible

additionalProperties: false
```

## Documentation/devicetree/bindings/iio/adc/ti,ads131m08.yaml
```yaml
# SPDX-License-Identifier: (GPL-2.0-only OR BSD-2-Clause)
%YAML 1.2
---
$id: http://devicetree.org/schemas/iio/adc/ti,ads131m08.yaml#
$schema: http://devicetree.org/meta-schemas/core.yaml#

title: Texas Instruments ADS131M0x 2-, 3-, 4-, 6- and 8-Channel ADCs

maintainers:
  - Oleksij Rempel <o.rempel@pengutronix.de>

description: |
  The ADS131M0x are a family of multichannel, simultaneous sampling,
  24-bit, delta-sigma, analog-to-digital converters (ADCs) with a
  built-in programmable gain amplifier (PGA) and internal reference.
  Communication with the ADC chip is via SPI.

  Datasheets:
  - ADS131M08: https://www.ti.com/lit/ds/symlink/ads131m08.pdf
  - ADS131M06: https://www.ti.com/lit/ds/symlink/ads131m06.pdf
  - ADS131M04: https://www.ti.com/lit/ds/symlink/ads131m04.pdf
  - ADS131M03: https://www.ti.com/lit/ds/symlink/ads131m03.pdf
  - ADS131M02: https://www.ti.com/lit/ds/symlink/ads131m02.pdf

properties:
  compatible:
    enum:
      - ti,ads131m02
      - ti,ads131m03
      - ti,ads131m04
      - ti,ads131m06
      - ti,ads131m08

  reg:
    description: SPI chip select number.

  clocks:
    description:
      Phandle to the external clock source required by the ADC's CLKIN pin.
      The datasheet recommends specific frequencies based on the desired power
      mode (e.g., 8.192 MHz for High-Resolution mode).
    maxItems: 1

  '#address-cells':
    const: 1

  '#size-cells':
    const: 0

required:
  - compatible
  - reg
  - clocks

patternProperties:
  "^channel@([0-7])$":
    type: object
    $ref: /schemas/iio/adc/adc.yaml#
    description: |
      Properties for a single ADC channel. The maximum valid channel number
      depends on the specific compatible string used (e.g., 0-1 for ads131m02,
      0-7 for ads131m08).

    properties:
      reg:
        description: The channel index (0-7).
        minimum: 0
        maximum: 7 # Max channels on ADS131M08

      label: true

    required:
      - reg

    unevaluatedProperties: false

allOf:
  - $ref: /schemas/spi/spi-peripheral-props.yaml#

  - if:
      properties:
        compatible:
          contains:
            const: ti,ads131m02
    then:
      patternProperties:
        "^channel@[0-7]$":
          properties:
            reg:
              maximum: 1
        "^channel@([2-7])$": false

  - if:
      properties:
        compatible:
          contains:
            const: ti,ads131m03
    then:
      patternProperties:
        "^channel@[0-7]$":
          properties:
            reg:
              maximum: 2
        "^channel@([3-7])$": false

  - if:
      properties:
        compatible:
          contains:
            const: ti,ads131m04
    then:
      patternProperties:
        "^channel@[0-7]$":
          properties:
            reg:
              maximum: 3
        "^channel@([4-7])$": false

  - if:
      properties:
        compatible:
          contains:
            const: ti,ads131m06
    then:
      patternProperties:
        "^channel@[0-7]$":
          properties:
            reg:
              maximum: 5
        "^channel@([6-7])$": false

unevaluatedProperties: false

examples:
  - |
    #include <dt-bindings/clock/stm32mp1-clks.h>

    spi1 {
        #address-cells = <1>;
        #size-cells = <0>;

        adc@0 {
            compatible = "ti,ads131m02";
            reg = <0>;
            spi-max-frequency = <8000000>;

            clocks = <&rcc CK_MCO2>;

            #address-cells = <1>;
            #size-cells = <0>;

            channel@0 {
                reg = <0>;
                label = "input_voltage";
            };

            channel@1 {
                reg = <1>;
                label = "input_current";
            };
        };
    };
```
