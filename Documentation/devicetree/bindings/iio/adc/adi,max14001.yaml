## Documentation/devicetree/bindings/iio/adc/microchip,pac1944.yaml
```yaml
# SPDX-License-Identifier: (GPL-2.0 OR BSD-2-Clause)
%YAML 1.2
---
$id: http://devicetree.org/schemas/iio/adc/microchip,pac1944.yaml#
$schema: http://devicetree.org/meta-schemas/core.yaml#

title: Microchip PAC194x and PAC195x Power Monitors with Accumulator

maintainers:
  - Marius Cristea <marius.cristea@microchip.com>

description: |
  This device is part of the Microchip family of Power Monitors with
  Accumulator. The datasheet for PAC1941-1, PAC1941-2, PAC1942-1, PAC1942-2,
  PAC1943-1 and PAC1944-1 can be found here:
    https://ww1.microchip.com/downloads/aemDocuments/documents/MSLD/ProductDocuments/DataSheets/PAC194X-Family-Data-Sheet-DS20006543.pdf
  The datasheet for PAC1951-1, PAC1951-2, PAC1952-1, PAC1952-2, PAC1953-1 and
  PAC1954-1 can be found here:
    https://ww1.microchip.com/downloads/aemDocuments/documents/MSLD/ProductDocuments/DataSheets/PAC195X-Family-Data-Sheet-DS20006539.pdf

properties:
  compatible:
    enum:
      - microchip,pac1941
      - microchip,pac1941-2
      - microchip,pac1942
      - microchip,pac1942-2
      - microchip,pac1943
      - microchip,pac1944
      - microchip,pac1951
      - microchip,pac1951-2
      - microchip,pac1952
      - microchip,pac1952-2
      - microchip,pac1953
      - microchip,pac1954

  reg:
    maxItems: 1

  vdd-supply: true

  "#address-cells":
    const: 1

  "#size-cells":
    const: 0

  interrupts:
    items:
      - description:
          ALERT1 output. Asserted when a user-programmed over/under
          voltage, current, or power limit routed to ALERT1 is exceeded.
      - description:
          ALERT2 output. Asserted when a user-programmed over/under
          voltage, current, or power limit routed to ALERT2 is exceeded.
    minItems: 1

  interrupt-names:
    oneOf:
      - items:
          - const: alert1
      - items:
          - const: alert2
      - items:
          - const: alert1
          - const: alert2

  gpio-controller: true

  "#gpio-cells":
    const: 2
    description: |
      GPIO 0 corresponds to the SLOW/ALERT1/GPIO multi-function pin and GPIO 1
      corresponds to the ALERT2/GPIO multi-function pin. The second cell takes
      standard GPIO flags.

  powerdown-gpios:
    description: |
      A GPIO used to trigger a change in sampling rate (lowering the chip
      power consumption). Driving this GPIO low puts the device in Power-Down
      state (all circuitry is powered down, including SMBus). It should be
      marked GPIO_ACTIVE_LOW.
    maxItems: 1

  slow-gpios:
    description: |
      SLOW input pin. If this pin is forced high, the sampling rate is forced
      to 8 SPS. When it is forced low, the sampling rate is 1024 SPS, unless
      a different sample rate has been programmed. This pin is multi-function:
      SLOW input, ALERT1 output, or general-purpose (open-drain) GPIO; when
      used as slow-gpios the ALERT1 function is not available. It should be
      marked GPIO_ACTIVE_HIGH.
    maxItems: 1

patternProperties:
  "^channel@[1-4]$":
    type: object
    $ref: adc.yaml
    description:
      Represents the external channels which are connected to the ADC.

    properties:
      reg:
        items:
          minimum: 1
          maximum: 4

      shunt-resistor-micro-ohms:
        description:
          Value in micro Ohms of the shunt resistor connected between
          the SENSE+ and SENSE- inputs, across which the current is measured.
          Value is needed to compute the scaling of the measured current.
        minimum: 1

      microchip,vbus-input-range-microvolt:
        description: |
          In order to increase measurement resolution while keeping the same
          number of bits, the device has a configurable VBUS full-scale range
          (FSR). The range should be set by hardware design and it should not
          be changed during runtime. The bipolar capability for VBUS enables
          accurate offset measurement and correction.
          The VBUS could be configured into the following full-scale range:
            - VBUS has unipolar 0V to 32V FSR (default) for PAC195X or 0V to 9V
              (default) for PAC194X.
            - VBUS has bipolar -32V to 32V FSR for PAC195X or -9V to 9V for
              PAC194X. The actual range is limited to about -200 mV due to the
              impact of the ESD structures.
            - VBUS has bipolar -16V to 16V FSR for PAC195X or -4.5V to 4.5V for
              PAC194X. The actual range is limited to about -200 mV due to the
              impact of the ESD structures.

      microchip,vsense-input-range-microvolt:
        description: |
          In order to decrease the power dissipation on the shunt resistor
          and, at the same time, to increase measurement resolution while
          keeping the same number of bits, the device has a configurable
          VSENSE full-scale scale (FSR). The range should be set by hardware
          design and it should not be changed during runtime.
          The VSENSE could be configured into the following full-scale range:
            - VSENSE has unipolar 0V to 100 mV FSR (default)
            - VSENSE has bipolar -100 mV to 100 mV FSR
            - VSENSE has bipolar -50 mV to 50 mV FSR
        oneOf:
          - items:
              - const: 0
              - const: 100000
          - items:
              - const: -50000
              - const: 50000
          - items:
              - const: -100000
              - const: 100000

      microchip,accumulation-mode:
        $ref: /schemas/types.yaml#/definitions/uint32
        description:
          The Hardware Accumulator may be used to accumulate VPOWER or VSENSE
          values for any channel. By setting the accumulator for a channel
          to accumulate the VPOWER values gives a measure of accumulated power
          over a time period, which is equivalent to energy. Setting the
          accumulator for a channel to accumulate VSENSE values gives a measure
          of accumulated current, which is equivalent to charge. This allows the
          accumulator to be used as a coulomb counter.
          This functionality needs to be setup once and must not be changed
          during the runtime, just in case the user wants to measure the charge
          or the energy consumed from board power up till the user has control
          or during a reboot of the system.
          The Hardware Accumulator could be configured to accumulate VPOWER
          or VSENSE
            <0>  -  Accumulator accumulates VPOWER (default)
            <1>  -  Accumulator accumulates VSENSE
        enum: [0, 1]
        default: 0

    required:
      - reg
      - shunt-resistor-micro-ohms

    unevaluatedProperties: false

required:
  - compatible
  - reg
  - vdd-supply
  - "#address-cells"
  - "#size-cells"

allOf:
  - if:
      properties:
        compatible:
          pattern: "^microchip,pac194"
    then:
      patternProperties:
        "^channel@[1-4]$":
          properties:
            microchip,vbus-input-range-microvolt:
              oneOf:
                - items:
                    - const: 0
                    - const: 9000000
                - items:
                    - const: -9000000
                    - const: 9000000
                - items:
                    - const: -4500000
                    - const: 4500000
              default: [0, 9000000]
  - if:
      properties:
        compatible:
          pattern: "^microchip,pac195"
    then:
      patternProperties:
        "^channel@[1-4]$":
          properties:
            microchip,vbus-input-range-microvolt:
              oneOf:
                - items:
                    - const: 0
                    - const: 32000000
                - items:
                    - const: -32000000
                    - const: 32000000
                - items:
                    - const: -16000000
                    - const: 16000000
              default: [0, 32000000]
  - if:
      properties:
        compatible:
          pattern: "^microchip,pac19[45]1(-2)?$"
    then:
      patternProperties:
        "^channel@[2-4]$": false
  - if:
      properties:
        compatible:
          pattern: "^microchip,pac19[45]2(-2)?$"
    then:
      patternProperties:
        "^channel@[3-4]$": false
  - if:
      properties:
        compatible:
          pattern: "^microchip,pac19[45]3(-2)?$"
    then:
      properties:
        channel@4: false
  - if:
      required:
        - slow-gpios
    then:
      properties:
        interrupts:
          maxItems: 1
        interrupt-names:
          oneOf:
            - items:
                - const: alert2
  - if:
      properties:
        interrupt-names:
          contains:
            const: alert1
      required:
        - interrupt-names
    then:
      properties:
        slow-gpios: false

unevaluatedProperties: false

examples:
  - |
    i2c {
        #address-cells = <1>;
        #size-cells = <0>;

        power-monitor@10 {
            compatible = "microchip,pac1954";
            reg = <0x10>;
            vdd-supply = <&vdd>;

            #address-cells = <1>;
            #size-cells = <0>;

            channel@1 {
                reg = <0x1>;
                shunt-resistor-micro-ohms = <24900>;
                label = "CPU";
                microchip,vbus-input-range-microvolt = <0 32000000>;
                microchip,vsense-input-range-microvolt = <(-50000) 50000>;
            };

            channel@3 {
                reg = <0x3>;
                shunt-resistor-micro-ohms = <75000>;
                label = "MEM";
                microchip,vbus-input-range-microvolt = <(-16000000) 16000000>;
                microchip,vsense-input-range-microvolt = <0 100000>;
            };

            channel@4 {
                reg = <0x4>;
                shunt-resistor-micro-ohms = <100000>;
                label = "NET";
                microchip,vbus-input-range-microvolt = <(-32000000) 32000000>;
                microchip,vsense-input-range-microvolt = <(-100000) 100000>;
                microchip,accumulation-mode = <1>;
            };
        };
    };

...
```

## Documentation/devicetree/bindings/iio/adc/nuvoton,ma35d1-eadc.yaml
```yaml
# SPDX-License-Identifier: (GPL-2.0-only OR BSD-2-Clause)
%YAML 1.2
---
$id: http://devicetree.org/schemas/iio/adc/nuvoton,ma35d1-eadc.yaml#
$schema: http://devicetree.org/meta-schemas/core.yaml#

title: Nuvoton MA35D1 Enhanced Analog to Digital Converter

maintainers:
  - Chi-Wen Weng <cwweng@nuvoton.com>

description:
  The Nuvoton MA35D1 Enhanced Analog to Digital Converter is a 12-bit
  ADC controller with 8 external input channels, 4 fixed differential
  input pairs and 1 internal VBAT input. Board wired ADC inputs are
  described using channel child nodes.

properties:
  compatible:
    const: nuvoton,ma35d1-eadc

  reg:
    maxItems: 1

  interrupts:
    minItems: 1
    maxItems: 4
    items:
      - description: ADINT0 end-of-conversion interrupt
      - description: ADINT1 end-of-conversion interrupt
      - description: ADINT2 end-of-conversion interrupt
      - description: ADINT3 end-of-conversion interrupt

  clocks:
    maxItems: 1

  resets:
    maxItems: 1

  vref-supply:
    description:
      External reference voltage supply connected to the VREF pin. If this
      property is omitted, the internal 1.6 V reference is used.

  dmas:
    maxItems: 1

  dma-names:
    const: rx

  '#address-cells':
    const: 1

  '#size-cells':
    const: 0

patternProperties:
  '^channel@[0-7]$':
    type: object
    $ref: adc.yaml
    unevaluatedProperties: false

    properties:
      reg:
        maximum: 7

      diff-channels: true

    allOf:
      - if:
          properties:
            reg:
              const: 0
        then:
          properties:
            diff-channels:
              items:
                - const: 0
                - const: 4
      - if:
          properties:
            reg:
              const: 1
        then:
          properties:
            diff-channels:
              items:
                - const: 1
                - const: 5
      - if:
          properties:
            reg:
              const: 2
        then:
          properties:
            diff-channels:
              items:
                - const: 2
                - const: 6
      - if:
          properties:
            reg:
              const: 3
        then:
          properties:
            diff-channels:
              items:
                - const: 3
                - const: 7
      - if:
          properties:
            reg:
              enum: [4, 5, 6, 7]
        then:
          not:
            required:
              - diff-channels

    required:
      - reg

required:
  - compatible
  - reg
  - interrupts
  - clocks
  - '#address-cells'
  - '#size-cells'

additionalProperties: false

examples:
  - |
    #include <dt-bindings/clock/nuvoton,ma35d1-clk.h>
    #include <dt-bindings/interrupt-controller/arm-gic.h>
    #include <dt-bindings/interrupt-controller/irq.h>
    #include <dt-bindings/reset/nuvoton,ma35d1-reset.h>

    soc {
        #address-cells = <2>;
        #size-cells = <2>;

        adc@40430000 {
            compatible = "nuvoton,ma35d1-eadc";
            reg = <0x0 0x40430000 0x0 0x10000>;
            interrupts = <GIC_SPI 65 IRQ_TYPE_LEVEL_HIGH>;
            clocks = <&clk EADC_GATE>;
            resets = <&reset MA35D1_RESET_EADC0>;

            #address-cells = <1>;
            #size-cells = <0>;

            channel@0 {
                reg = <0>;
            };

            channel@2 {
                reg = <2>;
                diff-channels = <2 6>;
            };
        };
    };
...
```

## Documentation/devicetree/bindings/iio/adc/sigma-delta-modulator.yaml
```yaml
# SPDX-License-Identifier: (GPL-2.0-only OR BSD-2-Clause)
%YAML 1.2
---
$id: http://devicetree.org/schemas/iio/adc/sigma-delta-modulator.yaml#
$schema: http://devicetree.org/meta-schemas/core.yaml#

title: Sigma delta modulator

maintainers:
  - Arnaud Pouliquen <arnaud.pouliquen@foss.st.com>

properties:
  compatible:
    description: |
      "sd-modulator" can be used as a generic SD modulator,
      if the modulator is not specified in the compatible list.
    enum:
      - sd-modulator
      - ads1201

  '#io-backend-cells':
    const: 0

  '#io-channel-cells':
    const: 0

  reg:
    maxItems: 1

  vref-supply:
    description: Phandle to the vref input analog reference voltage.

required:
  - compatible

allOf:
  - anyOf:
    - required: ['#io-backend-cells']
    - required: ['#io-channel-cells']

additionalProperties: false

examples:
  - |
    // Exemple1: SD modulator is an IIO backend device
    ads1201_0 {
      compatible = "ti,ads1201";
      #io-backend-cells = <0>;
    };

    //Example2: SD modulator is an IIO channel provider
    ads1201_1 {
      compatible = "sd-modulator";
      #io-channel-cells = <0>;
    };

...
```
