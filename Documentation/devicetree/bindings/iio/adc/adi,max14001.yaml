## Documentation/devicetree/bindings/iio/adc/starfive,jhb100-saradc.yaml
```yaml
# SPDX-License-Identifier: (GPL-2.0 OR BSD-2-Clause)
%YAML 1.2
---
$id: http://devicetree.org/schemas/iio/adc/starfive,jhb100-saradc.yaml#
$schema: http://devicetree.org/meta-schemas/core.yaml#

title: Successive Approximation Register (SAR) A/D converter for the StarFive JHB100 SoC

maintainers:
  - Xingyu Wu <xingyu.wu@starfivetech.com>

properties:
  compatible:
    const: starfive,jhb100-saradc

  reg:
    maxItem: 1

  interrupts:
    maxItems: 1

  clocks:
    maxItems: 1

  resets:
    maxItems: 2

  "#io-channel-cells":
    const: 1

  upper-bound-mv:
    description: The upper bound voltage value of the monitor.
    $ref: /schemas/types.yaml#/definitions/uint16

  lower-bound-mv:
    description: The lower bound voltage value of the monitor.
    $ref: /schemas/types.yaml#/definitions/uint16

  scan-freq:
    description: Number of the scan cycle interval.
    $ref: /schemas/types.yaml#/definitions/uint16

required:
  - compatible
  - reg
  - interrupts
  - clocks
  - resets
  - "#io-channel-cells"

additionalProperties: false

examples:
  - |
    adc@11be1400 {
      compatible = "starfive,jhb100-saradc";
      reg = <0x11be1400 0x400>;
      interrupts = <172>;
      clocks = <&per0crg 18>;
      resets = <&per0crg 11>, <&per0crg 46>;
      #io-channel-cells = <1>;
      };
```

## Documentation/devicetree/bindings/iio/adc/ti,ads1118.yaml
```yaml
# SPDX-License-Identifier: (GPL-2.0 OR BSD-2-Clause)
%YAML 1.2
---
$id: http://devicetree.org/schemas/iio/adc/ti,ads1118.yaml#
$schema: http://devicetree.org/meta-schemas/core.yaml#

title: TI ADS1018/ADS1118 SPI analog to digital converter

maintainers:
  - Kurt Borja <kuurtb@gmail.com>

description: |
  The ADS1018/ADS1118 is a precision, low-power, 12-bit or 16-bit, noise-free,
  analog-to-digital converter (ADC). It integrates a programmable gain amplifier
  (PGA), voltage reference, oscillator and high-accuracy temperature sensor.

  Datasheets:
    - ADS1018: https://www.ti.com/lit/ds/symlink/ads1018.pdf
    - ADS1118: https://www.ti.com/lit/ds/symlink/ads1118.pdf

properties:
  compatible:
    enum:
      - ti,ads1018
      - ti,ads1118

  reg:
    maxitems: 1

  interrupts:
    description: DOUT/DRDY (Data Out/Data Ready) line.
    maxitems: 1

  drdy-gpios:
    description:
      Extra GPIO line connected to DOUT/DRDY (Data Out/Data Ready). This allows
      distinguishing between latched and real DRDY IRQs.
    maxitems: 1

  '#address-cells':
    const: 1

  '#size-cells':
    const: 0

  '#io-channel-cells':
    const: 1

required:
  - compatible
  - reg
  - drdy-gpios
  - '#address-cells'
  - '#size-cells'

patternProperties:
  "^channel@[0-7]$":
    type: object
    $ref: /schemas/iio/adc/adc.yaml#
    description: Properties for a single ADC channel.

    properties:
      reg:
        minimum: 0
        maximum: 7
        description: The channel index (0-7).

      ti,gain:
        $ref: /schemas/types.yaml#/definitions/uint32
        minimum: 0
        maximum: 5
        description:
          Programmable gain amplifier configuration, as described in the PGA
          Config Register Field description. If not present, the default is
          used.

      ti,datarate:
        $ref: /schemas/types.yaml#/definitions/uint32
        minimum: 0
        maximum: 7
        description:
          Data rate configuration, as described in the DR Config Register Field
          description. If not present, the default is used.

    required:
      - reg

    additionalProperties: false

allOf:
  - $ref: /schemas/spi/spi-peripheral-props.yaml#

  - if:
    properties:
      compatible:
        contains:
          const: ti,ads1018
    then:
      patternProperties:
        "^channel@[0-7]$":
          properties:
            ti,datarate:
              maximum: 6

unevaluatedProperties: false

examples:
  - |
    spi0 {
        #address-cells = <1>;
        #size-cells = <0>;

        ads1118@0 {
            compatible = "ti,ads1118";
            reg = <0>;

            #address-cells = <1>;
            #size-cells = <0>;

            spi-max-frequency = <4000000>;
            spi-cpha;

            interrupts-extended = <&gpio 14 IRQ_TYPE_EDGE_FALLING>;
            drdy-gpios = <&gpio 14 GPIO_ACTIVE_LOW>;

            channel@4 {
                reg = <4>;
                ti,gain = <0>;
                ti,datarate = <7>;
            };
        };
    };
```

## Documentation/devicetree/bindings/iio/adc/ti,ads1119.yaml
```yaml
# SPDX-License-Identifier: (GPL-2.0-only OR BSD-2-Clause)
%YAML 1.2
---
$id: http://devicetree.org/schemas/iio/adc/ti,ads1119.yaml#
$schema: http://devicetree.org/meta-schemas/core.yaml#

title: Texas Instruments ADS1119 ADC

maintainers:
  - João Paulo Gonçalves <jpaulo.silvagoncalves@gmail.com>

description: |
  The TI ADS1119 is a precision 16-bit ADC over I2C that offers single-ended and
  differential measurements using a multiplexed input. It features a programmable
  gain, a programmable sample rate, an internal oscillator and voltage reference,
  and a 50/60Hz rejection filter.

properties:
  compatible:
    const: ti,ads1119

  reg:
    maxItems: 1

  interrupts:
    maxItems: 1

  reset-gpios:
    maxItems: 1

  vref-supply:
    description:
      ADC external reference voltage (VREF).

  "#address-cells":
    const: 1

  "#size-cells":
    const: 0

  "#io-channel-cells":
    const: 1

required:
  - compatible
  - reg
  - "#address-cells"
  - "#size-cells"

patternProperties:
  "^channel@([0-6])$":
    $ref: adc.yaml
    type: object
    description: |
      ADC channels.

    properties:
      reg:
        description: |
          0: Voltage over AIN0 and AIN1.
          1: Voltage over AIN2 and AIN3.
          2: Voltage over AIN1 and AIN2.
          3: Voltage over AIN0 and GND.
          4: Voltage over AIN1 and GND.
          5: Voltage over AIN2 and GND.
          6: Voltage over AIN3 and GND.
        items:
          - minimum: 0
            maximum: 6

      ti,gain:
        $ref: /schemas/types.yaml#/definitions/uint32
        description: |
          PGA gain value.
        enum: [1, 4]
        default: 1

      ti,datarate:
        $ref: /schemas/types.yaml#/definitions/uint32
        description: |
          Data acquisition rate in samples per second.
        enum: [20, 90, 330, 1000]
        default: 20

    required:
      - reg

additionalProperties: false

examples:
  - |
    #include <dt-bindings/interrupt-controller/irq.h>
    #include <dt-bindings/gpio/gpio.h>

    i2c {
        #address-cells = <1>;
        #size-cells = <0>;

        adc@40 {
            compatible = "ti,ads1119";
            reg = <0x40>;
            #address-cells = <1>;
            #size-cells = <0>;
            #io-channel-cells = <1>;

            channel@0 {
                reg = <0>;
                ti,gain = <4>;
                ti,datarate = <330>;
            };

            channel@4 {
                reg = <4>;
                ti,datarate = <1000>;
            };

            channel@5 {
                reg = <5>;
                ti,gain = <4>;
            };
        };
    };
```

## Documentation/devicetree/bindings/iio/adc/ti,ads1120.yaml
```yaml
# SPDX-License-Identifier: (GPL-2.0-only OR BSD-2-Clause)
%YAML 1.2
---
$id: http://devicetree.org/schemas/iio/adc/ti,ads1120.yaml#
$schema: http://devicetree.org/meta-schemas/core.yaml#

title: Texas Instruments ADS1120 4-channel, 16-bit, 2kSPS ADC

maintainers:
  - Ajith Anandhan <ajithanandhan0406@gmail.com>

description: |
  The ADS1120 is a precision, 16-bit, analog-to-digital converter (ADC)
  that features two differential or four single-ended inputs through a
  flexible input multiplexer.

  Datasheet: https://www.ti.com/lit/gpn/ads1120

properties:
  compatible:
    const: ti,ads1120

  reg:
    maxItems: 1

  interrupts:
    minItems: 1
    maxItems: 2
    description: |
      Interrupts for the DRDY (data ready) pin(s). The device can output
      DRDY on a dedicated pin or multiplex it with DOUT. If both pins are
      wired, both interrupts can be specified.

  interrupt-names:
    minItems: 1
    maxItems: 2
    items:
      enum:
        - drdy
        - dout

  avdd-supply:
    description: |
      Analog power supply, typically 2.3V to 5.5V.

  vref-supply:
    description: |
      Optional external voltage reference. Can be connected to either
      REFP0/REFN0 or REFP1/REFN1 pins. If not supplied, the internal
      2.048V reference is used.

  ti,avdd-is-ref:
    type: boolean
    description: |
      If present, indicates that the AVDD supply voltage is of sufficient
      quality and stability to be used as the voltage reference instead of
      the internal reference. This allows the driver to select AVDD as the
      reference source for potentially better performance.

  clocks:
    maxItems: 1
    description: |
      Optional external clock input. If not specified, the internal
      oscillator is used.

  spi-max-frequency:
    maximum: 4000000

  spi-cpha: true

  "#io-channel-cells":
    const: 1

required:
  - compatible
  - reg

allOf:
  - $ref: /schemas/spi/spi-peripheral-props.yaml#

unevaluatedProperties: false

examples:
  - |
    #include <dt-bindings/interrupt-controller/irq.h>
    spi {
        #address-cells = <1>;
        #size-cells = <0>;

        adc@0 {
            compatible = "ti,ads1120";
            reg = <0>;
            spi-max-frequency = <4000000>;
            spi-cpha;

            interrupts-extended = <&gpio1 25 IRQ_TYPE_EDGE_FALLING>;
            interrupt-names = "drdy";

            avdd-supply = <&reg_3v3>;
            vref-supply = <&reg_vref_2v5>;

            clocks = <&clk_4mhz>;

            ti,avdd-is-ref;

            #io-channel-cells = <1>;
        };
    };
...
```

## Documentation/devicetree/bindings/iio/adc/ti,ads112c04.yaml
```yaml
# SPDX-License-Identifier: (GPL-2.0-only OR BSD-2-Clause)
%YAML 1.2
---
$id: http://devicetree.org/schemas/iio/adc/ti,ads112c04.yaml#
$schema: http://devicetree.org/meta-schemas/core.yaml#

title: Texas Instruments ADS112C04 ADC

maintainers:
  - Kyle Hsieh <kylehsieh1995@gmail.com>

description: |
  The ADS112C04 (16-bit) are precision analog-to-digital converters (ADCs)
  with an I2C interface. They feature a flexible input multiplexer, a
  low-noise programmable gain amplifier (PGA), two programmable excitation
  current sources, a voltage reference, and a precision temperature sensor.

properties:
  compatible:
    enum:
      - ti,ads112c04

  reg:
    maxItems: 1
    description: I2C address of the device.

  interrupts:
    maxItems: 1
    description:
      Data ready (DRDY) interrupt output. It is asserted low when a new
      conversion is ready.

  "#io-channel-cells":
    const: 1

  reset-gpios:
    maxItems: 1
    description:
      GPIO connected to the RESET pin. Active low.

  avdd-supply:
    description: Analog power supply (AVDD).

  dvdd-supply:
    description: Digital power supply (DVDD).

  vref-supply:
    description: External reference power supply (connected to REFP/REFN).

required:
  - compatible
  - reg

additionalProperties: false

examples:
  - |
    #include <dt-bindings/interrupt-controller/irq.h>
    #include <dt-bindings/gpio/gpio.h>
    i2c {
        #address-cells = <1>;
        #size-cells = <0>;

        adc@40 {
            compatible = "ti,ads112c04";
            reg = <0x40>;
            interrupt-parent = <&gpio>;
            interrupts = <12 IRQ_TYPE_EDGE_FALLING>;
            #io-channel-cells = <1>;
            reset-gpios = <&gpio 13 GPIO_ACTIVE_LOW>;
            avdd-supply = <&vdd_3v3_reg>;
            dvdd-supply = <&vdd_3v3_reg>;
            vref-supply = <&vref_reg>;
        };
    };
...
```
