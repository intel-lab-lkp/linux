## Documentation/devicetree/bindings/iio/adc/microchip,pac1711.yaml
```yaml
# SPDX-License-Identifier: (GPL-2.0-only OR BSD-2-Clause)
%YAML 1.2
---
$id: http://devicetree.org/schemas/iio/adc/microchip,pac1711.yaml#
$schema: http://devicetree.org/meta-schemas/core.yaml#

title: Microchip PAC1711 Power Monitors with Accumulator

maintainers:
  - Ariana Lazar <ariana.lazar@microchip.com>

description: |
  This device is part of the Microchip family of Power Monitors with Accumulator.
  Datasheet links:
  [PAC1711]: https://ww1.microchip.com/downloads/aemDocuments/documents/MSLD/ProductDocuments/PAC1711-Data-Sheet-DS20007058.pdf
  [PAC1721]: https://ww1.microchip.com/downloads/aemDocuments/documents/MSLD/ProductDocuments/PAC1721-Single-Channel-Power-Monitor-with-Accumulator-DS20007088.pdf
  [PAC1811]: https://ww1.microchip.com/downloads/aemDocuments/documents/MSLD/ProductDocuments/DataSheets/PAC1811-Data-Sheet-DS20007066.pdf
  [PAC1821]: https://ww1.microchip.com/downloads/aemDocuments/documents/MSLD/ProductDocuments/DataSheets/PAC1821-Data-Sheet-DS20007097.pdf

  PAC1711, PAC1721, PAC1811 and PAC1821 are Single Channel Power Monitors
  with Accumulator, having 12-bit or 16-bit resolution. The devices PAC1711
  and PAC1811 can measure up to 42V Full-Scale Range, respectively 9V
  Full-Scale Range for PAC1721 and PAC1821.

  The accumulation-source property aims to specify what kind of hardware is
  intended to be used/available for the user. There are two main cases here:
    - the user wants to measure also the current/power consumed before the
      driver insertion (e.g. from the boot to user control) and if this is a
      runtime setting, the hardware accumulator will be reset by the default
      configuration the driver starts with.
    - the driver does not know what type of hardware it's dealing with. In
      case the part is monitoring the charge/discharge current it does not
      make sense in user-space to change the accumulator to calculate energy.
      Same if the hardware is intended to calculate energy it does not make
      sense in user-space to change to Coulomb counter. Changing the setting
      from one mode to another will reset the hardware accumulator inside the
      chip.

properties:
  compatible:
    enum:
      - microchip,pac1711
      - microchip,pac1721
      - microchip,pac1811
      - microchip,pac1821

  reg:
    maxItems: 1

  vdd-supply: true

  "#io-channel-cells":
    const: 1

  shunt-resistor-micro-ohms:
    description:
      Value in micro Ohms of the shunt resistor connected between the VSENSE+
      and VSENSE- inputs, across which the current is measured. This value is
      needed to compute the scaling of the measured current.

  label:
    description: Unique name to identify which device this is.

  microchip,vbus-input-range-microvolt:
    description: |
      Specifies the voltage range in microvolts chosen for the voltage full
      scale range (FSR). The range should be set as <minimum, maximum> by
      hardware design and should not be changed during runtime.

      The VBUS could be configured into the following full scale range:
        - for PAC1711 or PAC1811:
            - VBUS has unipolar 0V to 42V FSR (default)
            - VBUS has bipolar -42V to 42V FSR
            - VBUS has bipolar -21V to 21V FSR
        - for PAC1721 or PAC1821:
            - VBUS has unipolar 0V to 9V FSR (default)
            - VBUS has bipolar -9V to 9V FSR
            - VBUS has bipolar -4.5V to 4.5V FSR

  microchip,vsense-input-range-microvolt:
    description: |
      Specifies the voltage range in microvolts chosen for the current full
      scale range (FSR). The current is calculated by dividing the vsense
      voltage by the value of the shunt resistor. The range should be set as
      <minimum, maximum> by hardware design and it should not be changed
      during runtime.

      The VSENSE could be configured into the following full scale range:
        - VSENSE has unipolar 0 mV to 100 mV FSR (default)
        - VSENSE has bipolar -100 mV to 100 mV FSR
        - VSENSE has bipolar -50 mV to 50 mV FSR
    oneOf:
      - items:
          - const: 0
          - const: 100000
      - items:
          - const: -100000
          - const: 100000
      - items:
          - const: -50000
          - const: 50000

  microchip,accumulation-source:
    $ref: /schemas/types.yaml#/definitions/string
    description: |
      The Hardware Accumulator may be used to accumulate VPOWER or VSENSE values
      for any channel. By setting the accumulator for a channel to accumulate
      the VPOWER values gives a measure of accumulated power over a time period,
      which is equivalent to energy. Setting the accumulator for a channel to
      accumulate VSENSE values gives a measure of accumulated current, which is
      equivalent to charge.

      The Hardware Accumulator could be configured as:
       "energy" - Accumulator accumulates VPOWER (energy)
       "charge" - Accumulator accumulates VSENSE (Coulomb Counter)
    enum: [energy, charge]
    default: energy

required:
  - compatible
  - reg
  - vdd-supply
  - shunt-resistor-micro-ohms

allOf:
  - if:
      properties:
        compatible:
          pattern: "^microchip,pac1[78]11$"
    then:
      properties:
        microchip,vbus-input-range-microvolt:
          oneOf:
            - items:
                - const: 0
                - const: 42000000
            - items:
                - const: -42000000
                - const: 42000000
            - items:
                - const: -21000000
                - const: 21000000
          default: [0, 42000000]
  - if:
      properties:
        compatible:
          pattern: "^microchip,pac1[78]21$"
    then:
      properties:
        microchip,vbus-input-range-microvolt:
          oneOf:
            - items:
                - const: 0
                - const: 9000000
            - items:
                - const: -9000000
                - const: 9000000
            - items:
                - const: -4500000
                - const: 4500000
          default: [0, 9000000]

additionalProperties: false

examples:
  - |
    i2c {
        #address-cells = <1>;
        #size-cells = <0>;

        power-monitor@40 {
            compatible = "microchip,pac1711";
            reg = <0x40>;

            shunt-resistor-micro-ohms = <11000000>;
            label = "VDD3V3";
            vdd-supply = <&vdd>;
            microchip,vbus-input-range-microvolt = <(-21000000) 21000000>;
            microchip,vsense-input-range-microvolt = <(-50000) 50000>;
            microchip,accumulation-source = "energy";
        };
    };
...
```

## Documentation/devicetree/bindings/iio/adc/microchip,pac1921.yaml
```yaml
# SPDX-License-Identifier: (GPL-2.0 OR BSD-2-Clause)
%YAML 1.2
---
$id: http://devicetree.org/schemas/iio/adc/microchip,pac1921.yaml#
$schema: http://devicetree.org/meta-schemas/core.yaml#

title: Microchip PAC1921 High-Side Power/Current Monitor with Anaog Output

maintainers:
  - Matteo Martelli <matteomartelli3@gmail.com>

description: |
  The PAC1921 is a power/current monitoring device with an analog output
  and I2C/SMBus interface.

  Datasheet can be found here:
  https://ww1.microchip.com/downloads/en/DeviceDoc/PAC1921-Data-Sheet-DS20005293E.pdf

properties:
  compatible:
    const: microchip,pac1921

  reg:
    maxItems: 1

  "#io-channel-cells":
    const: 1

  shunt-resistor-micro-ohms:
    description:
      Value in micro Ohms of the shunt resistor connected between
      the SENSE+ and SENSE- inputs, across which the current is measured.
      Value is needed to compute the scaling of the measured current.

  label:
    description: Unique name to identify which device this is.

  microchip,dv-gain:
    description:
      Digital multiplier to control the effective bus voltage gain. The gain
      value of 1 is the setting for the full-scale range and it can be increased
      when the system is designed for a lower VBUS range.
    $ref: /schemas/types.yaml#/definitions/uint32
    enum: [1, 2, 4, 8, 16, 32]
    default: 1

  microchip,di-gain:
    description:
      Digital multiplier to control the effective current gain. The gain
      value of 1 is the setting for the full-scale range and it can be
      increased when the system is designed for a lower VSENSE range.
    $ref: /schemas/types.yaml#/definitions/uint32
    enum: [1, 2, 4, 8, 16, 32, 64, 128]
    default: 1

required:
  - compatible
  - reg
  - shunt-resistor-micro-ohms

additionalProperties: false

examples:
  - |
    i2c {
        #address-cells = <1>;
        #size-cells = <0>;

        adc@4c {
            compatible = "microchip,pac1921";
            #io-channel-cells = <1>;
            label = "vbat";
            reg = <0x4c>;
            shunt-resistor-micro-ohms = <10000>;
            microchip,dv-gain = <4>;
            microchip,di-gain = <32>;
        };
    };
...
```
