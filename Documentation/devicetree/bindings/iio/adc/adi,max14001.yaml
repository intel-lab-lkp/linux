## Documentation/devicetree/bindings/iio/adc/ti,ads7038.yaml
```yaml
# SPDX-License-Identifier: (GPL-2.0 OR BSD-2-Clause)
%YAML 1.2
---
$id: http://devicetree.org/schemas/iio/adc/ti,ads7038.yaml#
$schema: http://devicetree.org/meta-schemas/core.yaml#

title: Texas Instruments ADS7038 and similar ADCs

maintainers:
  - Andre Werner <andre.werner@systec-electronic.com>

description: |
  Family of 7 channel, 12 bit ADCs with SPI interface.

  Datasheet: https://www.ti.com/lit/gpn/ads7038

properties:
  compatible:
    enum:
      - ti,ads7038

  reg:
    maxItems: 1

  spi-max-frequency:
    maximum: 60000000

  avdd-supply:
    description: Analog supply voltage, also used as the reference voltage to the ADC.

  dvdd-supply:
    description: Digital I/O supply voltage.

  average-samples:
    description: |
      If specified ADC is configured for avaraging measurements (OSR_CFG Register).
      This effects output format for measurement and sampling time.
    $ref: /schemas/types.yaml#/definitions/uint32
    enum: [0,1,2,3,4,5,6,7]

  status-enabled:
    description: |
      If specified ADC transmits chip status (DATA_CFG Register).

  crc-enabled:
    description: |
      Checking the integrity of the data bits exchanged over
      SPI interface (GENERAL_CFG Register).

  gpio-controller:
    const: true
    decription: Marks the device node as a GPIO controller.

  "#gpio-cells":
    const: 2
    description: Should be 2. See gpio.txt in this directory for a
                 description of the cells format.

required:
  - compatible
  - reg
  - avdd-supply
  - dvdd-supply
  - gpio-controller
  - #gpio-cells

additionalProperties: false

examples:
  - |
    spi {
        #address-cells = <1>;
        #size-cells = <0>;

        adc@0 {
            compatible = "ti,ads7038";
            reg = <0>;
            avdd-supply = <&refin_avdd_supply>;
            avdd-supply = <&refin_dvdd_supply>;
            spi-max-frequency = <10000000>;
            gpio-controller;
            #gpio-cells = <2>;
        };
    };
```

## Documentation/devicetree/bindings/iio/adc/ti,ads7138.yaml
```yaml
# SPDX-License-Identifier: (GPL-2.0 OR BSD-2-Clause)
%YAML 1.2
---
$id: http://devicetree.org/schemas/iio/adc/ti,ads7138.yaml#
$schema: http://devicetree.org/meta-schemas/core.yaml#

title: Texas Instruments ADS7128/ADS7138 Analog to Digital Converter (ADC)

maintainers:
  - Tobias Sperling <tobias.sperling@softing.com>

description: |
  The ADS7128 is 12-Bit, 8-Channel Sampling Analog to Digital Converter (ADC)
  with an I2C interface.

  Datasheets:
    https://www.ti.com/product/ADS7128
    https://www.ti.com/product/ADS7138

properties:
  compatible:
    enum:
      - ti,ads7128
      - ti,ads7138

  reg:
    maxItems: 1

  avdd-supply:
    description:
      The regulator used as analog supply voltage as well as reference voltage.

  interrupts:
    description:
      Interrupt on ALERT pin, triggers on low level.
    maxItems: 1

required:
  - compatible
  - reg
  - avdd-supply

additionalProperties: false

examples:
  - |
    #include <dt-bindings/interrupt-controller/irq.h>
    i2c {
        #address-cells = <1>;
        #size-cells = <0>;

        adc@10 {
            compatible = "ti,ads7138";
            reg = <0x10>;
            avdd-supply = <&reg_stb_3v3>;
            interrupt-parent = <&gpio2>;
            interrupts = <12 IRQ_TYPE_LEVEL_LOW>;
        };
    };
...
```

## Documentation/devicetree/bindings/iio/adc/ti,tla2528.yaml
```yaml
# SPDX-License-Identifier: (GPL-2.0 OR BSD-2-Clause)
%YAML 1.2
---
$id: http://devicetree.org/schemas/iio/adc/ti,tla2528.yaml#
$schema: http://devicetree.org/meta-schemas/core.yaml#

title: Texas Instruments TLA2528 8-channel 12bit I2C ADC

maintainers:
  - Maxime Chevallier <maxime.chevallier@bootlin.com>

description: |
  12bit 8-channel I2C ADC.

properties:
  compatible:
    const: ti,tla2528

  reg:
    maxItems: 1

  vref-supply:
    description: Supply for 2.35V to 5.5V reference voltage

  "#io-channel-cells":
    const: 1

required:
  - compatible
  - reg
  - vref-supply

unevaluatedProperties: false

examples:
  - |
    i2c {
        #address-cells = <1>;
        #size-cells = <0>;

        adc@17 {
            compatible = "ti,tla2528";
            reg = <0x17>;
            vref-supply = <&reg_adc_supply>;
            #io-channel-cells = <1>;
        };
    };
...
```

## Documentation/devicetree/bindings/iio/adc/xilinx-xadc.yaml
```yaml
# SPDX-License-Identifier: (GPL-2.0-only OR BSD-2-Clause)
%YAML 1.2
---
$id: http://devicetree.org/schemas/iio/adc/xilinx-xadc.yaml#
$schema: http://devicetree.org/meta-schemas/core.yaml#

title: Xilinx 7 Series XADC and UltraScale/UltraScale+ System Monitor

maintainers:
  - Avermoal <avermoal@gmail.com>

description: |
  The Xilinx XADC is an ADC that can be found in the Series 7 FPGAs from Xilinx.
  The XADC has a DRP interface for communication. Currently two different
  frontends for the DRP interface exist. One that is only available on the ZYNQ
  family as a hardmacro in the SoC portion of the ZYNQ. The other one is
  available on all series 7 platforms and is a softmacro with an AXI interface.
  This binding document describes the bindings for both of them since the
  bindings are very similar.

  The Xilinx System Monitor is an ADC that is found in the UltraScale and
  UltraScale+ FPGAs from Xilinx. The System Monitor provides a DRP interface
  for communication. Xilinx provides a standard IP core that can be used to
  access the System Monitor through an AXI interface in the FPGA fabric.
  This IP core is called the Xilinx System Management Wizard. This document
  describes the bindings for this IP.

properties:
  compatible:
    description: |
      Specifies the interface type and the target device.
      - "xlnx,zynq-xadc-1.00.a"
      for ZYNQ device configuration interface (hardmacro in SoC)
      - "xlnx,axi-xadc-1.00.a"
      for AXI pcore softmacro on all Series 7 FPGAs
      - "xlnx,system-management-wiz-1.3"
      for UltraScale/UltraScale+ System Monitor via AXI
    enum:
      - xlnx,zynq-xadc-1.00.a
      - xlnx,axi-xadc-1.00.a
      - xlnx,system-management-wiz-1.3

  reg:
    description: Address and length of the register set for the device.
    maxItems: 1

  interrupts:
    description: Interrupt for the XADC control interface.
    maxItems: 1

  clocks:
    description: |
      When using the ZYNQ this must be the ZYNQ PCAP clock,
      when using the axi-xadc or the axi-system-management-wizard this must be
      the clock that provides the clock to the AXI bus interface of the core.
    maxItems: 1

  xlnx,external-mux:
    description: |
      External multiplexer mode. If omitted, defaults to "none".
      - "none" – no external multiplexer (default)
      - "single" – one external multiplexer
      - "dual" – two external multiplexers for simultaneous sampling
    $ref: /schemas/types.yaml#/definitions/string
    enum: [none, single, dual]
    default: none

  xlnx,external-mux-channel:
    description: |
      Configures which pair of pins is used to sample data in external mux mode.
      For single mode: 0 (VP/VN) or 1..16 (VAUXP[0..15]/VAUXN[0..15]).
      For dual mode: 1..8, where the value n corresponds to the pair
      (VAUXP[n-1]/VAUXN[n-1] and VAUXP[n+7]/VAUXN[n+7]).
    $ref: /schemas/types.yaml#/definitions/uint32
    minimum: 0
    maximum: 16

  xlnx,channels:
    description: |
      Container for external channels that are connected to the ADC.
      If this property is not present, no external channels will be assumed.
    type: object
    properties:
      "#address-cells":
        const: 1
      "#size-cells":
        const: 0
    patternProperties:
      "^channel@[0-9a-f]+$":
        type: object
        description: Each child node represents one external channel.
        properties:
          reg:
            description: |
              Pair of pins the channel is connected to.
              0: VP/VN
              1..16: VAUXP[0..15]/VAUXN[0..15]
            $ref: /schemas/types.yaml#/definitions/uint32
            minimum: 0
            maximum: 16
          xlnx,bipolar:
            description: If present, the channel is used in bipolar mode.
            type: boolean
        required:
          - reg
        additionalProperties: false
    additionalProperties: false

required:
  - compatible
  - reg
  - interrupts
  - clocks

unevaluatedProperties: false

examples:
  - |
    xadc@f8007100 {
        compatible = "xlnx,zynq-xadc-1.00.a";
        reg = <0xf8007100 0x20>;
        interrupts = <0 7 4>;
        interrupt-parent = <&gic>;
        clocks = <&pcap_clk>;

        xlnx,channels {
            #address-cells = <1>;
            #size-cells = <0>;
            channel@0 {
                reg = <0>;
            };
            channel@1 {
                reg = <1>;
            };
            channel@8 {
                reg = <8>;
            };
        };
    };
  - |
    xadc@43200000 {
        compatible = "xlnx,axi-xadc-1.00.a";
        reg = <0x43200000 0x1000>;
        interrupts = <0 53 4>;
        interrupt-parent = <&gic>;
        clocks = <&fpga1_clk>;

        xlnx,channels {
            #address-cells = <1>;
            #size-cells = <0>;
            channel@0 {
                reg = <0>;
                xlnx,bipolar;
            };
        };
    };
  - |
    adc@80000000 {
        compatible = "xlnx,system-management-wiz-1.3";
        reg = <0x80000000 0x1000>;
        interrupts = <0 81 4>;
        interrupt-parent = <&gic>;
        clocks = <&fpga1_clk>;

        xlnx,channels {
            #address-cells = <1>;
            #size-cells = <0>;
            channel@0 {
                reg = <0>;
                xlnx,bipolar;
            };
        };
    };
...
```

## Documentation/devicetree/bindings/iio/adc/xlnx,axi-xadc.yaml
```yaml
# SPDX-License-Identifier: (GPL-2.0 OR BSD-2-Clause)
%YAML 1.2
---
$id: http://devicetree.org/schemas/iio/adc/xlnx,axi-xadc.yaml#
$schema: http://devicetree.org/meta-schemas/core.yaml#

title: Xilinx XADC and System Monitor ADC

description:
  The Xilinx XADC is an ADC that can be found in the Series 7 FPGAs from
  Xilinx. The XADC has a DRP interface for communication. Currently two
  different frontends for the DRP interface exist. One that is only available
  on the ZYNQ family as a hardmacro in the SoC portion of the ZYNQ. The other
  one is available on all series 7 platforms and is a softmacro with an AXI
  interface.

  The Xilinx System Monitor is an ADC that is found in the UltraScale and
  UltraScale+ FPGAs from Xilinx. The System Monitor provides a DRP interface
  for communication. Xilinx provides a standard IP core that can be used to
  access the System Monitor through an AXI interface in the FPGA fabric. This
  IP core is called the Xilinx System Management Wizard.

maintainers:
  - Lars-Peter Clausen <lars@metafoo.de>
  - Sai Krishna Potthuri <sai.krishna.potthuri@amd.com>

properties:
  compatible:
    enum:
      - xlnx,zynq-xadc-1.00.a
      - xlnx,axi-xadc-1.00.a
      - xlnx,system-management-wiz-1.3

  reg:
    maxItems: 1

  interrupts:
    maxItems: 1

  clocks:
    maxItems: 1
    description:
      When using the ZYNQ this must be the ZYNQ PCAP clock,
      when using the axi-xadc or the axi-system-management-wizard this must be
      the clock that provides the clock to the AXI bus interface of the core.

  xlnx,external-mux:
    $ref: /schemas/types.yaml#/definitions/string
    enum:
      - none
      - single
      - dual
    default: none
    description: |
      External multiplexer configuration:
      - "none": No external multiplexer is used
      - "single": External multiplexer mode is used with one multiplexer
      - "dual": External multiplexer mode is used with two multiplexers
        for simultaneous sampling

  xlnx,external-mux-channel:
    $ref: /schemas/types.yaml#/definitions/uint32
    minimum: 0
    maximum: 16
    description: |
      Configures which pair of pins is used to sample data in external mux mode.
      Valid values for single external multiplexer mode are 0-16:
      0: VP/VN
      1-16: VAUXP[0-15]/VAUXN[0-15]
      Valid values for dual external multiplexer mode are 1-8:
      1-8: VAUXP[0-7]/VAUXN[0-7] - VAUXP[8-15]/VAUXN[8-15]
      This property needs to be present if the device is configured for
      external multiplexer mode (either single or dual).

  xlnx,channels:
    description: List of external channels that are connected to the ADC
    type: object
    properties:
      '#address-cells':
        const: 1
      '#size-cells':
        const: 0

    patternProperties:
      "^channel@([0-9]|1[0-6])$":
        type: object
        properties:
          reg:
            minimum: 0
            maximum: 16
            description: |
              Pair of pins the channel is connected to:
                0: VP/VN
                1-16: VAUXP[0-15]/VAUXN[0-15]
              Note each channel number should only be used at most once.

          xlnx,bipolar:
            type: boolean
            description: If set, the channel is used in bipolar mode

        required:
          - reg

        additionalProperties: false

    required:
      - '#address-cells'
      - '#size-cells'

    additionalProperties: false

allOf:
  - if:
      required:
        - xlnx,external-mux
      properties:
        xlnx,external-mux:
          enum:
            - single
            - dual
    then:
      required:
        - xlnx,external-mux-channel

required:
  - compatible
  - reg

additionalProperties: false

examples:
  - |
    #include <dt-bindings/interrupt-controller/arm-gic.h>
    #include <dt-bindings/interrupt-controller/irq.h>
    adc@f8007100 {
        compatible = "xlnx,zynq-xadc-1.00.a";
        reg = <0xf8007100 0x20>;
        interrupts = <GIC_SPI 7 IRQ_TYPE_LEVEL_HIGH>;
        clocks = <&pcap_clk>;

        xlnx,channels {
            #address-cells = <1>;
            #size-cells = <0>;
            channel@0 {
                reg = <0>;
            };
            channel@1 {
                reg = <1>;
            };
            channel@8 {
                reg = <8>;
            };
        };
    };
```
