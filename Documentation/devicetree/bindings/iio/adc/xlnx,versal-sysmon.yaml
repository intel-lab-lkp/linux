## Documentation/devicetree/bindings/iio/adc/xlnx,versal-sysmon.yaml
```yaml
# SPDX-License-Identifier: (GPL-2.0-only OR BSD-2-Clause)
# Copyright (C) 2022 - 2026, Advanced Micro Devices, Inc.
%YAML 1.2
---
$id: http://devicetree.org/schemas/iio/adc/xlnx,versal-sysmon.yaml#
$schema: http://devicetree.org/meta-schemas/core.yaml#

title: AMD/Xilinx Versal System Monitor

maintainers:
  - Salih Erim <salih.erim@amd.com>

description:
  The AMD/Xilinx Versal System Monitor (SysMon) is the successor to the
  Zynq UltraScale+ AMS block. It provides on-chip voltage and temperature
  monitoring with up to 160 supply voltage measurement points and up to
  64 temperature satellites distributed across the SoC. The hardware
  supports configurable threshold alarms and oversampling. The device
  can be accessed via memory-mapped I/O or via an I2C interface.

properties:
  compatible:
    enum:
      - xlnx,versal-sysmon
      - xlnx,versal-sysmon-i2c

  reg:
    maxItems: 1

  interrupts:
    maxItems: 1

  '#io-channel-cells':
    const: 1

  supply-channels:
    type: object
    description:
      Container for supply voltage measurement channels.

    properties:
      '#address-cells':
        const: 1

      '#size-cells':
        const: 0

    patternProperties:
      "^channel@([0-9a-f]|[1-9][0-9a-f])$":
        $ref: adc.yaml

        description:
          Measures a supply rail voltage. The register index and rail
          name are assigned by the hardware design tool (Vivado).

        properties:
          reg:
            minimum: 0
            maximum: 159
            description:
              Supply measurement register index assigned by the hardware
              design tool.

          label:
            description:
              Name of the supply rail being monitored.

          bipolar: true

        required:
          - reg
          - label

        unevaluatedProperties: false

    required:
      - '#address-cells'
      - '#size-cells'

    additionalProperties: false

  temperature-channels:
    type: object
    description:
      Container for temperature satellite measurement channels.

    properties:
      '#address-cells':
        const: 1

      '#size-cells':
        const: 0

    patternProperties:
      "^channel@([1-9a-f]|[1-3][0-9a-f]|40)$":
        $ref: adc.yaml

        description:
          Reads a temperature satellite sensor. Each satellite monitors
          a specific region of the SoC die.

        properties:
          reg:
            minimum: 1
            maximum: 64
            description:
              Temperature satellite number (1-based hardware index).

          label:
            description:
              Name identifying this temperature satellite.

          xlnx,aie-temp:
            type: boolean
            description:
              Indicates this satellite monitors an AI Engine tile.

        required:
          - reg
          - label

        unevaluatedProperties: false

    required:
      - '#address-cells'
      - '#size-cells'

    additionalProperties: false

required:
  - compatible
  - reg

additionalProperties: false

examples:
  - |
    #include <dt-bindings/interrupt-controller/arm-gic.h>

    sysmon@f1270000 {
        compatible = "xlnx,versal-sysmon";
        reg = <0xf1270000 0x4000>;
        interrupts = <GIC_SPI 144 IRQ_TYPE_LEVEL_HIGH>;
        #io-channel-cells = <1>;

        supply-channels {
            #address-cells = <1>;
            #size-cells = <0>;

            channel@0 {
                reg = <0>;
                label = "vccaux";
            };

            channel@3 {
                reg = <3>;
                label = "vcc_ram";
                bipolar;
            };
        };

        temperature-channels {
            #address-cells = <1>;
            #size-cells = <0>;

            channel@a {
                reg = <10>;
                label = "aie-temp-ch1";
                xlnx,aie-temp;
            };
        };
    };
```

## Documentation/devicetree/bindings/iio/adc/xlnx,xadc.yaml
```yaml
# SPDX-License-Identifier: (GPL-2.0-only OR BSD-2-Clause)

%YAML 1.2
---
$id: http://devicetree.org/schemas/iio/adc/xlnx,xadc.yaml#
$schema: http://devicetree.org/meta-schemas/core.yaml#

title: Xilinx XADC device driver

maintainers:
  - Omer PALA <palaomer100@gmail.com>

description: |
  This binding document describes the bindings for the Xilinx 7 Series XADC as well
  as the UltraScale/UltraScale+ System Monitor.

properties:
  compatible:
    enum:
      - xlnx,zynq-xadc-1.00.a
      - xlnx,axi-xadc-1.00.a
      - xlnx,system-management-wiz-1.3

  reg:
    description: Address and length of the register set for the device
    maxItems: 1

  interrupts:
    description: Interrupt for the XADC control interface.
    maxItems: 1

  clocks:
    maxItems: 1

  xlnx,external-mux:
    description: Selects the external mux mode.
    enum: [none, single, dual]
    default: none

  xlnx,external-mux-channel:
    description: >
      Configures which pair of pins is used to sample data in
      external mux mode.
    $ref: /schemas/types.yaml#/definitions/uint32

  xlnx,channels:
    type: object
    description: List of external channels that are connected to the ADC.
    properties:
      "#address-cells":
        const: 1
      "#size-cells":
        const: 0
    required:
      - "#address-cells"
      - "#size-cells"
    patternProperties:
      "^channel@[0-9a-f]+$":
        type: object
        properties:
          reg:
            description: Pair of pins the channel is connected to
            items:
              - minimum: 0
                maximum: 16
          xlnx,bipolar:
            description: If set the channel is used in bipolar mode.
            $ref: /schemas/types.yaml#/definitions/flag
        required:
          - reg
        additionalProperties: false
    additionalProperties: false

required:
  - compatible
  - reg
  - interrupts
  - clocks

unevaluatedProperties: false

allOf:
  - if:
      not:
        properties:
          xlnx,external-mux:
            enum: [single, dual]
    then:
      properties:
        xlnx,external-mux-channel: false

  - if:
      properties:
        xlnx,external-mux:
          const: single
      required:
        - xlnx,external-mux
    then:
      properties:
        xlnx,external-mux-channel:
          minimum: 0
          maximum: 16
      required:
        - xlnx,external-mux-channel

  - if:
      properties:
        xlnx,external-mux:
          const: dual
      required:
        - xlnx,external-mux
    then:
      properties:
        xlnx,external-mux-channel:
          minimum: 1
          maximum: 8
      required:
        - xlnx,external-mux-channel

examples:
  - |
    soc {
      #address-cells = <1>;
      #size-cells = <1>;

      xadc@f8007100 {
        compatible = "xlnx,zynq-xadc-1.00.a";
        reg = <0xf8007100 0x20>;
        interrupts = <0 7 4>;
        interrupt-parent = <&gic>;
        clocks = <&pcap_clk>;

        xlnx,external-mux = "single";
        xlnx,external-mux-channel = <0>;

        xlnx,channels {
          #address-cells = <1>;
          #size-cells = <0>;

          channel@0 {
            reg = <0>;
          };
          channel@1 {
            reg = <1>;
          };
          channel@8 {
            reg = <8>;
          };
        };
      };
      xadc@43200000 {
        compatible = "xlnx,axi-xadc-1.00.a";
        reg = <0x43200000 0x1000>;
        interrupts = <0 53 4>;
        interrupt-parent = <&gic>;
        clocks = <&fpga1_clk>;

        xlnx,external-mux = "single";
        xlnx,external-mux-channel = <0>;

        xlnx,channels {
          #address-cells = <1>;
          #size-cells = <0>;
          channel@0 {
            reg = <0>;
            xlnx,bipolar;
          };
        };
      };
      adc@80000000 {
        compatible = "xlnx,system-management-wiz-1.3";
        reg = <0x80000000 0x1000>;
        interrupts = <0 81 4>;
        interrupt-parent = <&gic>;
        clocks = <&fpga1_clk>;

        xlnx,external-mux = "single";
        xlnx,external-mux-channel = <0>;

        xlnx,channels {
          #address-cells = <1>;
          #size-cells = <0>;
          channel@0 {
            reg = <0>;
            xlnx,bipolar;
          };
        };
      };
    };
```

## Documentation/devicetree/bindings/iio/chemical/dfrobot,sen0322.yaml
```yaml
# SPDX-License-Identifier: (GPL-2.0 OR BSD-2-Clause)
%YAML 1.2
---
$id: http://devicetree.org/schemas/iio/chemical/dfrobot,sen0322.yaml#
$schema: http://devicetree.org/meta-schemas/core.yaml#

title: DFRobot SEN0322 oxygen sensor

maintainers:
  - Tóth János <gomba007@gmail.com>

description: >
  DFRobot SEN0322 is an oxygen sensor. It supports I2C for communication.

  Datasheet:
    https://wiki.dfrobot.com/Gravity_I2C_Oxygen_Sensor_SKU_SEN0322

properties:
  compatible:
    const: dfrobot,sen0322

  reg:
    maxItems: 1

required:
  - compatible
  - reg

additionalProperties: false

examples:
  - |
    i2c {
      #address-cells = <1>;
      #size-cells = <0>;

      sen0322@73 {
        compatible = "dfrobot,sen0322";
        reg = <0x73>;
      };
    };
```

## Documentation/devicetree/bindings/iio/chemical/sharp,gp2y1010au0f.yaml
```yaml
# SPDX-License-Identifier: (GPL-2.0 OR BSD-2-Clause)
%YAML 1.2
---
$id: http://devicetree.org/schemas/iio/chemical/sharp,gp2y1010au0f.yaml#
$schema: http://devicetree.org/meta-schemas/core.yaml#

title: Sharp GP2Y1010AU0F Optical Dust Sensor

maintainers:
  - Suraj Sonawane <surajsonawane0215@gmail.com>

description: |
  Optical dust sensor measuring particulate matter concentration via infrared scattering.
  Requires ADC for analog output and GPIO for pulsed LED control with strict timing.
  Datasheet: https://global.sharp/products/device/lineup/data/pdf/datasheet/gp2y1010au_appl_e.pdf

properties:
  compatible:
    const: sharp,gp2y1010au0f

  reg:
    maxItems: 1

  vdd-supply: true

  led-gpios:
    description: GPIO connected to the sensor's LED control pin (V-LED)
    maxItems: 1

  io-channels:
    description: ADC channel connected to the sensor's analog output (Vo)
    maxItems: 1

  io-channel-names:
    const: dust

  sharp,led-on-delay-us:
    description: |
      Delay in microseconds after turning the LED ON before reading ADC.
      The datasheet recommends 280µs after LED ON for accurate measurement.
      (See Section 6-1 of the datasheet: Sampling timing = 0.28ms)

    default: 280
    minimum: 0
    maximum: 320

  sharp,measurement-window-us:
    description: |
      Duration in microseconds the LED remains ON for measurement.
      The recommended pulse width is 320µs ±20µs. (See Section 6-1)

    default: 320
    minimum: 300
    maximum: 340

required:
  - compatible
  - reg
  - led-gpios
  - io-channels
  - io-channel-names

additionalProperties: false

examples:
  - |
    #include <dt-bindings/gpio/gpio.h>

    dust_sensor {
        compatible = "sharp,gp2y1010au0f";
        reg = <0>;
        vdd-supply = <&vcc>;
        led-gpios = <&gpio 44 GPIO_ACTIVE_HIGH>;
        io-channels = <&adc 0>;
        io-channel-names = "dust";
        sharp,led-on-delay-us = <280>;
        sharp,measurement-window-us = <320>;
    };
```

## Documentation/devicetree/bindings/iio/dac/adi,ad5504.yaml
```yaml
# SPDX-License-Identifier: (GPL-2.0 OR BSD-2-Clause)
%YAML 1.2
---
$id: http://devicetree.org/schemas/iio/dac/adi,ad5504.yaml#
$schema: http://devicetree.org/meta-schemas/core.yaml#

title: Analog Devices AD5501 and AD5504 DACs

maintainers:
  - Lars-Peter Clausen <lars@metafoo.de>
  - Jonathan Cameron <jic23@kernel.org>

description: |
  High voltage (up to 60V) DACs with temperature sensor alarm function
  https://www.analog.com/media/en/technical-documentation/data-sheets/ad5504.pdf
  https://www.analog.com/media/en/technical-documentation/data-sheets/ad5501.pdf

properties:
  compatible:
    enum:
      - adi,ad5501
      - adi,ad5504

  reg:
    maxItems: 1

  interrupts:
    description: Used for temperature alarm.
    maxItems: 1

  vcc-supply: true
  vlogic-supply: true

  output-range-microvolt:
    description: |
      Specify the channel output full scale range. The R_SEL pin
      determines if the range is 0-30V or 0-60V.
    items:
      - const: 0
      - enum: [30000000, 60000000]
    default: [0, 60000000]

  range-sel-gpios:
    description:
      GPIO connected to the R_SEL pin to select the output voltage range.
    maxItems: 1

  clr-gpios:
    description: GPIO that controls the /CLR pin (active low).
    maxItems: 1

  ldac-gpios:
    description: GPIO that controls the /LDAC pin (active low).
    maxItems: 1

additionalProperties: false

required:
  - compatible
  - reg

allOf:
  - not:
      required:
        - range-sel-gpios
        - output-range-microvolt

examples:
  - |
    #include <dt-bindings/interrupt-controller/irq.h>
    #include <dt-bindings/gpio/gpio.h>

    spi {
        #address-cells = <1>;
        #size-cells = <0>;
        dac@0 {
            reg = <0>;
            compatible = "adi,ad5504";
            vcc-supply = <&dac_vcc>;
            interrupts = <55 IRQ_TYPE_EDGE_FALLING>;

            output-range-microvolt = <0 60000000>;
            clr-gpios = <&gpio 4 GPIO_ACTIVE_LOW>;
            ldac-gpios = <&gpio 5 GPIO_ACTIVE_LOW>;
        };
    };
...
```
