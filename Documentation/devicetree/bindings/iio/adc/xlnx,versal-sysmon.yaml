## Documentation/devicetree/bindings/iio/dac/adi,ad5529r.yaml
```yaml
# SPDX-License-Identifier: (GPL-2.0 OR BSD-2-Clause)
%YAML 1.2
---
$id: http://devicetree.org/schemas/iio/dac/adi,ad5529r.yaml#
$schema: http://devicetree.org/meta-schemas/core.yaml#

title: Analog Devices AD5529R 16-Channel 12/16-bit High Voltage DAC

maintainers:
  - Janani Sunil <janani.sunil@analog.com>

description: |
  The AD5529R is a 16-channel, 12-bit or 16-bit, high voltage, buffered voltage output
  digital-to-analog converter (DAC) with an integrated precision reference.
  The device operates from unipolar and bipolar supplies. It is guaranteed
  monotonic and has built-in rail-to-rail output buffers that can source or
  sink up to 25mA.

  Specifications:
  * 16 independent 12-bit or 16-bit DAC channels
  * Independently programmable output ranges: 0V to 5V, 0V to 10V, 0V to 20V,
    0V to 40V, ±5V, ±10V, ±15V, and ±20V
  * The device supports SPI communication with Mode 0 and Mode 3.
  * 4.096V precision reference, 12ppm/°C maximum
  * Built-in function generation: Toggle, Sinusoidal Dither, and Ramp waveforms
  * Multiplexer for output voltage, load current sense and die temperature

  Datasheet: https://www.analog.com/media/en/technical-documentation/data-sheets/ad5529r.pdf

properties:
  compatible:
    enum:
      - adi,ad5529r-16   # 16-bit variant
      - adi,ad5529r-12   # 12-bit variant

  reg:
    maxItems: 1

  spi-max-frequency:
    maximum: 25000000
    description:
      Maximum SPI frequency. The device supports SPI Mode 0 and Mode 3.
      Read operations are limited to 25MHz maximum.

  reset-gpios:
    maxItems: 1
    description:
      GPIO connected to the RESET pin. Active low. When asserted low,
      performs a power-on reset and initializes the device to its default state.

  clear-gpios:
    maxItems: 1
    description:
      GPIO connected to the CLEAR pin. Active low. When asserted low,
      clears all DAC data registers without affecting configuration settings.

  interrupts:
    maxItems: 1
    description:
      Interrupt connected to the ALARM pin. Active low interrupt output
      for overtemperature conditions, SPI CRC errors, and function completion.

  tg0-gpios:
    maxItems: 1
    description:
      GPIO connected to the TG0 toggle pin. Pulsing this pin allows all
      selected DACs to be updated synchronously for coordinated output changes.

  tg1-gpios:
    maxItems: 1
    description:
      GPIO connected to the TG1 toggle pin. Pulsing this pin allows all
      selected DACs to be updated synchronously for coordinated output changes.

  tg2-gpios:
    maxItems: 1
    description:
      GPIO connected to the TG2 toggle pin. Pulsing this pin allows all
      selected DACs to be updated synchronously for coordinated output changes.

  tg3-gpios:
    maxItems: 1
    description:
      GPIO connected to the TG3 toggle pin. Pulsing this pin allows all
      selected DACs to be updated synchronously for coordinated output changes.

  io-channels:
    maxItems: 1
    description:
      ADC channel connected to the MUXOUT pin for monitoring output voltage,
      load current sense, and die temperature.

  io-channel-names:
    const: muxout

  vdd-supply:
    description: Digital power supply (1.08V to 1.98V)

  avdd-supply:
    description: Analog power supply (4.75V to 5.25V)

  hvdd-supply:
    description:
      High voltage positive supply (7V to 45V). Supply voltage should be chosen
      based on configured output ranges (see datasheet Table 9).

  hvss-supply:
    description:
      High voltage negative supply (-22.5V to 0V). Required only when using bipolar
      output ranges (±5V, ±10V, ±15V, ±20V). Supply voltage should be
      chosen based on configured output ranges (see datasheet Table 9).

  vref-supply:
    description:
      External voltage reference supply (4.056V to 4.136V, typically 4.096V).
      When specified, the device uses external reference mode and the VREF pin becomes an
      input. The device uses the internal 4.096V precision reference otherwise.

  "#address-cells":
    const: 1

  "#size-cells":
    const: 0

patternProperties:
  "^channel@([0-9]|1[0-5])$":
    type: object
    description: Child nodes for individual channel configuration

    properties:
      reg:
        description: Channel number.
        minimum: 0
        maximum: 15

      adi,output-range-microvolt:
        description: |
          Output voltage range for this channel as [min, max] in microvolts.
          If not specified, defaults to 0V to 5V range.
        oneOf:
          - items:
              - const: 0
              - enum: [5000000, 10000000, 20000000, 40000000]
          - items:
              - const: -5000000
              - const: 5000000
          - items:
              - const: -10000000
              - const: 10000000
          - items:
              - const: -15000000
              - const: 15000000
          - items:
              - const: -20000000
              - const: 20000000

    required:
      - reg

    additionalProperties: false

required:
  - compatible
  - reg
  - vdd-supply
  - avdd-supply
  - hvdd-supply

dependencies:
  spi-cpha: [ spi-cpol ]
  spi-cpol: [ spi-cpha ]

allOf:
  - $ref: /schemas/spi/spi-peripheral-props.yaml#

unevaluatedProperties: false

examples:
  - |
    #include <dt-bindings/gpio/gpio.h>

    spi {
        #address-cells = <1>;
        #size-cells = <0>;

        dac@0 {
            compatible = "adi,ad5529r-16";
            reg = <0>;
            spi-max-frequency = <25000000>;

            vdd-supply = <&vdd_regulator>;
            avdd-supply = <&avdd_regulator>;
            hvdd-supply = <&hvdd_regulator>;
            hvss-supply = <&hvss_regulator>;

            reset-gpios = <&gpio0 87 GPIO_ACTIVE_LOW>;

            #address-cells = <1>;
            #size-cells = <0>;

            channel@0 {
                reg = <0>;
                adi,output-range-microvolt = <0 5000000>;
            };

            channel@1 {
                reg = <1>;
                adi,output-range-microvolt = <(-10000000) 10000000>;
            };

            channel@2 {
                reg = <2>;
                adi,output-range-microvolt = <0 40000000>;
            };
        };
    };
...
```

## Documentation/devicetree/bindings/iio/dac/adi,ad5706r.yaml
```yaml
# SPDX-License-Identifier: (GPL-2.0-only OR BSD-2-Clause)
%YAML 1.2
---
$id: http://devicetree.org/schemas/iio/dac/adi,ad5706r.yaml#
$schema: http://devicetree.org/meta-schemas/core.yaml#

title: Analog Devices AD5706R 4-Channel Current Output DAC

maintainers:
  - Alexis Czezar Torreno <alexisczezar.torreno@analog.com>

description: |
  The AD5706R is a 16-bit, 4-channel current output digital-to-analog
  converter with SPI interface.

  Datasheet:
    https://www.analog.com/en/products/ad5706r.html

properties:
  compatible:
    enum:
      - adi,ad5706r

  reg:
    maxItems: 1

  avdd-supply:
    description: Analog power supply

  spi-max-frequency:
    maximum: 50000000

required:
  - compatible
  - reg
  - avdd-supply

allOf:
  - $ref: /schemas/spi/spi-peripheral-props.yaml#

unevaluatedProperties: false

examples:
  - |
    spi {
        #address-cells = <1>;
        #size-cells = <0>;

        dac@0 {
            compatible = "adi,ad5706r";
            reg = <0>;
            avdd-supply = <&dac_avdd>;
            spi-max-frequency = <50000000>;
        };
    };
...
```

## Documentation/devicetree/bindings/iio/dac/adi,ad8460.yaml
```yaml
# SPDX-License-Identifier: (GPL-2.0 OR BSD-2-Clause)
# Copyright 2024 Analog Devices Inc.
%YAML 1.2
---
$id: http://devicetree.org/schemas/iio/dac/adi,ad8460.yaml#
$schema: http://devicetree.org/meta-schemas/core.yaml#

title: Analog Devices AD8460 DAC

maintainers:
  - Mariel Tinaco <mariel.tinaco@analog.com>

description: |
  Analog Devices AD8460 110 V High Voltage, 1 A High Current,
  Arbitrary Waveform Generator with Integrated 14-Bit High Speed DAC
  https://www.analog.com/media/en/technical-documentation/data-sheets/ad8460.pdf

properties:
  compatible:
    enum:
      - adi,ad8460

  reg:
    maxItems: 1

  dmas:
    maxItems: 1

  dma-names:
    items:
      - const: tx

  spi-max-frequency:
    maximum: 20000000

  hvcc-supply:
    description: Positive high voltage power supply line

  hvee-supply:
    description: Negative high voltage power supply line

  vcc-5v-supply:
    description: Low voltage power supply

  vref-5v-supply:
    description: Reference voltage for analog low voltage and protection threshold DACs.

  dvdd-3p3v-supply:
    description: Digital supply bypass

  avdd-3p3v-supply:
    description: Analog supply bypass

  refio-1p2v-supply:
    description: Drive voltage in the range of 1.2V maximum to as low as
      low as 0.12V through the REF_IO pin to adjust full scale output span

  clocks:
    description: The clock for the DAC. This is the sync clock

  adi,rset-ohms:
    description: Specify value of external resistor connected to FS_ADJ pin
      to establish internal HVDAC's reference current I_REF
    default: 2000
    minimum: 2000
    maximum: 20000

  adi,range-microvolt:
    description: |
      Voltage output range specified as <minimum, maximum>
    oneOf:
      - items:
          - const: -40000000
          - const: 40000000

  adi,range-microamp:
    description: |
      Current output range specified as <minimum, maximum>
    oneOf:
      - items:
          - const: 0
          - const: 50000
      - items:
          - const: -50000
          - const: 50000

  adi,temp-max-millicelsius:
    description: Overtemperature threshold
    default: 50000
    minimum: 20000
    maximum: 150000

  sdn-reset-gpios:
    description: GPIO spec for the SHUTDOWN RESET pin. As the line is active high,
      it should be marked GPIO_ACTIVE_HIGH.
    maxItems: 1

  reset-gpios:
    description: GPIO spec for the RESET pin. As the line is active low, it
      should be marked GPIO_ACTIVE_LOW.
    maxItems: 1

  sdn-io-gpios:
    description: GPIO spec for the SHUTDOWN INPUT/OUTPUT pin. As the line is
      active high, it should be marked GPIO_ACTIVE_HIGH.
    maxItems: 1

required:
  - compatible
  - reg
  - clocks

allOf:
  - $ref: /schemas/spi/spi-peripheral-props.yaml#

additionalProperties: false

examples:
  - |
    #include <dt-bindings/gpio/gpio.h>

    spi {
        #address-cells = <1>;
        #size-cells = <0>;

        dac@0 {
            compatible = "adi,ad8460";
            reg = <0>;
            spi-max-frequency = <8000000>;
            adi,rset-ohms = <2000>;
            adi,range-microvolt = <(-40000000) 40000000>;
            adi,range-microamp = <0 50000>;
            adi,temp-max-millicelsius = <50000>;

            dmas = <&tx_dma 0>;
            dma-names = "tx";

            sdn-reset-gpios = <&gpio 86 GPIO_ACTIVE_HIGH>;
            reset-gpios = <&gpio 91 GPIO_ACTIVE_LOW>;
            sdn-io-gpios = <&gpio 88 GPIO_ACTIVE_HIGH>;

            clocks = <&sync_ext_clk>;

            hvcc-supply = <&hvcc>;
            hvee-supply = <&hvee>;
            vcc-5v-supply = <&vcc_5>;
            vref-5v-supply = <&vref_5>;
            dvdd-3p3v-supply = <&dvdd_3_3>;
            avdd-3p3v-supply = <&avdd_3_3>;
            refio-1p2v-supply = <&refio_1_2>;
        };
    };

...
```

## Documentation/devicetree/bindings/iio/dac/maxim,ds4424.yaml
```yaml
# SPDX-License-Identifier: (GPL-2.0 OR BSD-2-Clause)
%YAML 1.2
---
$id: http://devicetree.org/schemas/iio/dac/maxim,ds4424.yaml#
$schema: http://devicetree.org/meta-schemas/core.yaml#

title: Maxim Integrated DS4402/DS4404 and DS4422/DS4424 Current DACs

maintainers:
  - Ismail Kose <ihkose@gmail.com>

description: |
  Datasheets publicly available at:
  https://datasheets.maximintegrated.com/en/ds/DS4402-DS4404.pdf
  https://datasheets.maximintegrated.com/en/ds/DS4422-DS4424.pdf

properties:
  compatible:
    enum:
      - maxim,ds4402
      - maxim,ds4404
      - maxim,ds4422
      - maxim,ds4424

  reg:
    maxItems: 1

  vcc-supply: true

  maxim,rfs-ohms:
    description: |
      Array of resistance values in Ohms for the external Rfs resistors
      connected to the FS pins.
      - For DS44x2 (2 channels): 2 values required.
      - For DS44x4 (4 channels): 4 values required.
      Typical values range from 40000 (40 kOhm) to 160000 (160 kOhm).

required:
  - compatible
  - reg
  - maxim,rfs-ohms

allOf:
  - if:
      properties:
        compatible:
          contains:
            enum:
              - maxim,ds4402
              - maxim,ds4422
    then:
      properties:
        maxim,rfs-ohms:
          minItems: 2
          maxItems: 2
  - if:
      properties:
        compatible:
          contains:
            enum:
              - maxim,ds4404
              - maxim,ds4424
    then:
      properties:
        maxim,rfs-ohms:
          minItems: 4
          maxItems: 4

additionalProperties: false

examples:
  - |
    i2c {
        #address-cells = <1>;
        #size-cells = <0>;

        dac@10 {
            compatible = "maxim,ds4424";
            reg = <0x10>; /* When A0, A1 pins are ground */
            vcc-supply = <&vcc_3v3>;
            maxim,rfs-ohms = <5100>, <5100>, <5100>, <5100>;
        };
    };
...
```
