## Documentation/devicetree/bindings/iio/humidity/sciosense,ens21x.yaml
```yaml
# SPDX-License-Identifier: (GPL-2.0 OR BSD-2-Clause)
%YAML 1.2
---
$id: http://devicetree.org/schemas/iio/humidity/sciosense,ens21x.yaml#
$schema: http://devicetree.org/meta-schemas/core.yaml#

title: ScioSense ENS21x temperature and humidity sensor

maintainers:
  - Joshua Felmeden <jfelmeden@thegoodpenguin.co.uk>

description: |
  Temperature and Humidity sensor.

  Datasheet:
    https://www.sciosense.com/wp-content/uploads/2024/04/ENS21x-Datasheet.pdf
    https://www.sciosense.com/wp-content/uploads/2023/12/ENS210-Datasheet.pdf

properties:
  compatible:
    enum:
      - sciosense,ens210
      - sciosense,ens210a
      - sciosense,ens211
      - sciosense,ens212
      - sciosense,ens213a
      - sciosense,ens215

  reg:
    maxItems: 1

required:
  - compatible
  - reg

unevaluatedProperties: false

examples:
  - |
    i2c {
       #address-cells = <1>;
       #size-cells = <0>;

       temperature-sensor@43 {
           compatible = "sciosense,ens210";
           reg = <0x43>;
       };
    };
...
```

## Documentation/devicetree/bindings/iio/humidity/ti,hdc3020.yaml
```yaml
# SPDX-License-Identifier: (GPL-2.0-only OR BSD-2-Clause)
%YAML 1.2
---
$id: http://devicetree.org/schemas/iio/humidity/ti,hdc3020.yaml#
$schema: http://devicetree.org/meta-schemas/core.yaml#

title: HDC3020/HDC3021/HDC3022 humidity and temperature iio sensors

maintainers:
  - Jonathan Cameron <jic23@kernel.org>

description: |
  The HDC302x is an integrated capacitive based relative humidity (RH)
  and temperature sensor.

  datasheet is available:
    https://www.ti.com/lit/ds/symlink/hdc3020.pdf

properties:
  compatible:
    enum:
      - ti,hdc3020
      - ti,hdc3021
      - ti,hdc3022

  interrupts:
    maxItems: 1

  reg:
    maxItems: 1

required:
  - compatible
  - reg

additionalProperties: false

examples:
  - |
    i2c {
        #address-cells = <1>;
        #size-cells = <0>;

        humidity@47 {
            compatible = "ti,hdc3020";
            reg = <0x47>;
        };
    };
```

## Documentation/devicetree/bindings/iio/imu/adi,adis16550.yaml
```yaml
# SPDX-License-Identifier: (GPL-2.0 OR BSD-2-Clause)
%YAML 1.2
---
$id: http://devicetree.org/schemas/iio/imu/adi,adis16550.yaml#
$schema: http://devicetree.org/meta-schemas/core.yaml#

title: Analog Devices ADIS16550 and similar IMUs

maintainers:
  - Nuno Sa <nuno.sa@analog.com>
  - Ramona Gradinariu <ramona.gradinariu@analog.com>
  - Antoniu Miclaus <antoniu.miclaus@analog.com>

properties:
  compatible:
    enum:
      - adi,adis16550
      - adi,adis16550w

  reg:
    maxItems: 1

  spi-cpha: true

  spi-cpol: true

  spi-max-frequency:
    maximum: 15000000

  vdd-supply: true

  interrupts:
    maxItems: 1

  reset-gpios:
    description:
      RESET active low pin.
    maxItems: 1

  clocks:
    maxItems: 1
    description: If not provided, then the internal clock is used.

  adi,sync-mode:
    description:
      Configures the device SYNC pin. The following modes are supported
      0 - output_sync
      1 - direct_sync
      2 - scaled_sync
      3 - pulse_sync
    $ref: /schemas/types.yaml#/definitions/uint32
    minimum: 1
    maximum: 2

required:
  - compatible
  - reg
  - interrupts
  - spi-cpha
  - spi-cpol
  - spi-max-frequency
  - vdd-supply

allOf:
  - if:
      properties:
        adi,sync-mode:
          const: 2

    then:
      dependencies:
        adi,sync-mode: [ clocks ]

  - $ref: /schemas/spi/spi-peripheral-props.yaml#

unevaluatedProperties: false

examples:
  - |
    #include <dt-bindings/interrupt-controller/irq.h>
    spi {
        #address-cells = <1>;
        #size-cells = <0>;

        imu@0 {
            compatible = "adi,adis16550";
            reg = <0>;
            spi-max-frequency = <15000000>;
            spi-cpol;
            spi-cpha;
            vdd-supply = <&vdd>;
            interrupts = <4 IRQ_TYPE_EDGE_FALLING>;
            interrupt-parent = <&gpio>;
        };
    };
...
```

## Documentation/devicetree/bindings/iio/imu/adi,adis16607.yaml
```yaml
# SPDX-License-Identifier: (GPL-2.0-only OR BSD-2-Clause)
%YAML 1.2
---
$id: http://devicetree.org/schemas/iio/imu/adi,adis16607.yaml#
$schema: http://devicetree.org/meta-schemas/core.yaml#

title: Analog Devices ADIS16607 IMU

maintainers:
  - Radu Sabau <radu.sabau@analog.com>

description: |
  Analog Devices ADIS16607 Precision MEMS Inertial Measurement Unit (IMU)
  with a triaxial gyroscope, triaxial accelerometer, and temperature sensor.
  Uses SPI Half-Duplex communication protocol.

properties:
  compatible:
    enum:
      - adi,adis16607-2
      - adi,adis16607-3

  reg:
    maxItems: 1

  spi-cpha: true

  spi-cpol: true

  spi-max-frequency:
    maximum: 10000000

  vdd-supply: true

  interrupts:
    maxItems: 1

  clocks:
    description:
      Optional external clock for sync mode. If not provided, the internal
      8 kHz clock is used.
    maxItems: 1

  reset-gpios:
    description:
      Optional GPIO for hardware reset. If specified, it will be asserted
      during driver probe. The line is active low.
    maxItems: 1

required:
  - compatible
  - reg
  - interrupts
  - spi-cpha
  - spi-cpol
  - vdd-supply

allOf:
  - $ref: /schemas/spi/spi-peripheral-props.yaml#

unevaluatedProperties: false

examples:
  - |
    #include <dt-bindings/interrupt-controller/irq.h>
    #include <dt-bindings/gpio/gpio.h>
    spi {
        #address-cells = <1>;
        #size-cells = <0>;

        imu@0 {
            compatible = "adi,adis16607-2";
            reg = <0>;
            spi-cpha;
            spi-cpol;
            spi-max-frequency = <10000000>;
            vdd-supply = <&vdd>;
            interrupts = <4 IRQ_TYPE_LEVEL_HIGH>;
            interrupt-parent = <&gpio>;
            clocks = <&sync_clk>;
            reset-gpios = <&gpio 10 GPIO_ACTIVE_LOW>;
        };
    };
```

## Documentation/devicetree/bindings/iio/imu/bosch,bmi260.yaml
```yaml
# SPDX-License-Identifier: (GPL-2.0 OR BSD-2-Clause)
%YAML 1.2
---
$id: http://devicetree.org/schemas/iio/imu/bosch,bmi260.yaml#
$schema: http://devicetree.org/meta-schemas/core.yaml#

title: Bosch BMI260 6-Axis IMU

maintainers:
  - Justin Weiss <justin@justinweiss.com>

description: |
  BMI260 is a 6-axis inertial measurement unit that can measure acceleration and
  angular velocity. The sensor also supports configurable interrupt events such
  as motion detection and step counting. The sensor can communicate over
  I2C or SPI.
  https://www.bosch-sensortec.com/products/motion-sensors/imus/bmi260/

properties:
  compatible:
    const: bosch,bmi260

  reg:
    maxItems: 1

  vdd-supply: true
  vddio-supply: true

  interrupts:
    minItems: 1
    maxItems: 2

  interrupt-names:
    minItems: 1
    maxItems: 2
    items:
      enum:
        - INT1
        - INT2

  drive-open-drain:
    description:
      set if the specified interrupt pins should be configured as
      open drain. If not set, defaults to push-pull.

  mount-matrix:
    description:
      an optional 3x3 mounting rotation matrix.

required:
  - compatible
  - reg
  - vdd-supply
  - vddio-supply

allOf:
  - $ref: /schemas/spi/spi-peripheral-props.yaml#

unevaluatedProperties: false

examples:
  - |
    #include <dt-bindings/interrupt-controller/irq.h>
    i2c {
        #address-cells = <1>;
        #size-cells = <0>;

        imu@68 {
            compatible = "bosch,bmi260";
            reg = <0x68>;
            vdd-supply = <&vdd>;
            vddio-supply = <&vddio>;
            interrupt-parent = <&gpio1>;
            interrupts = <16 IRQ_TYPE_EDGE_RISING>;
            interrupt-names = "INT1";
        };
    };
```
