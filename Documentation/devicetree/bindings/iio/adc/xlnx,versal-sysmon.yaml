## Documentation/devicetree/bindings/iio/dac/microchip,mcp48feb02.yaml
```yaml
# SPDX-License-Identifier: (GPL-2.0 OR BSD-2-Clause)
%YAML 1.2
---
$id: http://devicetree.org/schemas/iio/dac/microchip,mcp48feb02.yaml#
$schema: http://devicetree.org/meta-schemas/core.yaml#

title: Microchip MCP48F(E/V)B(0/1/2)(1/2/4/8) DAC with SPI Interface Families

maintainers:
  - Ariana Lazar <ariana.lazar@microchip.com>

description: |
  Datasheet for MCP48FEB01, MCP48FEB02, MCP48FEB11, MCP48FEB12, MCP48FEB21,
  MCP48FEB22 can be found here:
    https://ww1.microchip.com/downloads/aemDocuments/documents/OTH/ProductDocuments/DataSheets/20005429B.pdf
  Datasheet for MCP48FVB01, MCP48FVB02, MCP48FVB11, MCP48FVB12, MCP48FVB21,
  MCP48FVB22 can be found here:
    https://ww1.microchip.com/downloads/aemDocuments/documents/OTH/ProductDocuments/DataSheets/20005466A.pdf
  Datasheet for MCP48FEB04, MCP48FEB14, MCP48FEB24, MCP48FEB08, MCP48FEB18,
  MCP48FEB28, MCP48FVB04, MCP48FVB14, MCP48FVB24, MCP48FVB08, MCP48FVB18,
  MCP48FVB28 can be found here:
    https://ww1.microchip.com/downloads/aemDocuments/documents/MSLD/ProductDocuments/DataSheets/MCP48FXBX4-8-Family-Data-Sheet-DS20006362A.pdf

  +------------+--------------+-------------+-------------+------------+
  | Device     |  Resolution  |   Channels  | Vref number | Memory     |
  |------------|--------------|-------------|-------------|------------|
  | MCP48FEB01 |              |      1      |      1      |   EEPROM   |
  | MCP48FEB02 |     8-bit    |      2      |      1      |   EEPROM   |
  | MCP48FEB04 |              |      4      |      2      |   EEPROM   |
  | MCP48FEB08 |              |      8      |      2      |   EEPROM   |
  |------------|--------------|-------------|-------------|------------|
  | MCP48FEB11 |              |      1      |      1      |   EEPROM   |
  | MCP48FEB12 |    10-bit    |      2      |      1      |   EEPROM   |
  | MCP48FEB14 |              |      4      |      2      |   EEPROM   |
  | MCP48FEB18 |              |      8      |      2      |   EEPROM   |
  |------------|--------------|-------------|-------------|------------|
  | MCP48FEB21 |              |      1      |      1      |   EEPROM   |
  | MCP48FEB22 |    12-bit    |      2      |      1      |   EEPROM   |
  | MCP48FEB24 |              |      4      |      2      |   EEPROM   |
  | MCP48FEB28 |              |      8      |      2      |   EEPROM   |
  |------------|--------------|-------------|-------------|------------|
  | MCP48FVB01 |              |      1      |      1      |   RAM      |
  | MCP48FVB02 |     8-bit    |      2      |      1      |   RAM      |
  | MCP48FVB04 |              |      4      |      2      |   RAM      |
  | MCP48FVB08 |              |      8      |      2      |   RAM      |
  |------------|--------------|-------------|-------------|------------|
  | MCP48FVB11 |              |      1      |      1      |   RAM      |
  | MCP48FVB12 |    10-bit    |      2      |      1      |   RAM      |
  | MCP48FVB14 |              |      4      |      2      |   RAM      |
  | MCP48FVB18 |              |      8      |      2      |   RAM      |
  |------------|--------------|-------------|-------------|------------|
  | MCP48FVB21 |              |      1      |      1      |   RAM      |
  | MCP48FVB22 |    12-bit    |      2      |      1      |   RAM      |
  | MCP48FVB24 |              |      4      |      2      |   RAM      |
  | MCP48FVB28 |              |      8      |      2      |   RAM      |
  +------------+--------------+-------------+-------------+------------+

properties:
  compatible:
    enum:
      - microchip,mcp48feb01
      - microchip,mcp48feb02
      - microchip,mcp48feb04
      - microchip,mcp48feb08
      - microchip,mcp48feb11
      - microchip,mcp48feb12
      - microchip,mcp48feb14
      - microchip,mcp48feb18
      - microchip,mcp48feb21
      - microchip,mcp48feb22
      - microchip,mcp48feb24
      - microchip,mcp48feb28
      - microchip,mcp48fvb01
      - microchip,mcp48fvb02
      - microchip,mcp48fvb04
      - microchip,mcp48fvb08
      - microchip,mcp48fvb11
      - microchip,mcp48fvb12
      - microchip,mcp48fvb14
      - microchip,mcp48fvb18
      - microchip,mcp48fvb21
      - microchip,mcp48fvb22
      - microchip,mcp48fvb24
      - microchip,mcp48fvb28

  reg:
    maxItems: 1

  "#address-cells":
    const: 1

  "#size-cells":
    const: 0

  vdd-supply:
    description:
      Provides power to the chip and it could be used as reference voltage. The
      voltage is used to calculate scale. For parts without EEPROM at powerup
      this will be the selected as voltage reference.

  vref-supply:
    description: |
      Vref pin (it could be found as Vref0 into the datasheet) may be used as a
      voltage reference when this supply is specified. The internal reference
      will be taken into account for voltage reference besides VDD if this supply
      does not exist.

      This supply will be voltage reference for the following outputs:
        - for single-channel device: Vout0;
        - for dual-channel device: Vout0, Vout1;
        - for quad-channel device: Vout0, Vout2;
        - for octal-channel device: Vout0, Vout2, Vout4, Vout6;

  vref1-supply:
    description: |
      Vref1 pin may be used as a voltage reference when this supply is specified.
      The internal reference will be taken into account for voltage reference
      beside VDD if this supply does not exist.

      This supply will be voltage reference for the following outputs:
        - for quad-channel device: Vout1, Vout3;
        - for octal-channel device: Vout1, Vout3, Vout5, Vout7;

  lat-gpios:
    description:
      LAT pin to be used as a hardware trigger to synchronously update the DAC
      channels. The pin is active Low. It could be also found as LAT0 in
      datasheet.
    maxItems: 1

  lat1-gpios:
    description:
      LAT1 pin to be used as a hardware trigger to synchronously update the odd
      DAC channels on devices with 4 and 8 channels. The pin is active Low.
    maxItems: 1

  microchip,vref-buffered:
    type: boolean
    description:
      Enable buffering of the external Vref/Vref0 pin in cases where the
      external reference voltage does not have sufficient current capability in
      order not to drop its voltage when connected to the internal resistor
      ladder circuit.

  microchip,vref1-buffered:
    type: boolean
    description:
      Enable buffering of the external Vref1 pin in cases where the external
      reference voltage does not have sufficient current capability in order not
      to drop its voltage when connected to the internal resistor ladder
      circuit.

patternProperties:
  "^channel@[0-7]$":
    $ref: dac.yaml
    type: object
    description: Voltage output channel.

    properties:
      reg:
        description: The channel number.
        maxItems: 1

      label:
        description: Unique name to identify which channel this is.

    required:
      - reg

    unevaluatedProperties: false

required:
  - compatible
  - reg
  - vdd-supply

allOf:
  - if:
      properties:
        compatible:
          contains:
            enum:
              - microchip,mcp48feb01
              - microchip,mcp48feb11
              - microchip,mcp48feb21
              - microchip,mcp48fvb01
              - microchip,mcp48fvb11
              - microchip,mcp48fvb21
    then:
      properties:
        lat1-gpios: false
        vref1-supply: false
        microchip,vref1-buffered: false
        channel@0:
          properties:
            reg:
              const: 0
      patternProperties:
        "^channel@[1-7]$": false
  - if:
      properties:
        compatible:
          contains:
            enum:
              - microchip,mcp48feb02
              - microchip,mcp48feb12
              - microchip,mcp48feb22
              - microchip,mcp48fvb02
              - microchip,mcp48fvb12
              - microchip,mcp48fvb22
    then:
      properties:
        lat1-gpios: false
        vref1-supply: false
        microchip,vref1-buffered: false
      patternProperties:
        "^channel@[0-1]$":
          properties:
            reg:
              enum: [0, 1]
        "^channel@[2-7]$": false
  - if:
      properties:
        compatible:
          contains:
            enum:
              - microchip,mcp48fvb04
              - microchip,mcp48fvb14
              - microchip,mcp48fvb24
              - microchip,mcp48feb04
              - microchip,mcp48feb14
              - microchip,mcp48feb24
    then:
      patternProperties:
        "^channel@[0-3]$":
          properties:
            reg:
              enum: [0, 1, 2, 3]
        "^channel@[4-7]$": false
  - if:
      properties:
        compatible:
          contains:
            enum:
              - microchip,mcp48fvb08
              - microchip,mcp48fvb18
              - microchip,mcp48fvb28
              - microchip,mcp48feb08
              - microchip,mcp48feb18
              - microchip,mcp48feb28
    then:
      patternProperties:
        "^channel@[0-7]$":
          properties:
            reg:
              enum: [0, 1, 2, 3, 4, 5, 6, 7]
  - if:
      not:
        required:
          - vref-supply
    then:
      properties:
        microchip,vref-buffered: false
  - if:
      not:
        required:
          - vref1-supply
    then:
      properties:
        microchip,vref1-buffered: false

additionalProperties: false

examples:
    - |
      spi {
          #address-cells = <1>;
          #size-cells = <0>;

          dac@0 {
            compatible = "microchip,mcp48feb08";
            reg = <0>;
            vdd-supply = <&vdac_vdd>;
            vref-supply = <&vref_reg>;

            #address-cells = <1>;
            #size-cells = <0>;
            channel@0 {
              reg = <0>;
              label = "Adjustable_voltage_ch0";
            };

            channel@1 {
              reg = <0x1>;
              label = "Adjustable_voltage_ch1";
            };
          };
      };
...
```

## Documentation/devicetree/bindings/iio/dds/adi,ad9832.yaml
```yaml
# SPDX-License-Identifier: GPL-2.0-only OR BSD-2-Clause
%YAML 1.2
---
$id: http://devicetree.org/schemas/iio/dds/adi,ad9832.yaml#
$schema: http://devicetree.org/meta-schemas/core.yaml#

title: Analog Devices AD9832 / AD9835 DDS

maintainers:
  - Hungyu Lin <dennylin0707@gmail.com>

description: |
  Analog Devices AD9832 and AD9835 are SPI-controlled direct digital
  synthesizers (DDS) capable of generating programmable frequency and
  phase output signals using an external master clock.

properties:
  compatible:
    enum:
      - adi,ad9832
      - adi,ad9835

  reg:
    maxItems: 1

  spi-max-frequency:
    maximum: 20000000

  clocks:
    maxItems: 1

  clock-names:
    const: mclk

  avdd-supply:
    description: Analog power supply

  dvdd-supply:
    description: Digital power supply

required:
  - compatible
  - reg
  - clocks
  - clock-names
  - avdd-supply
  - dvdd-supply

unevaluatedProperties: false

examples:
  - |
    spi {
        #address-cells = <1>;
        #size-cells = <0>;

        ad9832@0 {
            compatible = "adi,ad9832";
            reg = <0>;
            spi-max-frequency = <20000000>;
            clocks = <&mclk>;
            clock-names = "mclk";
            avdd-supply = <&vdd_3v3>;
            dvdd-supply = <&vdd_3v3>;
        };
    };
```

## Documentation/devicetree/bindings/iio/flow/sensirion,slf3s.yaml
```yaml
# SPDX-License-Identifier: (GPL-2.0-only OR BSD-2-Clause)
%YAML 1.2
---
$id: http://devicetree.org/schemas/iio/flow/sensirion,slf3s.yaml#
$schema: http://devicetree.org/meta-schemas/core.yaml#

title: Sensirion SLF3S liquid flow sensor

maintainers:
  - Wadim Mueller <wafgo01@gmail.com>

description:
  Family of digital liquid-flow sensors from Sensirion with I2C interface.
  All family members share the same register map; sub-types differ only in
  the flow scale factor and the calibrated measurement range, both of
  which are detected at probe time via the product-information register.

properties:
  compatible:
    oneOf:
      - items:
          - enum:
              - sensirion,slf3s-0600f
              - sensirion,slf3s-1300f
              - sensirion,slf3s-4000b
          - const: sensirion,slf3s
      - const: sensirion,slf3s

  reg:
    maxItems: 1

  interrupts:
    maxItems: 1
    description:
      Optional data-ready interrupt line.  If omitted the driver falls
      back to polled I2C reads.

  vdd-supply: true

  sensirion,medium:
    $ref: /schemas/types.yaml#/definitions/string
    enum: [ water, ipa ]
    default: water
    description:
      Calibration medium the sensor is configured for at probe time.
      SLF3S sensors are factory-calibrated for both water and
      isopropyl alcohol (IPA); this property selects which calibration
      to activate.  Defaults to water when omitted.

required:
  - compatible
  - reg
  - vdd-supply

additionalProperties: false

examples:
  - |
    i2c {
        #address-cells = <1>;
        #size-cells = <0>;

        flow-sensor@8 {
            compatible = "sensirion,slf3s-0600f", "sensirion,slf3s";
            reg = <0x08>;
            vdd-supply = <&reg_3v3>;
        };
    };
```

## Documentation/devicetree/bindings/iio/frequency/adi,ad9832.yaml
```yaml
# SPDX-License-Identifier: (GPL-2.0 OR BSD-2-Clause)
%YAML 1.2
---
$id: http://devicetree.org/schemas/iio/frequency/adi,ad9832.yaml#
$schema: http://devicetree.org/meta-schemas/core.yaml#

title: Analog Devices AD9832/AD9835 Direct Digital Synthesizer

maintainers:
  - Michael Hennerich <michael.hennerich@analog.com>

properties:
  compatible:
    enum:
      - adi,ad9832
      - adi,ad9835

  reg:
    maxItems: 1

  spi-max-frequency:
    maximum: 20000000

  clocks:
    maxItems: 1

  clock-names:
    const: mclk

  avdd-supply:
    description: Analog power supply.

  dvdd-supply:
    description: Digital power supply.

required:
  - compatible
  - reg
  - clocks
  - clock-names
  - avdd-supply
  - dvdd-supply

allOf:
  - $ref: /schemas/spi/spi-peripheral-props.yaml#

unevaluatedProperties: false

examples:
  - |
    spi {
        #address-cells = <1>;
        #size-cells = <0>;

        dds@0 {
            compatible = "adi,ad9832";
            reg = <0>;
            spi-max-frequency = <20000000>;
            clocks = <&dds_clk>;
            clock-names = "mclk";
            avdd-supply = <&avdd_reg>;
            dvdd-supply = <&dvdd_reg>;
        };
    };
...
```
