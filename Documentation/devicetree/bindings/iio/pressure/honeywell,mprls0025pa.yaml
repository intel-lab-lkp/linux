## Documentation/devicetree/bindings/interconnect/qcom,shikra-epss-l3.yaml
```yaml
# SPDX-License-Identifier: (GPL-2.0-only OR BSD-2-Clause)
%YAML 1.2
---
$id: http://devicetree.org/schemas/interconnect/qcom,shikra-epss-l3.yaml#
$schema: http://devicetree.org/meta-schemas/core.yaml#

title: Qualcomm Epoch Subsystem (EPSS) L3 Shikra Interconnect Provider

maintainers:
  - Raviteja Laggyshetty <raviteja.laggyshetty@oss.qualcomm.com>

description:
  L3 cache bandwidth requirements on Qualcomm SoCs is serviced by the EPSS.
  The EPSS L3 interconnect provider aggregates the L3 bandwidth requests
  from CPU/GPU and relays it to the EPSS HW.

  The Qualcomm Shikra SoC EPSS L3 supports up to twelve frequency lookup
  table (LUT) entries.

properties:
  compatible:
    enum:
      - qcom,shikra-epss-l3

  reg:
    maxItems: 1

  clocks:
    items:
      - description: xo clock
      - description: alternate clock

  clock-names:
    items:
      - const: xo
      - const: alternate

  '#interconnect-cells':
    const: 1

required:
  - compatible
  - reg
  - clocks
  - clock-names
  - '#interconnect-cells'

additionalProperties: false

examples:
  - |
    epss_l3: interconnect@fd90000 {
      compatible = "qcom,shikra-epss-l3";
      reg = <0xfd90000 0x1000>;

      clocks = <&rpm_smd_xo_clk_src>, <&gpll0>;
      clock-names = "xo", "alternate";

      #interconnect-cells = <1>;
    };
```

## Documentation/devicetree/bindings/interconnect/qcom,sm4450-rpmh.yaml
```yaml
# SPDX-License-Identifier: GPL-2.0-only OR BSD-2-Clause
%YAML 1.2
---
$id: http://devicetree.org/schemas/interconnect/qcom,sm4450-rpmh.yaml#
$schema: http://devicetree.org/meta-schemas/core.yaml#

title: Qualcomm RPMh Network-On-Chip Interconnect on SM4450

maintainers:
  - Tengfei Fan <quic_tengfan@quicinc.com>

description: |
  RPMh interconnect providers support system bandwidth requirements through
  RPMh hardware accelerators known as Bus Clock Manager (BCM).

  See also:: include/dt-bindings/interconnect/qcom,sm4450.h

properties:
  compatible:
    enum:
      - qcom,sm4450-aggre1-noc
      - qcom,sm4450-aggre2-noc
      - qcom,sm4450-clk-virt
      - qcom,sm4450-cnoc2
      - qcom,sm4450-cnoc3
      - qcom,sm4450-gem-noc
      - qcom,sm4450-lpass-ag-noc
      - qcom,sm4450-mc-virt
      - qcom,sm4450-mmss-noc
      - qcom,sm4450-pcie-anoc
      - qcom,sm4450-system-noc
      - qcom,sm4450-video-aggre-noc

  reg:
    maxItems: 1

  clocks:
    minItems: 1
    maxItems: 4

required:
  - compatible

allOf:
  - $ref: qcom,rpmh-common.yaml#
  - if:
      properties:
        compatible:
          contains:
            enum:
              - qcom,sm4450-clk-virt
              - qcom,sm4450-mc-virt
    then:
      properties:
        reg: false
    else:
      required:
        - reg

  - if:
      properties:
        compatible:
          contains:
            enum:
              - qcom,sm4450-pcie-anoc
    then:
      properties:
        clocks:
          items:
            - description: aggre-NOC PCIe 0 AXI clock
            - description: cfg-NOC PCIe a-NOC AHB clock

  - if:
      properties:
        compatible:
          contains:
            enum:
              - qcom,sm4450-aggre1-noc
    then:
      properties:
        clocks:
          items:
            - description: aggre USB3 PRIM AXI clock

  - if:
      properties:
        compatible:
          contains:
            enum:
              - qcom,sm4450-aggre2-noc
    then:
      properties:
        clocks:
          items:
            - description: RPMH CC IPA clock
            - description: aggre-NOC USB3 AXI clock

  - if:
      properties:
        compatible:
          contains:
            enum:
              - qcom,sm4450-aggre1-noc
              - qcom,sm4450-aggre2-noc
              - qcom,sm4450-pcie-anoc
    then:
      required:
        - clocks
    else:
      properties:
        clocks: false

unevaluatedProperties: false

examples:
  - |
    #include <dt-bindings/clock/qcom,sm4450-gcc.h>
    #include <dt-bindings/clock/qcom,rpmh.h>

    interconnect-0 {
        compatible = "qcom,sm4450-clk-virt";
        #interconnect-cells = <2>;
        qcom,bcm-voters = <&apps_bcm_voter>;
    };

    interconnect@1700000 {
        compatible = "qcom,sm4450-aggre2-noc";
        reg = <0x01700000 0x31080>;
        #interconnect-cells = <2>;
        qcom,bcm-voters = <&apps_bcm_voter>;
        clocks = <&rpmhcc RPMH_IPA_CLK>,
                 <&gcc GCC_AGGRE_USB3_PRIM_AXI_CLK>;
    };
```

## Documentation/devicetree/bindings/leds/maxim,max77705.yaml
```yaml
# SPDX-License-Identifier: GPL-2.0-only OR BSD-2-Clause
%YAML 1.2
---
$id: http://devicetree.org/schemas/leds/maxim,max77705.yaml#
$schema: http://devicetree.org/meta-schemas/core.yaml#

title: Maxim MAX77705 Companion Power Management IC and USB Type-C interface IC LEDs

maintainers:
  - Dzmitry Sankouski <dsankouski@gmail.com>

description: |
  This is a part of device tree bindings for Maxim MAX77705 multi functional device.

  Up to 4 LEDs supported. One LED is represented by one child node.

  See also Documentation/devicetree/bindings/mfd/maxim,max77705.yaml for
  additional information and example.

properties:
  compatible:
    const: maxim,max77705-led

  "#address-cells":
    const: 1

  "#size-cells":
    const: 0

patternProperties:
  "^led@[0-3]$":
    type: object
    $ref: common.yaml#
    properties:
      reg:
        description:
          LED index.
    unevaluatedProperties: false
    required:
      - reg

required:
  - compatible

additionalProperties: false
```

## Documentation/devicetree/bindings/mailbox/google,gs101-mbox.yaml
```yaml
# SPDX-License-Identifier: (GPL-2.0-only OR BSD-2-Clause)
# Copyright 2024 Linaro Ltd.
%YAML 1.2
---
$id: http://devicetree.org/schemas/mailbox/google,gs101-mbox.yaml#
$schema: http://devicetree.org/meta-schemas/core.yaml#

title: Samsung Exynos Mailbox Controller

maintainers:
  - Tudor Ambarus <tudor.ambarus@linaro.org>

description: |
  The samsung exynos mailbox controller has 16 flag bits for hardware interrupt
  generation and a shared register for passing mailbox messages. When the
  controller is used by the ACPM protocol the shared register is ignored and
  the mailbox controller acts as a doorbell. The controller just raises the
  interrupt to the firmware after the ACPM protocol has written the message to
  SRAM.

properties:
  compatible:
    const: google,gs101-mbox

  reg:
    maxItems: 1

  clocks:
    maxItems: 1

  clock-names:
    items:
      - const: pclk

  interrupts:
    description: IRQ line for the RX mailbox.
    maxItems: 1

  '#mbox-cells':
    description: |
      <&phandle type channel>
      phandle : label name of controller.
      type    : channel type, doorbell or data-transfer.
      channel : channel number.

      Here is how a client can reference them:
      mboxes = <&ap2apm_mailbox DOORBELL 2>;
      mboxes = <&ap2apm_mailbox DATA 3>;
    const: 2

required:
  - compatible
  - reg
  - clocks
  - clock-names
  - interrupts
  - '#mbox-cells'

additionalProperties: false

examples:
  # Doorbell mode.
  - |
    #include <dt-bindings/interrupt-controller/arm-gic.h>
    #include <dt-bindings/clock/google,gs101.h>

    soc {
        #address-cells = <1>;
        #size-cells = <1>;

        ap2apm_mailbox: mailbox@17610000 {
            compatible = "google,gs101-acpm-mbox";
            reg = <0x17610000 0x1000>;
            clocks = <&cmu_apm CLK_GOUT_APM_MAILBOX_APM_AP_PCLK>;
            clock-names = "pclk";
            interrupts = <GIC_SPI 73 IRQ_TYPE_LEVEL_HIGH 0>;
            #mbox-cells = <2>;
        };
    };
```

## Documentation/devicetree/bindings/media/i2c/ams,mira220.yaml
```yaml
# SPDX-License-Identifier: (GPL-2.0 OR BSD-2-Clause)
%YAML 1.2
---
$id: http://devicetree.org/schemas/media/i2c/ams,mira220.yaml#
$schema: http://devicetree.org/meta-schemas/core.yaml#

title: ams 2.2 MP NIR enhanced global shutter image sensor

maintainers:
  - Philippe Baetens <philippebaetens@gmail.com>

description: |-
  2.2 MP NIR enhanced global shutter image sensor designed for 2D and 3D
  consumer and industrial machine vision applications.
  Due to its small size, configurability and high sensitivity both
  in visual as well as NIR, the Mira220 is well suited for 2D and
  3D applications, which include Active Stereo Vision,
  Structured Light Vision for Robotics and AR/VR.

allOf:
  - $ref: /schemas/media/video-interface-devices.yaml#

properties:
  compatible:
    const: ams,mira220

  reg:
    description: I2C device address
    maxItems: 1

  clocks:
    maxItems: 1

  vdig-supply:
    description:
      Digital I/O voltage supply, 1.35 volts

  vana-supply:
    description:
      Analog1 voltage supply, 2.8 volts

  vddl-supply:
    description:
      Digital core voltage supply, 1.8 volts

  reset-gpios:
    description: Sensor reset (XCLR) GPIO
    maxItems: 1

  port:
    $ref: /schemas/graph.yaml#/$defs/port-base
    additionalProperties: false
    description:
      Video output port

    properties:
      endpoint:
        $ref: /schemas/media/video-interfaces.yaml#
        unevaluatedProperties: false

        properties:
          data-lanes:
            anyOf:
              - items:
                  - const: 1
                  - const: 2

          clock-noncontinuous: true

        required:
          - data-lanes
          - link-frequencies


required:
  - compatible
  - reg
  - clocks
  - vdig-supply
  - vana-supply
  - vddl-supply
  - port

additionalProperties: false

examples:
  - |
    i2c {
        #address-cells = <1>;
        #size-cells = <0>;

        mira220: camera-sensor@54 {
            compatible = "ams,mira220";
            reg = <0x54>;
            clocks = <&cam1_clk>;
            vana-supply = <&cam1_reg>;	/* 2.5v */
            vdig-supply = <&cam_dummy_reg>;	/* 1.8v */
            vddl-supply = <&cam_dummy_reg>;	/* 1.35v */
            port {
                mira220_ep: endpoint {
                    clock-lanes = <0>;
                    data-lanes = <1 2>;
                    link-frequencies = /bits/ 64 <750000000>;
                };
            };
        };
    };
...
```
