## Documentation/devicetree/bindings/media/st,stm32mp25-venc.yaml
```yaml
# SPDX-License-Identifier: (GPL-2.0 OR BSD-2-Clause)

%YAML 1.2
---
$id: http://devicetree.org/schemas/media/st,stm32mp25-venc.yaml#
$schema: http://devicetree.org/meta-schemas/core.yaml#

title: STMicroelectronics STM32MP25 VENC video encoder

maintainers:
  - Hugues Fruchet <hugues.fruchet@foss.st.com>

description:
  The STMicroelectronics STM32MP25 SOCs embeds a VENC video hardware encoder
  peripheral based on Verisilicon VC8000NanoE IP (former Hantro H1).

properties:
  compatible:
    const: st,stm32mp25-venc

  reg:
    maxItems: 1

  interrupts:
    maxItems: 1

  interrupt-names:
    maxItems: 1

  clocks:
    maxItems: 1

  clock-names:
    maxItems: 1

required:
  - compatible
  - reg
  - interrupts
  - interrupt-names
  - clocks
  - clock-names

additionalProperties: false

examples:
  - |
    #include <dt-bindings/interrupt-controller/arm-gic.h>
    venc: venc@580e0000 {
        compatible = "st,stm32mp25-venc";
        reg = <0x580e0000 0x800>;
        interrupts = <GIC_SPI 167 IRQ_TYPE_LEVEL_HIGH>;
        interrupt-names = "venc";
        clocks = <&ck_icn_p_venc>;
        clock-names = "venc-clk";
    };
```

## Documentation/devicetree/bindings/memory-controllers/amd,versalnet-edac.yaml
```yaml
# SPDX-License-Identifier: (GPL-2.0 OR BSD-2-Clause)
%YAML 1.2
---
$id: http://devicetree.org/schemas/memory-controllers/amd,versalnet-edac.yaml#
$schema: http://devicetree.org/meta-schemas/core.yaml#

title: AMD Versal NET EDAC

maintainers:
  - Shubhrajyoti Datta <shubhrajyoti.datta@amd.com>

description:
  The integrated DDR Memory Controllers (DDRMCs) support both DDR4 and LPDDR4/
  4X memory interfaces. Versal NET DDR memory controller has an optional ECC support
  which correct single bit ECC errors and detect double bit ECC errors.
  It also has support for reporting other errors like MMCM (Mixed-Mode Clock
  Manager) errors and General software errors.

properties:
  compatible:
    const: amd,versalnet-edac

  amd,dwidth:
    description:
      DDR memory controller device width.
    enum: [16, 32]
    $ref: /schemas/types.yaml#/definitions/uint32

  amd,num-chans:
    description:
      Number of channels.
    enum: [1, 2]
    $ref: /schemas/types.yaml#/definitions/uint32

  amd,num-rank:
    description:
      Number of rank.
    enum: [1, 2, 4]
    $ref: /schemas/types.yaml#/definitions/uint32

required:
  - compatible
  - amd,dwidth
  - amd,num-chans
  - amd,num-rank

additionalProperties: false

examples:
  - |
    memory-controller {
       compatible = "amd,versalnet-edac";
       amd,dwidth = <32>;
       amd,num-chans = <2>;
       amd,num-rank = <1>;
     };
```

## Documentation/devicetree/bindings/mips/lantiq/lantiq,dcdc-xrx200.yaml
```yaml
# SPDX-License-Identifier: GPL-2.0-only OR BSD-2-Clause
%YAML 1.2
---
$id: http://devicetree.org/schemas/mips/lantiq/lantiq,dcdc-xrx200.yaml#
$schema: http://devicetree.org/meta-schemas/core.yaml#

title: Lantiq DCDC (DC-DC converter with voltage sensor)

maintainers:
  - Aleksander Jan Bajkowski <olek2@wp.pl>

description:
  Lantiq DCDC is a voltage converter with a voltage sensor. The converter is
  inside the xRX200 SoC. This driver only reads the voltage and prints it at
  startup. The voltage supplied by this converter powers one of the power
  domains. It powers the CPU core and probably other peripherals as well.

properties:
  compatible:
    items:
      - enum:
          - lantiq,dcdc-xrx200

  reg:
    maxItems: 1

required:
  - compatible
  - reg

additionalProperties: false

examples:
  - |
    dcdc@106a00 {
        compatible = "lantiq,dcdc-xrx200";
        reg = <0x106a00 0x200>;
    };
```

## Documentation/devicetree/bindings/mips/lantiq/lantiq,gptu-xway.yaml
```yaml
# SPDX-License-Identifier: GPL-2.0-only OR BSD-2-Clause
%YAML 1.2
---
$id: http://devicetree.org/schemas/mips/lantiq/lantiq,gptu-xway.yaml#
$schema: http://devicetree.org/meta-schemas/core.yaml#

title: Lantiq Xway SoC series General Purpose Timer Unit (GPTU)

maintainers:
  - Aleksander Jan Bajkowski <olek2@wp.pl>

description:
  The Lantiq SoC has six built-in 16-bit general purpose timers. The voice
  firmware needs these timers as a reference.

properties:
  $nodename:
    pattern: "^gptu@[0-9a-f]+$"

  compatible:
    items:
      - enum:
          - lantiq,ase-gptu
          - lantiq,danube-gptu
          - lantiq,xrx100-gptu
          - lantiq,xrx200-gptu
      - const: lantiq,gptu-xway

  reg:
    maxItems: 1

  interrupts:
    items:
      - description: timer1a interrupt
      - description: timer1b interrupt
      - description: timer2a interrupt
      - description: timer2b interrupt
      - description: timer3a interrupt
      - description: timer3b interrupt

  interrupt-names:
    items:
      - const: timer1a
      - const: timer1b
      - const: timer2a
      - const: timer2b
      - const: timer3a
      - const: timer3b

required:
  - compatible
  - reg
  - interrupts
  - interrupt-names

additionalProperties: false

examples:
  - |
    gptu@e100a00 {
        compatible = "lantiq,ase-gptu", "lantiq,gptu-xway";
        reg = <0xe100a00 0x100>;
        interrupt-parent = <&icu0>;
        interrupts = <126>, <127>, <128>, <129> ,<130>, <131>;
        interrupt-names = "timer1a", "timer1b", "timer2a", "timer2b",
                "timer3a", "timer3b";
    };
```

## Documentation/devicetree/bindings/mips/lantiq/lantiq,vmmc-xway.yaml
```yaml
# SPDX-License-Identifier: (GPL-2.0-only OR BSD-2-Clause)
%YAML 1.2
---
$id: http://devicetree.org/schemas/mips/lantiq/lantiq,vmmc-xway.yaml#
$schema: http://devicetree.org/meta-schemas/core.yaml#

title: Lantiq VMMC (Voice MIPS Macro Core)

maintainers:
  - Aleksander Jan Bajkowski <olek2@wp.pl>

description:
  The Lantiq SoCs have a 2nd mips core called "Voice MIPS Macro Core (VMMC)"
  which is used to run the voice firmware. The firmware handles analog
  telephone lines.

properties:
  compatible:
    items:
      - enum:
          - lantiq,vmmc-xway

  reg:
    maxItems: 1

  interrupts:
    minItems: 6
    maxItems: 6

  gpios: true

required:
  - compatible
  - reg
  - interrupts

additionalProperties: false

examples:
  - |
    #include <dt-bindings/gpio/gpio.h>
    vmmc@107000 {
        compatible = "lantiq,vmmc-xway";
        reg = <0x107000 0x300>;
        interrupt-parent = <&icu0>;
        interrupts = <150>, <151>, <152>, <153>, <154>, <155>;
        gpios = <&gpio 30 GPIO_ACTIVE_HIGH
                 &gpio 31 GPIO_ACTIVE_HIGH
                 &gpio 3  GPIO_ACTIVE_HIGH>;

    };
```

## Documentation/devicetree/bindings/mips/mips-cm.yaml
```yaml
# SPDX-License-Identifier: (GPL-2.0-only OR BSD-2-Clause)
%YAML 1.2
---
$id: http://devicetree.org/schemas/mips/mips-cm.yaml#
$schema: http://devicetree.org/meta-schemas/core.yaml#

title: MIPS Coherence Manager

description: |
  Defines a location of the MIPS Coherence Manager registers.

maintainers:
  - Jiaxun Yang <jiaxun.yang@flygoat.com>

properties:
  compatible:
    const: mti,mips-cm

  reg:
    description: |
      Base address and size of an unoccupied memory region, which will be
      used to map the MIPS CM registers block.
    maxItems: 1

required:
  - compatible
  - reg

additionalProperties: false

examples:
  - |
    cm@1fbf8000 {
      compatible = "mti,mips-cm";
      reg = <0x1bde8000 0x8000>;
    };
...
```

## Documentation/devicetree/bindings/mmc/mmc-card.yaml
```yaml
# SPDX-License-Identifier: GPL-2.0
%YAML 1.2
---
$id: http://devicetree.org/schemas/mmc/mmc-card.yaml#
$schema: http://devicetree.org/meta-schemas/core.yaml#

title: MMC Card / eMMC Generic

maintainers:
  - Ulf Hansson <ulf.hansson@linaro.org>

description: |
  This documents describes the devicetree bindings for a mmc-host controller
  child node describing a mmc-card / an eMMC.

  It's possible to define a fixed partition table for an eMMC for the user
  partition and one of the 2 boot partition (boot0/boot1) if supported by the
  eMMC.

properties:
  compatible:
    const: mmc-card

  reg:
    const: 0

  broken-hpi:
    $ref: /schemas/types.yaml#/definitions/flag
    description:
      Use this to indicate that the mmc-card has a broken hpi
      implementation, and that hpi should not be used.

  "#address-cells": true

  "#size-cells": true

patternProperties:
  "^partitions(-boot[01])?$":
    type: object

    properties:
      "#address-cells": true

      "#size-cells": true

    patternProperties:
      "@[0-9a-f]+$":
        type: object

        properties:
          reg:
            description: partition's offset and size within the flash (in sector
              block, 512byte)
            maxItems: 1


          label:
            description: The label / name for this partition.

          read-only:
            description: This parameter, if present, is a hint that this partition
              should only be mounted read-only. This is usually used for flash
              partitions containing early-boot firmware images or data which should
              not be clobbered.
            type: boolean

        required:
          - reg
          - label

        additionalProperties: false

    additionalProperties: false

required:
  - compatible
  - reg

additionalProperties: false

examples:
  - |
    mmc {
        #address-cells = <1>;
        #size-cells = <0>;

        card@0 {
            compatible = "mmc-card";
            reg = <0>;
            broken-hpi;

            #address-cells = <0>;
            #size-cells = <0>;

            partitions {
                #address-cells = <1>;
                #size-cells = <1>;

                partition@0 {
                    label = "kernel"; /* Kernel */
                    reg = <0x0 0x10000>; /* 32 MB */
                };

                partition@3400 {
                    label = "rootfs";
                    reg = <0x3400 0x200000>; /* 1GB */
                };
            };

            partitions-boot0 {
                #address-cells = <1>;
                #size-cells = <1>;

                partition@0 {
                    label = "bl";
                    reg = <0x0 0x10000>; /* 32MB */
                    read-only;
                };
            };
        };
    };

...
```

## Documentation/devicetree/bindings/mtd/partitions/binman-partition.yaml
```yaml
# SPDX-License-Identifier: (GPL-2.0 OR BSD-2-Clause)
# Copyright 2023 Google LLC

%YAML 1.2
---
$id: http://devicetree.org/schemas/mtd/partitions/binman-partition.yaml#
$schema: http://devicetree.org/meta-schemas/core.yaml#

title: Binman partition

maintainers:
  - Simon Glass <sjg@chromium.org>

select: false

description: |
  This corresponds to a binman 'entry'. It is a single partition which holds
  data of a defined type.

allOf:
  - $ref: /schemas/mtd/partitions/partition.yaml#

properties:
  compatible:
    oneOf:
      - const: binman,entry     # generic binman entry
      - items:
          - const: u-boot       # u-boot.bin from U-Boot project
          - const: atf-bl31     # bl31.bin or bl31.elf from TF-A project

additionalProperties: false

examples:
  - |
    partitions {
        compatible = "binman";
        #address-cells = <1>;
        #size-cells = <1>;

        partition@100000 {
            compatible = "u-boot";
            reg = <0x100000 0xf00000>;
        };

        partition@200000 {
            compatible = "atf-bl31";
            reg = <0x200000 0x100000>;
        };
    };
```

## Documentation/devicetree/bindings/mtd/partitions/binman.yaml
```yaml
# SPDX-License-Identifier: (GPL-2.0 OR BSD-2-Clause)
# Copyright 2023 Google LLC

%YAML 1.2
---
$id: http://devicetree.org/schemas/mtd/partitions/binman.yaml#
$schema: http://devicetree.org/meta-schemas/core.yaml#

title: Binman firmware layout

maintainers:
  - Simon Glass <sjg@chromium.org>

select: false

description: |
  The binman node provides a layout for firmware, used when packaging firmware
  from multiple projects. It is based on fixed-partitions, with some
  extensions, but uses 'compatible' to indicate the contents of the node, to
  avoid perturbing or confusing existing installations which use 'label' for a
  particular purpose.

  Binman supports properties used as inputs to the firmware-packaging process,
  such as those which control alignment of partitions. This binding addresses
  these 'input' properties. For example, it is common for the 'reg' property
  (an 'output' property) to be set by Binman, based on the alignment requested
  in the input.

  Once processing is complete, input properties have mostly served their
  purpose, at least until the firmware is repacked later, e.g. due to a
  firmware update. The 'fixed-partitions' binding should provide enough
  information to read the firmware at runtime, including decompression if
  needed.

  Documentation for Binman is available at:

  https://u-boot.readthedocs.io/en/latest/develop/package/binman.html

  with the current image-description format at:

  https://u-boot.readthedocs.io/en/latest/develop/package/binman.html#image-description-format

allOf:
  - $ref: /schemas/mtd/partitions/fixed-partitions.yaml#

properties:
  compatible:
    const: binman

additionalProperties: false

examples:
  - |
    partitions {
        compatible = "binman";
        #address-cells = <1>;
        #size-cells = <1>;

        partition@100000 {
            label = "u-boot";
            reg = <0x100000 0xf00000>;
        };
    };
```

## Documentation/devicetree/bindings/mtd/partitions/gpt.yaml
```yaml
# SPDX-License-Identifier: (GPL-2.0-only OR BSD-2-Clause)
%YAML 1.2
---
$id: http://devicetree.org/schemas/mtd/partitions/gpt.yaml#
$schema: http://devicetree.org/meta-schemas/core.yaml#

title: GUID Partition Table (GPT)

description: The GPT format is commonly used on block devices to describe a
partitioning scheme. It mainly consists of a Legacy or Protective MBR for
backwards compatibility, a primary GPT header with an array of Partition Table
Entries, and a backup header with a backup array of PTEs. This partition table
format can be used on MTD devices, specifically NOR flash devices, since NAND
flashes are susceptible to bad blocks which could easily corrupt the GPT layout.
Logical Block Addresses (LBAs) are defined to target 512-byte blocks.

maintainers:
  - Romain Gantois <romain.gantois@bootlin.com>

select: false

properties:
  compatible:
    const: gpt

  '#address-cells': false

  '#size-cells': false

required:
  - compatible

additionalProperties: false

examples:
  - |
    flash@0 {
      partitions {
        compatible = "gpt";
      };
    };
```
