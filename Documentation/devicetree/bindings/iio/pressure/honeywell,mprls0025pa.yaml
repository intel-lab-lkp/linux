## Documentation/devicetree/bindings/iio/pressure/honeywell,mprls0025pa.yaml
```yaml
# SPDX-License-Identifier: (GPL-2.0-only OR BSD-2-Clause)
%YAML 1.2
---
$id: http://devicetree.org/schemas/iio/pressure/honeywell,mprls0025pa.yaml#
$schema: http://devicetree.org/meta-schemas/core.yaml#

title: Honeywell mprls0025pa pressure sensor

maintainers:
  - Andreas Klinger <ak@it-klinger.de>

description: |
  Honeywell pressure sensor of model mprls0025pa.

  This sensor has an I2C and SPI interface. Only the I2C interface is
  implemented.

  There are many models with different pressure ranges available. The vendor
  calls them "mpr series". All of them have the identical programming model and
  differ in the pressure range, unit and transfer function.

  To support different models one need to specify the pressure range as well as
  the transfer function. Pressure range needs to be converted from its unit to
  pascal.

  The transfer function defines the ranges of numerical values delivered by the
  sensor. The minimal range value stands for the minimum pressure and the
  maximum value also for the maximum pressure with linear relation inside the
  range.

  Specifications about the devices can be found at:
    https://prod-edam.honeywell.com/content/dam/honeywell-edam/sps/siot/en-us/
      products/sensors/pressure-sensors/board-mount-pressure-sensors/
      micropressure-mpr-series/documents/
      sps-siot-mpr-series-datasheet-32332628-ciid-172626.pdf

properties:
  compatible:
    const: honeywell,mprls0025pa

  reg:
    maxItems: 1

  interrupts:
    maxItems: 1

  reset-gpios:
    description:
      Optional GPIO for resetting the device.
      If not present the device is not reset during the probe.
    maxItems: 1

  honeywell,pmin-pascal:
    description:
      Minimum pressure value the sensor can measure in pascal.
      To be specified only if honeywell,pressure-triplet is set to "NA".

  honeywell,pmax-pascal:
    description:
      Maximum pressure value the sensor can measure in pascal.
      To be specified only if honeywell,pressure-triplet is set to "NA".

  honeywell,transfer-function:
    description: |
      Transfer function which defines the range of valid values delivered by
      the sensor.
      1 - A, 10% to 90% of 2^24 (1677722 .. 15099494)
      2 - B, 2.5% to 22.5% of 2^24 (419430 .. 3774874)
      3 - C, 20% to 80% of 2^24 (3355443 .. 13421773)
    enum: [1, 2, 3]
    $ref: /schemas/types.yaml#/definitions/uint32

  honeywell,pressure-triplet:
    description: |
      Case-sensitive five character string that defines pressure range, unit
      and type as part of the device nomenclature. In the unlikely case of a
      custom chip, set to "NA" and provide pmin-pascal and pmax-pascal.
    enum: [0001BA, 01.6BA, 02.5BA, 0060MG, 0100MG, 0160MG, 0250MG, 0400MG,
           0600MG, 0001BG, 01.6BG, 02.5BG, 0100KA, 0160KA, 0250KA, 0006KG,
           0010KG, 0016KG, 0025KG, 0040KG, 0060KG, 0100KG, 0160KG, 0250KG,
           0015PA, 0025PA, 0030PA, 0001PG, 0005PG, 0015PG, 0030PG, 0300YG,
           NA]
    $ref: /schemas/types.yaml#/definitions/string

  spi-max-frequency:
    maximum: 800000

  vdd-supply:
    description: provide VDD power to the sensor.

required:
  - compatible
  - reg
  - honeywell,pressure-triplet
  - honeywell,transfer-function

additionalProperties: false

dependentSchemas:
  honeywell,pmin-pascal:
    properties:
      honeywell,pressure-triplet:
        const: NA
  honeywell,pmax-pascal:
    properties:
      honeywell,pressure-triplet:
        const: NA

examples:
  - |
    #include <dt-bindings/gpio/gpio.h>
    #include <dt-bindings/interrupt-controller/irq.h>
    i2c {
        #address-cells = <1>;
        #size-cells = <0>;

        pressure@18 {
            compatible = "honeywell,mprls0025pa";
            reg = <0x18>;
            reset-gpios = <&gpio3 19 GPIO_ACTIVE_HIGH>;
            interrupt-parent = <&gpio3>;
            interrupts = <21 IRQ_TYPE_EDGE_RISING>;

            honeywell,pressure-triplet = "0025PA";
            honeywell,transfer-function = <1>;
            vdd-supply = <&vcc_3v3>;
        };
    };
  - |
    spi {
        #address-cells = <1>;
        #size-cells = <0>;

        pressure@0 {
            compatible = "honeywell,mprls0025pa";
            reg = <0>;
            spi-max-frequency = <800000>;
            reset-gpios = <&gpio1 28 GPIO_ACTIVE_HIGH>;
            interrupt-parent = <&gpio0>;
            interrupts = <30 IRQ_TYPE_EDGE_RISING>;

            honeywell,pressure-triplet = "0015PA";
            honeywell,transfer-function = <1>;
        };
    };
...
```

## Documentation/devicetree/bindings/input/adi,adp5589.yaml
```yaml
# SPDX-License-Identifier: (GPL-2.0-only OR BSD-2-Clause)
%YAML 1.2
---
$id: http://devicetree.org/schemas/input/adi,adp5589.yaml#
$schema: http://devicetree.org/meta-schemas/core.yaml#

title: Analog Devices ADP5589 and similar Keypad Controllers

maintainers:
  - Nuno Sa <nuno.sa@analog.com>
  - Michael Hennerich <michael.hennerich@analog.com>

description: |
  Analog Devices Mobile I/O Expander and QWERTY Keypad Controllers
   - https://www.analog.com/media/en/technical-documentation/data-sheets/ADP5589.pdf
   - https://www.analog.com/media/en/technical-documentation/data-sheets/ADP5585.pdf

properties:
  compatible:
    enum:
      - adi,adp5589
      - adi,adp5585
      - adi,adp5585-2

  reg:
    maxItems: 1

  vcc-supply: true

  interrupts:
    maxItems: 1

  gpio-controller:
    description:
      This property applies if there are pins not used in the keypad.

  '#gpio-cells':
    const: 2

  interrupt-controller:
    description:
      This property applies if there are pins not used in the keypad.

  '#interrupt-cells':
    const: 2

  adi,cols-mask:
    description:
      Defines the number of pins (columns) being used ad part of the keymap. As
      the device is fully configurable and we can have holes in the columns
      being used, this is given as mask.
    $ref: /schemas/types.yaml#/definitions/uint32
    minimum: 0x1
    maximum: 0x3f

  adi,rows-mask:
    description:
      Defines the number of pins (rows) being used ad part of the keymap. As
      the device is fully configurable and we can have holes in the rows being
      used, this is given as mask.
    $ref: /schemas/types.yaml#/definitions/uint32
    minimum: 0x1
    maximum: 0xff

  adi,key-poll-ms:
    description: Configure time between consecutive scan cycles.
    enum: [10, 20, 30, 40]
    default: 10

  adi,unlock-keys:
    description:
      Specifies a maximum of 2 keys that can be used to unlock the keypad.
      If this property is set, the keyboard will be locked and only unlocked
      after these keys are pressed. The value 127 serves as a wildcard which
      means any key can be used for unlocking.
    $ref: /schemas/types.yaml#/definitions/uint32-array
    minItems: 1
    maxItems: 2
    items:
      anyOf:
        - minimum: 1
          maximum: 88
        - minimum: 97
          maximum: 115
        - const: 127

  adi,unlock-trigger-sec:
    description:
      Defines the time in which the second unlock event must occur after the
      first unlock event has occurred.
    maximum: 7
    default: 0

  adi,reset1-keys:
    description:
      Defines the trigger events (key presses) that can generate reset
      conditions one the reset1 block.
    $ref: /schemas/types.yaml#/definitions/uint32-array
    minItems: 1
    maxItems: 3
    items:
      anyOf:
        - minimum: 1
          maximum: 88
        - minimum: 97
          maximum: 115

  adi,reset2-keys:
    description:
      Defines the trigger events (key presses) that can generate reset
      conditions one the reset2 block.
    $ref: /schemas/types.yaml#/definitions/uint32-array
    minItems: 1
    maxItems: 2
    items:
      anyOf:
        - minimum: 1
          maximum: 88
        - minimum: 97
          maximum: 115

  adi,reset1-active-high:
    description: Sets the reset1 signal as active high.
    type: boolean

  adi,reset2-active-high:
    description: Sets the reset2 signal as active high.
    type: boolean

  adi,rst-passtrough-enable:
    description: Allows the RST pin to override (OR with) the reset1 signal.
    type: boolean

  adi,reset-trigger-ms:
    description:
      Defines the length of time that the reset events must be active before a
      reset signal is generated. All events must be active at the same time for
      the same duration.
    enum: [0, 1000, 1500, 2000, 2500, 3000, 3500, 4000]
    default: 0

  adi,reset-pulse-width-us:
    description: Defines the pulse width of the reset signals.
    enum: [500, 1000, 2000, 10000]
    default: 500

  '#address-cells':
    const: 1

  '#size-cells':
    const: 0

patternProperties:
  "^gpio@":
    type: object
    additionalProperties: false

    properties:
      reg:
        description: The GPIO number being configured.
        maximum: 18

      adi,pull-up-ohms:
        description: The pullup resistor to be used.
        enum: [100000, 300000]
        default: 300000

    required:
      - reg

dependencies:
  adi,rows-mask:
    - linux,keymap
    - adi,cols-mask
  adi,cols-mask:
    - linux,keymap
    - adi,rows-mask
  linux,keymap:
    - adi,rows-mask
    - adi,cols-mask
    - interrupts
  interrupt-controller:
    - interrupts
  adi,unlock-trigger-sec:
    - adi,unlock-keys
  adi,reset1-active-high:
    - adi,reset1-keys
  adi,rst-passtrough-enable:
    - adi,reset1-keys
  adi,reset2-active-high:
    - adi,reset2-keys

required:
  - compatible
  - reg
  - vcc-supply

allOf:
  - $ref: matrix-keymap.yaml#
  - $ref: input.yaml#
  - if:
      properties:
        compatible:
          enum:
            - adi,adp5585-2
    then:
      properties:
        adi,unlock-keys: false
        adi,unlock-trigger-sec: false
        adi,rows-mask:
          maximum: 0x2f
        adi,cols-mask:
          maximum: 0x1f
        adi,reset1-keys:
          items:
            anyOf:
              - minimum: 1
                maximum: 30
              - minimum: 37
                maximum: 47
        adi,reset2-keys:
          items:
            anyOf:
              - minimum: 1
                maximum: 30
              - minimum: 37
                maximum: 47
      patternProperties:
        "^gpio@":
          properties:
            reg:
              maximum: 10
  - if:
      properties:
        compatible:
          enum:
            - adi,adp5585
    then:
      properties:
        adi,unlock-keys: false
        adi,unlock-trigger-sec: false
        adi,rows-mask:
          maximum: 0x1f
        adi,cols-mask:
          maximum: 0x1f
        adi,reset1-keys:
          items:
            anyOf:
              - minimum: 1
                maximum: 25
              - enum: [37, 38, 39, 40, 41, 43, 44, 45, 46, 47]
        adi,reset2-keys:
          items:
            anyOf:
              - minimum: 1
                maximum: 25
              - enum: [37, 38, 39, 40, 41, 43, 44, 45, 46, 47]
      patternProperties:
        "^gpio@":
          properties:
            reg:
              enum: [0, 1, 2, 3, 4, 6, 7, 8, 9, 10]

unevaluatedProperties: false


examples:
  - |
    #include <dt-bindings/interrupt-controller/irq.h>
    #include <dt-bindings/input/input.h>
    i2c {
        #address-cells = <1>;
        #size-cells = <0>;

        keys@34 {
            compatible = "adi,adp5589";
            reg = <0x34>;

            vcc-supply = <&vcc>;
            interrupts = <21 IRQ_TYPE_EDGE_FALLING>;
            interrupt-parent = <&gpio>;

            adi,rows-mask = <0x13>;
            adi,cols-mask = <0xf>;

            linux,keymap = <
                MATRIX_KEY(0x00, 0x00, KEY_1)
                MATRIX_KEY(0x00, 0x01, KEY_2)
                MATRIX_KEY(0x00, 0x02, KEY_3)
                MATRIX_KEY(0x00, 0x03, KEY_4)
                MATRIX_KEY(0x01, 0x00, KEY_5)
                MATRIX_KEY(0x01, 0x01, KEY_6)
                MATRIX_KEY(0x01, 0x02, KEY_7)
                MATRIX_KEY(0x01, 0x03, KEY_8)
                MATRIX_KEY(0x04, 0x00, KEY_9)
                MATRIX_KEY(0x04, 0x01, KEY_A)
                MATRIX_KEY(0x04, 0x02, KEY_B)
                MATRIX_KEY(0x04, 0x03, KEY_C)
            >;

            #address-cells = <1>;
            #size-cells = <0>;

            gpio@10 {
                reg = <10>;
                adi,pull-up-ohms = <100000>;
            };
        };
    };
...
```

## Documentation/devicetree/bindings/input/touchscreen/hynitron,cst816x.yaml
```yaml
# SPDX-License-Identifier: (GPL-2.0-only OR BSD-2-Clause)
%YAML 1.2
---
$id: http://devicetree.org/schemas/input/touchscreen/hynitron,cst816x.yaml#
$schema: http://devicetree.org/meta-schemas/core.yaml#

title: Hynitron CST816x Series Capacitive Touch controller

maintainers:
  - Oleh Kuzhylnyi <kuzhylol@gmail.com>

description: |
  Bindings for CST816x high performance self-capacitance touch chip series
  with single point gesture and real two-point operation.

properties:
  compatible:
    enum:
      - hynitron,cst816s

  reg:
    maxItems: 1

  interrupts:
    maxItems: 1

  reset-gpios:
    maxItems: 1

  linux,keycodes:
    minItems: 1
    maxItems: 16
    description: |
      Specifies the numeric keycodes associated with each available gesture in
      the following order (enter 0 for unused and reserved gestures):
      0: Touch
      1: Swipe up
      2: Swipe down
      3: Swipe left
      4: Swipe right
      5-11: Reserved
      12: Long press
      13-15: Reserved

required:
  - compatible
  - reg
  - interrupts

additionalProperties: false

examples:
  - |
    #include <dt-bindings/gpio/gpio.h>
    #include <dt-bindings/input/linux-event-codes.h>
    #include <dt-bindings/interrupt-controller/irq.h>
    i2c {
          #address-cells = <1>;
          #size-cells = <0>;
          touchscreen@15 {
              compatible = "hynitron,cst816s";
              reg = <0x15>;
              interrupt-parent = <&gpio0>;
              interrupts = <4 IRQ_TYPE_EDGE_RISING>;
              reset-gpios = <&gpio 17 GPIO_ACTIVE_LOW>;
              linux,keycodes = <BTN_TOUCH>,
                               <KEY_UP>,
                               <KEY_DOWN>,
                               <KEY_LEFT>,
                               <KEY_RIGHT>,
                               <KEY_RESERVED>,
                               <KEY_RESERVED>,
                               <KEY_RESERVED>,
                               <KEY_RESERVED>,
                               <KEY_RESERVED>,
                               <KEY_RESERVED>,
                               <KEY_RESERVED>,
                               <BTN_TOOL_TRIPLETAP>;
          };
    };

...
```
