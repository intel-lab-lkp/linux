## Documentation/devicetree/bindings/net/airoha,en7581.yaml
```yaml
# SPDX-License-Identifier: (GPL-2.0-only OR BSD-2-Clause)
%YAML 1.2
---
$id: http://devicetree.org/schemas/net/airoha,en7581.yaml#
$schema: http://devicetree.org/meta-schemas/core.yaml#

title: Airoha EN7581 Frame Engine Ethernet controller

allOf:
  - $ref: ethernet-controller.yaml#

maintainers:
  - Lorenzo Bianconi <lorenzo@kernel.org>

description:
  The frame engine ethernet controller can be found on Airoha SoCs.
  These SoCs have dual GMAC ports.

properties:
  compatible:
    enum:
      - airoha,en7581-eth

  reg:
    items:
      - description: Frame engine base address
      - description: QDMA0 base address
      - description: QDMA1 base address

  reg-names:
    items:
      - const: fe
      - const: qdma0
      - const: qdma1

  interrupts:
    maxItems: 10

  resets:
    maxItems: 7

  reset-names:
    items:
      - const: fe
      - const: pdma
      - const: qdma
      - const: xsi-mac
      - const: hsi0-mac
      - const: hsi1-mac
      - const: hsi-mac

  "#address-cells":
    const: 1

  "#size-cells":
    const: 0

required:
  - compatible
  - reg
  - interrupts
  - resets
  - reset-names

unevaluatedProperties: false

examples:
  - |
    #include <dt-bindings/interrupt-controller/arm-gic.h>
    #include <dt-bindings/interrupt-controller/irq.h>
    #include <dt-bindings/clock/en7523-clk.h>
    #include <dt-bindings/reset/airoha,en7581-reset.h>

    soc {
      #address-cells = <2>;
      #size-cells = <2>;

      eth0: ethernet@1fb50000 {
        compatible = "airoha,en7581-eth";
        reg = <0 0x1fb50000 0 0x2600>,
              <0 0x1fb54000 0 0x2000>,
              <0 0x1fb56000 0 0x2000>;
        reg-names = "fe", "qdma0", "qdma1";

        resets = <&scuclk EN7581_FE_RST>,
                 <&scuclk EN7581_FE_PDMA_RST>,
                 <&scuclk EN7581_FE_QDMA_RST>,
                 <&scuclk EN7581_XSI_MAC_RST>,
                 <&scuclk EN7581_DUAL_HSI0_MAC_RST>,
                 <&scuclk EN7581_DUAL_HSI1_MAC_RST>,
                 <&scuclk EN7581_HSI_MAC_RST>;
        reset-names = "fe", "pdma", "qdma", "xsi-mac",
                      "hsi0-mac", "hsi1-mac", "hsi-mac";

        interrupts = <GIC_SPI 37 IRQ_TYPE_LEVEL_HIGH>,
                     <GIC_SPI 55 IRQ_TYPE_LEVEL_HIGH>,
                     <GIC_SPI 56 IRQ_TYPE_LEVEL_HIGH>,
                     <GIC_SPI 57 IRQ_TYPE_LEVEL_HIGH>,
                     <GIC_SPI 38 IRQ_TYPE_LEVEL_HIGH>,
                     <GIC_SPI 58 IRQ_TYPE_LEVEL_HIGH>,
                     <GIC_SPI 59 IRQ_TYPE_LEVEL_HIGH>,
                     <GIC_SPI 60 IRQ_TYPE_LEVEL_HIGH>,
                     <GIC_SPI 49 IRQ_TYPE_LEVEL_HIGH>,
                     <GIC_SPI 64 IRQ_TYPE_LEVEL_HIGH>;
      };
    };
```

## Documentation/devicetree/bindings/net/bluetooth/amlogic,w155s2-bt.yaml
```yaml
# SPDX-License-Identifier: (GPL-2.0-only OR BSD-2-Clause)
# Copyright (C) 2024 Amlogic, Inc. All rights reserved
%YAML 1.2
---
$id: http://devicetree.org/schemas/net/bluetooth/amlogic,w155s2-bt.yaml#
$schema: http://devicetree.org/meta-schemas/core.yaml#

title: Amlogic Bluetooth chips

description:
  This binding describes UART-attached Amlogic bluetooth chips.

maintainers:
  - Yang Li <yang.li@amlogic.com>

properties:
  compatible:
    oneOf:
      - const: amlogic,w155s2-bt
      - items:
          - enum:
              - amlogic,w265s1-bt
              - amlogic,w265p1-bt
              - amlogic,w265s2-bt
          - const: amlogic,w155s2-bt

  bt-enable-gpios:
    maxItems: 1
    description: gpio specifier used to enable BT

  bt-supply:
    description: bluetooth chip 3.3V supply regulator handle

  clocks:
    maxItems: 1
    description: clock provided to the controller (32.768KHz)

  antenna-number:
    default: 1
    description: device supports up to two antennas
    $ref: /schemas/types.yaml#/definitions/uint32

  firmware-name:
    description: specify the path of firmware bin to load
    $ref: /schemas/types.yaml#/definitions/string-array

required:
  - compatible
  - bt-enable-gpios
  - bt-supply
  - clocks
  - firmware-name

additionalProperties: false

examples:
  - |
    #include <dt-bindings/gpio/gpio.h>
    bluetooth {
        compatible = "amlogic,w155s2-bt";
        bt-enable-gpios = <&gpio 17 GPIO_ACTIVE_HIGH>;
        bt-supply = <&wcn_3v3>;
        clocks = <&extclk>;
        firmware-name = "amlogic/aml_w155s2_bt_uart.bin";
    };
```

## Documentation/devicetree/bindings/net/bluetooth/mediatek,mt7925-bluetooth.yaml
```yaml
# SPDX-License-Identifier: (GPL-2.0 OR BSD-2-Clause)
%YAML 1.2
---
$id: http://devicetree.org/schemas/net/bluetooth/mediatek,mt7925-bluetooth.yaml#
$schema: http://devicetree.org/meta-schemas/core.yaml#

title: Bluetooth mediatek use BT_KILL_1V2_L hardware pin to reset BT

maintainers:
  - Sean Wang <sean.wang@mediatek.com>

description:
  MT7925 modules provides hardware pin called W_DISABLE#2 to reset Bluetotoh,
  two methods are used to reset Bluetooth. When an exception occurs, resetting
  Bluetooth by hardware pin is more stable than resetting Bluetooth by software.

allOf:
  - $ref: bluetooth-controller.yaml#

properties:
  compatible:
    enum:
      - mediatek,mt7925-bluetooth

  reset-gpios:
    maxItems: 1
    description:
      This pin can is used to externally reset BT function. When pull low,
      the Bluetooth and USB interface will be also disabled. After 100ms,
      it is pulled high to 3.3V to re_enable the device and trigger the
      next probe. This is typically used on M.2 key E modules.

required:
  - compatible
  - reset-gpios

unevaluatedProperties: false

examples:
  - |
    #include <dt-bindings/gpio/gpio.h>

    bluetooth {
      compatible = "mediatek,mt7925-bluetooth";
      #gpio-cells = <2>;
      reset-gpios = <&pio 248 GPIO_ACTIVE_LOW>;
    };
```

## Documentation/devicetree/bindings/net/davinci_emac.yaml
```yaml
# SPDX-License-Identifier: (GPL-2.0-only OR BSD-2-Clause)
%YAML 1.2
---
$id: http://devicetree.org/schemas/net/davinci_emac.yaml#
$schema: http://devicetree.org/meta-schemas/core.yaml#

title: Texas Instruments Davici EMAC

maintainers:
  - Adam Ford <aford@gmail.com>

description:
  Ethernet based on the Programmable Real-Time Unit and Industrial
  Communication Subsystem.

allOf:
  - $ref: ethernet-controller.yaml#

properties:
  compatible:
    items:
      - enum:
          - ti,davinci-dm6467-emac # da850
          - ti,dm816-emac
          - ti,am3517-emac

  reg:
    maxItems: 1

  interrupts:
    minItems: 4

  clocks:
    maxItems: 1

  clock-names:
    items:
      - const: ick

  power-domains:
    maxItems: 1

  resets:
    maxItems: 1

  local-mac-address: true
  mac-address: true

  syscon:
    $ref: /schemas/types.yaml#/definitions/phandle
    description: a phandle to the global system controller on
      to enable/disable interrupts

  ti,davinci-ctrl-reg-offset:
    $ref: /schemas/types.yaml#/definitions/uint32
    description:
      Offset to control register

  ti,davinci-ctrl-mod-reg-offset:
    $ref: /schemas/types.yaml#/definitions/uint32
    description:
      Offset to control module register

  ti,davinci-ctrl-ram-offset:
    $ref: /schemas/types.yaml#/definitions/uint32
    description:
      Offset to control module ram

  ti,davinci-ctrl-ram-size:
    $ref: /schemas/types.yaml#/definitions/uint32
    description:
      Size of control module ram

  ti,davinci-rmii-en:
    $ref: /schemas/types.yaml#/definitions/uint8
    description:
      RMII enable means use RMII

  ti,davinci-no-bd-ram:
    type: boolean
    description:
      Enable if EMAC have BD RAM

additionalProperties: false

required:
  - compatible
  - reg
  - interrupts
  - clocks
  - ti,davinci-ctrl-reg-offset
  - ti,davinci-ctrl-mod-reg-offset
  - ti,davinci-ctrl-ram-offset
  - ti,davinci-ctrl-ram-size

examples:
  - |
    eth0: ethernet@220000 {
      compatible = "ti,davinci-dm6467-emac";
      reg = <0x220000 0x4000>;
      ti,davinci-ctrl-reg-offset = <0x3000>;
      ti,davinci-ctrl-mod-reg-offset = <0x2000>;
      ti,davinci-ctrl-ram-offset = <0>;
      ti,davinci-ctrl-ram-size = <0x2000>;
      local-mac-address = [ 00 00 00 00 00 00 ];
      interrupts = <33>, <34>, <35>,<36>;
      clocks = <&psc1 5>;
      power-domains = <&psc1 5>;
      status = "disabled";
    };
```

## Documentation/devicetree/bindings/net/mediatek,mt7621-eth.yaml
```yaml
# SPDX-License-Identifier: (GPL-2.0-only OR BSD-2-Clause)
%YAML 1.2
---
$id: http://devicetree.org/schemas/net/mediatek,mt7621-eth.yaml#
$schema: http://devicetree.org/meta-schemas/core.yaml#

title: MediaTek MT7621 Frame Engine Ethernet controller

maintainers:
  - Arınç ÜNAL <arinc.unal@arinc9.com>

description:
  The frame engine ethernet controller can be found on MediaTek MT7621 SoC. This
  SoC has got dual GMAC ports.

properties:
  compatible:
    const: mediatek,mt7621-eth

  reg:
    maxItems: 1

  clocks:
    maxItems: 2

  clock-names:
    items:
      - const: fe
      - const: ethif

  interrupts:
    maxItems: 1

  resets:
    maxItems: 2

  reset-names:
    items:
      - const: fe
      - const: eth

  mediatek,ethsys:
    $ref: /schemas/types.yaml#/definitions/phandle
    description:
      Phandle to the syscon node that handles the port setup.

  mdio-bus:
    $ref: mdio.yaml#
    unevaluatedProperties: false

  "#address-cells":
    const: 1

  "#size-cells":
    const: 0

patternProperties:
  "^mac@[0-1]$":
    type: object
    unevaluatedProperties: false
    allOf:
      - $ref: ethernet-controller.yaml#
    description:
      Ethernet MAC node
    properties:
      compatible:
        const: mediatek,eth-mac

      reg:
        maxItems: 1

    required:
      - reg
      - compatible

required:
  - compatible
  - reg
  - interrupts
  - clocks
  - clock-names
  - resets
  - reset-names
  - mediatek,ethsys

unevaluatedProperties: false

examples:
  - |
    #include <dt-bindings/interrupt-controller/mips-gic.h>
    #include <dt-bindings/clock/mt7621-clk.h>
    #include <dt-bindings/reset/mt7621-reset.h>

    soc {
        #address-cells = <1>;
        #size-cells = <1>;

        ethernet: ethernet@1e100000 {
            compatible = "mediatek,mt7621-eth";
            reg = <0x1e100000 0x10000>;

            clocks = <&sysc MT7621_CLK_FE>, <&sysc MT7621_CLK_ETH>;
            clock-names = "fe", "ethif";

            #address-cells = <1>;
            #size-cells = <0>;

            resets = <&sysc MT7621_RST_FE>, <&sysc MT7621_RST_ETH>;
            reset-names = "fe", "eth";

            interrupt-parent = <&gic>;
            interrupts = <GIC_SHARED 3 IRQ_TYPE_LEVEL_HIGH>;

            mediatek,ethsys = <&sysc>;

            pinctrl-names = "default";
            pinctrl-0 = <&mdio_pins>, <&rgmii1_pins>, <&rgmii2_pins>;

            gmac0: mac@0 {
                compatible = "mediatek,eth-mac";
                reg = <0>;
                phy-mode = "rgmii";

                fixed-link {
                    speed = <1000>;
                    full-duplex;
                    pause;
                };
            };

            gmac1: mac@1 {
                compatible = "mediatek,eth-mac";
                reg = <1>;
                phy-mode = "rgmii";

                fixed-link {
                    speed = <1000>;
                    full-duplex;
                    pause;
                };
            };
        };
    };
```
