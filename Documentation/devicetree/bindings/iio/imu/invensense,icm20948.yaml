## Documentation/devicetree/bindings/iio/light/avago,apds9900.yaml
```yaml
# SPDX-License-Identifier: (GPL-2.0 OR BSD-2-Clause)
%YAML 1.2
---
$id: http://devicetree.org/schemas/iio/light/avago,apds9900.yaml#
$schema: http://devicetree.org/meta-schemas/core.yaml#

title: Avago APDS-9900/9901 combined ALS/IR-LED/Proximity sensor

maintainers:
  - Svyatoslav Ryhel <clamor95@gmail.com>

description: |
  The APDS-9900/9901 provides digital ambient light sensing (ALS),
  IR LED and a complete proximity detection system in a single
  8 pin package over I2C interface.
  Datasheet at https://docs.broadcom.com/doc/AV02-2867EN

properties:
  compatible:
    enum:
      - avago,apds9900
      - avago,apds9901

  reg:
    maxItems: 1

  interrupts:
    maxItems: 1

  vdd-supply: true

  avago,pdrive-microamp:
    description:
      The LED drive current is controlled by a regulated current
      sink on the LDR pin. This feature eliminates the need to use
      a current limiting resistor to control LED current. The LED
      drive current can be configured for 12.5 mA, 25 mA, 50 mA
      or 100 mA. For higher LED drive requirements, an external
      P type transistor can be used to control the LED current.
    enum: [12500, 25000, 50000, 100000]
    default: 100000

  avago,ppcount:
    $ref: /schemas/types.yaml#/definitions/uint32
    description:
      The number of LED pulses can be programmed to a value of 1 to
      255 pulses as needed. Increasing the number of LED pulses at a
      given current will increase the sensor sensitivity. Sensitivity
      grows by the square root of the number of pulses. Each pulse
      has a 16 mS period.
    minimum: 1
    maximum: 255
    default: 1

additionalProperties: false

required:
  - compatible
  - reg
  - interrupts

examples:
  - |
    #include <dt-bindings/interrupt-controller/irq.h>

    i2c {
        #address-cells = <1>;
        #size-cells = <0>;

        light-sensor@39 {
            compatible = "avago,apds9900";
            reg = <0x39>;

            interrupt-parent = <&gpio>;
            interrupts = <82 IRQ_TYPE_EDGE_RISING>;

            vdd-supply = <&vdd_2v85_als>;

            avago,pdrive-microamp = <100000>;
            avago,ppcount = <3>;
        };
    };
...
```

## Documentation/devicetree/bindings/iio/light/brcm,apds9160.yaml
```yaml
# SPDX-License-Identifier: (GPL-2.0 OR BSD-2-Clause)
%YAML 1.2
---
$id: http://devicetree.org/schemas/iio/light/brcm,apds9160.yaml#
$schema: http://devicetree.org/meta-schemas/core.yaml#

title: Broadcom Combined Proximity & Ambient light sensor

maintainers:
  - Mikael Gonella-Bolduc <m.gonella.bolduc@gmail.com>

description: |
  Datasheet: https://docs.broadcom.com/docs/APDS-9160-003-DS

properties:
  compatible:
    enum:
      - brcm,apds9160

  reg:
    maxItems: 1

  interrupts:
    maxItems: 1

  vdd-supply: true

  ps-cancellation-duration:
    $ref: /schemas/types.yaml#/definitions/uint32
    description: |
      Proximity sensor cancellation pulse duration in half clock cycles.
      This parameter determines a cancellation pulse duration.
      The cancellation is applied in the integration phase to cancel out
      unwanted reflected light from very near objects such as tempered glass
      in front of the sensor.
    minimum: 0
    maximum: 63
    default: 0

  ps-cancellation-current-coarse:
    $ref: /schemas/types.yaml#/definitions/uint32
    description: |
      Proximity sensor crosstalk cancellation current coarse value.
      This parameter adjust the current in steps of 60 nA up to 240 nA.
      This parameter is used in conjunction with the cancellation duration.
    minimum: 0
    maximum: 4
    default: 0

  ps-cancellation-current-fine:
    $ref: /schemas/types.yaml#/definitions/uint32
    description: |
      Proximity sensor crosstalk cancellation current fine value.
      This parameter adjust the current in steps of 2.4 nA up to 36 nA.
      This parameter is used in conjunction with the cancellation duration.
    minimum: 0
    maximum: 15
    default: 0

required:
  - compatible
  - reg
  - vdd-supply

additionalProperties: false

examples:
  - |
    #include <dt-bindings/interrupt-controller/irq.h>

    i2c {
        #address-cells = <1>;
        #size-cells = <0>;

        light-sensor@53 {
            compatible = "brcm,apds9160";
            reg = <0x53>;
            vdd-supply = <&vdd_reg>;
            interrupts = <29 IRQ_TYPE_EDGE_FALLING>;
            interrupt-parent = <&pinctrl>;
            ps-cancellation-duration = <10>;
            ps-cancellation-current-coarse = <2>;
            ps-cancellation-current-fine = <10>;
        };
    };
...
```

## Documentation/devicetree/bindings/iio/light/capella,cm36686.yaml
```yaml
# SPDX-License-Identifier: (GPL-2.0 OR BSD-2-Clause)
%YAML 1.2
---
$id: http://devicetree.org/schemas/iio/light/capella,cm36686.yaml#
$schema: http://devicetree.org/meta-schemas/core.yaml#

title: Capella cm36686 I2C Ambient Light and Proximity sensor

maintainers:
  - Erikas Bitovtas <xerikasxx@gmail.com>

properties:
  compatible:
    oneOf:
      - const: capella,cm36672p
      - items:
          - const: capella,cm36686
          - const: capella,cm36672p

  reg:
    maxItems: 1
    description: I2C address of the device. Must be 0x60 for both cm36686
      and cm36672p sensors.

  interrupts:
    maxItems: 1

  vdd-supply:
    description:
      Regulator that provides power to the sensor.

  vddio-supply:
    description:
      Regulator used to power IO and I2C bus.

  vled-supply:
    description:
      Regulator used to power proximity LED

  proximity-near-level: true

  capella,proximity-led-current-microamp:
    description:
      Current for proximity IR LED
    enum: [50000, 75000, 100000, 120000, 140000, 160000, 180000, 200000]
    default: 50000

  capella,glass-factor:
    $ref: /schemas/types.yaml#/definitions/uint32
    description:
      Lux amplification factor to account for packaging - a number by which a
      lux reading is multiplied.
    default: 1

allOf:
  - if:
      properties:
        compatible:
          enum:
            - capella,cm36672p
    then:
      properties:
        capella,glass-factor: false

additionalProperties: false

required:
  - compatible
  - reg
  - vdd-supply
  - vddio-supply
  - vled-supply

examples:
  - |
    #include <dt-bindings/interrupt-controller/irq.h>

    i2c {
      #address-cells = <1>;
      #size-cells = <0>;

      light-sensor@60 {
        compatible = "capella,cm36686", "capella,cm36672p";
        reg = <0x60>;

        vdd-supply = <&pm8916_l8>;
        vddio-supply = <&pm8916_l6>;
        vled-supply = <&reg_prox_vled>;

        interrupts-extended = <&tlmm 113 IRQ_TYPE_EDGE_FALLING>;

        proximity-near-level = <30>;

        capella,glass-factor = <16>;
        capella,proximity-led-current-microamp = <100000>;
      };
    };
```

## Documentation/devicetree/bindings/iio/light/pixart,paj7620.yaml
```yaml
# SPDX-License-Identifier: (GPL-2.0-only OR BSD-2-Clause)
%YAML 1.2
---
$id: http://devicetree.org/schemas/iio/light/pixart,paj7620.yaml#
$schema: http://devicetree.org/meta-schemas/core.yaml#

title: PixArt PAJ7620 Gesture Sensor

maintainers:
  - Harpreet Saini <sainiharpreet29@yahoo.com>

description: |
  The PixArt PAJ7620 is a gesture recognition sensor with an integrated
  infrared LED and CMOS array. It communicates over an I2C interface and
  provides gesture data via a dedicated interrupt pin.

properties:
  compatible:
    const: pixart,paj7620

  reg:
    maxItems: 1
    description: The I2C address of the sensor.

  interrupts:
    maxItems: 1
    description: Interrupt mapping for the sensor's physical INT pin.

required:
  - compatible
  - reg
  - interrupts

additionalProperties: false

examples:
  - |
    #include <dt-bindings/interrupt-controller/irq.h>
    i2c {
        #address-cells = <1>;
        #size-cells = <0>;

        paj7620@73 {
            compatible = "pixart,paj7620";
            reg = <0x73>;
            interrupts = <4 IRQ_TYPE_EDGE_FALLING>;
        };
    };
```

## Documentation/devicetree/bindings/iio/light/rohm,bh1730fvc.yaml
```yaml
# SPDX-License-Identifier: (GPL-2.0 OR BSD-2-Clause)
%YAML 1.2
---
$id: http://devicetree.org/schemas/iio/light/rohm,bh1730fvc.yaml#
$schema: http://devicetree.org/meta-schemas/core.yaml#

title: ROHM BH1730FVC ambient light sensor

maintainers:
  - CTCaer <ctcaer@gmail.com>

description:
  Digital 16-bit ambient light sensor with an I2C interface. The device has
  two photodiodes (visible and infrared) and supports four gain settings and
  programmable integration time.

properties:
  compatible:
    const: rohm,bh1730fvc

  reg:
    maxItems: 1

  als-vdd-supply:
    description: Regulator for the analog/digital supply (VDD).

  als-vid-supply:
    description: Regulator for the LED indicator supply (VID).

  rohm,integration-cycle:
    description:
      Number of internal clock cycles used for the ADC integration time.
      Used together with rohm,lux-multiplier to calibrate the lux output.
    $ref: /schemas/types.yaml#/definitions/uint32

  rohm,lux-multiplier:
    description:
      Lux scaling multiplier applied after integration. Used together with
      rohm,integration-cycle to calibrate the lux output.
    $ref: /schemas/types.yaml#/definitions/uint32

  rohm,opt-win-coeff:
    description:
      Optical-window calibration coefficients. Specified as a flat list of
      triplets <rc cv ci>, one triplet per window region, where rc is the
      visible/IR ratio cutoff and cv/ci are the visible and IR weighting
      factors used in that region.
    $ref: /schemas/types.yaml#/definitions/uint32-matrix
    items:
      minItems: 3
      maxItems: 3

  rohm,gain-coeff:
    description:
      Per-gain sensitivity coefficients. Eight u32 values arranged as four
      <cl fl> pairs, one pair for each supported gain (1x, 2x, 64x, 128x).
    $ref: /schemas/types.yaml#/definitions/uint32-array
    minItems: 8
    maxItems: 8

required:
  - compatible
  - reg

dependencies:
  rohm,integration-cycle: ['rohm,lux-multiplier']
  rohm,lux-multiplier: ['rohm,integration-cycle']

additionalProperties: false

examples:
  - |
    i2c {
        #address-cells = <1>;
        #size-cells = <0>;

        light-sensor@29 {
            compatible = "rohm,bh1730fvc";
            reg = <0x29>;
            als-vdd-supply = <&vdd_als>;
            als-vid-supply = <&vid_als>;
            rohm,integration-cycle = <38>;
            rohm,lux-multiplier = <1000>;
            rohm,opt-win-coeff = <260 1290 2733>,
                                 <550 795 859>,
                                 <1090 510 345>,
                                 <2130 276 130>;
            rohm,gain-coeff = <3000 0xffffffff
                               2000 9800
                               15 60000
                               0 1300>;
        };
    };

...
```

## Documentation/devicetree/bindings/iio/light/ti,opt4048.yaml
```yaml
# SPDX-License-Identifier: (GPL-2.0 OR BSD-2-Clause)
%YAML 1.2
---
$id: http://devicetree.org/schemas/iio/light/ti,opt4048.yaml#
$schema: http://devicetree.org/meta-schemas/core.yaml#

title: Texas Instruments OPT4048 XYZ tristimulus color sensor

maintainers:
  - Paul Kocialkowski <paulk@sys-base.io>

description: |
  The device supports both interrupt-driven and interrupt-less operation,
  depending on whether an interrupt property is present in the device-tree.

properties:
  compatible:
    const: ti,opt4048

  reg:
    maxItems: 1

  interrupts:
    maxItems: 1
    description: |
      The interrupt is detected on a falling edge, with a low level asserted
      for 1 us. It might be missed because of hardware interrupt debouncing
      mechanisms due to this short time.

  vdd-supply: true

additionalProperties: false

required:
  - compatible
  - reg
  - vdd-supply

examples:
  - |
    #include <dt-bindings/interrupt-controller/irq.h>
    i2c {
        #address-cells = <1>;
        #size-cells = <0>;

        light-sensor@44 {
          compatible = "ti,opt4048";
            reg = <0x44>;
            interrupt-parent = <&pio>;
            interrupts = <0 8 IRQ_TYPE_EDGE_FALLING>;
            vdd-supply = <&reg_vcc_io>;
        };
    };
...
```

## Documentation/devicetree/bindings/iio/light/vishay,veml3328.yaml
```yaml
# SPDX-License-Identifier: (GPL-2.0-only OR BSD-2-Clause)
%YAML 1.2
---
$id: http://devicetree.org/schemas/iio/light/vishay,veml3328.yaml#
$schema: http://devicetree.org/meta-schemas/core.yaml#

title: Vishay VEML3328 RGBCIR Light Sensor

maintainers:
  - Joshua Crofts <joshua.crofts1@gmail.com>

description:
  Vishay VEML3328 color RGBCIR light sensor.

  The VEML3328 datasheet can be found at https://www.vishay.com/docs/84968/veml3328.pdf

properties:
  compatible:
    enum:
      - vishay,veml3328

  reg:
    maxItems: 1

  vdd-supply: true

required:
  - compatible
  - reg
  - vdd-supply

additionalProperties: false

examples:
  - |
    i2c {
        #address-cells = <1>;
        #size-cells = <0>;

        light-sensor@10 {
            compatible = "vishay,veml3328";
            reg = <0x10>;
            vdd-supply = <&vcc_3v3>;
        };
    };
```

## Documentation/devicetree/bindings/iio/light/vishay,veml6040.yaml
```yaml
# SPDX-License-Identifier: (GPL-2.0 OR BSD-2-Clause)
%YAML 1.2
---
$id: http://devicetree.org/schemas/iio/light/vishay,veml6040.yaml#
$schema: http://devicetree.org/meta-schemas/core.yaml#

title: VEML6040 RGBW Light Sensor

maintainers:
  - Arthur Becker <arthur.becker@sentec.com>

description:
  Datasheet at https://www.vishay.com/docs/84276/veml6040.pdf

properties:
  compatible:
    const: vishay,veml6040

  reg:
    enum:
      - 0x10

  vdd-supply: true

required:
  - compatible
  - reg
  - vdd-supply

additionalProperties: false

examples:
  - |
    i2c {
        #address-cells = <1>;
        #size-cells = <0>;

        light-sensor@10 {
            compatible = "vishay,veml6040";
            reg = <0x10>;
            vdd-supply = <&vdd_reg>;
        };
    };
...
```

## Documentation/devicetree/bindings/iio/light/vishay,veml6075.yaml
```yaml
# SPDX-License-Identifier: (GPL-2.0-only OR BSD-2-Clause)
%YAML 1.2
---
$id: http://devicetree.org/schemas/iio/light/vishay,veml6075.yaml#
$schema: http://devicetree.org/meta-schemas/core.yaml#

title: Vishay VEML6070 UVA, VEML6075 UVA/B and VEML6040 RGBW sensors

maintainers:
  - Javier Carrasco <javier.carrasco.cruz@gmail.com>

description:
  VEML6040 datasheet at https://www.vishay.com/docs/84276/veml6040.pdf

properties:
  compatible:
    enum:
      - vishay,veml6040
      - vishay,veml6070
      - vishay,veml6075

  reg:
    maxItems: 1

  vdd-supply: true

required:
  - compatible
  - reg
  - vdd-supply

allOf:
  - if:
      properties:
        compatible:
          enum:
            - vishay,veml6070
    then:
      properties:
        rset-kohms:
          $ref: /schemas/types.yaml#/definitions/uint32
          description: |
            Value in kilo Ohms of the Rset resistor used to select
            the integration time.
          minimum: 75
          maximum: 1200

additionalProperties: false

examples:
  - |
    i2c {
        #address-cells = <1>;
        #size-cells = <0>;

        uv-sensor@10 {
            compatible = "vishay,veml6075";
            reg = <0x10>;
            vdd-supply = <&vdd_reg>;
        };
    };
...
```
