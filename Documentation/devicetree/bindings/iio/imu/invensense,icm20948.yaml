## Documentation/devicetree/bindings/iio/magnetometer/infineon,tlv493d.yaml
```yaml
# SPDX-License-Identifier: GPL-2.0-only OR BSD-2-Clause
%YAML 1.2
---
$id: http://devicetree.org/schemas/iio/magnetometer/infineon,tlv493d.yaml#
$schema: http://devicetree.org/meta-schemas/core.yaml#

title: Infineon Technologies TLV493D Low-Power 3D Magnetic Sensor

maintainers:
  - Dixit Parmar <dixitparmar19@gmail.com>

properties:
  $nodename:
    pattern: '^magnetometer@[0-9a-f]+$'

  compatible:
    const: infineon,tlv493d-a1b6

  reg:
    maxItems: 1

  vdd:
    description: 2.8V to 3.5V VDD supply

  interrupts:
    maxItems: 1

required:
  - compatible
  - reg
  - vdd

additionalProperties: false

example:
  - |
    i2c {
      #address-cells = <1>;
      #size-cells = <0>;
      magnetometer@5e {
        compatible = "infineon,tlv493d-a1b6";
        reg = <0x5e>;
        vdd = <&hall_vcc>;
      };
    };
```

## Documentation/devicetree/bindings/iio/magnetometer/memsic,mmc5983.yaml
```yaml
# SPDX-License-Identifier: (GPL-2.0 OR BSD-2-Clause)
%YAML 1.2
---
$id: http://devicetree.org/schemas/iio/magnetometer/memsic,mmc5983.yaml#
$schema: http://devicetree.org/meta-schemas/core.yaml#

title: MEMSIC MMC5983MA 3-axis magnetic sensor

maintainers:
  - Vladislav Kulikov <vlad.kulikov.c@gmail.com>

properties:
  compatible:
    const: memsic,mmc5983

  reg:
    maxItems: 1

  vdd-supply:
    description: Regulator that provides power to the sensor

required:
  - compatible
  - reg

additionalProperties: false

examples:
  - |
    i2c {
        #address-cells = <1>;
        #size-cells = <0>;
        magnetometer@30 {
            compatible = "memsic,mmc5983";
            reg = <0x30>;
            vdd-supply = <&vdd_3v3_reg>;
        };
    };
```

## Documentation/devicetree/bindings/iio/magnetometer/qst,qmc5883p.yaml
```yaml
# SPDX-License-Identifier: (GPL-2.0 OR BSD-2-Clause)
%YAML 1.2
---
$id: http://devicetree.org/schemas/iio/magnetometer/qst,qmc5883p.yaml#
$schema: http://devicetree.org/meta-schemas/core.yaml#

title: QST QMC5883P 3-axis magnetometer

maintainers:
  - Hardik Phalet <hardik.phalet@pm.me>

description:
  The QMC5883P is a 3-axis anisotropic magneto-resistive (AMR) sensor with a
  16-bit ADC. It communicates over I2C (standard and fast modes) and is
  targeted at compass, navigation, and industrial applications.

properties:
  compatible:
    const: qst,qmc5883p

  reg:
    maxItems: 1
    description: I2C address of the device; the default address is 0x2c.

  vdd-supply:
    description:
      VDD power supply (2.5 V to 3.6 V). Powers all internal analog and
      digital functional blocks.

required:
  - compatible
  - reg

additionalProperties: false

examples:
  - |
    i2c {
        #address-cells = <1>;
        #size-cells = <0>;

        magnetometer@2c {
            compatible = "qst,qmc5883p";
            reg = <0x2c>;
            vdd-supply = <&vdd_3v3>;
        };
    };
...
```

## Documentation/devicetree/bindings/iio/magnetometer/qstcorp,qmc5883l.yaml
```yaml
# SPDX-License-Identifier: (GPL-2.0 OR BSD-2-Clause)
%YAML 1.2
---
$id: http://devicetree.org/schemas/iio/magnetometer/qstcorp,qmc5883l.yaml#
$schema: http://devicetree.org/meta-schemas/core.yaml#

title: QST QMC5883L 3-Axis Magnetic Sensor

maintainers:
  - Siratul Islam <email@sirat.me>

properties:
  compatible:
    enum:
      - qstcorp,qmc5883l

  reg:
    maxItems: 1

  interrupts:
    maxItems: 1

  vdd-supply: true

  vddio-supply: true

additionalProperties: false

required:
  - compatible
  - reg
  - vdd-supply
  - vddio-supply

examples:
  - |
    i2c {
        #address-cells = <1>;
        #size-cells = <0>;

        magnetometer@d {
            compatible = "qstcorp,qmc5883l";
            reg = <0x0d>;
            vdd-supply = <&vdd_3v3_reg>;
            vddio-supply = <&vdd_3v3_reg>;
        };
    };
...
```

## Documentation/devicetree/bindings/iio/magnetometer/qstcorp,qmc5883p.yaml
```yaml
# SPDX-License-Identifier: (GPL-2.0 OR BSD-2-Clause)
%YAML 1.2
---
$id: http://devicetree.org/schemas/iio/magnetometer/qstcorp,qmc5883p.yaml#
$schema: http://devicetree.org/meta-schemas/core.yaml#

title: QSTCORP QMC5883P 3-axis magnetometer

maintainers:
  - Hardik Phalet <hardik.phalet@pm.me>

description:
  The QMC5883P is a 3-axis anisotropic magneto-resistive (AMR) sensor with a
  16-bit ADC. It communicates over I2C (standard and fast modes) and is
  targeted at compass, navigation, and industrial applications.

properties:
  compatible:
    const: qstcorp,qmc5883p

  reg:
    maxItems: 1
    description: I2C address of the device; the default address is 0x2c

  vdd-supply:
    description:
      VDD power supply (2.5 V to 3.6 V). Powers all internal analog and
      digital functional blocks.

required:
  - compatible
  - reg
  - vdd-supply

additionalProperties: false

examples:
  - |
    i2c {
        #address-cells = <1>;
        #size-cells = <0>;

        magnetometer@2c {
            compatible = "qstcorp,qmc5883p";
            reg = <0x2c>;
            vdd-supply = <&vdd_3v3>;
        };
    };
```

## Documentation/devicetree/bindings/iio/opensensorfusion,osf.yaml
```yaml
# SPDX-License-Identifier: (GPL-2.0-only OR BSD-2-Clause)
%YAML 1.2
---
$id: http://devicetree.org/schemas/iio/opensensorfusion,osf.yaml#
$schema: http://devicetree.org/meta-schemas/core.yaml#

title: Open Sensor Fusion Sensor Aggregation Hub

maintainers:
  - Jinseob Kim <kimjinseob88@gmail.com>

description: |
  This binding documents the generic Open Sensor Fusion host interface. Open
  Sensor Fusion is a sensor aggregation hub. The hub exposes an OSF protocol
  data stream over its host interface and reports capabilities and samples for
  multiple sensor classes. The actual sensor channels are discovered at runtime
  from OSF capability reports instead of describing them in Device Tree. The
  protocol version is discovered at runtime.

  Public project documentation is available at:

    https://github.com/opensensorfusion

  The compatible describes the generic Open Sensor Fusion host interface. It
  is not an OSF GREEN board identity, and it does not encode the OSF0 wire
  magic. OSF0, protocol_major, and protocol_minor are wire-protocol details
  exchanged in OSF frames.

allOf:
  - $ref: /schemas/serial/serial-peripheral-props.yaml#

properties:
  compatible:
    const: opensensorfusion,osf

  vcc-supply:
    description:
      Regulator supplying power to the Open Sensor Fusion device.

required:
  - compatible
  - vcc-supply

unevaluatedProperties: false

examples:
  - |
    serial {
        sensor {
            compatible = "opensensorfusion,osf";
            vcc-supply = <&vcc_sensor>;
        };
    };
...
```
