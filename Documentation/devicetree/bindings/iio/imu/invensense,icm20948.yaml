## Documentation/devicetree/bindings/iio/imu/invensense,icm20948.yaml
```yaml
# SPDX-License-Identifier: (GPL-2.0-only OR BSD-2-Clause)
%YAML 1.2
---
$id: http://devicetree.org/schemas/iio/imu/invensense,icm20948.yaml#
$schema: http://devicetree.org/meta-schemas/core.yaml#

title: InvenSense ICM-20948 Inertial Measurement Unit

maintainers:
  - Bharadwaj Raju <bharadwaj.raju777@gmail.com>

description: |
  9-axis motion-tracking device that combines a 3-axis gyroscope, 3-axis
  accelerometer, and a 3-axis magnetometer.

  https://invensense.tdk.com/wp-content/uploads/2024/03/DS-000189-ICM-20948-v1.6.pdf

properties:
  compatible:
    enum:
      - invensense,icm20948

  reg:
    maxItems: 1

examples:
  - |
    i2c {
      #address-cells = <1>;
      #size-cells = <0>;

      icm20948 {
        compatible = "invensense,icm20948";
        reg = <0x69>;
      }
    }
```

## Documentation/devicetree/bindings/iio/imu/invensense,icm42607.yaml
```yaml
# SPDX-License-Identifier: (GPL-2.0-only OR BSD-2-Clause)
%YAML 1.2
---
$id: http://devicetree.org/schemas/iio/imu/invensense,icm42607.yaml#
$schema: http://devicetree.org/meta-schemas/core.yaml#

title: InvenSense ICM-42607 Inertial Measurement Unit

description: |
  6-axis MotionTracking device that combines a 3-axis gyroscope and a 3-axis
  accelerometer.

properties:
  compatible:
    enum:
      - invensense,icm42607
      - invensense,icm42607p
  reg:
    maxItems: 1

  interrupts:
    minItems: 1
    maxItems: 2

  interrupt-names:
    minItems: 1
    maxItems: 2
    items:
      enum:
        - INT1
        - INT2

  drive-open-drain:
    type: boolean

  mount-matrix: true

  spi-cpha: true
  spi-cpol: true

  vdd-supply:
    description: Regulator that provides power to the sensor

  vddio-supply:
    description: Regulator that provides power to the bus

required:
  - compatible
  - reg
  - interrupts

allOf:
  - $ref: /schemas/spi/spi-peripheral-props.yaml#

unevaluatedProperties: false

examples:
  - |
    #include <dt-bindings/interrupt-controller/irq.h>
    i2c {
        #address-cells = <1>;
        #size-cells = <0>;

        icm42607p@68 {
            compatible = "invensense,icm42607p";
            reg = <0x68>;
            interrupt-parent = <&gpio2>;
            interrupts = <7 IRQ_TYPE_EDGE_FALLING>;
            interrupt-names = "INT1";
            vdd-supply = <&vdd>;
            vddio-supply = <&vddio>;
        };
    };
  - |
    #include <dt-bindings/interrupt-controller/irq.h>
    spi {
        #address-cells = <1>;
        #size-cells = <0>;

        icm42607p@0 {
            compatible = "invensense,icm42607p";
            reg = <0>;
            spi-max-frequency = <24000000>;
            spi-cpha;
            spi-cpol;
            interrupt-parent = <&gpio1>;
            interrupts = <2 IRQ_TYPE_EDGE_FALLING>;
            interrupt-names = "INT1";
            vdd-supply = <&vdd>;
            vddio-supply = <&vddio>;
        };
    };
```

## Documentation/devicetree/bindings/iio/imu/invensense,icm45600.yaml
```yaml
# SPDX-License-Identifier: (GPL-2.0-only OR BSD-2-Clause)
%YAML 1.2
---
$id: http://devicetree.org/schemas/iio/imu/invensense,icm45600.yaml#
$schema: http://devicetree.org/meta-schemas/core.yaml#

title: InvenSense ICM-456xx Inertial Measurement Unit

maintainers:
  - Remi Buisson <remi.buisson@tdk.com>

description: |
  6-axis MotionTracking device that combines a 3-axis gyroscope and a 3-axis
  accelerometer.

  It has a configurable host interface that supports I3C, I2C and SPI serial
  communication, features up to 8kB FIFO and 2 programmable interrupts with
  ultra-low-power wake-on-motion support to minimize system power consumption.

  Other industry-leading features include InvenSense on-chip APEX Motion
  Processing engine for gesture recognition, activity classification, and
  pedometer, along with programmable digital filters, and an embedded
  temperature sensor.

  https://invensense.tdk.com/wp-content/uploads/documentation/DS-000576_ICM-45605.pdf

properties:
  compatible:
    enum:
      - invensense,icm45605
      - invensense,icm45686
      - invensense,icm45688p
      - invensense,icm45608
      - invensense,icm45634
      - invensense,icm45689
      - invensense,icm45606
      - invensense,icm45687

  reg:
    maxItems: 1

  interrupts:
    minItems: 1
    maxItems: 2

  interrupt-names:
    minItems: 1
    maxItems: 2
    items:
      enum:
        - INT1
        - INT2
    description: Choose chip interrupt pin to be used as interrupt input.

  drive-open-drain:
    type: boolean

  vdd-supply:
    description: Regulator that provides power to the sensor

  vddio-supply:
    description: Regulator that provides power to the bus

required:
  - compatible
  - reg
  - interrupts
  - interrupt-names

allOf:
  - $ref: /schemas/spi/spi-peripheral-props.yaml#

unevaluatedProperties: false

examples:
  - |
    #include <dt-bindings/gpio/gpio.h>
    #include <dt-bindings/interrupt-controller/irq.h>
    i2c {
        #address-cells = <1>;
        #size-cells = <0>;

        icm45605@68 {
            compatible = "invensense,icm45605";
            reg = <0x68>;
            interrupt-parent = <&gpio2>;
            interrupt-names = "INT1";
            interrupts = <7 IRQ_TYPE_EDGE_RAISING>;
            vdd-supply = <&vdd>;
            vddio-supply = <&vddio>;
            mount-matrix = "1", "0", "0",
                           "0", "1", "0",
                           "0", "0", "1";
        };
    };
  - |
    #include <dt-bindings/gpio/gpio.h>
    #include <dt-bindings/interrupt-controller/irq.h>
    spi {
        #address-cells = <1>;
        #size-cells = <0>;

        icm45605@0 {
            compatible = "invensense,icm45605";
            reg = <0>;
            spi-max-frequency = <24000000>;
            interrupt-parent = <&gpio1>;
            interrupt-names = "INT1";
            interrupts = <6 IRQ_TYPE_EDGE_RAISING>;
            vdd-supply = <&vdd>;
            vddio-supply = <&vddio>;
            mount-matrix = "1", "0", "0",
                           "0", "1", "0",
                           "0", "0", "1";
        };
    };
  - |
    #include <dt-bindings/gpio/gpio.h>
    #include <dt-bindings/interrupt-controller/irq.h>
    i3c {
        #address-cells = <3>;
        #size-cells = <0>;

        icm45600@68,46A00000011 {
            compatible = "invensense,icm45600";
            reg = <0x68 0x46A 0x84>;
            interrupt-parent = <&gpio1>;
            interrupt-names = "INT1";
            interrupts = <5 IRQ_TYPE_EDGE_RISING>;
            vdd-supply = <&vdd>;
            vddio-supply = <&vddio>;
            mount-matrix = "1", "0", "0",
                           "0", "1", "0",
                           "0", "0", "1";
        };
    };
```

## Documentation/devicetree/bindings/iio/imu/opensensorfusion,osf-green.yaml
```yaml
# SPDX-License-Identifier: (GPL-2.0-only OR BSD-2-Clause)
%YAML 1.2
---
$id: http://devicetree.org/schemas/iio/imu/opensensorfusion,osf-green.yaml#
$schema: http://devicetree.org/meta-schemas/core.yaml#

title: OSF GREEN sensor aggregation board

maintainers:
  - Jinseob Kim <kimjinseob88@gmail.com>

description: |
  OSF GREEN is an STM32F405-based sensor aggregation board from the Open
  Sensor Fusion open hardware project. It sends OSF0 capability, status, and
  sample frames to a host over a UART link.

  Open Sensor Fusion is not a generic industry standard. Public project and
  hardware documentation is available at:

    https://github.com/opensensorfusion
    https://github.com/opensensorfusion/opensensorfusion-hardware

allOf:
  - $ref: /schemas/serial/serial-peripheral-props.yaml#

properties:
  compatible:
    const: opensensorfusion,osf-green

required:
  - compatible

unevaluatedProperties: false

examples:
  - |
    serial {
        sensor {
            compatible = "opensensorfusion,osf-green";
        };
    };

...
```

## Documentation/devicetree/bindings/iio/imu/opensensorfusion,osf-uart.yaml
```yaml
# SPDX-License-Identifier: (GPL-2.0-only OR BSD-2-Clause)
%YAML 1.2
---
$id: http://devicetree.org/schemas/iio/imu/opensensorfusion,osf-uart.yaml#
$schema: http://devicetree.org/meta-schemas/core.yaml#

title: Open Sensor Fusion UART sensor aggregation device

maintainers:
  - Jinseob Kim <kimjinseob88@gmail.com>

description:
  UART-attached sensor aggregation device using the OSF0 frame format.
  The device sends capability, status, and sample frames to the host.

properties:
  compatible:
    const: opensensorfusion,osf-uart

required:
  - compatible

additionalProperties: false

examples:
  - |
    serial {
        osf {
            compatible = "opensensorfusion,osf-uart";
        };
    };

...
```

## Documentation/devicetree/bindings/iio/light/ams,as7343.yaml
```yaml
# SPDX-License-Identifier: GPL-2.0-only OR BSD-2-Clause
%YAML 1.2
---
$id: http://devicetree.org/schemas/iio/light/ams,as7343.yaml#
$schema: http://devicetree.org/meta-schemas/core.yaml#

title: AMS AS7343 14-Channel Multi-Spectral Sensor

maintainers:
  - Chang Yu <marcus.yu.56@gmail.com>

description: |
  The AMS AS7343 is a 14-channel multi-spectral sensor with i2c address of 0x39.
  https://look.ams-osram.com/m/5f2d27fff9a874d2/original/AS7343-14-Channel-Multi-Spectral-Sensor.pdf

properties:
  compatible:
    enum:
      - ams,as7343

  reg:
    description:
      I2C address of the device (0x39).
    maxItems: 1

  interrupts:
    description:
      Open drain output active low interrupt pin.
    maxItems: 1

  vdd-supply: true

  led-max-microamp:
    description:
      The driver current for the external LED connected to the LDR pin.
    minimum: 4000
    maximum: 258000
    multipleOf: 2000
    default: 12000

required:
  - compatible
  - reg
  - vdd-supply

additionalProperties: false

examples:
  - |
    #include <dt-bindings/interrupt-controller/irq.h>

    i2c {
        #address-cells = <1>;
        #size-cells = <0>;

        multispectral-sensor@39 {
            compatible = "ams,as7343";
            reg = <0x39>;
            interrupts = <7 IRQ_TYPE_LEVEL_LOW>;
            vdd-supply = <&vdd_regulator>;
            led-max-microamp = <14000>;
        };
    };
```

## Documentation/devicetree/bindings/iio/light/ams,tcs3400.yaml
```yaml
# SPDX-License-Identifier: (GPL-2.0-only OR BSD-2-Clause)
%YAML 1.2
---
$id: "http://devicetree.org/schemas/iio/light/ams,tcs3400.yaml#"
$schema: "http://devicetree.org/meta-schemas/core.yaml#"

title: AMS TCS3400 Color Light-to-Digital Converter

maintainers:
  - name: Petr Hodina
    email: petr.hodina@protonmail.com

description: |
  The AMS TCS3400 is an I2C-connected color light sensor providing
  RGBC or RGB-IR measurements with a programmable integration time
  and gain.

properties:
  compatible:
    const: ams,tcs3400

  reg:
    maxItems: 1

  interrupts:
    maxItems: 1
    description:
      Interrupt line signaling ALS data ready or threshold events.

  vdd-supply:
    description:
      Regulator supplying the main sensor power.

required:
  - compatible
  - reg
  - vdd-supply

additionalProperties: false

examples:
  - |
    i2c {
        #address-cells = <1>;
        #size-cells = <0>;

        light-sensor@39 {
            compatible = "ams,tcs3400";
            reg = <0x39>;
            interrupt-parent = <&gpio1>;
            interrupts = <5 IRQ_TYPE_EDGE_FALLING>;
            vdd-supply = <&vdd_3v3>;
        };
    };
```

## Documentation/devicetree/bindings/iio/light/ams,tcs3430.yaml
```yaml
# SPDX-License-Identifier: (GPL-2.0 OR BSD-2-Clause)
%YAML 1.2
---
$id: http://devicetree.org/schemas/iio/light/ams,tcs3430.yaml#
$schema: http://devicetree.org/meta-schemas/core.yaml#

title: AMS TCS3430 XYZ tristimulus color sensor

maintainers:
  - Paul Kocialkowski <paulk@sys-base.io>

description: |
  The device supports both interrupt-driven and interrupt-less operation,
  depending on whether an interrupt property is present in the device-tree.

properties:
  compatible:
    const: ams,tcs3430

  reg:
    maxItems: 1

  interrupts:
    maxItems: 1
    description: The interrupt is detected on a low level.

  vdd-supply: true

additionalProperties: false

required:
  - compatible
  - reg
  - vdd-supply

examples:
  - |
    #include <dt-bindings/interrupt-controller/irq.h>
    i2c {
        #address-cells = <1>;
        #size-cells = <0>;

        light-sensor@39 {
          compatible = "ams,tcs3430";
            reg = <0x39>;
            interrupt-parent = <&pio>;
            interrupts = <0 8 IRQ_TYPE_EDGE_FALLING>;
            vdd-supply = <&reg_vcc_io>;
        };
    };
...
```

## Documentation/devicetree/bindings/iio/light/avago,apds9160.yaml
```yaml
# SPDX-License-Identifier: (GPL-2.0 OR BSD-2-Clause)
%YAML 1.2
---
$id: http://devicetree.org/schemas/iio/light/avago,apds9160.yaml#
$schema: http://devicetree.org/meta-schemas/core.yaml#

title: Broadcom Combined Proximity & Ambient light sensor

maintainers:
  - Mikael Gonella-Bolduc <m.gonella.bolduc@gmail.com>

description: |
  Datasheet: https://docs.broadcom.com/docs/APDS-9160-003-DS

properties:
  compatible:
    enum:
      - avago,apds9160
      - broadmobi,apds9160

  reg:
    maxItems: 1

  interrupts:
    maxItems: 1

  vdd-supply: true

additionalProperties: false

required:
  - compatible
  - reg

examples:
  - |
    #include <dt-bindings/interrupt-controller/irq.h>

    i2c {
        #address-cells = <1>;
        #size-cells = <0>;

        apds9160@53 {
          compatible = "broadmobi,apds9160";
          reg = <0x53>;
          interrupts = <29 IRQ_TYPE_EDGE_FALLING>;
          interrupt-parent = <&pinctrl>;
        };
    };
...
```

## Documentation/devicetree/bindings/iio/light/avago,apds9300.yaml
```yaml
# SPDX-License-Identifier: (GPL-2.0 OR BSD-2-Clause)
%YAML 1.2
---
$id: http://devicetree.org/schemas/iio/light/avago,apds9300.yaml#
$schema: http://devicetree.org/meta-schemas/core.yaml#

title: Avago Gesture, RGB, ALS and Proximity sensors

maintainers:
  - Jonathan Cameron <jic23@kernel.org>
  - Matt Ranostay <matt@ranostay.sg>
  - Subhajit Ghosh <subhajit.ghosh@tweaklogic.com>

description: |
  Avago (Broadcom) optical and proximity sensors with I2C interfaces.
  Datasheet: https://docs.broadcom.com/doc/AV02-1077EN
  Datasheet: https://docs.broadcom.com/doc/AV02-4191EN
  Datasheet: https://docs.broadcom.com/doc/AV02-4755EN

properties:
  compatible:
    oneOf:
      - enum:
          - avago,apds9300
          - avago,apds9306
          - avago,apds9960

  reg:
    maxItems: 1

  interrupts:
    maxItems: 1

  vdd-supply: true

required:
  - compatible
  - reg

allOf:
  - $ref: ../common.yaml#
  - if:
      properties:
        compatible:
          contains:
            enum:
              - avago,apds9960
    then:
      required:
        - interrupts

additionalProperties: false

examples:
  - |
    #include <dt-bindings/interrupt-controller/irq.h>

    i2c {
        #address-cells = <1>;
        #size-cells = <0>;

        light-sensor@39 {
            compatible = "avago,apds9300";
            reg = <0x39>;
            interrupt-parent = <&gpio2>;
            interrupts = <29 IRQ_TYPE_EDGE_FALLING>;
        };
    };
...
```
