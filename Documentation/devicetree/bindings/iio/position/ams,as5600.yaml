## Documentation/devicetree/bindings/iio/proximity/awinic,aw96xxx.yaml
```yaml
# SPDX-License-Identifier: (GPL-2.0-only OR BSD-2-Clause)
%YAML 1.2
---
$id: http://devicetree.org/schemas/input/awinic,aw96xxx.yaml#
$schema: http://devicetree.org/meta-schemas/core.yaml#

title: Awinic's AW96XXX capacitive proximity sensor

maintainers:
  - Shuaijie Wang <wangshuaijie@awinic.com>

description: |
  Awinic's AW96XXX proximity sensor.
  The specific absorption rate (SAR) is a metric that measures
  the degree of absorption of electromagnetic radiation emitted by wireless
  devices, such as mobile phones and tablets, by human tissue.
  In mobile phone applications, the proximity sensor is primarily used to detect
  the proximity of the human body to the phone. When the phone approaches the human body,
  it will actively reduce the transmit power of the antenna to keep the SAR within a safe
  range. Therefore, we also refer to the proximity sensor as a SAR sensor.

properties:
  compatible:
    enum:
      - awinic,aw96103
      - awinic,aw96105
      - awinic,aw96303
      - awinic,aw96305
      - awinic,aw96308

  reg:
    maxItems: 1

  interrupts:
    description:
      Generated by the device to announce that a close/far
      proximity event has happened.
    maxItems: 1

  awinic,sar-num:
    $ref: /schemas/types.yaml#/definitions/uint32
    description:
      Set the number of the SAR(Specific Absorption Rate) sensor.
      It is set to 0 if one awinic sar chip is used.
      If two awinic sar chips are used, awinic,sar-label in the first
      awinic-sar should be set to 0 and awinic,sar-label in the second
      awinic-sar should be set to 1.
      In an application where a device utilizes multiple proximity sensors,
      it is used to retrieve the names of the register configuration files
      that the drivers need to load. For example: aw963xx_reg_0.bin/aw963xx_reg_1.bin

  awinic,regulator-power-supply:
    description:
      Choose if you want to use a regulator to power the chip. Then the
      vccX-supply has to be set.

  vcc0-supply:
    description:
      Optional regulator for chip, 1.7V-3.6V.
      If two awinic sar chips are used, the first regulator
      should set the ID to vcc0-supply and the second regulator
      should set the ID to vcc1-supply.

  awinic,channel-use-mask:
    $ref: /schemas/types.yaml#/definitions/uint32
    description:
      The mask of channels used.
      Configure according to the specific chip channel used.
      Bit[31:0] Each bit represents a channel.
      If the customer uses ch0 and ch2, then channel_use_mask=<0x05>
      For a 3-channel chip, the maximum value is 0x07;
      For a 5-channel chip, the maximum value is 0x1F;
      For a 8-channel chip, the maximum value is 0xFF;

  awinic,monitor-esd:
    type: boolean
    description:
      Choose if you want to monitor ESD.

  awinic,pin-set-inter-pull-up:
    type: boolean
    description:
      Choose if you want to set the interrupt pin to internal pull-up.

  awinic,using-pm-ops:
    type: boolean
    description:
      Choose if you want to change the chip mode on suppend and resume.

  awinic,use-plug-cail:
    type: boolean
    description:
      Choose If you want to perform calibration when plugging and unplugging the charger.

  awinic,irq-mux:
    $ref: /schemas/types.yaml#/definitions/uint32
    enum: [2, 5]
    description:
      You only need to set this configuration item if you are using AW96308 adn AW96305BFOR.
      If CS2 is used as the interrupt pin, this item should be set to 2.
      If CS5 is used as the interrupt pin, this item should be set to 5.

required:
  - compatible
  - reg
  - interrupts
  - awinic,sar-num
  - awinic,channel-use-mask

additionalProperties: false

examples:
  - |
    #include <dt-bindings/interrupt-controller/irq.h>
    i2c {
        #address-cells = <1>;
        #size-cells = <0>;
        proximity@12 {
            compatible = "awinic,aw96308";
            reg = <0x12>;
            interrupt-parent = <&gpio>;
            interrupts = <23 IRQ_TYPE_EDGE_FALLING>;
            awinic,sar-num = <0>;
            awinic,channel-use-mask = <0xff>;
            awinic,irq-mux = <2>;
        };
    };
```

## Documentation/devicetree/bindings/iio/proximity/nicera,d3323aa.yaml
```yaml
# SPDX-License-Identifier: (GPL-2.0-only OR BSD-2-Clause)
%YAML 1.2
---
$id: http://devicetree.org/schemas/iio/proximity/nicera,d3323aa.yaml#
$schema: http://devicetree.org/meta-schemas/core.yaml#

title: Nicera D3-323-AA PIR sensor

maintainers:
  - Waqar Hameed <waqar.hameed@axis.com>

description: |
  PIR sensor for human detection.
  Datasheet: https://www.endrich.com/Datenbl%C3%A4tter/Sensoren/D3-323-AA_e.pdf

properties:
  compatible:
    const: nicera,d3323aa

  vdd-gpio:
    maxItems: 1
    description:
      GPIO for supply voltage (1.8 to 5.5 V).
      This GPIO will be driven low by the driver in order to cut the supply and
      reset the device (driving it then back to high to power it on).

  clk-vout-gpio:
    maxItems: 1
    description:
      GPIO for clock and detection.
      After reset, the device signals with two falling edges on this pin that it
      is ready for configuration (within 1.2 s), which the driver listens for as
      interrupts.
      During configuration, it is used as clock for data reading and writing (on
      data-gpio). The driver drives this pin with the frequency of 1 kHz (bit
      banging).
      After all this, the device is now in operational mode and signals on this
      pin for any detections. The driver listens for this as interrupts.

  data-gpio:
    maxItems: 1
    description:
      GPIO for data reading and writing.
      During configuration, configuration data will be written and read back
      with bit banging (together with clk-vout-gpio as clock).
      After this, during operational mode, the device will output serial data on
      this GPIO. However, the driver currently doesn't read this.

required:
  - compatible
  - vdd-gpio
  - clk-vout-gpio
  - data-gpio

additionalProperties: false

examples:
  - |
    #include <dt-bindings/gpio/gpio.h>

    proximity {
        compatible = "nicera,d3323aa";
        vdd-gpio = <&gpio 73 0>;
        clk-vout-gpio = <&gpio 78 0>;
        data-gpio = <&gpio 76 0>;
    };
...
```

## Documentation/devicetree/bindings/iio/proximity/pulsedlight,lidar-lite-v2.yaml
```yaml
# SPDX-License-Identifier: (GPL-2.0-only OR BSD-2-Clause)
%YAML 1.2
---
$id: http://devicetree.org/schemas/iio/proximity/pulsedlight,lidar-lite-v2.yaml#
$schema: http://devicetree.org/meta-schemas/core.yaml#

title: Pulsedlight LIDAR-Lite v2 range-finding sensor

maintainers:
  - Matt Ranostay <mranostay@gmail.com>

description: |
  Support for LIDAR_Lite v2 and v3 laser rangefinders. These devices
  can use a simple I2C communication bus or can operate in a PWM mode using a
  mode control pin to trigger acquisitions and return the measured distance.
  It also have a power enable pin, which can be used to shut off the device.

properties:
  compatible:
    oneOf:
      - items:
          - enum:
              - grmn,lidar-lite-v3
          - const: pulsedlight,lidar-lite-v2
      - const: pulsedlight,lidar-lite-v2

  reg:
    maxItems: 1

  powerdown-gpios:
    description: GPIO that can be driven low to shut off power to the device.
    maxItems: 1

  vdd-supply: true

required:
  - compatible
  - reg
  - vdd-supply

additionalProperties: false

examples:
  - |
    i2c {
        #address-cells = <1>;
        #size-cells = <0>;
        lidar@62 {
            compatible = "grmn,lidar-lite-v3", "pulsedlight,lidar-lite-v2";
            reg = <0x62>;
            vdd-supply = <&vdd_5v0>;
        };
    };
...
```

## Documentation/devicetree/bindings/iio/proximity/sharp,gp2ap070s.yaml
```yaml
# SPDX-License-Identifier: (GPL-2.0-only OR BSD-2-Clause)
%YAML 1.2
---
$id: http://devicetree.org/schemas/iio/proximity/sharp,gp2ap070s.yaml#
$schema: http://devicetree.org/meta-schemas/core.yaml#

title: Sharp GP2AP070S Proximity sensor

maintainers:
  - Kaustabh Chakraborty <kauschluss@disroot.org>

allOf:
  - $ref: ../common.yaml#

properties:
  compatible:
    const: sharp,gp2ap070s

  reg:
    maxItems: 1

  interrupts:
    maxItems: 1

  vdd-supply:
    description: Voltage supply for the internal circuitry

  vled-supply:
    description: Voltage supply for the IR LED

  proximity-near-level: true

required:
  - compatible
  - reg
  - interrupts
  - vdd-supply

additionalProperties: false

examples:
  - |
    #include <dt-bindings/interrupt-controller/irq.h>

    i2c {
      #address-cells = <1>;
      #size-cells = <0>;

      proximity@39 {
        compatible = "sharp,gp2ap070s";
        reg = <0x39>;
        interrupt-parent = <&gpio>;
        interrupts = <1 IRQ_TYPE_EDGE_BOTH>;
        vdd-supply = <&vdd_supply>;
        vled-supply = <&vled_supply>;
        proximity-near-level = <500>;
      };
    };

...
```

## Documentation/devicetree/bindings/iio/proximity/st,vl53l1x.yaml
```yaml
# SPDX-License-Identifier: (GPL-2.0 OR BSD-2-Clause)
%YAML 1.2
---
$id: http://devicetree.org/schemas/iio/proximity/st,vl53l1x.yaml#
$schema: http://devicetree.org/meta-schemas/core.yaml#

title: ST VL53L1X ToF ranging sensor

maintainers:
  - Siratul Islam <email@sirat.me>

properties:
  compatible:
    const: st,vl53l1x

  reg:
    maxItems: 1

  interrupts:
    maxItems: 1

  reset-gpios:
    maxItems: 1

  vdd-supply: true

required:
  - compatible
  - reg

additionalProperties: false

examples:
  - |
    #include <dt-bindings/interrupt-controller/irq.h>
    i2c {
        #address-cells = <1>;
        #size-cells = <0>;

        proximity@29 {
            compatible = "st,vl53l1x";
            reg = <0x29>;
            interrupt-parent = <&gpio>;
            interrupts = <23 IRQ_TYPE_EDGE_FALLING>;
            reset-gpios = <&gpio 5 1>;
            vdd-supply = <&vdd_3v3>;
        };
    };
...
```

## Documentation/devicetree/bindings/iio/proximity/tyhx,hx9023s.yaml
```yaml
# SPDX-License-Identifier: (GPL-2.0-only OR BSD-2-Clause)
%YAML 1.2
---
$id: http://devicetree.org/schemas/iio/proximity/tyhx,hx9023s.yaml#
$schema: http://devicetree.org/meta-schemas/core.yaml#

title: TYHX HX9023S capacitive proximity sensor

maintainers:
  - Yasin Lee <yasin.lee.x@gmail.com>

description: |
  TYHX HX9023S proximity sensor. Datasheet can be found here:
    http://www.tianyihexin.com/ueditor/php/upload/file/20240614/1718336303992081.pdf

allOf:
  - $ref: /schemas/iio/iio.yaml#

properties:
  compatible:
    const: tyhx,hx9023s

  reg:
    maxItems: 1

  interrupts:
    description: |
      Generated by device to announce preceding read request has finished
      and data is available or that a close/far proximity event has happened.
    maxItems: 1

  vdd-supply: true

patternProperties:
  "^channel@[0-4]$":
    $ref: adc.yaml
    type: object

    properties:
      reg:
        minimum: 0
        maximum: 4
        description: The channel number.

      input-channel:
        $ref: /schemas/types.yaml#/definitions/uint32
        minimum: 0
        maximum: 4
        description: |
          Specify the input pin used in single-ended configuration.

      diff-channels: true

    required:
      - reg

    additionalProperties: false

required:
  - compatible
  - reg

unevaluatedProperties: false

examples:
  - |
    #include <dt-bindings/interrupt-controller/irq.h>
    i2c {
      #address-cells = <1>;
      #size-cells = <0>;
      proximity@2a {
        compatible = "tyhx,hx9023s";
        reg = <0x2a>;
        interrupt-parent = <&pio>;
        interrupts = <16 IRQ_TYPE_EDGE_FALLING>;
        vdd-supply = <&pp1800_prox>;
        channel@0 {
          reg = <0>;
          input-channel = <0>;
        };
        channel@1 {
          reg = <1>;
          input-channel = <1>;
        };
        channel@2 {
          reg = <2>;
          input-channel = <2>;
        };
        channel@3 {
          reg = <3>;
          diff-channels = <1 0>;
        };
        channel@4 {
          reg = <4>;
          diff-channels = <2 0>;
        };
      };
    };
```

## Documentation/devicetree/bindings/iio/temperature/adi,max30210.yaml
```yaml
# SPDX-License-Identifier: (GPL-2.0-only OR BSD-2-Clause)
# Copyright 2026 Analog Devices Inc.
%YAML 1.2
---
$id: http://devicetree.org/schemas/iio/temperature/adi,max30210.yaml#
$schema: http://devicetree.org/meta-schemas/core.yaml#

title: Analog Devices MAX30210 Temperature Sensor

maintainers:
  - John Erasmus Mari Geronimo <johnerasmusmari.geronimo@analog.com>

description: |
  The MAX30210 is a temperature sensor with an I2C interface.
  https://www.analog.com/media/en/technical-documentation/data-sheets/max30210.pdf

properties:
  compatible:
    enum:
      - adi,max30210

  reg:
    maxItems: 1

  vdd-supply:
    description: Analog supply voltage input.

  powerdown-gpios:
    description: GPIO connected to the CVT/PDB pin (active low).
    maxItems: 1

  interrupts:
    description: Connected to INT pin. Interrupt triggered on both rising and falling edges.
    maxItems: 1

required:
  - compatible
  - reg
  - vdd-supply

additionalProperties: false

examples:
  - |
    #include <dt-bindings/interrupt-controller/irq.h>
    #include <dt-bindings/gpio/gpio.h>

    i2c {
        #address-cells = <1>;
        #size-cells = <0>;

        temperature-sensor@40 {
            compatible = "adi,max30210";
            reg = <0x40>;
            vdd-supply = <&vdd>;
            powerdown-gpios = <&gpio 12 GPIO_ACTIVE_LOW>;

            interrupt-parent = <&gpio>;
            interrupts = <17 IRQ_TYPE_EDGE_BOTH>;
        };
    };
...
```

## Documentation/devicetree/bindings/iio/temperature/ams,as6200.yaml
```yaml
# SPDX-License-Identifier: (GPL-2.0 OR BSD-2-Clause)
%YAML 1.2
---
$id: http://devicetree.org/schemas/iio/temperature/ams,as6200.yaml#
$schema: http://devicetree.org/meta-schemas/core.yaml#

title: AMS AS6200 Temperature Sensor

maintainers:
  - Abdel Alkuor <alkuor@gmail.com>

description: |
  https://ams.com/documents/20143/36005/AS6200_DS000449_4-00.pdf

properties:
  compatible:
    const: ams,as6200

  reg:
    maxItems: 1

  vdd-supply: true

  interrupts:
    maxItems: 1

required:
  - compatible
  - reg
  - vdd-supply

additionalProperties: false

examples:
  - |
    #include <dt-bindings/interrupt-controller/irq.h>
    i2c {
        #address-cells = <1>;
        #size-cells = <0>;

        temperature-sensor@48 {
            compatible = "ams,as6200";
            reg = <0x48>;
            vdd-supply = <&vdd>;
            interrupt-parent = <&gpio1>;
            interrupts = <17 IRQ_TYPE_EDGE_BOTH>;
        };
    };
...
```
