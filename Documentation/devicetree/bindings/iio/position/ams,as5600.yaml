## Documentation/devicetree/bindings/iio/position/ams,as5600.yaml
```yaml
# SPDX-License-Identifier: (GPL-2.0-only OR BSD-2-Clause)
%YAML 1.2
---
$id: http://devicetree.org/schemas/iio/position/ams,as5600.yaml#
$schema: http://devicetree.org/meta-schemas/core.yaml#

title: ams AS5600 Magnetic Rotary Position Sensor

maintainers:
  - Muchamad Coirul Anwar <muchamadcoirulanwar@gmail.com>

description: |
  The ams AS5600 is a 12-bit programmable contactless
  magnetic rotary position sensor communicating over I2C.
  The device address is fixed at 0x36.

properties:
  compatible:
    const: ams,as5600

  reg:
    const: 0x36

required:
  - compatible
  - reg

additionalProperties: false

examples:
  - |
    i2c {
        #address-cells = <1>;
        #size-cells = <0>;

        position-sensor@36 {
            compatible = "ams,as5600";
            reg = <0x36>;
        };
    };
```

## Documentation/devicetree/bindings/iio/pressure/bosch,bmp390.yaml
```yaml
# SPDX-License-Identifier: (GPL-2.0-only OR BSD-2-Clause)
%YAML 1.2
---
$id: http://devicetree.org/schemas/iio/pressure/bosch,bmp390.yaml#
$schema: http://devicetree.org/meta-schemas/core.yaml#

title: Bosch Sensortec BMP390 Pressure Sensor

maintainers:
  - Liquancin Mereena Mathai <liquancin.mereenamathai@in.bosch.com>

description: |
   This binding describes the Bosch Sensortec BMP390 pressure
   iio sensors with an i2c and spi interface
   Specifications about the sensor can be found at:
   https://www.bosch-sensortec.com/products/environmental-sensors/pressure-sensors/bmp390/

properties:
  compatible:
    enum:
      - bosch,bmp390

  reg:
    maxItems: 1

  interrupts:
    maxItems: 1

  spi-max-frequency:
    maximum: 10000000

required:
  - compatible
  - reg

additionalProperties: false

examples:
  - |
    i2c {
        #address-cells = <1>;
        #size-cells = <0>;
        bmp390@76 {
            compatible = "bosch,bmp390";
            reg = <0x76>;
            interrupt-parent = <&gpio0>;
            interrupts = <7 0>;
        };
    };
  - |
    spi {
        #address-cells = <1>;
        #size-cells = <0>;
        status = "okay";
        pinctrl-names = "default";
        pinctrl-0 = <&spi0_pins>;
        bmp390@0 {
            compatible = "bosch,bmp390";
            reg = <0>;
            spi-max-frequency = <10000000>;
            interrupt-parent = <&gpio0>;
            interrupts = <7 0>;
        };
    };
```

## Documentation/devicetree/bindings/iio/pressure/honeywell,hsc030pa.yaml
```yaml
# SPDX-License-Identifier: (GPL-2.0-only OR BSD-2-Clause)
%YAML 1.2
---
$id: http://devicetree.org/schemas/iio/pressure/honeywell,hsc030pa.yaml#
$schema: http://devicetree.org/meta-schemas/core.yaml#

title: Honeywell TruStability HSC and SSC pressure sensor families

description: |
  support for Honeywell TruStability HSC and SSC digital pressure sensor
  families.

  These sensors have either an I2C, an SPI or an analog interface. Only the
  digital versions are supported by this driver.

  There are 118 models with different pressure ranges available in each family.
  The vendor calls them "HSC series" and "SSC series". All of them have an
  identical programming model but differ in pressure range, unit and transfer
  function.

  To support different models one need to specify the pressure range as well as
  the transfer function. Pressure range can either be provided via range_str or
  in case it's a custom chip via numerical range limits converted to pascals.

  The transfer function defines the ranges of raw conversion values delivered
  by the sensor. pmin-pascal and pmax-pascal corespond to the minimum and
  maximum pressure that can be measured.

  Specifications about the devices can be found at:
  https://prod-edam.honeywell.com/content/dam/honeywell-edam/sps/siot/en-us/products/sensors/pressure-sensors/board-mount-pressure-sensors/trustability-hsc-series/documents/sps-siot-trustability-hsc-series-high-accuracy-board-mount-pressure-sensors-50099148-a-en-ciid-151133.pdf
  https://prod-edam.honeywell.com/content/dam/honeywell-edam/sps/siot/en-us/products/sensors/pressure-sensors/board-mount-pressure-sensors/trustability-ssc-series/documents/sps-siot-trustability-ssc-series-standard-accuracy-board-mount-pressure-sensors-50099533-a-en-ciid-151134.pdf

maintainers:
  - Petre Rodan <petre.rodan@subdimension.ro>

properties:
  compatible:
    enum:
      - honeywell,hsc
      - honeywell,ssc

  reg:
    maxItems: 1

  honeywell,transfer-function:
    description: |
      Transfer function which defines the range of valid values delivered by
      the sensor.
      0 - A, 10% to 90% of 2^14
      1 - B, 5% to 95% of 2^14
      2 - C, 5% to 85% of 2^14
      3 - F, 4% to 94% of 2^14
    $ref: /schemas/types.yaml#/definitions/uint32

  honeywell,range_str:
    description: |
      Five character string that defines "pressure range, unit and type"
      as part of the device nomenclature. In the unlikely case of a custom
      chip, set to "NA" and provide honeywell,pmin-pascal honeywell,pmax-pascal
    enum: [001BA, 1.6BA, 2.5BA, 004BA, 006BA, 010BA, 1.6MD, 2.5MD, 004MD,
           006MD, 010MD, 016MD, 025MD, 040MD, 060MD, 100MD, 160MD, 250MD,
           400MD, 600MD, 001BD, 1.6BD, 2.5BD, 004BD, 2.5MG, 004MG, 006MG,
           010MG, 016MG, 025MG, 040MG, 060MG, 100MG, 160MG, 250MG, 400MG,
           600MG, 001BG, 1.6BG, 2.5BG, 004BG, 006BG, 010BG, 100KA, 160KA,
           250KA, 400KA, 600KA, 001GA, 160LD, 250LD, 400LD, 600LD, 001KD,
           1.6KD, 2.5KD, 004KD, 006KD, 010KD, 016KD, 025KD, 040KD, 060KD,
           100KD, 160KD, 250KD, 400KD, 250LG, 400LG, 600LG, 001KG, 1.6KG,
           2.5KG, 004KG, 006KG, 010KG, 016KG, 025KG, 040KG, 060KG, 100KG,
           160KG, 250KG, 400KG, 600KG, 001GG, 015PA, 030PA, 060PA, 100PA,
           150PA, 0.5ND, 001ND, 002ND, 004ND, 005ND, 010ND, 020ND, 030ND,
           001PD, 005PD, 015PD, 030PD, 060PD, 001NG, 002NG, 004NG, 005NG,
           010NG, 020NG, 030NG, 001PG, 005PG, 015PG, 030PG, 060PG, 100PG,
           150PG, NA]
    $ref: /schemas/types.yaml#/definitions/string

  honeywell,pmin-pascal:
    description: |
      Minimum pressure value the sensor can measure in pascal.
      To be specified only if honeywell,range_str is set to "NA".
    $ref: /schemas/types.yaml#/definitions/int32

  honeywell,pmax-pascal:
    description: |
      Maximum pressure value the sensor can measure in pascal.
      To be specified only if honeywell,range_str is set to "NA".
    $ref: /schemas/types.yaml#/definitions/int32

  vdd-supply:
    description: |
      Provide VDD power to the sensor (either 3.3V or 5V depending on the chip).
      Optional, activate only if required by the target board.

  spi-max-frequency:
    description: SPI clock to be kept between 50 and 800kHz

  clock-frequency:
    description: i2c clock to be kept between 100 and 400kHz

required:
  - compatible
  - reg
  - honeywell,transfer-function
  - honeywell,range_str
  - clock-frequency
  - spi-max-frequency

additionalProperties: false

examples:
  - |
    #include <dt-bindings/gpio/gpio.h>
    i2c {
        status = "okay";
        clock-frequency = <400000>;
        #address-cells = <1>;
        #size-cells = <0>;

        HSCMRNN030PA2A3@28 {
          status = "okay";
          compatible = "honeywell,hsc";
          reg = <0x28>;

          honeywell,transfer-function = <0>;
          honeywell,range_str = "030PA";
        };
    };

    spi {
        # note that MOSI is not required by this sensor
        status = "okay";
        #address-cells = <1>;
        #size-cells = <0>;

        HSCMLNN100PASA3@0 {
          status = "okay";
          compatible = "honeywell,hsc";
          reg = <0>;
          spi-max-frequency = <800000>;

          honeywell,transfer-function = <0>;
          honeywell,range_str = "100PA";
        };

        HSC_CUSTOM_CHIP@0 {
          status = "okay";
          compatible = "honeywell,hsc";
          reg = <1>;
          spi-max-frequency = <800000>;

          honeywell,transfer-function = <0>;
          honeywell,range_str = "NA";
          honeywell,pmin-pascal = <0>;
          honeywell,pmax-pascal = <206850>;
        };

    };
```

## Documentation/devicetree/bindings/iio/pressure/infineon,dps310.yaml
```yaml
# SPDX-License-Identifier: GPL-2.0-only OR BSD-2-Clause
%YAML 1.2
---
$id: http://devicetree.org/schemas/iio/pressure/infineon,dps310.yaml#
$schema: http://devicetree.org/meta-schemas/core.yaml#

title: Infineon DPS310 barometric pressure and temperature sensor

maintainers:
  - Eddie James <eajames@linux.ibm.com>

description:
  The DPS310 is a barometric pressure and temperature sensor with an I2C
  interface.

properties:
  compatible:
    enum:
      - infineon,dps310

  reg:
    maxItems: 1

  "#io-channel-cells":
    const: 0

required:
  - compatible
  - reg

additionalProperties: false

examples:
  - |
    i2c {
        #address-cells = <1>;
        #size-cells = <0>;

        pressure-sensor@76 {
          compatible = "infineon,dps310";
          reg = <0x76>;
          #io-channel-cells = <0>;
        };
    };
```

## Documentation/devicetree/bindings/iio/pressure/meas,ms5637.yaml
```yaml
# SPDX-License-Identifier: (GPL-2.0 OR BSD-2-Clause)
%YAML 1.2
---
$id: http://devicetree.org/schemas/iio/pressure/meas,ms5637.yaml#
$schema: http://devicetree.org/meta-schemas/core.yaml#
title: Measurement Specialties ms5637 and similar pressure sensors

maintainers:
  - Louis Adamian <adamianlouis@gmail.com>

description:
  Measurement Specialties pressure and temperature sensors. The MS5803
  family supports both I2C and SPI interfaces. All other variants are I2C only.

properties:
  compatible:
    oneOf:
      - enum:
          - meas,ms5637-02ba
          - meas,ms5637-30ba
          - meas,ms5803-01ba
          - meas,ms5803-02ba
          - meas,ms5803-05ba
          - meas,ms5803-14ba
          - meas,ms5803-30ba
          - meas,ms5805
          - meas,ms5837-02ba
          - meas,ms5837-30ba
          - meas,ms8607-temppressure
      # These generic compatible strings do not identify the sub-variants of
      # the part. They are retained so that existing device trees continue
      # to bind, and each is treated as the -02BA variant of its family.
      - enum:
          - meas,ms5637
          - meas,ms5803
          - meas,ms5837
        deprecated: true

  reg:
    maxItems: 1

  vdd-supply:
    description: Regulator that provides power to the sensor

required:
  - compatible
  - reg
  - vdd-supply

allOf:
  - if:
      properties:
        compatible:
          contains:
            enum:
              - meas,ms5803
              - meas,ms5803-01ba
              - meas,ms5803-02ba
              - meas,ms5803-05ba
              - meas,ms5803-14ba
              - meas,ms5803-30ba
    then:
      $ref: /schemas/spi/spi-peripheral-props.yaml#
      properties:
        spi-max-frequency:
          maximum: 20000000

unevaluatedProperties: false

examples:
  - |
    i2c {
        #address-cells = <1>;
        #size-cells = <0>;

        pressure@76 {
            compatible = "meas,ms5637-02ba";
            reg = <0x76>;
            vdd-supply = <&vcc_3v3>;
        };
    };
  - |
    spi {
        #address-cells = <1>;
        #size-cells = <0>;

        pressure@0 {
            compatible = "meas,ms5803-14ba";
            reg = <0>;
            vdd-supply = <&vcc_3v3>;
            spi-max-frequency = <20000000>;
        };
    };
```

## Documentation/devicetree/bindings/iio/pressure/sensirion,sdp31.yaml
```yaml
# SPDX-License-Identifier: (GPL-2.0-only OR BSD-2-Clause)
%YAML 1.2
---
$id: http://devicetree.org/schemas/iio/pressure/sensirion,sdp31.yaml#
$schema: http://devicetree.org/meta-schemas/core.yaml#

title: Sensirion SDP31 differential pressure sensor

maintainers:
  - Muhammad Abu Bakar <m.abubakar365@yahoo.com>

description: |
  Differential pressure sensor from Sensirion with an I2C interface.

properties:
  compatible:
    const: sensirion,sdp31

  reg:
    maxItems: 1

  vdd-supply: true

required:
  - compatible
  - reg

additionalProperties: false

examples:
  - |
    i2c {
      #address-cells = <1>;
      #size-cells = <0>;
      pressure@21 {
        compatible = "sensirion,sdp31";
        reg = <0x21>;
        vdd-supply = <&vdd_3v3>;
      };
    };
```

## Documentation/devicetree/bindings/iio/pressure/sensirion,sdp500.yaml
```yaml
# SPDX-License-Identifier: (GPL-2.0-only OR BSD-2-Clause)
%YAML 1.2
---
$id: http://devicetree.org/schemas/iio/pressure/sdp500.yaml#
$schema: http://devicetree.org/meta-schemas/core.yaml#

title: sdp500/sdp510 pressure sensor with I2C bus interface

maintainers:
  - Petar Stoykov <petar.stoykov@prodrive-technologies.com>

description: |
  Pressure sensor from Sensirion with I2C bus interface.
  There is no software difference between sdp500 and sdp510.

properties:
  compatible:
    enum:
      - sensirion,sdp500
      - sensirion,sdp510

  reg:
    maxItems: 1

required:
  - compatible
  - reg

additionalProperties: false

examples:
  - |
    i2c {
      #address-cells = <1>;
      #size-cells = <0>;
      pressure@40 {
        compatible = "sensirion,sdp500";
        reg = <0x40>;
        vdd-supply = <&foo>;
      };
    };
```
