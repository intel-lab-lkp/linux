## Documentation/devicetree/bindings/iio/temperature/microchip,mcp9600.yaml
```yaml
# SPDX-License-Identifier: (GPL-2.0 OR BSD-2-Clause)
%YAML 1.2
---
$id: http://devicetree.org/schemas/iio/temperature/microchip,mcp9600.yaml#
$schema: http://devicetree.org/meta-schemas/core.yaml#

title: Microchip MCP9600 and similar thermocouple EMF converters

maintainers:
  - Andrew Hepp <andrew.hepp@ahepp.dev>

description:
  https://ww1.microchip.com/downloads/en/DeviceDoc/MCP960X-Data-Sheet-20005426.pdf

properties:
  compatible:
    oneOf:
      - const: microchip,mcp9600
      - items:
          - const: microchip,mcp9600
          - const: microchip,mcp9601

  reg:
    maxItems: 1

  interrupts:
    minItems: 1
    maxItems: 4

  interrupt-names:
    minItems: 1
    items:
      - const: alert1
      - const: alert2
      - const: alert3
      - const: alert4

  thermocouple-type:
    $ref: /schemas/types.yaml#/definitions/uint32
    default: 3
    description:
      Type of thermocouple (THERMOCOUPLE_TYPE_K if omitted).
      Use defines in dt-bindings/iio/temperature/thermocouple.h.
      Supported types are B, E, J, K, N, R, S, T.

  vdd-supply: true

allOf:
  - if:
      properties:
        compatible:
          contains:
            const: microchip,mcp9601
    then:
      properties:
        interrupts:
          minItems: 1
          maxItems: 6
        interrupt-names:
          items:
            - const: alert1
            - const: alert2
            - const: alert3
            - const: alert4
            - const: open-circuit
            - const: short-circuit
        microchip,vsense:
          default: false
          description:
            This flag indicates that the chip has been wired with VSENSE to
            enable open and short circuit detect. By default, this is false,
            since there's no way to detect that the chip is wired correctly.
          type: boolean

required:
  - compatible
  - reg

additionalProperties: false

examples:
  - |
    #include <dt-bindings/iio/temperature/thermocouple.h>
    #include <dt-bindings/interrupt-controller/irq.h>
    i2c {
        #address-cells = <1>;
        #size-cells = <0>;

        temperature-sensor@60 {
            compatible = "microchip,mcp9600";
            reg = <0x60>;
            interrupt-parent = <&gpio>;
            interrupts = <25 IRQ_TYPE_EDGE_RISIN>;
            interrupt-names = "alert1";
            thermocouple-type = <THERMOCOUPLE_TYPE_K>;
            vdd-supply = <&vdd>;
        };
    };
  - |
    #include <dt-bindings/iio/temperature/thermocouple.h>
    #include <dt-bindings/interrupt-controller/irq.h>
    i2c {
        #address-cells = <1>;
        #size-cells = <0>;

        temperature-sensor@60 {
            compatible = "microchip,mcp9601", "microchip,mcp9600";
            microchip,vsense;
            reg = <0x62>;
            interrupt-parent = <&gpio>;
            vdd-supply = <&vdd>;
        };
    };
```

## Documentation/devicetree/bindings/iio/temperature/microchip,mcp9982.yaml
```yaml
# SPDX-License-Identifier: (GPL-2.0 OR BSD-2-Clause)
%YAML 1.2
---
$id: http://devicetree.org/schemas/iio/temperature/microchip,mcp9982.yaml#
$schema: http://devicetree.org/meta-schemas/core.yaml#

title: Microchip MCP998X/33 and MCP998XD/33D Multichannel Automotive
       Temperature Monitor Family

maintainers:
  - Victor Duicu <victor.duicu@microchip.com>

description: |
  The MCP998X/33 and MCP998XD/33D family is a high-accuracy 2-wire multichannel
  automotive temperature monitor.
  The datasheet can be found here:
    https://ww1.microchip.com/downloads/aemDocuments/documents/MSLD/ProductDocuments/DataSheets/MCP998X-Family-Data-Sheet-DS20006827.pdf

properties:
  compatible:
    enum:
      - microchip,mcp9933
      - microchip,mcp9933d
      - microchip,mcp9982
      - microchip,mcp9982d
      - microchip,mcp9983
      - microchip,mcp9983d
      - microchip,mcp9984
      - microchip,mcp9984d
      - microchip,mcp9985
      - microchip,mcp9985d

  reg:
    maxItems: 1

  interrupts:
    minItems: 2
    maxItems: 2

  interrupt-names:
    description:
      -alert-therm is used to handle a HIGH or LOW limit.
      -therm-addr is used to handle a THERM limit on chips
      without "D" in the name.
      -sys-shutdown is used to handle a THERM limit on chips
      with "D" in the name.
    items:
      - const: alert-therm
      - const: therm-addr
      - const: sys-shutdown

  "#address-cells":
    const: 1

  "#size-cells":
    const: 0

  microchip,enable-anti-parallel:
    description:
      Enable anti-parallel diode mode operation.
      MCP9984/84D/85/85D and MCP9933/33D support reading two external diodes
      in anti-parallel connection on the same set of pins.
    type: boolean

  microchip,parasitic-res-on-channel1-2:
    description:
      Indicates that the chip and the diodes/transistors are sufficiently far
      apart that a parasitic resistance is added to the wires, which can affect
      the measurements. Due to the anti-parallel diode connections, channels
      1 and 2 are affected together.
    type: boolean

  microchip,parasitic-res-on-channel3-4:
    description:
      Indicates that the chip and the diodes/transistors are sufficiently far
      apart that a parasitic resistance is added to the wires, which can affect
      the measurements. Due to the anti-parallel diode connections, channels
      3 and 4 are affected together.
    type: boolean

  vdd-supply: true

patternProperties:
  "^channel@[1-4]$":
    description:
      Represents the external temperature channels to which
      a remote diode is connected.
    type: object

    properties:
      reg:
        items:
          minimum: 1
          maximum: 4

      microchip,ideality-factor:
        description:
          Each channel has an ideality factor.
          Beta compensation and resistance error correction automatically
          correct for most ideality errors. So ideality factor does not need
          to be adjusted in general.
        $ref: /schemas/types.yaml#/definitions/uint32
        default: 18

      label:
        description: Unique name to identify which channel this is.

    required:
      - reg

    additionalProperties: false

required:
  - compatible
  - reg
  - vdd-supply

allOf:
  - if:
      properties:
        compatible:
          contains:
            enum:
              - microchip,mcp9982d
              - microchip,mcp9983d
              - microchip,mcp9984d
              - microchip,mcp9985d
              - microchip,mcp9933d
    then:
      properties:
        interrupts-names:
          items:
            - const: alert-therm
            - const: sys-shutdown
    else:
      properties:
        interrupts-names:
          items:
            - const: alert-therm
            - const: therm-addr

  - if:
      properties:
        compatible:
          contains:
            enum:
              - microchip,mcp9982
              - microchip,mcp9983
              - microchip,mcp9982d
              - microchip,mcp9983d
    then:
      properties:
        microchip,enable-anti-parallel: false

  - if:
      properties:
        compatible:
          contains:
            enum:
              - microchip,mcp9982d
              - microchip,mcp9983d
              - microchip,mcp9984d
              - microchip,mcp9985d
              - microchip,mcp9933d
    then:
      properties:
        microchip,parasitic-res-on-channel1-2: false
        microchip,parasitic-res-on-channel3-4: false
        microchip,ideality-factor: false

additionalProperties: false

examples:
  - |
    i2c {
        #address-cells = <1>;
        #size-cells = <0>;

        temperature-sensor@4c {
            compatible = "microchip,mcp9985";
            reg = <0x4c>;

            #address-cells = <1>;
            #size-cells = <0>;

            microchip,enable-anti-parallel;
            microchip,parasitic-res-on-channel1-2;
            microchip,parasitic-res-on-channel3-4;
            vdd-supply = <&vdd>;

            channel@1 {
                reg = <1>;
                label = "CPU Temperature";
            };

            channel@2 {
                reg = <2>;
                label = "GPU Temperature";
            };
        };
    };

...
```

## Documentation/devicetree/bindings/iio/temperature/nuvoton,nct7718.yaml
```yaml
# SPDX-License-Identifier: (GPL-2.0 OR BSD-2-Clause)
%YAML 1.2
---
$id: http://devicetree.org/schemas/iio/temperature/nuvoton,nct7718.yaml#
$schema: http://devicetree.org/meta-schemas/core.yaml#

title: Nuvoton NCT7718W Thermal Sensor IC

maintainers:
  - Ming Yu <tmyu0@nuvoton.com>

description:
  https://www.nuvoton.com/resource-files/Nuvoton_NCT7718W_Datasheet_V11.pdf

properties:
  compatible:
    const: nuvoton,nct7718

  reg:
    maxItems: 1

  interrupts:
    maxItems: 1

required:
  - compatible
  - reg

additionalProperties: false

examples:
  - |
    #include <dt-bindings/interrupt-controller/irq.h>
    i2c {
        #address-cells = <1>;
        #size-cells = <0>;

        temp-sensor@4c {
            compatible = "nuvoton,nct7718";
            reg = <0x4c>;
            interrupt-parent = <&gpio0>;
            interrupts = <26 IRQ_TYPE_EDGE_FALLING>;
        };
    };
```

## Documentation/devicetree/bindings/iio/temperature/nxp,p3t1755.yaml
```yaml
# SPDX-License-Identifier: (GPL-2.0 OR BSD-2-Clause)
%YAML 1.2
---
$id: http://devicetree.org/schemas/iio/temperature/nxp,p3t1755.yaml#
$schema: http://devicetree.org/meta-schemas/core.yaml#

title: NXP P3T175xDP Temperature Sensor

maintainers:
  - Lakshay Piplani <lakshay.piplani@nxp.com>

description: |
  Datasheet: https://www.nxp.com/docs/en/data-sheet/P3T1755.pdf

  P3T175xDP (P3T1750/P3T1755) is a digital temperature sensor with a range of
  -40°C to +125°C and a 12-bit resolution. It supports communication over both
  I2C and I3C interfaces.

  The I2C interface supports up to 32 static addresses and provides an ALERT
  output to signal when temperature thresholds are crossed.

  The I3C interface supports In-Band interrupts (IBI) in interrupt mode,
  allowing the device to notify the controller of threshold events without
  dedicated alert pin.

properties:
  compatible:
    enum:
      - nxp,p3t1750dp
      - nxp,p3t1755dp

  interrupts:
    maxItems: 1

  reg:
    maxItems: 1
    description: |
      In I2C mode, the device supports up to 32 static addresses.
      In I3C mode, the 'reg' property encodes a triplet of
      <static-address BCR PID> used for device matching.
      Static address is optional if matching is done via PID.

required:
  - compatible
  - reg

additionalProperties: false

examples:
  - |
    #include <dt-bindings/interrupt-controller/irq.h>
    i2c {
        #address-cells = <1>;
        #size-cells = <0>;

        temp-sensor@48 {
            compatible = "nxp,p3t1755dp";
            reg = <0x48>;
            interrupt-parent = <&gpio2>;
            interrupts = <3 IRQ_TYPE_EDGE_FALLING>;
        };
    };
```

## Documentation/devicetree/bindings/input/adafruit,seesaw-gamepad.yaml
```yaml
# SPDX-License-Identifier: (GPL-2.0-only OR BSD-2-Clause)
%YAML 1.2
---
$id: http://devicetree.org/schemas/input/adafruit,seesaw-gamepad.yaml#
$schema: http://devicetree.org/meta-schemas/core.yaml#

title: Adafruit Mini I2C Gamepad with seesaw

maintainers:
  - Anshul Dalal <anshulusr@gmail.com>

description: |
  Adafruit Mini I2C Gamepad

    +-----------------------------+
    |   ___                       |
    |  /   \               (X)    |
    | |  S  |  __   __  (Y)   (A) |
    |  \___/  |ST| |SE|    (B)    |
    |                             |
    +-----------------------------+

  S -> 10-bit precision bidirectional analog joystick
  ST -> Start
  SE -> Select
  X, A, B, Y -> Digital action buttons

  The gamepad exposes button events through the seesaw GPIO block and joystick
  axes through the seesaw ADC block. If the optional IRQ pin is wired, button
  presses can be interrupt-driven while joystick axes remain polled. Without an
  IRQ, the driver falls back to fully polled operation.

  Datasheet: https://cdn-learn.adafruit.com/downloads/pdf/gamepad-qt.pdf
  Product page: https://www.adafruit.com/product/5743
  Arduino Driver: https://github.com/adafruit/Adafruit_Seesaw

properties:
  compatible:
    const: adafruit,seesaw-gamepad

  reg:
    maxItems: 1

  interrupts:
    maxItems: 1
    description:
      Optional interrupt from the gamepad's open-drain INT pin. The device
      asserts INT low on button GPIO changes when interrupts are enabled in the
      seesaw firmware, so the host should typically use a falling-edge trigger.

required:
  - compatible
  - reg

additionalProperties: false

examples:
  - |
    #include <dt-bindings/interrupt-controller/irq.h>

    i2c {
        #address-cells = <1>;
        #size-cells = <0>;

        joystick@50 {
            compatible = "adafruit,seesaw-gamepad";
            interrupt-parent = <&gpio1>;
            interrupts = <18 IRQ_TYPE_EDGE_FALLING>;
            reg = <0x50>;
        };
    };
```

## Documentation/devicetree/bindings/input/adafruit_seesaw.yaml
```yaml
# SPDX-License-Identifier: (GPL-2.0-only OR BSD-2-Clause)
%YAML 1.2
---
$id: "http://devicetree.org/schemas/input/adafruit_seesaw.yaml#"
$schema: "http://devicetree.org/meta-schemas/core.yaml#"

title: Adafruit Mini I2C Gamepad with seesaw

maintainers:
  - Anshul Dalal <anshulusr@gmail.com>

description: |
  Bindings for Adafruit Mini I2C Gamepad

    +-----------------------------+
    |   ___                       |
    |  /   \               (X)    |
    | |  S  |  __   __  (Y)   (A) |
    |  \___/  |ST| |SE|    (B)    |
    |                             |
    +-----------------------------+

  S -> 10-bit percision bidirectional analog joystick
  ST -> Start
  SE -> Select
  X, A, B, Y -> Digital action buttons

  Product page: https://www.adafruit.com/product/5743
  Arduino Driver: https://github.com/adafruit/Adafruit_Seesaw

properties:
  compatible:
    const: adafruit,seesaw_gamepad

required:
  - compatible

additionalProperties: false

examples:
  - |
    seesaw_gamepad@50 {
        compatible = "adafruit,seesaw_gamepad";
        reg = <0x50>;
    };
```
