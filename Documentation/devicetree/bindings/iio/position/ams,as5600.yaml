## Documentation/devicetree/bindings/input/apple,dockchannel-hid.yaml
```yaml
# SPDX-License-Identifier: (GPL-2.0-only OR BSD-2-Clause)
%YAML 1.2
---
$id: http://devicetree.org/schemas/input/apple,dockchannel-hid.yaml#
$schema: http://devicetree.org/meta-schemas/core.yaml#

title: Apple DockChannel HID Transport

maintainers:
  - Michael Reeves <michael.reeves077@gmail.com>

description:
  HID transport for keyboard and trackpad devices connected via the
  DockChannel FIFO mailbox on Apple Silicon SoCs. The endpoint includes a
  small RTKit coprocessor called MTP which must be booted before the HID
  transport becomes available.

properties:
  compatible:
    oneOf:
      - items:
          - const: apple,t8112-dockchannel-hid
      - items:
          - enum:
              - apple,t6020-dockchannel-hid
              - apple,t8122-dockchannel-hid
          - const: apple,t8112-dockchannel-hid

  reg:
    items:
      - description: Coprocessor ASC registers
      - description: Coprocessor SRAM/mailbox registers

  reg-names:
    items:
      - const: coproc-asc
      - const: coproc-sram

  mboxes:
    items:
      - description: ASC mailbox used for RTKit control
      - description: DockChannel FIFO mailbox used for HID packets

  mbox-names:
    items:
      - const: asc
      - const: dockchannel

  iommus:
    maxItems: 1

  keyboard:
    type: object
    properties:
      hid-country-code:
        $ref: /schemas/types.yaml#/definitions/uint32
        description:
          HID country code for the keyboard layout variant.

    additionalProperties: false

required:
  - compatible
  - reg
  - reg-names
  - mboxes
  - mbox-names
  - iommus

additionalProperties: false

examples:
  - |
    soc {
        #address-cells = <2>;
        #size-cells = <2>;

        hid@24e400000 {
            compatible = "apple,t8112-dockchannel-hid";
            reg = <0x2 0x4e400000 0x0 0x4000>,
                  <0x2 0x4ec00000 0x0 0x100000>;
            reg-names = "coproc-asc", "coproc-sram";
            mboxes = <&mtp_mbox>, <&mtp_dockchannel>;
            mbox-names = "asc", "dockchannel";
            iommus = <&mtp_dart 1>;

            keyboard {
                hid-country-code = <0>;
            };
        };
    };
```

## Documentation/devicetree/bindings/input/awinic,aw_sar.yaml
```yaml
# SPDX-License-Identifier: (GPL-2.0-only OR BSD-2-Clause)
%YAML 1.2
---
$id: http://devicetree.org/schemas/input/awinic,aw_sar.yaml#
$schema: http://devicetree.org/meta-schemas/core.yaml#

title: Awinic sar sensor driver family

maintainers:
  - Shuaijie Wang <wangshuaijie@awinic.com>

properties:
  compatible:
    enum:
      - awinic,aw96103
      - awinic,aw96105
      - awinic,aw96303
      - awinic,aw96305
      - awinic,aw96308

  reg:
    maxItems: 1

  irq-gpio:
    maxItems: 1

  awinic,sar-label:
    $ref: /schemas/types.yaml#/definitions/uint32
    description:
      Set the label of the SAR(Specific Absorption Rate) sensor.
      It is set to 0 if one awinic sar chip is used.
      If two awinic sar chips are used, awinic,sar-label in the first
      awinic-sar should be set to 0 and awinic,sar-label in the second
      awinic-sar should be set to 1.


  awinic,regulator-power-supply:
    description:
      Choose if you want to use a regulator to power the chip. Then the
      vccX-supply has to be set.

  vcc0-supply:
    description:
      Optional regulator for chip, 1.7V-3.6V.
      If two awinic sar chips are used, the first regulator
      should set the ID to vcc0-supply and the second regulator
      should set the ID to vcc1-supply.

  awinic,channel-use-mask:
    $ref: /schemas/types.yaml#/definitions/uint32
    description:
      The mask of channels used.
      Configure according to the specific chip channel used.
      Bit[31:0] Each bit represents a channel.
      If the customer uses ch0 and ch2, then channel_use_mask=<0x05>
      For a 3-channel chip, the maximum value is 0x07;
      For a 5-channel chip, the maximum value is 0x1F;
      For a 8-channel chip, the maximum value is 0xFF;

  awinic,update-fw:
    type: boolean
    description:
      Choose if you want to update the firmware.

  awinic,monitor-esd:
    type: boolean
    description:
      Choose if you want to monitor ESD.

  awinic,pin-set-inter-pull-up:
    type: boolean
    description:
      Choose if you want to set the interrupt pin to internal pull-up.

  awinic,using-pm-ops:
    type: boolean
    description:
      Choose if you want to change the chip mode on suppend and resume.

  awinic,use-plug-cail:
    type: boolean
    description:
      Choose If you want to perform calibration when plugging and unplugging the charger.

  awinic,start-mode:
    $ref: /schemas/types.yaml#/definitions/uint32
    description:
      You only need to set this configuration item if you are using AW963XX.
      When connecting to AW963XX, select the location where the firmware starts.
      Set 0 if start in rom.
      Set 1 if start in ram

  awinic,irq-mux:
    $ref: /schemas/types.yaml#/definitions/uint32
    description:
      You only need to set this configuration item if you are using AW96308 adn AW96305BFOR.
      If CS2 is used as the interrupt pin, this item should be set to 2.
      If CS5 is used as the interrupt pin, this item should be set to 5.

required:
  - compatible
  - reg
  - irq-gpio
  - awinic,sar-label
  - awinic,channel-use-mask

unevaluatedProperties: false

examples:
  - |
    #include <dt-bindings/gpio/gpio.h>
    #include <dt-bindings/interrupt-controller/irq.h>
    i2c {
        #address-cells = <1>;
        #size-cells = <0>;
        awinic-sar@12 {
            compatible = "awinic,aw96308";
            reg = <0x12>;
            irq-gpio = <&tlmm 72 0>;
            awinic,sar-label = < 0 >;
            awinic,channel-use-mask = <0xff>;
            awinic,start-mode = < 0 >;
            awinic,irq-mux = < 2 >;
        };
    };
```

## Documentation/devicetree/bindings/input/cirrus,cs40l50.yaml
```yaml
# SPDX-License-Identifier: GPL-2.0-only OR BSD-2-Clause
%YAML 1.2
---
$id: http://devicetree.org/schemas/input/cirrus,cs40l50.yaml#
$schema: http://devicetree.org/meta-schemas/core.yaml#

title: Cirrus Logic CS40L50 Advanced Haptic Driver

maintainers:
  - James Ogletree <james.ogletree@cirrus.com>

description:
  CS40L50 is a haptic driver with waveform memory,
  integrated DSP, and closed-loop algorithms.

properties:
  compatible:
    enum:
      - cirrus,cs40l50

  reg:
    maxItems: 1

  interrupts:
    maxItems: 1

  reset-gpios:
    maxItems: 1

  va-supply:
    description: Power supply for internal analog circuits.

  vp-supply:
    description: Power supply for always-on circuits.

  vio-supply:
    description: Power supply for digital input/output.

  vamp-supply:
    description: Power supply for the Class D amplifier.

required:
  - compatible
  - reg
  - interrupts
  - reset-gpios
  - vp-supply
  - vio-supply

additionalProperties: false

examples:
  - |
    #include <dt-bindings/gpio/gpio.h>
    #include <dt-bindings/interrupt-controller/irq.h>

    i2c {
      #address-cells = <1>;
      #size-cells = <0>;

      haptic-driver@34 {
        compatible = "cirrus,cs40l50";
        reg = <0x34>;
        interrupt-parent = <&gpio>;
        interrupts = <113 IRQ_TYPE_LEVEL_LOW>;
        reset-gpios = <&gpio 112 GPIO_ACTIVE_LOW>;
        vp-supply = <&vreg>;
        vio-supply = <&vreg>;
      };
    };
```

## Documentation/devicetree/bindings/input/dlg,da9062-onkey.yaml
```yaml
# SPDX-License-Identifier: (GPL-2.0 OR BSD-2-Clause)
%YAML 1.2
---
$id: http://devicetree.org/schemas/input/dlg,da9062-onkey.yaml#
$schema: http://devicetree.org/meta-schemas/core.yaml#

title: Dialog DA9061/62/63 OnKey Module

maintainers:
  - Biju Das <biju.das.jz@bp.renesas.com>

description: |
  This module is part of the DA9061/DA9062/DA9063. For more details about entire
  For DA906{1,2,3} see Documentation/devicetree/bindings/mfd/dlg,da9063.yaml

  This module provides the KEY_POWER event.

properties:
  compatible:
    oneOf:
      - items:
          - enum:
              - dlg,da9062-onkey
              - dlg,da9063-onkey
      - items:
          - enum:
              - dlg,da9061-onkey
          - const: dlg,da9062-onkey # da9062-onkey fallback

  dlg,disable-key-power:
    type: boolean
    description:
      Disable power-down using a long key-press. If this entry exists
      the OnKey driver will remove support for the KEY_POWER key press
      when triggered using a long press of the OnKey.

required:
  - compatible

additionalProperties: false

examples:
  - |
    #include <dt-bindings/interrupt-controller/irq.h>
    i2c {
      #address-cells = <1>;
      #size-cells = <0>;
      pmic@58 {
        compatible = "dlg,da9063";
        reg = <0x58>;
        interrupt-parent = <&gpio6>;
        interrupts = <11 IRQ_TYPE_LEVEL_LOW>;
        interrupt-controller;

        onkey {
          compatible = "dlg,da9063-onkey";
          dlg,disable-key-power;
        };
      };
    };
```
