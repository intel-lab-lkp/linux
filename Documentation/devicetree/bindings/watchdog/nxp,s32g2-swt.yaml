## arch/arm/mach-goldengate/Kconfig
```kconfig
# SPDX-License-Identifier: GPL-2.0-only
config ARCH_CORTINA_ACCESS
	bool "Cortina Systems CS75xx (Goldengate G2)"
	depends on ARCH_MULTI_V7
	select ARM_ERRATA_754322
	select ARM_ERRATA_764369 if SMP
	select ARM_GIC
	select ARM_GLOBAL_TIMER
	select CACHE_L2X0
	select CLKSRC_ARM_GLOBAL_TIMER_SCHED_CLOCK
	select HAVE_ARM_SCU if SMP
	select HAVE_ARM_TWD if SMP
	help
	  Support for the Cortina Systems CS75xx (Goldengate G2) family of
	  network processors, such as the CS7542 used in the Securifi
	  Almond+ router. These SoCs have two Cortex-A9 cores with a PL310
	  L2 cache controller, a packet processing engine, PCIe, NAND and
	  the usual low speed peripherals.
```

## arch/arm/mach-zte/Kconfig
```kconfig
# SPDX-License-Identifier: GPL-2.0-only
menuconfig ARCH_ZTE
	bool "ZTE zx family"
	depends on ARCH_MULTI_V7
	help
	  Support for ZTE zx-based family of processors.

if ARCH_ZTE

config SOC_ZX297520V3
	default y if ARCH_ZTE
	bool "zx297520v3"
	select ARM_GIC_V3
	select ARM_AMBA
	select HAVE_ARM_ARCH_TIMER
	select PM_GENERIC_DOMAINS if PM
	help
	  Support for ZTE zx297520v3 SoC. It is a single core SoC used in cheap
	  LTE to WiFi routers. These devices can be identified by the occurrence
	  of the string "zx297520v3" in the boot output and /proc/cpuinfo of
	  their stock firmware.

	  Please read Documentation/arch/arm/zte/zx297520v3.rst on how to boot
	  the kernel.

endif
```

## arch/arm64/Kconfig.debug
```kconfig
# SPDX-License-Identifier: GPL-2.0-only

config PID_IN_CONTEXTIDR
	bool "Write the current PID to the CONTEXTIDR register"
	help
	  Enabling this option causes the kernel to write the current PID to
	  the CONTEXTIDR register, at the expense of some additional
	  instructions during context switch. Say Y here only if you are
	  planning to use hardware trace tools with this kernel.

config DEBUG_EFI
	depends on EFI && DEBUG_INFO
	bool "UEFI debugging"
	help
	  Enable this option to include EFI specific debugging features into
	  the kernel that are only useful when using a debug build of the
	  UEFI firmware

config ARM64_RELOC_TEST
	depends on m
	tristate "Relocation testing module"

config ARM64_PTDUMP_CONSOLE
	bool "Dump early kernel page table"
	depends on DEBUG_KERNEL
	depends on ARCH_HAS_PTDUMP
	select PTDUMP
	help
	  Enable this option to dump early kernel page table entries during
	  boot using the PTDUMP framework. This helps in examining kernel's
	  page table mapping entries and their attributes etc.

	  If in doubt, say N.

source "drivers/hwtracing/coresight/Kconfig"
```

## arch/mips/ath79/Kconfig
```kconfig
# SPDX-License-Identifier: GPL-2.0
if ATH79

config SOC_AR71XX
	select HAVE_PCI
	def_bool n

config SOC_AR724X
	select HAVE_PCI
	def_bool n

config SOC_AR913X
	def_bool n

config SOC_AR933X
	def_bool n

config SOC_AR934X
	select HAVE_PCI
	def_bool n

config SOC_QCA955X
	select HAVE_PCI
	def_bool n
endif
```

## arch/openrisc/Kconfig.debug
```kconfig
# SPDX-License-Identifier: GPL-2.0-only
menu "openrisc Testing"

menuconfig RUNTIME_KERNEL_TESTING_MENU
    bool "openrisc kernel runtime testing"
    default y
    help
      Enable openrisc kernel runtime testing. With this option, one can
      build and run tests to verify the correctness of relevant components
      in the kernel at runtime.

if RUNTIME_KERNEL_TESTING_MENU

config OR_KPROBES_KUNIT
    tristate "KUnit test for kprobes on openrisc"
    depends on KUNIT
    depends on KPROBES
    default KUNIT_ALL_TESTS
    help
      Enable testing of KProbes in OpenRISC for instructions that
      require simulation. When further changes related to probes or
      tracing are added to OpenRISC's port, these tests can help
      verify that instruction simulation and processing of delay slots
      continue to work as expected.

      If unsure, say N

endif # RUNTIME_KERNEL_TESTING_MENU

endmenu # "openrisc Testing"
```

## arch/powerpc/sysdev/xive/Kconfig
```kconfig
# SPDX-License-Identifier: GPL-2.0
config PPC_XIVE
	bool
	select PPC_SMP_MUXED_IPI
	select HARDIRQS_SW_RESEND

config PPC_XIVE_NATIVE
	bool
	select PPC_XIVE
	depends on PPC_POWERNV

config PPC_XIVE_SPAPR
	bool
	select PPC_XIVE

config PPC_XIVE_KUNIT_TEST
	tristate "KUnit tests for XIVE interrupt controller" if !KUNIT_ALL_TESTS
	depends on KUNIT && PPC_XIVE
	default KUNIT_ALL_TESTS
	help
	  This builds unit tests for the XIVE interrupt controller.

	  If unsure, say N.
```

## arch/riscv/Kconfig.debug
```kconfig
source "arch/riscv/kernel/tests/Kconfig.debug"
source "arch/riscv/kvm/Kconfig.debug"
```

## arch/riscv/kernel/tests/Kconfig.debug
```kconfig
# SPDX-License-Identifier: GPL-2.0-only
menu "arch/riscv/kernel Testing and Coverage"

config AS_HAS_ULEB128
	def_bool $(as-instr,.reloc label$(comma) R_RISCV_SET_ULEB128$(comma) 127\n.reloc label$(comma) R_RISCV_SUB_ULEB128$(comma) 127\nlabel:\n.word 0)

menuconfig RUNTIME_KERNEL_TESTING_MENU
       bool "arch/riscv/kernel runtime Testing"
       default y
       help
         Enable riscv kernel runtime testing.

if RUNTIME_KERNEL_TESTING_MENU

config RISCV_MODULE_LINKING_KUNIT
       bool "KUnit test riscv module linking at runtime" if !KUNIT_ALL_TESTS
       depends on KUNIT
       default KUNIT_ALL_TESTS
       help
         Enable this option to test riscv module linking at boot. This will
	 enable a module called "test_module_linking".

         KUnit tests run during boot and output the results to the debug log
         in TAP format (http://testanything.org/). Only useful for kernel devs
         running the KUnit test harness, and not intended for inclusion into a
         production build.

         For more information on KUnit and unit tests in general please refer
         to the KUnit documentation in Documentation/dev-tools/kunit/.

         If unsure, say N.

config RISCV_KPROBES_KUNIT
       tristate "KUnit test for riscv kprobes" if !KUNIT_ALL_TESTS
       depends on KUNIT
       depends on KPROBES
       default KUNIT_ALL_TESTS
       help
         Enable testing for riscv kprobes. Useful for riscv and/or kprobes
         development. The test verifies that kprobes do not change the behaviour
         of some sample functions.

         If unsure, say N.

config RISCV_STACKTRACE_KUNIT_TEST
	bool "KUnit tests for RISC-V stack trace start frames"
	depends on KUNIT && STACKTRACE && FRAME_POINTER && KALLSYMS
	help
	  Check that stack_trace_save() starts at its caller and skips exactly
	  the requested number of frames through a known call chain, and that
	  ftrace_return_address(), which CALLER_ADDR1 and up are built on,
	  returns the caller it was asked for. This catches a stack walker
	  that exposes its own implementation frames to its users.

	  If unsure, say N.

endif # RUNTIME_TESTING_MENU

endmenu # "arch/riscv/kernel runtime Testing"
```

## arch/riscv/kvm/Kconfig.debug
```kconfig
# SPDX-License-Identifier: GPL-2.0-only
menu "arch/riscv/kvm testing"

config RISCV_KVM_TEST_CSR
        bool "Test KVM CSR emulation"
        depends on KVM
        default n
        help
            Enable this option to enable the emulation of a test hypervisor csr.
            The KVM test csr is the vsscratch register. Once this is enabled,
            reading/writing to the vsscratch register will trap into the host
            supervisor and reflect the change.

            If unsure, say N.

endmenu # "arch/riscv/kvm testing"
```

## arch/riscv/lib/crypto/Kconfig
```kconfig
# SPDX-License-Identifier: GPL-2.0-only

config CRYPTO_CHACHA_RISCV64
	tristate
	depends on 64BIT && RISCV_ISA_V && TOOLCHAIN_HAS_VECTOR_CRYPTO
	default CRYPTO_LIB_CHACHA
	select CRYPTO_ARCH_HAVE_LIB_CHACHA
	select CRYPTO_LIB_CHACHA_GENERIC

config CRYPTO_POLY1305_RISCV
	tristate
	default CRYPTO_LIB_POLY1305
	select CRYPTO_ARCH_HAVE_LIB_POLY1305

config CRYPTO_SHA256_RISCV64
	tristate
	depends on 64BIT && RISCV_ISA_V && TOOLCHAIN_HAS_VECTOR_CRYPTO
	default CRYPTO_LIB_SHA256
	select CRYPTO_ARCH_HAVE_LIB_SHA256
	select CRYPTO_ARCH_HAVE_LIB_SHA256_SIMD
	select CRYPTO_LIB_SHA256_GENERIC
```

## arch/s390/kvm/Kconfig
```kconfig
# SPDX-License-Identifier: GPL-2.0
#
# KVM configuration
#
source "virt/kvm/Kconfig"

menuconfig VIRTUALIZATION
	def_bool y
	prompt "KVM"
	help
	  Say Y here to get to see options for using your Linux host to run other
	  operating systems inside virtual machines (guests).
	  This option alone does not add any kernel code.

	  If you say N, all options in this submenu will be skipped and disabled.

if VIRTUALIZATION

config KVM
	def_tristate y
	prompt "Kernel-based Virtual Machine (KVM) support"
	select HAVE_KVM_CPU_RELAX_INTERCEPT
	select KVM_ASYNC_PF
	select KVM_ASYNC_PF_SYNC
	select KVM_COMMON
	select HAVE_KVM_IRQCHIP
	select HAVE_KVM_IRQ_ROUTING
	select HAVE_KVM_INVALID_WAKEUPS
	select HAVE_KVM_NO_POLL
	select KVM_VFIO
	select VIRT_XFER_TO_GUEST_WORK
	select KVM_MMU_LOCKLESS_AGING
	select KVM_GENERIC_PRE_FAULT_MEMORY
	help
	  Support hosting paravirtualized guest machines using the SIE
	  virtualization capability on the mainframe. This should work
	  on any 64bit machine.

	  This module provides access to the hardware capabilities through
	  a character device node named /dev/kvm.

	  To compile this as a module, choose M here: the module
	  will be called kvm.

	  If unsure, say N.

config KVM_S390_UCONTROL
	bool "Userspace controlled virtual machines"
	depends on KVM
	help
	  Allow CAP_SYS_ADMIN users to create KVM virtual machines that are
	  controlled by userspace.

	  If unsure, say N.

config KVM_ARM64
	def_tristate y
	prompt "KVM support for hardware accelerated arm64 guests"
	depends on HAS_IOMEM
	depends on KVM
	select GUEST_PERF_EVENTS if PERF_EVENTS
	select HAVE_KVM_CPU_RELAX_INTERCEPT
	select HAVE_KVM_IRQCHIP
	select HAVE_KVM_VCPU_RUN_PID_CHANGE
	select IRQ_BYPASS_MANAGER
	select KVM_COMMON
	select KVM_MMIO
	select KVM_VFIO
	select SCHED_INFO
	select XARRAY_MULTI
	help
	  Enable support for hosting paravirtualized, hardware-accelerated
	  arm64 virtual machines on s390 systems using the Start ARM Execution
	  (SAE) instruction. This requires hardware models that support the Arm
	  execution facility (AEF).

	  The module provides a character device named /dev/kvm-arm64 to expose
	  the hardware capabilities.

	  To compile this driver as a module, choose M here. The module will
	  be called kvm-arm64.

	  If unsure, say N.

endif # VIRTUALIZATION
```

## arch/s390/kvm/arm64/Kconfig
```kconfig
# SPDX-License-Identifier: GPL-2.0

config KVM_ARM64
	def_tristate y
	prompt "Kernel-based Virtual Machine (KVM) support for arm64 guests"
	depends on HAS_IOMEM
	select KVM
	select KVM_VFIO
	select IRQ_BYPASS_MANAGER
	select SCHED_INFO
	select XARRAY_MULTI
	select KVM_COMMON
	select HAVE_KVM_CPU_RELAX_INTERCEPT
	select HAVE_KVM_MSI
	select HAVE_KVM_IRQCHIP
	select HAVE_KVM_IRQ_ROUTING
	select HAVE_KVM_VCPU_RUN_PID_CHANGE
	select KVM_GENERIC_PRE_FAULT_MEMORY
	select GUEST_PERF_EVENTS if PERF_EVENTS
	help
	  Support hosting virtualized arm64 guest machines on s390 host machines.

	  If unsure, say N.
```

## arch/s390/kvm/s390/Kconfig
```kconfig
# SPDX-License-Identifier: GPL-2.0
#
# KVM_S390 configuration

config KVM_S390
	def_tristate y
	prompt "Kernel-based Virtual Machine (KVM) support (s390)"
	select KVM
	select HAVE_KVM_CPU_RELAX_INTERCEPT
	select KVM_ASYNC_PF
	select KVM_ASYNC_PF_SYNC
	select KVM_COMMON
	select HAVE_KVM_IRQCHIP
	select HAVE_KVM_IRQ_ROUTING
	select HAVE_KVM_INVALID_WAKEUPS
	select HAVE_KVM_NO_POLL
	select KVM_VFIO
	select VIRT_XFER_TO_GUEST_WORK
	select KVM_MMU_LOCKLESS_AGING
	select KVM_GENERIC_PRE_FAULT_MEMORY
	help
	  Support hosting paravirtualized s390 guest machines using the SIE
	  virtualization capability on the mainframe. This should work
	  on any 64bit machine.

	  This module provides access to the hardware capabilities through
	  a character device node named /dev/kvm.

	  To compile this as a module, choose M here: the module
	  will be called kvm.

	  If unsure, say N.

config KVM_S390_UCONTROL
	bool "Userspace controlled virtual machines"
	depends on KVM_S390
	help
	  Allow CAP_SYS_ADMIN users to create KVM virtual machines that are
	  controlled by userspace.

	  If unsure, say N.
```

## arch/sh/configs/landisk-of_defconfig
```kconfig
CONFIG_SYSVIPC=y
CONFIG_LOG_BUF_SHIFT=14
CONFIG_NAMESPACES=y
CONFIG_EXPERT=y
CONFIG_KEXEC=y
CONFIG_CPU_SUBTYPE_SH7751R=y
CONFIG_MEMORY_START=0x0c000000
CONFIG_SH_OF_BOARD=y
CONFIG_HEARTBEAT=y
CONFIG_MODULES=y
CONFIG_MODULE_UNLOAD=y
CONFIG_MODULE_FORCE_UNLOAD=y
CONFIG_FLATMEM_MANUAL=y
CONFIG_NET=y
CONFIG_PACKET=y
CONFIG_UNIX=y
CONFIG_INET=y
CONFIG_IP_ADVANCED_ROUTER=y
CONFIG_IP_PNP=y
# CONFIG_IPV6 is not set
CONFIG_NETFILTER=y
CONFIG_ATALK=m
CONFIG_PCI=y
CONFIG_PCI_SH7751=y
CONFIG_PCCARD=y
CONFIG_YENTA=y
CONFIG_UEVENT_HELPER=y
CONFIG_BLK_DEV_LOOP=y
CONFIG_BLK_DEV_RAM=y
CONFIG_BLK_DEV_SD=y
CONFIG_BLK_DEV_SR=y
# CONFIG_BLK_DEV_BSG is not set
CONFIG_ATA=y
CONFIG_PATA_ARTOP=y
CONFIG_PATA_OF_PLATFORM=y
CONFIG_ATA_GENERIC=y
CONFIG_MD=y
CONFIG_BLK_DEV_MD=m
CONFIG_MD_LINEAR=m
CONFIG_MD_RAID0=m
CONFIG_MD_RAID1=m
CONFIG_NETDEVICES=y
CONFIG_TUN=m
CONFIG_8139CP=y
CONFIG_USB_PEGASUS=m
CONFIG_USB_RTL8150=m
# CONFIG_INPUT_KEYBOARD is not set
# CONFIG_INPUT_MOUSE is not set
# CONFIG_SERIO is not set
CONFIG_SERIAL_SH_SCI=y
CONFIG_SERIAL_SH_SCI_EARLYCON=y
CONFIG_HW_RANDOM=y
CONFIG_SOUND=m
CONFIG_HID_A4TECH=m
CONFIG_HID_BELKIN=m
CONFIG_HID_CHERRY=m
CONFIG_HID_CHICONY=m
CONFIG_HID_CYPRESS=m
CONFIG_HID_EZKEY=m
CONFIG_HID_GYRATION=m
CONFIG_HID_ITE=y
CONFIG_HID_KENSINGTON=y
CONFIG_HID_REDRAGON=y
CONFIG_HID_MICROSOFT=m
CONFIG_HID_MONTEREY=m
CONFIG_HID_PANTHERLORD=m
CONFIG_HID_PETALYNX=m
CONFIG_HID_SAMSUNG=m
CONFIG_HID_SUNPLUS=m
CONFIG_USB_HID=m
CONFIG_USB=y
CONFIG_USB_MON=y
CONFIG_USB_EHCI_HCD=y
# CONFIG_USB_EHCI_TT_NEWSCHED is not set
CONFIG_USB_OHCI_HCD=y
CONFIG_USB_PRINTER=m
CONFIG_USB_STORAGE=m
CONFIG_USB_STORAGE_DATAFAB=m
CONFIG_USB_STORAGE_FREECOM=m
CONFIG_USB_STORAGE_ISD200=m
CONFIG_USB_STORAGE_SDDR09=m
CONFIG_USB_STORAGE_SDDR55=m
CONFIG_USB_STORAGE_JUMPSHOT=m
CONFIG_USB_SERIAL=m
CONFIG_USB_SERIAL_FTDI_SIO=m
CONFIG_USB_SERIAL_PL2303=m
CONFIG_USB_EMI62=m
CONFIG_USB_EMI26=m
CONFIG_USB_SISUSBVGA=m
CONFIG_RENESAS_SH7751_INTC=y
CONFIG_RENESAS_SH7751IRL_INTC=y
CONFIG_EXT2_FS=y
CONFIG_EXT3_FS=y
CONFIG_REISERFS_FS=y
CONFIG_ISO9660_FS=m
CONFIG_MSDOS_FS=y
CONFIG_VFAT_FS=y
CONFIG_NTFS_FS=m
CONFIG_NTFS_RW=y
CONFIG_TMPFS=y
CONFIG_ROMFS_FS=y
CONFIG_UFS_FS=m
CONFIG_NFS_FS=m
CONFIG_NFSD=m
CONFIG_NLS_CODEPAGE_437=y
CONFIG_NLS_CODEPAGE_932=y
CONFIG_INIT_STACK_NONE=y
CONFIG_CRC_T10DIF=y
CONFIG_DEBUG_MEMORY_INIT=y
# CONFIG_FTRACE is not set
CONFIG_SH_STANDARD_BIOS=y
```
