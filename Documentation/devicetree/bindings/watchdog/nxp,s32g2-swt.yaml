## Documentation/devicetree/bindings/watchdog/nxp,s32g2-swt.yaml
```yaml
# SPDX-License-Identifier: GPL-2.0-only OR BSD-2-Clause
%YAML 1.2
---
$id: http://devicetree.org/schemas/watchdog/nxp,s32g2-swt.yaml#
$schema: http://devicetree.org/meta-schemas/core.yaml#

title: NXP Software Watchdog Timer (SWT)

maintainers:
  - Daniel Lezcano <daniel.lezcano@kernel.org>

allOf:
  - $ref: watchdog.yaml#

properties:
  compatible:
    oneOf:
      - const: nxp,s32g2-swt
      - items:
          - const: nxp,s32g3-swt
          - const: nxp,s32g2-swt

  reg:
    maxItems: 1

  clocks:
    items:
      - description: Counter clock
      - description: Module clock
      - description: Register clock
    minItems: 1

  clock-names:
    items:
      - const: counter
      - const: module
      - const: register
    minItems: 1

required:
  - compatible
  - reg
  - clocks
  - clock-names

unevaluatedProperties: false

examples:
  - |
    watchdog@40100000 {
        compatible = "nxp,s32g2-swt";
        reg = <0x40100000 0x1000>;
        clocks = <&clks 0x3a>, <&clks 0x3b>;
        clock-names = "counter", "module";
        timeout-sec = <10>;
    };
```

## Documentation/devicetree/bindings/watchdog/qcom,gh-watchdog.yaml
```yaml
# SPDX-License-Identifier: (GPL-2.0-only OR BSD-2-Clause)
%YAML 1.2
---
$id: http://devicetree.org/schemas/watchdog/qcom,gh-watchdog.yaml#
$schema: http://devicetree.org/meta-schemas/core.yaml#

title: Qualcomm Gunyah Virtual Watchdog

maintainers:
  - Hrishabh Rajput <hrishabh.rajput@oss.qualcomm.com>

description: |+
  The Gunyah Hypervisor provides an SMC-based watchdog interface for its virtual
  machines. The virtual machines use this information to determine the
  pretimeout IRQ which the hypervisor will be using to communicate pretimeout
  event.
  See also: [1]

  [1]: https://github.com/quic/gunyah-resource-manager/blob/1b23ceb0dfa010b3b6b5a5f7a4ec1e95b93ab99d/src/vm_creation/dto_construct.c#L519

properties:
  compatible:
    allOf:
      - const: gunyah-hypervisor
      - const: simple-bus

  "#address-cells":
    description: Number of cells needed to represent 64-bit capability IDs.
    const: 2

  "#size-cells":
    description: must be 0, because capability IDs are not memory address
                  ranges and do not have a size.
    const: 0

patternProperties:
  "^gh-watchdog":
    type: object
    description:
      Watchdog node which provides information about the pretimeout IRQ which
      will be used to communicate the pretimeout event.

    properties:
      compatible:
        const: qcom,gh-watchdog

      interrupts:
        items:
          description: Interrupt for the pretimeout.

    additionalProperties: false

    required:
      - compatible
      - interrupts

additionalProperties: false

required:
  - compatible
  - "#address-cells"
  - "#size-cells"

examples:
  - |
    #include <dt-bindings/interrupt-controller/arm-gic.h>

    hypervisor {
        compatible = "gunyah-hypervisor", "simple-bus";
        #address-cells = <2>;
        #size-cells = <0>;

        gh-watchdog {
            compatible = "qcom,gh-watchdog";
            interrupts = <GIC_SPI 0 IRQ_TYPE_EDGE_RISING>; /* Pretimeout IRQ */
        };
```

## Documentation/devicetree/bindings/watchdog/qcom,restart-reason.yaml
```yaml
# SPDX-License-Identifier: (GPL-2.0 OR BSD-2-Clause)
%YAML 1.2
---
$id: http://devicetree.org/schemas/watchdog/qcom,restart-reason.yaml#
$schema: http://devicetree.org/meta-schemas/core.yaml#

title: Qualcomm IPQ SoC restart reason location

maintainers:
  - Kathiravan Thirumoorthy <kathiravan.thirumoorthy@oss.qualcomm.com>

description:
  The Qualcomm IPQ SoC restart reason memory region, in IMEM, is used to
  identify the cause of the system restart. This will be helpful to identify
  the cause when the RAM dump collection is disabled.

properties:
  compatible:
    const: qcom,restart-reason-info

  reg:
    maxItems: 1

required:
  - compatible
  - reg

additionalProperties: false

examples:
  - |
    imem@8600000 {
      compatible = "qcom,ipq5424-imem", "syscon", "simple-mfd";
      reg = <0x08600000 0x1000>;

      #address-cells = <1>;
      #size-cells = <1>;

      ranges = <0 0x08600000 0x1000>;

      restart-reason@7b0 {
        compatible = "qcom,restart-reason-info";
        reg = <0x7b0 0x4>;
      };
    };
...
```

## Documentation/devicetree/bindings/watchdog/renesas,rzn1-wdt.yaml
```yaml
# SPDX-License-Identifier: (GPL-2.0-only OR BSD-2-Clause)
%YAML 1.2
---
$id: http://devicetree.org/schemas/watchdog/renesas,rzn1-wdt.yaml#
$schema: http://devicetree.org/meta-schemas/core.yaml#

title: Renesas RZ/N1 Watchdog Timer (WDT) Controller

maintainers:
  - Wolfram Sang <wsa+renesas@sang-engineering.com>

properties:
  compatible:
    items:
      - const: renesas,r9a06g032-wdt # RZ/N1D
      - const: renesas,rzn1-wdt      # RZ/N1

  reg:
    maxItems: 1

  interrupts:
    maxItems: 1

  clocks:
    maxItems: 1

  timeout-sec: true

  renesas,reset-line:
    $ref: /schemas/types.yaml#/definitions/uint32
    enum: [0, 1]
    description: |
      The watchdog reset line (dt-bindings/watchdog/renesas,rzn1-wdt.h defines
      these values). A wachdog timeout asserts this reset line to perform a
      hardware system reset. Two watchdogs are present in the RZ/N1 SoC and
      each of them has a dedicated reset line.

        - 0: RZN1_WDT_A7_0
          This reset line can be asserted only by the A7 0 watchdog. This
          watchdog is the one mapped at 0x40008000 on RZ/N1 SoCs.

        - 1: RZN1_WDT_A7_1
          This reset line can be asserted only by the A7 1 watchdog. This
          watchdog is the one mapped at 0x40009000 on RZ/N1 SoCs.

      If the renesas,reset-line property is not present, the watchdog timeout
      only triggers an interrupt.

required:
  - compatible
  - reg
  - interrupts
  - clocks

allOf:
  - $ref: watchdog.yaml#

additionalProperties: false

examples:
  - |
    #include <dt-bindings/clock/r9a06g032-sysctrl.h>
    #include <dt-bindings/interrupt-controller/arm-gic.h>
    #include <dt-bindings/watchdog/renesas,rzn1-wdt.h>

    watchdog@40008000 {
            compatible = "renesas,r9a06g032-wdt", "renesas,rzn1-wdt";
            reg = <0x40008000 0x1000>;
            interrupts = <GIC_SPI 73 IRQ_TYPE_EDGE_RISING>;
            clocks = <&sysctrl R9A06G032_CLK_WATCHDOG>;
            renesas,reset-line = <RZN1_WDT_A7_0>;
    };
```

## Documentation/devicetree/bindings/watchdog/renesas,wwdt.yaml
```yaml
# SPDX-License-Identifier: (GPL-2.0-only OR BSD-2-Clause)
%YAML 1.2
---
$id: http://devicetree.org/schemas/watchdog/renesas,wwdt.yaml#
$schema: http://devicetree.org/meta-schemas/core.yaml#

title: Renesas Windowed Watchdog Timer (WWDT) Controller

maintainers:
  - Wolfram Sang <wsa+renesas@sang-engineering.com>

properties:
  compatible:
    items:
      - const: renesas,r8a779g0-wwdt  # V4H
      - const: renesas,rcar-gen4-wwdt

  reg:
    maxItems: 1

  interrupts:
    items:
      - description: Pretimeout, 75% of overflow reached
      - description: Error occurred

  interrupt-names:
    items:
      - const: pretimeout
      - const: error

  clocks:
    items:
      - description: Bus clock
      - description: Counting clock

  clock-names:
    items:
      - const: bus
      - const: cnt

  power-domains:
    maxItems: 1

  resets:
    items:
      - description: Reset circuitry driven by bus clock
      - description: Reset circuitry driven by counting clock

  reset-names:
    items:
      - const: bus
      - const: cnt

required:
  - compatible
  - reg
  - clocks
  - clock-names

allOf:
  - $ref: watchdog.yaml#

additionalProperties: false

examples:
  - |
    #include <dt-bindings/clock/r8a779g0-cpg-mssr.h>
    #include <dt-bindings/power/r8a779g0-sysc.h>
    #include <dt-bindings/interrupt-controller/arm-gic.h>
    wwdt0: watchdog@ffc90000 {
            compatible = "renesas,r8a779g0-wwdt",
                         "renesas,rcar-gen4-wwdt";
            reg = <0xffc90000 0x10>;
            interrupts = <GIC_SPI 310 IRQ_TYPE_LEVEL_HIGH>,
                         <GIC_SPI 311 IRQ_TYPE_LEVEL_HIGH>;
            interrupt-names = "pretimeout", "error";
            clocks = <&cpg CPG_CORE R8A779G0_CLK_SASYNCRT>,
                     <&cpg CPG_CORE R8A779G0_CLK_R>;
            clock-names = "bus", "cnt";
            power-domains = <&sysc R8A779G0_PD_ALWAYS_ON>;
            resets = <&cpg 1318>, <&cpg 1200>;
            reset-names = "bus", "cnt";
    };
```

## Documentation/devicetree/bindings/watchdog/ti,davinci-wdt.yaml
```yaml
# SPDX-License-Identifier: GPL-2.0-only OR BSD-2-Clause
%YAML 1.2
---
$id: http://devicetree.org/schemas/watchdog/ti,davinci-wdt.yaml#
$schema: http://devicetree.org/meta-schemas/core.yaml#

title: Texas Instruments DaVinci/Keystone Watchdog Timer (WDT) Controller

description: |
  Documentation:
  Davinci DM646x - https://www.ti.com/lit/ug/spruer5b/spruer5b.pdf
  Keystone - https://www.ti.com/lit/ug/sprugv5a/sprugv5a

maintainers:
  - Andrew Davis <afd@ti.com>

allOf:
  - $ref: watchdog.yaml#

properties:
  compatible:
    enum:
      - ti,davinci-wdt
      - ti,keystone-wdt

  reg:
    maxItems: 1

  clocks:
    maxItems: 1

  power-domains:
    description:
      A phandle and PM domain specifier as defined by bindings of 
      the power controller specified by phandle. 
      See Documentation/devicetree/bindings/power/power-domain.yaml for details.

required:
  - compatible
  - reg
  - clocks

unevaluatedProperties: false

examples:
  - |
    watchdog@2320000 {
        compatible = "ti,davinci-wdt";
        reg = <0x02320000 0x80>;
        timeout-sec = <30>;
        clocks = <&clkwdtimer0>;
    };
```

## Documentation/devicetree/bindings/x86/cpus.yaml
```yaml
# SPDX-License-Identifier: GPL-2.0 OR BSD-2-Clause
%YAML 1.2
---
$id: http://devicetree.org/schemas/x86/cpus.yaml#
$schema: http://devicetree.org/meta-schemas/core.yaml#

title: x86 CPUs

maintainers:
  - Ricardo Neri <ricardo.neri-calderon@linux.intel.com>

description: |
  Description of x86 CPUs in a system through the "cpus" node.

  Detailed information about the CPU architecture can be found in the Intel
  Software Developer's Manual:
    https://intel.com/sdm

properties:
  compatible:
    enum:
      - intel,x86

  reg:
    description: |
      Local APIC ID of the CPU. If the CPU has more than one execution thread,
      then the property is an array with one element per thread.

  enable-method:
    $ref: /schemas/types.yaml#/definitions/string
    description: |
      The method used to wake up secondary CPUs. This property is not needed if
      the secondary processors are booted using INIT assert, de-assert followed
      by Start-Up IPI messages as described in the Volume 3, Section 11.4 of
      Intel Software Developer's Manual.

      It is also optional for the bootstrap CPU.

    oneOf:
      - items:
          - const: intel,wakeup-mailbox
            description: |
              CPUs are woken up using the mailbox mechanism. The platform
              firmware boots the secondary CPUs and puts them in a state
              to check the mailbox for a wakeup command from the operating
              system.

required:
  - reg
  - compatible

unevaluatedProperties: false

examples:
  - |
    /*
     * A system with two CPUs. cpu@0 is the bootstrap CPU and its status is
     * "okay". It does not have the enable-method property. cpu@1 is a
     * secondary CPU. Its status is "disabled" and defines the enable-method
     * property.
     */

    cpus {
      #address-cells = <1>;
      #size-cells = <0>;

      cpu@0 {
        reg = <0x0 0x1>;
        compatible = "intel,x86";
        status = "okay";
      };

      cpu@1 {
        reg = <0x0 0x1>;
        compatible = "intel,x86";
        status = "disabled";
        enable-method = "intel,wakeup-mailbox";
      };
    };
```

## Documentation/devicetree/bindings/x86/wakeup.yaml
```yaml
# SPDX-License-Identifier: (GPL-2.0-only OR BSD-2-Clause)
# Copyright (C) 2024 Intel Corporation
%YAML 1.2
---
$id: http://devicetree.org/schemas/x86/wakeup.yaml#
$schema: http://devicetree.org/meta-schemas/core.yaml#

title: x86 mailbox wakeup
maintainers:
  - Yunhong Jiang <yunhong.jiang@linux.intel.com>

description: |
  The x86 mailbox wakeup mechanism defines a mechanism to let the bootstrap
  processor (BSP) to wake up application processors (APs) through a wakeup
  mailbox.

  The "wakeup-mailbox-addr" property specifies the wakeup mailbox address. The
  wakeup mailbox is a 4K-aligned 4K-size memory block allocated in the reserved
  memory.

  The wakeup mailbox structure is defined as follows.

    uint16_t command;
    uint16_t reserved;
    uint32_t apic_id;
    uint64_t wakeup_vector;
    uint8_t  reservedForOs[2032];

  The memory after reservedForOs field is reserved and OS should not touch it.

  To wakes up a AP, the BSP prepares the wakeup routine, fills the wakeup
  routine's address into the wakeup_vector field, fill the apic_id field with
  the target AP's APIC_ID, and write 1 to the command field. After receiving the
  wakeup command, the target AP will jump to the wakeup routine.

  For each AP, the mailbox can be used only once for the wakeup command. After
  the AP jumps to the wakeup routine, the mailbox will no longer be checked by
  this AP.

  The wakeup mailbox structure and the wakeup process is the same as
  the Multiprocessor Wakeup Mailbox Structure defined in ACPI spec version 6.5,
  section 5.2.12.19 [1].

  References:

  [1] https://uefi.org/specs/ACPI/6.5/05_ACPI_Software_Programming_Model.html

select: false

properties:
  wakeup-mailbox-addr:
    $ref: /schemas/types.yaml#/definitions/uint64
    description: |
      The physical address of the wakeup mailbox data structure. The address
      must be 4K bytes aligned 4k-size memory and it should be in the reserved
      memory.

      This requires the "enable-method" property in the cpus node is set to
      "acpi-wakeup-mailbox".

required:
  - wakeup-mailbox-addr

additionalProperties: false
```

## arch/arm/configs/zx29_defconfig
```kconfig
CONFIG_SYSVIPC=y
CONFIG_BLK_DEV_INITRD=y
# CONFIG_RD_BZIP2 is not set
# CONFIG_RD_LZMA is not set
# CONFIG_RD_XZ is not set
# CONFIG_RD_LZ4 is not set
CONFIG_EXPERT=y
CONFIG_KALLSYMS_ALL=y
CONFIG_ARCH_ZTE=y
CONFIG_ARM_PSCI=y
CONFIG_ARM_APPENDED_DTB=y
CONFIG_CMDLINE="console=ttyAMA0 earlyprintk root=/dev/ram rw"
CONFIG_CPU_FREQ=y
CONFIG_CPUFREQ_DT_PLATDEV=y
# CONFIG_SUSPEND is not set
CONFIG_PM=y
CONFIG_BINFMT_FLAT=y
CONFIG_NET=y
CONFIG_PACKET=y
CONFIG_UNIX=y
CONFIG_INET=y
# CONFIG_STANDALONE is not set
# CONFIG_PREVENT_FIRMWARE_BUILD is not set
# CONFIG_ALLOW_DEV_COREDUMP is not set
CONFIG_MTD=y
CONFIG_MTD_BLOCK=y
CONFIG_BLK_DEV_RAM=y
CONFIG_BLK_DEV_RAM_COUNT=4
CONFIG_SRAM=y
CONFIG_KEYBOARD_GPIO_POLLED=y
# CONFIG_INPUT_MOUSE is not set
CONFIG_VT_HW_CONSOLE_BINDING=y
CONFIG_SERIAL_AMBA_PL011=y
CONFIG_SERIAL_AMBA_PL011_CONSOLE=y
CONFIG_SERIAL_DEV_BUS=y
# CONFIG_HW_RANDOM is not set
CONFIG_PINCTRL=y
CONFIG_GPIOLIB=y
CONFIG_GPIO_GENERIC_PLATFORM=y
CONFIG_POWER_RESET=y
CONFIG_MFD_SYSCON=y
CONFIG_REGULATOR=y
CONFIG_REGULATOR_FIXED_VOLTAGE=y
# CONFIG_HID is not set
CONFIG_USB_DWC2=y
CONFIG_USB_GADGET=y
CONFIG_MMC=y
CONFIG_MMC_DW=y
CONFIG_RESET_CONTROLLER=y
CONFIG_RESET_SIMPLE=y
CONFIG_JFFS2_FS=y
CONFIG_PRINTK_TIME=y
CONFIG_DEBUG_LL=y
CONFIG_EARLY_PRINTK=y
```
