## Documentation/devicetree/bindings/phy/marvell,armada-cp110-utmi-phy.yaml
```yaml
# SPDX-License-Identifier: (GPL-2.0 OR BSD-2-Clause)

%YAML 1.2
---
$id: http://devicetree.org/schemas/phy/marvell,armada-cp110-utmi-phy.yaml#
$schema: http://devicetree.org/meta-schemas/core.yaml#

title: Marvell Armada CP110/CP115 UTMI PHY

maintainers:
  - Konstantin Porotchkin <kostap@marvell.com>

description:
  On Armada 7k/8k and CN913x, there are two host and one device USB controllers.
  Each of two exiting UTMI PHYs could be connected to either USB host or USB device
  controller.
  The USB device controller can only be connected to a single UTMI PHY port
                      0.H----- USB HOST0
  UTMI PHY0  --------/
                      0.D-----0
                               \------ USB DEVICE
                      1.D-----1
  UTMI PHY1  --------\
                      1.H----- USB HOST1

  On Armada 380 there is an additional USB-2.0-only controller,
  and an additional UTMI PHY respectively.
  The USB device controller can only be connected to a single UTMI PHY port,
  either UTMI PHY0 or UTMI PHY2.



properties:
  compatible:
    enum:
      - marvell,a38x-utmi-phy
      - marvell,cp110-utmi-phy

  reg:
    anyOf:
      - items:
          - description: UTMI registers
      - items:
          - description: UTMI registers
          - description: USB config register
          - description: UTMI config registers

  reg-names:
    anyOf:
      - items:
          - const: utmi
      - items:
          - const: utmi
          - const: usb-cfg
          - const: utmi-cfg

  "#address-cells":
    const: 1

  "#size-cells":
    const: 0

  marvell,system-controller:
    description:
      Phandle to the system controller node.
      Optional when usb-cfg and utmi-cfg regs are given.
    $ref: /schemas/types.yaml#/definitions/phandle

# Required child nodes:

patternProperties:
  "^usb-phy@[0|1|2]$":
    type: object
    description:
      Each UTMI PHY port must be represented as a sub-node.

    properties:
      reg:
        description: phy port index.
        maxItems: 1

      "#phy-cells":
        const: 0

    required:
      - reg
      - "#phy-cells"

    additionalProperties: false

required:
  - compatible
  - reg
  - "#address-cells"
  - "#size-cells"

additionalProperties: false

examples:
  - |
    cp0_utmi: utmi@580000 {
      compatible = "marvell,cp110-utmi-phy";
      reg = <0x580000 0x2000>;
      marvell,system-controller = <&cp0_syscon0>;
      #address-cells = <1>;
      #size-cells = <0>;

      cp0_utmi0: usb-phy@0 {
        reg = <0>;
        #phy-cells = <0>;
      };

      cp0_utmi1: usb-phy@1 {
        reg = <1>;
        #phy-cells = <0>;
      };
    };

    cp0_usb3_0 {
      usb-phy = <&cp0_usb3_0_phy0>;
      phys = <&cp0_utmi0>;
      phy-names = "utmi";
      /* UTMI0 is connected to USB host controller (default mode) */
      dr_mode = "host";
    };

    cp0_usb3_1 {
      usb-phy = <&cp0_usb3_0_phy1>;
      phys = <&cp0_utmi1>;
      phy-names = "utmi";
      /* UTMI1 is connected to USB device controller */
      dr_mode = "peripheral";
    };
```

## Documentation/devicetree/bindings/phy/marvell,pxa1928-hsic-phy.yaml
```yaml
# SPDX-License-Identifier: (GPL-2.0-only OR BSD-2-Clause)
%YAML 1.2
---
$id: http://devicetree.org/schemas/phy/marvell,pxa1928-hsic-phy.yaml#
$schema: http://devicetree.org/meta-schemas/core.yaml#

title: Marvell PXA1928 HSIC PHY

maintainers:
  - devicetree@vger.kernel.org

properties:
  $nodename:
    pattern: '^phy@[a-f0-9]+$'

  compatible:
    const: "marvell,pxa1928-hsic-phy"

  reg:
    maxItems: 1

  clocks:
    maxItems: 1

  '#phy-cells':
    const: 0

  resets:
    maxItems: 1

required:
  - compatible
  - reg
  - clocks
  - '#phy-cells'

additionalProperties: false
```

## Documentation/devicetree/bindings/phy/nuvoton,ma35d1-usb2-phy-otg.yaml
```yaml
# SPDX-License-Identifier: (GPL-2.0-only OR BSD-2-Clause)
%YAML 1.2
---
$id: http://devicetree.org/schemas/phy/nuvoton,ma35d1-usb2-phy-otg.yaml#
$schema: http://devicetree.org/meta-schemas/core.yaml#

title: Nuvoton MA35D1 USB 2.0 host PHY

maintainers:
  - Joey Lu <yclu4@nuvoton.com>

description:
  USB 2.0 PHY driver for the Nuvoton MA35D1 SoC, used by the EHCI and
  OHCI host controllers.

  USB0 (PHY index 0) is an OTG port whose physical signals are routed to
  either the DWC2 device controller or the EHCI0/OHCI0 host controller by
  a hardware mux that follows the USB ID pin.

  USB1 (PHY index 1) is a dedicated host port with no OTG capability.

properties:
  compatible:
    const: nuvoton,ma35d1-usb2-phy-otg

  clocks:
    maxItems: 1

  nuvoton,sys:
    $ref: /schemas/types.yaml#/definitions/phandle-array
    items:
      - items:
          - description: phandle to the system management syscon.
          - description: PHY instance index.
            enum:
              - 0   # USB0, OTG port (shared with DWC2 gadget controller)
              - 1   # USB1, host-only port
    description:
      A phandle to the syscon node covering the SYS register block, with
      one argument selecting the PHY instance. Index 0 selects the OTG
      port PHY (USB0) and index 1 selects the host-only PHY (USB1).

  "#phy-cells":
    const: 0

  nuvoton,rcalcode:
    $ref: /schemas/types.yaml#/definitions/uint32
    minimum: 0
    maximum: 15
    description:
      Resistor calibration trim code written to the RCALCODE field in
      USBPMISCR. The 4-bit value adjusts the PHY's internal termination
      resistance. When absent the hardware reset default is used.

  nuvoton,oc-active-high:
    type: boolean
    description:
      When present, the over-current detect input from the VBUS power
      switch is treated as active-high. The default (property absent) is
      active-low. This setting is shared by both USB host ports.

required:
  - compatible
  - clocks
  - nuvoton,sys
  - "#phy-cells"

additionalProperties: false

examples:
  - |
    #include <dt-bindings/clock/nuvoton,ma35d1-clk.h>

    usb_hphy0: usb-host-phy {
        compatible = "nuvoton,ma35d1-usb2-phy-otg";
        clocks = <&clk HUSBH0_GATE>;
        nuvoton,sys = <&sys 0>;
        #phy-cells = <0>;
    };
```

## Documentation/devicetree/bindings/phy/nuvoton,ma35d1-usb2-phy.yaml
```yaml
# SPDX-License-Identifier: (GPL-2.0-only OR BSD-2-Clause)
%YAML 1.2
---
$id: http://devicetree.org/schemas/phy/nuvoton,ma35d1-usb2-phy.yaml#
$schema: http://devicetree.org/meta-schemas/core.yaml#

title: Nuvoton MA35D1 USB2 phy

maintainers:
  - Hui-Ping Chen <hpchen0nvt@gmail.com>
  - Joey Lu <yclu4@nuvoton.com>

description:
  USB 2.0 PHY for the Nuvoton MA35D1 SoC. The PHY node is a standalone
  platform device that accesses the USB PHY control registers inside the
  system-management syscon block via the nuvoton,sys phandle.

  PHY0 is the OTG port whose signals are routed to either the DWC2 gadget
  controller or the EHCI0/OHCI0 host controller by a hardware mux that
  follows the USB ID pin automatically.

  PHY1 is a dedicated host-only port used by EHCI1/OHCI1.

properties:
  compatible:
    enum:
      - nuvoton,ma35d1-usb2-phy

  "#phy-cells":
    enum: [0, 1]
    description:
      When 0, the node exposes PHY0 only and consumers reference it
      with no cell argument. When 1, the single cell selects the port,
      with 0 for the OTG port (USB0, shared with DWC2 gadget controller)
      and 1 for the host-only port (USB1).

  clocks:
    maxItems: 1

  nuvoton,sys:
    $ref: /schemas/types.yaml#/definitions/phandle
    description:
      Phandle to the system-management syscon node providing access to the
      USB PHY control registers.

  nuvoton,rcalcode:
    $ref: /schemas/types.yaml#/definitions/uint32-array
    minItems: 2
    maxItems: 2
    items:
      minimum: 0
      maximum: 15
    description:
      Resistor calibration trim codes for PHY0 and PHY1 respectively.
      Each 4-bit value is written to the RCALCODE field in USBPMISCR and
      adjusts the PHY's internal termination resistance. Both entries must
      be supplied when this property is present; when absent the hardware
      reset default is used for each port.

  nuvoton,oc-active-high:
    type: boolean
    description:
      When present, the over-current detect input from the VBUS power switch
      is treated as active-high. The default (property absent) is active-low.
      This setting is shared by both USB host ports.

required:
  - compatible
  - "#phy-cells"
  - clocks
  - nuvoton,sys

additionalProperties: false

examples:
  - |
    #include <dt-bindings/clock/nuvoton,ma35d1-clk.h>

    usb_phy: usb-phy {
        compatible = "nuvoton,ma35d1-usb2-phy";
        clocks = <&clk HUSBH0_GATE>;
        nuvoton,sys = <&sys>;
        #phy-cells = <0>;
    };
```

## Documentation/devicetree/bindings/phy/nvidia,tegra-xmm6260.yaml
```yaml
# SPDX-License-Identifier: (GPL-2.0 OR BSD-2-Clause)
%YAML 1.2
---
$id: http://devicetree.org/schemas/phy/nvidia,tegra-xmm6260.yaml#
$schema: http://devicetree.org/meta-schemas/core.yaml#

title: Nvidia Tegra PHY for XMM6260 modem

description:
  A hardware configuration used in Tegra SoCs to provide proper interaction
  between the application processor and the modem, as well as control over
  one of the SoC's USB lines for the modem.

maintainers:
  - Svyatoslav Ryhel <clamor95@gmail.com>

properties:
  compatible:
    const: nvidia,tegra-xmm6260

  enable-gpios:
    description: GPIO connected to the EINT1 pin
    maxItems: 1

  nvidia,usb-bus:
    description:
      Contains two phandles; the first is pointing to the Host's USB controller
      and the second linking to the controller's PHY.
    $ref: /schemas/types.yaml#/definitions/phandle-array
    minItems: 2
    maxItems: 2

  phy-supply:
    description: Supply powering the PHY.

  "#phy-cells":
    const: 0

required:
  - compatible
  - nvidia,usb-bus
  - "#phy-cells"

additionalProperties: false

examples:
  - |
    #include <dt-bindings/gpio/gpio.h>

    phy {
        compatible = "nvidia,tegra-xmm6260";

        enable-gpios = <&gpio 165 GPIO_ACTIVE_HIGH>;
        phy-supply = <&vdd_3v3_vbat>;

        nvidia,usb-bus = <&hsic_usb>, <&phy2>;
        #phy-cells = <0>;
    };
```
