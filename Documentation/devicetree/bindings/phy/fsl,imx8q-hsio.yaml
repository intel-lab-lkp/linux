## Documentation/devicetree/bindings/phy/fsl,imx8q-hsio.yaml
```yaml
# SPDX-License-Identifier: (GPL-2.0-only OR BSD-2-Clause)
%YAML 1.2
---
$id: http://devicetree.org/schemas/phy/fsl,imx8q-hsio.yaml#
$schema: http://devicetree.org/meta-schemas/core.yaml#

title: Freescale i.MX8Q SoC series HSIO SERDES PHY

maintainers:
  - Richard Zhu <hongxing.zhu@nxp.com>

properties:
  compatible:
    enum:
      - fsl,imx8qxp-serdes
      - fsl,imx8qm-serdes
  reg:
    minItems: 4
    maxItems: 4

  "#phy-cells":
    const: 3
    description: |
      The first number defines the ID of the PHY contained in the HSIO macro.
      The second defines controller ID binded to the PHY. The third defines the
      HSIO configuratons refer to the different use cases. They are defined in
      dt-bindings/phy/phy-imx8-pcie.h

  reg-names:
    items:
      - const: reg
      - const: phy
      - const: ctrl
      - const: misc

  clocks:
    minItems: 5
    maxItems: 14

  clock-names:
    minItems: 5
    maxItems: 14

  fsl,refclk-pad-mode:
    description: |
      Specifies the mode of the refclk pad used. It can be UNUSED(PHY
      refclock is derived from SoC internal source), INPUT(PHY refclock
      is provided externally via the refclk pad) or OUTPUT(PHY refclock
      is derived from SoC internal source and provided on the refclk pad).
      Refer include/dt-bindings/phy/phy-imx8-pcie.h for the constants
      to be used.
    $ref: /schemas/types.yaml#/definitions/uint32
    enum: [ 0, 1, 2 ]

  power-domains:
    description: |
      i.MX8Q HSIO SerDes power domains. i.MX8QXP has one SerDes power domains.
      And i.MX8QM has two.
    minItems: 1
    maxItems: 2

required:
  - compatible
  - reg
  - "#phy-cells"
  - clocks
  - clock-names
  - fsl,refclk-pad-mode

allOf:
  - if:
      properties:
        compatible:
          contains:
            enum:
              - fsl,imx8qxp-serdes
    then:
      properties:
        clock-names:
          items:
            - const: apb_pclk0
            - const: pclk0
            - const: phy0_crr
            - const: ctl0_crr
            - const: misc_crr
        power-domains:
          minItems: 1

  - if:
      properties:
        compatible:
          contains:
            enum:
              - fsl,imx8qm-serdes
    then:
      properties:
        clock-names:
          items:
            - const: pclk0
            - const: pclk1
            - const: apb_pclk0
            - const: apb_pclk1
            - const: pclk2
            - const: epcs_tx
            - const: epcs_rx
            - const: apb_pclk2
            - const: phy0_crr
            - const: phy1_crr
            - const: ctl0_crr
            - const: ctl1_crr
            - const: ctl2_crr
            - const: misc_crr
        power-domains:
          minItems: 2

additionalProperties: false

examples:
  - |
    #include <dt-bindings/clock/imx8-clock.h>
    #include <dt-bindings/clock/imx8-lpcg.h>
    #include <dt-bindings/firmware/imx/rsrc.h>
    #include <dt-bindings/phy/phy-imx8-pcie.h>

    serdes: phy@5f1a0000 {
            compatible = "fsl,imx8qxp-serdes";
            reg = <0x5f1a0000 0x10000>,
                  <0x5f120000 0x10000>,
                  <0x5f140000 0x10000>,
                  <0x5f160000 0x10000>;
            reg-names = "reg", "phy", "ctrl", "misc";
            clocks = <&phyx1_lpcg IMX_LPCG_CLK_0>,
                     <&phyx1_lpcg IMX_LPCG_CLK_4>,
                     <&phyx1_crr1_lpcg IMX_LPCG_CLK_4>,
                     <&pcieb_crr3_lpcg IMX_LPCG_CLK_4>,
                     <&misc_crr5_lpcg IMX_LPCG_CLK_4>;
            clock-names = "apb_pclk0", "pclk0", "phy0_crr", "ctl0_crr",
                          "misc_crr";
            power-domains = <&pd IMX_SC_R_SERDES_1>;
            #phy-cells = <3>;
            status = "disabled";
    };
...
```

## Documentation/devicetree/bindings/phy/google,gs-usb-phy.yaml
```yaml
# SPDX-License-Identifier: (GPL-2.0-only OR BSD-2-Clause)
# Copyright (C) 2025, Google LLC
%YAML 1.2
---
$id: http://devicetree.org/schemas/phy/google,gs-usb-phy.yaml#
$schema: http://devicetree.org/meta-schemas/core.yaml#

title: Google Tensor Series (G5+) USB PHY

maintainers:
  - Roy Luo <royluo@google.com>

description: |
  Describes the USB PHY interfaces integrated with the DWC3 USB controller on
  Google Tensor SoCs, starting with the G5 generation.
  Two specific PHY IPs from Synopsys are integrated, including eUSB 2.0 PHY IP
  and USB 3.2/DisplayPort combo PHY IP.
  The first phandle argument within the PHY specifier is used to identify the
  desired PHY. The currently supported value is::
    0 - USB high-speed.

properties:
  compatible:
    items:
      - enum:
          - google,gs5-usb-phy

  reg:
    minItems: 3
    maxItems: 3

  reg-names:
    items:
      - const: usb2_cfg_csr
      - const: dp_top_csr
      - const: usb_top_cfg_csr

  "#phy-cells":
    const: 1

  clocks:
    maxItems: 1

  clock-names:
    items:
      - const: usb2_phy_clk

  resets:
    maxItems: 1

  reset-names:
    items:
      - const: usb2_phy_reset

  power-domains:
    maxItems: 1

  orientation-switch:
    type: boolean
    description:
      Indicates the PHY as a handler of USB Type-C orientation changes

required:
  - compatible
  - reg
  - reg-names
  - "#phy-cells"
  - clocks
  - clock-names
  - resets
  - reset-names

unevaluatedProperties: false

examples:
  - |
    soc {
        #address-cells = <2>;
        #size-cells = <2>;

        usb_phy: usb_phy@c410000 {
            compatible = "google,gs5-usb-phy";
            reg = <0 0x0c450014 0 0xc>,
                  <0 0x0c637000 0 0xa0>,
                  <0 0x0c45002c 0 0x4>;
            reg-names = "usb2_cfg_csr", "dp_top_csr", "usb_top_cfg_csr";
            #phy-cells = <1>;
            clocks = <&hsion_usb2_phy_reset_clk>;
            clock-names = "usb2_phy_clk";
            resets = <&hsion_resets_usb2_phy>;
            reset-names = "usb2_phy_reset";
            power-domains = <&hsio_n_usb_pd>;
            orientation-switch;
        };
    };
...
```

## Documentation/devicetree/bindings/phy/google,gs5-usb-phy.yaml
```yaml
# SPDX-License-Identifier: (GPL-2.0-only OR BSD-2-Clause)
# Copyright (C) 2025, Google LLC
%YAML 1.2
---
$id: http://devicetree.org/schemas/phy/google,gs5-usb-phy.yaml#
$schema: http://devicetree.org/meta-schemas/core.yaml#

title: Google Tensor Series (G5+) USB PHY

maintainers:
  - Roy Luo <royluo@google.com>

description: |
  Describes the USB PHY interfaces integrated with the DWC3 USB controller on
  Google Tensor SoCs, starting with the G5 generation.
  Two specific PHY IPs from Synopsys are integrated, including eUSB 2.0 PHY IP
  and USB 3.2/DisplayPort combo PHY IP.

properties:
  compatible:
    const: google,gs5-usb-phy

  reg:
    items:
      - description: USB3.2/DisplayPort combo PHY core registers.
      - description: USB3.2/DisplayPort combo PHY Type-C Assist registers.
      - description: USB2 PHY configuration registers.
      - description: USB3.2/DisplayPort combo PHY top-level registers.

  reg-names:
    items:
      - const: usb3_core
      - const: usb3_tca
      - const: usb2_cfg
      - const: usb3_top

  "#phy-cells":
    description: |
      The phandle's argument in the PHY specifier selects one of the three
      following PHY interfaces.
      - 0 for USB high-speed.
      - 1 for USB super-speed.
      - 2 for DisplayPort.
    const: 1

  clocks:
    minItems: 2
    items:
      - description: USB2 PHY clock.
      - description: USB2 PHY APB clock.
      - description: USB3.2/DisplayPort combo PHY clock.
      - description: USB3.2/DisplayPort combo PHY firmware clock.
    description:
      USB3 clocks are optional if the device is intended for USB2-only
      operation.

  clock-names:
    minItems: 2
    items:
      - const: usb2
      - const: usb2_apb
      - const: usb3
      - const: usb3_fw

  resets:
    minItems: 2
    items:
      - description: USB2 PHY reset.
      - description: USB2 PHY APB reset.
      - description: USB3.2/DisplayPort combo PHY reset.
    description:
      USB3 clocks are optional if the device is intended for USB2-only
      operation.

  reset-names:
    minItems: 2
    items:
      - const: usb2
      - const: usb2_apb
      - const: usb3

  power-domains:
    maxItems: 1

  orientation-switch:
    type: boolean
    description:
      Indicates the PHY as a handler of USB Type-C orientation changes

required:
  - compatible
  - reg
  - reg-names
  - "#phy-cells"
  - clocks
  - clock-names
  - resets
  - reset-names
  - power-domains
  - orientation-switch

additionalProperties: false

examples:
  - |
    soc {
        #address-cells = <2>;
        #size-cells = <2>;

        usb_phy: usb_phy@c410000 {
            compatible = "google,gs5-usb-phy";
            reg = <0 0x0c410000 0 0x20000>,
                  <0 0x0c430000 0 0x1000>,
                  <0 0x0c450014 0 0xc>,
                  <0 0x0c637000 0 0xa0>;
            reg-names = "usb3_core", "usb3_tca", "usb2_cfg", "usb3_top";
            #phy-cells = <1>;
            clocks = <&hsion_usb2_phy_clk>, <&hsion_u2phy_apb_clk>;
            clock-names = "usb2", "usb2_apb";
            resets = <&hsion_resets_usb2_phy>,
                     <&hsion_resets_u2phy_apb>;
            reset-names = "usb2", "usb2_apb";
            power-domains = <&hsio_n_usb_pd>;
            orientation-switch;
        };
    };
...
```

## Documentation/devicetree/bindings/phy/google,usb-phy.yaml
```yaml
# SPDX-License-Identifier: (GPL-2.0-only OR BSD-2-Clause)
# Copyright (C) 2025, Google LLC
%YAML 1.2
---
$id: http://devicetree.org/schemas/phy/google,usb-phy.yaml#
$schema: http://devicetree.org/meta-schemas/core.yaml#

title: Google USB PHY

maintainers:
  - Roy Luo <royluo@google.com>

description:
  Describes the USB PHY block on Google Tensor SoCs.

properties:
  compatible:
    items:
      - enum:
          - google,lga-usb-phy
      - const: google,usb-phy

  reg:
    minItems: 3
    maxItems: 3

  reg-names:
    items:
      - const: usb2_cfg_csr
      - const: dp_top_csr
      - const: usb_top_cfg_csr

  "#phy-cells":
    const: 1

  clocks:
    maxItems: 1

  clock-names:
    items:
      - const: usb2_phy_clk

  resets:
    maxItems: 1

  reset-names:
    items:
      - const: usb2_phy_reset

  power-domains:
    maxItems: 1

  orientation-switch:
    type: boolean
    description:
      Indicates the PHY as a handler of USB Type-C orientation changes

required:
  - compatible
  - reg
  - reg-names
  - "#phy-cells"
  - clocks
  - clock-names
  - resets
  - reset-names

unevaluatedProperties: false

examples:
  - |
    soc {
        #address-cells = <2>;
        #size-cells = <2>;

        usb_phy: usb_phy@c410000 {
            compatible = "google,lga-usb-phy", "google,usb-phy";
            reg = <0 0x0c450014 0 0xc>,
                  <0 0x0c637000 0 0xa0>,
                  <0 0x0c45002c 0 0x4>;
            reg-names = "usb2_cfg_csr", "dp_top_csr", "usb_top_cfg_csr";
            #phy-cells = <1>;
            clocks = <&hsion_usb2_phy_reset_clk>;
            clock-names = "usb2_phy_clk";
            resets = <&hsion_resets_usb2_phy>;
            reset-names = "usb2_phy_reset";
            power-domains = <&hsio_n_usb_pd>;
            orientation-switch;
        };
    };
...
```

## Documentation/devicetree/bindings/phy/hisilicon,inno-usb2-phy.yaml
```yaml
# SPDX-License-Identifier: (GPL-2.0-only OR BSD-2-Clause)
%YAML 1.2
---
$id: http://devicetree.org/schemas/phy/hisilicon,inno-usb2-phy.yaml#
$schema: http://devicetree.org/meta-schemas/core.yaml#

title: HiSilicon HiSTB SoCs INNO USB2 PHY device

maintainers:
  - Yang Xiwen <forbidden405@outlook.com>

properties:
  compatible:
    minItems: 1
    items:
      - enum:
          - hisilicon,hi3798cv200-usb2-phy
          - hisilicon,hi3798mv100-usb2-phy
          - hisilicon,hi3798mv200-usb2-phy
      - const: hisilicon,inno-usb2-phy

  reg:
    maxItems: 1
    description: |
      Should be the address space for PHY configuration register in peripheral
      controller, e.g. PERI_USB0 for USB 2.0 PHY01 on Hi3798CV200 SoC.
      Or direct MMIO address space.

  '#address-cells':
    const: 1

  '#size-cells':
    const: 0

  clocks:
    maxItems: 1
    description: reference clock

  resets:
    maxItems: 1

patternProperties:
  'phy@[0-9a-f]+':
    type: object
    additionalProperties: false
    description: individual ports provided by INNO PHY

    properties:
      reg:
        maxItems: 1

      '#phy-cells':
        const: 0

      resets:
        maxItems: 1

    required: [reg, '#phy-cells', resets]

required:
  - compatible
  - clocks
  - reg
  - '#address-cells'
  - '#size-cells'
  - resets

if:
  properties:
    compatible:
      contains:
        const: hisilicon,hi3798mv200-inno-usb2-phy
then:
  required:
    - ranges

additionalProperties: false

examples:
  - |
    #include <dt-bindings/clock/histb-clock.h>

    peripheral-controller@8a20000 {
        compatible = "hisilicon,hi3798cv200-perictrl", "syscon", "simple-mfd";
        reg = <0x8a20000 0x1000>;
        #address-cells = <1>;
        #size-cells = <1>;
        ranges = <0x0 0x8a20000 0x1000>;

        usb2-phy@120 {
            compatible = "hisilicon,hi3798cv200-usb2-phy";
            reg = <0x120 0x4>;
            clocks = <&crg HISTB_USB2_PHY1_REF_CLK>;
            resets = <&crg 0xbc 4>;
            #address-cells = <1>;
            #size-cells = <0>;

            phy@0 {
                reg = <0>;
                #phy-cells = <0>;
                resets = <&crg 0xbc 8>;
            };

            phy@1 {
                reg = <1>;
                #phy-cells = <0>;
                resets = <&crg 0xbc 9>;
            };
        };

        usb2-phy@124 {
            compatible = "hisilicon,hi3798cv200-usb2-phy";
            reg = <0x124 0x4>;
            clocks = <&crg HISTB_USB2_PHY2_REF_CLK>;
            resets = <&crg 0xbc 6>;
            #address-cells = <1>;
            #size-cells = <0>;

            phy@0 {
                reg = <0>;
                #phy-cells = <0>;
                resets = <&crg 0xbc 10>;
            };
        };
    };
```
