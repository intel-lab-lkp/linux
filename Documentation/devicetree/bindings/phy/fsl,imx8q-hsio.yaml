## Documentation/devicetree/bindings/phy/qcom,x1e80100-csi2-phy.yaml
```yaml
# SPDX-License-Identifier: (GPL-2.0 OR BSD-2-Clause)
%YAML 1.2
---
$id: http://devicetree.org/schemas/phy/qcom,x1e80100-csi2-phy.yaml#
$schema: http://devicetree.org/meta-schemas/core.yaml#

title: Qualcomm X1E80100 SoC CSI2 PHY

maintainers:
  - Bryan O'Donoghue <bod@kernel.org>

description:
  Qualcomm MIPI CSI2 C-PHY/D-PHY combination PHY. Connects MIPI CSI2 sensors
  to Qualcomm's Camera CSI Decoder. The PHY supports both C-PHY and D-PHY
  modes.

properties:
  compatible:
    const: qcom,x1e80100-csi2-phy

  reg:
    maxItems: 1

  clocks:
    maxItems: 3

  clock-names:
    items:
      - const: core
      - const: timer
      - const: ahb

  interrupts:
    maxItems: 1

  operating-points-v2: true

  opp-table:
    type: object

  power-domains:
    items:
      - description: Titan Top GDSC - Titan ISP Block, Global Distributed Switch Controller.
      - description: MMCX voltage rail
      - description: MXC or MXA voltage rail

  power-domain-names:
    items:
      - const: top
      - const: mmcx
      - const: mx

  vdda-0p9-supply:
    description: Phandle to a 0.9V regulator supply to a PHY.

  vdda-1p2-supply:
    description: Phandle to 1.2V regulator supply to a PHY.

  ports:
    $ref: /schemas/graph.yaml#/properties/ports

    properties:
      port@0:
        $ref: /schemas/graph.yaml#/$defs/port-base
        description:
          Sensor input. Always present. A single sensor is described by a
          single endpoint with one to four data lanes. DPHY split mode,
          where two independent sensors share the same PHY, is described
          by two endpoints; endpoint@0 with one or two data-lanes and
          endpoint@1 with exactly one data-lane.
        unevaluatedProperties: false

        patternProperties:
          "^endpoint(@[01])?$":
            $ref: /schemas/media/video-interfaces.yaml#
            unevaluatedProperties: false
            properties:
              bus-type:
                enum:
                  - 1 # MEDIA_BUS_TYPE_CSI2_CPHY
                  - 4 # MEDIA_BUS_TYPE_CSI2_DPHY

              data-lanes:
                minItems: 1
                maxItems: 4
                description:
                  An array of physical data lane indexes, 0-3, following the
                  CSIPHY hardware's own lane numbering. data-lane N corresponds
                  to bit 2N of the D-PHY lane enable mask. The indexes do not
                  denote package pad or ball positions. The dedicated clock lane
                  is not described.

            required:
              - bus-type
              - data-lanes
              - remote-endpoint

        allOf:
          - if:
              required:
                - endpoint@1
            then:
              properties:
                endpoint@0:
                  properties:
                    data-lanes:
                      minItems: 1
                      maxItems: 2
                endpoint@1:
                  properties:
                    data-lanes:
                      maxItems: 1
              required:
                - endpoint@0

      port@1:
        $ref: /schemas/graph.yaml#/properties/port
        description: Output to the CAMSS CSID controller.

    required:
      - port@0
      - port@1

required:
  - compatible
  - reg
  - clocks
  - clock-names
  - interrupts
  - operating-points-v2
  - power-domains
  - power-domain-names
  - vdda-0p9-supply
  - vdda-1p2-supply
  - ports

additionalProperties: false

examples:
  - |
    #include <dt-bindings/clock/qcom,x1e80100-camcc.h>
    #include <dt-bindings/clock/qcom,x1e80100-gcc.h>
    #include <dt-bindings/interrupt-controller/arm-gic.h>
    #include <dt-bindings/media/video-interfaces.h>
    #include <dt-bindings/power/qcom,rpmhpd.h>

    phy@ace4000 {
        compatible = "qcom,x1e80100-csi2-phy";
        reg = <0x0ace4000 0x2000>;

        clocks = <&camcc CAM_CC_CSIPHY0_CLK>,
                 <&camcc CAM_CC_CSI0PHYTIMER_CLK>,
                 <&camcc CAM_CC_CORE_AHB_CLK>;
        clock-names = "core",
                      "timer",
                      "ahb";

        interrupts = <GIC_SPI 477 IRQ_TYPE_EDGE_RISING>;

        operating-points-v2 = <&csiphy_opp_table>;

        power-domains = <&camcc CAM_CC_TITAN_TOP_GDSC>,
                        <&rpmhpd RPMHPD_MMCX>,
                        <&rpmhpd RPMHPD_MX>;
        power-domain-names = "top",
                             "mmcx",
                             "mx";

        vdda-0p9-supply = <&vreg_l2c_0p9>;
        vdda-1p2-supply = <&vreg_l1c_1p2>;

        ports {
            #address-cells = <1>;
            #size-cells = <0>;

            port@0 {
                reg = <0>;
                csiphy0_in: endpoint {
                    bus-type = <MEDIA_BUS_TYPE_CSI2_DPHY>;
                    data-lanes = <0 1 2 3>;
                    remote-endpoint = <&sensor_out>;
                };
            };

            port@1 {
                reg = <1>;
                csiphy0_out: endpoint {
                    remote-endpoint = <&csid_in>;
                };
            };
        };

        csiphy_opp_table: opp-table {
            compatible = "operating-points-v2";

            opp-300000000 {
                opp-hz = /bits/ 64 <300000000>;
                required-opps = <&rpmhpd_opp_low_svs_d1>,
                                <&rpmhpd_opp_low_svs_d1>;
            };
        };
    };
```

## Documentation/devicetree/bindings/phy/realtek,otto-serdes.yaml
```yaml
# SPDX-License-Identifier: GPL-2.0-only OR BSD-2-Clause
%YAML 1.2
---
$id: http://devicetree.org/schemas/phy/realtek,otto-serdes.yaml#
$schema: http://devicetree.org/meta-schemas/core.yaml#

title: Realtek Otto SerDes controller

maintainers:
  - Markus Stockhausen <markus.stockhausen@gmx.de>

description:
  The MIPS based Realtek Switch SoCs of the Realtek RTL838x, RTL839x, RTL930x and RTL931x series
  have multiple SerDes built in. They are linked to single, quad or octa PHYs like the RTL8218B,
  RTL8218D or RTL8214FC and are one of the integral part of the up-to-52-port switch architecture.

  Although these SerDes controllers have common basics they behave differently on the SoC families
  and rely on heavy register magic. To keep the driver clean it can load patch sequences from
  devictree and execute them during the controller actions like phy_init(), ...

  The driver exposes the SerDes registers different from the hardware but instead gives a
  consistent view and programming interface. So the RTL838x series has 6 ports and 4 pages, the
  RTL839x has 14 ports and 12 pages, the RTL930x has 12 ports and 64 pages and the RTL931x has
  14 ports and 192 pages.

properties:
  $nodename:
    pattern: "^serdes@[0-9a-f]+$"

  compatible:
    items:
      - enum:
          - realtek,rtl8380-serdes
          - realtek,rtl8390-serdes
          - realtek,rtl9300-serdes
          - realtek,rtl9310-serdes

  reg:
    items:
      description:
        The primary SerDes paged register memory location. Other SerDes control and management
        registers are distributed all over the I/O memory space and are identified by the driver.

  "#phy-cells":
    const: 4
    description:
      The first number defines the SerDes to use. The second number a linked SerDes. E.g. if a octa
      1G PHY is attached to two QSGMII SerDes. The third number is the first switch port this
      SerDes is working for, the fourth number is the last switch port the SerDes is working for.

  realtek,controlled-ports:
    $ref: /schemas/types.yaml#/definitions/uint32
    description:
      A bit mask defining the ports that are actively controlled by the driver. In case a bit is
      not set the driver will only process read operations on the SerDes. This is just in case the
      SerDes has been setup by U-Boot correctly and the driver malfunctions. If not set the driver
      will control all SerDes.

reguired:
  - compatible
  - reg
  - "#phy-cells"

additionalProperties:
  false

examples:
  - |
    serdes: serdes@1b00e780 {
      compatible = "realtek,rtl8380-serdes", "realtek,otto-serdes";
      reg = <0x1b00e780 0x1200>;
      controlled-ports = <0x003f>;
      #phy-cells = <4>;
    };
  - |
    serdes: serdes@1b00a000 {
      compatible = "realtek,rtl8390-serdes", "realtek,otto-serdes";
      reg = <0x1b00a000 0x1c00>;
      controlled-ports = <0x3fff>;
      #phy-cells = <4>;
    };
  - |
    serdes: serdes@1b0003b0 {
      compatible = "realtek,rtl9300-serdes", "realtek,otto-serdes";
      reg = <0x1b0003b0 0x8>;
      controlled-ports = <0x0fff>;
      #phy-cells = <4>;
    };
  - |
    serdes: serdes@1b005638 {
      compatible = "realtek,rtl9310-serdes", "realtek,otto-serdes";
      reg = <0x1b005638 0x8>;
      controlled-ports = <0x3fff>;
      #phy-cells = <4>;
    };
```

## Documentation/devicetree/bindings/phy/realtek,rtd-pcie-phy.yaml
```yaml
# SPDX-License-Identifier: (GPL-2.0 OR BSD-2-Clause)
# Copyright 2023 Realtek Semiconductor Corporation
%YAML 1.2
---
$id: http://devicetree.org/schemas/phy/realtek,rtd-pcie-phy.yaml#
$schema: http://devicetree.org/meta-schemas/core.yaml#

title: Realtek DHC PCIe PHY

maintainers:
  - Tzuyi Chang <tychang@realtek.com>

description:
  Realtek PCIe PHY supports the DHC(Digital Home Center) RTD series SoCs.
  The PCIe PHY driver is designed to support physical layer functionality
  of the PCIe controller.

properties:
  compatible:
    enum:
      - realtek,rtd1319-pcie0-phy
      - realtek,rtd1319-pcie1-phy
      - realtek,rtd1319-pcie2-phy
      - realtek,rtd1619b-pcie1-phy
      - realtek,rtd1619b-pcie2-phy
      - realtek,rtd1319d-pcie1-phy
      - realtek,rtd1315e-pcie1-phy

  "#phy-cells":
    const: 0

  nvmem-cells:
    maxItems: 1
    description:
      Phandle to nvmem cell that contains 'Tx swing trim'
      tuning parameter value for PCIe phy.

  nvmem-cell-names:
    items:
      - const: tx_swing_trim

  realtek,pcie-syscon:
    $ref: /schemas/types.yaml#/definitions/phandle
    description: phandle of syscon used to control PCIe MDIO register.

required:
  - compatible
  - realtek,pcie-syscon
  - "#phy-cells"

additionalProperties: false

examples:
  - |
    pcie1_phy {
        compatible = "realtek,rtd1319d-pcie1-phy";
        realtek,pcie-syscon = <&pcie1>;
        #phy-cells = <0>;
        nvmem-cells = <&otp_pcie_tx_swing_trim>;
        nvmem-cell-names = "tx_swing_trim";
    };
```

## Documentation/devicetree/bindings/phy/realtek,rtl8380m-serdes.yaml
```yaml
# SPDX-License-Identifier: GPL-2.0-only OR BSD-2-Clause
%YAML 1.2
---
$id: http://devicetree.org/schemas/phy/realtek,rtl8380m-serdes.yaml#
$schema: http://devicetree.org/meta-schemas/core.yaml#

title: Realtek Otto SerDes controller

maintainers:
  - Markus Stockhausen <markus.stockhausen@gmx.de>

description:
  The MIPS based Realtek Switch SoCs of the Realtek RTL838x, RTL839x, RTL930x
  and RTL931x series have multiple SerDes built in. They are linked to single,
  quad or octa PHYs like the RTL8218B, RTL8218D or RTL8214FC and are one of
  the integral part of the up-to-52-port switch architecture. Although these
  SerDes controllers have common basics they are designed differently in the
  SoC families.

properties:
  compatible:
    enum:
      - realtek,rtl8380m-serdes
      - realtek,rtl8392m-serdes
      - realtek,rtl9302b-serdes
      - realtek,rtl9311-serdes

  reg:
    maxItems: 1

  "#phy-cells":
    const: 4
    description:
      The first number defines the SerDes to use. The second number a linked
      SerDes. E.g. if a octa 1G PHY is attached to two QSGMII SerDes. The third
      number is the first switch port this SerDes is working for, the fourth
      number is the last switch port the SerDes is working for.

  firmware-name:
    maxItems: 1
    description:
      If present, name (or relative path) of the file within the firmware
      search path containing the firmware image to patch the SerDes.

required:
  - compatible
  - reg
  - "#phy-cells"

additionalProperties: false

examples:
  - |
    serdes: phy@1b0003b0 {
      compatible = "realtek,rtl9302b-serdes";
      reg = <0x1b0003b0 0x8>;
      firmware-name = "zyxel-xgs1210-12-serdes.fw";
      #phy-cells = <4>;
    };
```

## Documentation/devicetree/bindings/phy/renesas,rcar-gen5-mpphy.yaml
```yaml
# SPDX-License-Identifier: (GPL-2.0-only OR BSD-2-Clause)
%YAML 1.2
---
$id: http://devicetree.org/schemas/phy/renesas,rcar-gen5-mpphy.yaml#
$schema: http://devicetree.org/meta-schemas/core.yaml#

title: Renesas R-Car Generation 5 Multi-Protocol PHY

maintainers:
  - Marek Vasut <marek.vasut+renesas@mailbox.org>
  - Yoshihiro Shimoda <yoshihiro.shimoda.uh@renesas.com>

properties:
  compatible:
    items:
      - const: renesas,r8a78000-mpphy   # R-Car X5H MPPHY
      - const: renesas,rcar-gen5-mpphy  # R-Car Gen5 MPPHY

  reg:
    maxItems: 1

  clocks:
    minItems: 5
    maxItems: 5

  clock-names:
    items:
      - const: mpphy01
      - const: mpphy11
      - const: mpphy21
      - const: mpphy31
      - const: mpphy02

  power-domains:
    minItems: 4
    maxItems: 4

  power-domain-names:
    items:
      - const: mpp0
      - const: mpp1
      - const: mpp2
      - const: mpp3

  resets:
    minItems: 5
    maxItems: 5

  reset-names:
    items:
      - const: mpphy01
      - const: mpphy11
      - const: mpphy21
      - const: mpphy31
      - const: mpphy02

  '#phy-cells':
    const: 1

  renesas,num-lanes:
    description: PCIe lane count for each PHY input.
    $ref: /schemas/types.yaml#/definitions/uint32-array
    minItems: 4
    maxItems: 4

  renesas,phy-type:
    description: PHY multiplexing configuration for each output.
    $ref: /schemas/types.yaml#/definitions/uint32-array
    minItems: 8
    maxItems: 8

  renesas,external-ref-clock:
    description: PHY external reference clock select for each output.
    $ref: /schemas/types.yaml#/definitions/uint32-array
    minItems: 4
    maxItems: 4

  renesas,output-repeat-ref-clock:
    description: PHY repeat reference clock select for each output.
    $ref: /schemas/types.yaml#/definitions/uint32-array
    minItems: 4
    maxItems: 4

required:
  - compatible
  - reg
  - clocks
  - clock-names
  - power-domains
  - power-domain-names
  - resets
  - reset-names
  - '#phy-cells'
  - renesas,num-lanes
  - renesas,phy-type
  - renesas,external-ref-clock
  - renesas,output-repeat-ref-clock

additionalProperties: false

examples:
  - |
    #include <dt-bindings/phy/phy.h>

    phy@c9a00000 {
      compatible = "renesas,r8a78000-mpphy", "renesas,rcar-gen5-mpphy";
      reg = <0xc9a00000 0x100000>;
      #phy-cells = <1>;

      clocks = <&scmi_clk 340>, <&scmi_clk 341>, <&scmi_clk 342>,
               <&scmi_clk 343>, <&scmi_clk 344>;
      clock-names = "mpphy01", "mpphy11", "mpphy21", "mpphy31", "mpphy02";
      power-domains = <&scmi_devpd 17>, <&scmi_devpd 18>,
                      <&scmi_devpd 19>, <&scmi_devpd 20>;
      power-domain-names = "mpp0", "mpp1", "mpp2", "mpp3";
      resets = <&scmi_reset 340>, <&scmi_reset 341>, <&scmi_reset 342>,
               <&scmi_reset 343>, <&scmi_reset 344>;
      reset-names = "mpphy01", "mpphy11", "mpphy21", "mpphy31", "mpphy02";

      renesas,num-lanes = <4 4 0 0>;
      renesas,phy-type = <PHY_TYPE_PCIE 0>, <PHY_TYPE_PCIE 0>,
                         <PHY_TYPE_XPCS 2>, <PHY_TYPE_USB3 1>;
      renesas,external-ref-clock = <1 1 1 1>;
      renesas,output-repeat-ref-clock = <0 0 0 0>;
    };
```
