## Documentation/devicetree/bindings/phy/qcom,sa8255p-qmp-usb3-uni-phy.yaml
```yaml
# SPDX-License-Identifier: (GPL-2.0 OR BSD-2-Clause)
%YAML 1.2
---
$id: http://devicetree.org/schemas/phy/qcom,sa8255p-qmp-usb3-uni-phy.yaml#
$schema: http://devicetree.org/meta-schemas/core.yaml#

title: Qualcomm SA8255p QMP PHY controller

maintainers:
  - Mattijs Korpershoek <mkorpershoek@kernel.org>

properties:
  compatible:
    const: qcom,sa8255p-qmp-usb3-uni-phy

  reg:
    maxItems: 1

  "#phy-cells":
    const: 0

  power-domains:
    maxItems: 2

  power-domain-names:
    items:
      - const: transfer
      - const: core

required:
  - compatible
  - reg
  - "#phy-cells"
  - power-domains
  - power-domain-names

unevaluatedProperties: false

examples:
  - |
    soc {
        #address-cells = <2>;
        #size-cells = <2>;

        phy@88e8000 {
            compatible = "qcom,sa8255p-qmp-usb3-uni-phy";
            reg = <0x0 0x088e8000 0x0 0x2000>;
            #phy-cells = <0>;
            power-domains = <&scmi12_pd 2>, <&scmi12_pd 3>;
            power-domain-names = "transfer", "core";
        };
    };
```

## Documentation/devicetree/bindings/phy/qcom,sa8255p-usb-hs-phy.yaml
```yaml
# SPDX-License-Identifier: (GPL-2.0 OR BSD-2-Clause)
%YAML 1.2
---
$id: http://devicetree.org/schemas/phy/qcom,sa8255p-usb-hs-phy.yaml#
$schema: http://devicetree.org/meta-schemas/core.yaml#

title: Qualcomm SA8255p Synopsys Femto High-Speed USB PHY V2

maintainers:
  - Mattijs Korpershoek <mkorpershoek@kernel.org>

properties:
  compatible:
    const: qcom,sa8255p-usb-hs-phy

  reg:
    maxItems: 1

  "#phy-cells":
    const: 0

  power-domains:
    maxItems: 2

  power-domain-names:
    items:
      - const: core
      - const: transfer

required:
  - compatible
  - reg
  - "#phy-cells"
  - power-domains
  - power-domain-names

additionalProperties: false

examples:
  - |
    soc {
        #address-cells = <2>;
        #size-cells = <2>;

        phy@88e4000 {
            compatible = "qcom,sa8255p-usb-hs-phy";
            reg = <0x0 0x088e4000 0x0 0x120>;
            #phy-cells = <0>;
            power-domains = <&scmi12_pd 1>, <&scmi12_pd 0>;
            power-domain-names = "core", "transfer";
        };
    };
```

## Documentation/devicetree/bindings/phy/qcom,sc8280xp-qmp-usb3-uni-phy.yaml
```yaml
# SPDX-License-Identifier: (GPL-2.0 OR BSD-2-Clause)
%YAML 1.2
---
$id: http://devicetree.org/schemas/phy/qcom,sc8280xp-qmp-usb3-uni-phy.yaml#
$schema: http://devicetree.org/meta-schemas/core.yaml#

title: Qualcomm QMP PHY controller (USB, SC8280XP)

maintainers:
  - Vinod Koul <vkoul@kernel.org>

description:
  The QMP PHY controller supports physical layer functionality for a number of
  controllers on Qualcomm chipsets, such as, PCIe, UFS, and USB.

properties:
  compatible:
    oneOf:
      - items:
          - enum:
              - qcom,glymur-qmp-usb3-uni-phy
              - qcom,ipq5424-qmp-usb3-phy
              - qcom,ipq6018-qmp-usb3-phy
              - qcom,ipq8074-qmp-usb3-phy
              - qcom,ipq9574-qmp-usb3-phy
              - qcom,msm8996-qmp-usb3-phy
              - qcom,qcs8300-qmp-usb3-uni-phy
              - qcom,qdu1000-qmp-usb3-uni-phy
              - qcom,sa8255p-qmp-usb3-uni-phy
              - qcom,sa8775p-qmp-usb3-uni-phy
              - qcom,sc8180x-qmp-usb3-uni-phy
              - qcom,sc8280xp-qmp-usb3-uni-phy
              - qcom,sdm845-qmp-usb3-uni-phy
              - qcom,sdx55-qmp-usb3-uni-phy
              - qcom,sdx65-qmp-usb3-uni-phy
              - qcom,sdx75-qmp-usb3-uni-phy
              - qcom,sm8150-qmp-usb3-uni-phy
              - qcom,sm8250-qmp-usb3-uni-phy
              - qcom,sm8350-qmp-usb3-uni-phy
              - qcom,x1e80100-qmp-usb3-uni-phy
      - items:
          - enum:
              - qcom,ipq5210-qmp-usb3-phy
          - const: qcom,ipq9574-qmp-usb3-phy

  reg:
    maxItems: 1

  clocks:
    minItems: 4
    maxItems: 5

  clock-names:
    minItems: 4
    maxItems: 5

  power-domains:
    minItems: 1
    maxItems: 2

  power-domain-names:
    items:
      - const: usb_transfer
      - const: usb_core

  resets:
    maxItems: 2

  reset-names:
    items:
      - const: phy
      - const: phy_phy

  vdda-phy-supply: true

  vdda-pll-supply: true

  refgen-supply: true

  "#clock-cells":
    const: 0

  clock-output-names:
    maxItems: 1

  "#phy-cells":
    const: 0

required:
  - compatible
  - reg
  - "#phy-cells"

allOf:
  - if:
      properties:
        compatible:
          contains:
            enum:
              - qcom,ipq5424-qmp-usb3-phy
              - qcom,ipq6018-qmp-usb3-phy
              - qcom,ipq8074-qmp-usb3-phy
              - qcom,ipq9574-qmp-usb3-phy
              - qcom,msm8996-qmp-usb3-phy
              - qcom,sdx55-qmp-usb3-uni-phy
              - qcom,sdx65-qmp-usb3-uni-phy
              - qcom,sdx75-qmp-usb3-uni-phy
    then:
      properties:
        clocks:
          maxItems: 4
        clock-names:
          items:
            - const: aux
            - const: ref
            - const: cfg_ahb
            - const: pipe

  - if:
      properties:
        compatible:
          contains:
            enum:
              - qcom,glymur-qmp-usb3-uni-phy
              - qcom,qcs8300-qmp-usb3-uni-phy
              - qcom,qdu1000-qmp-usb3-uni-phy
              - qcom,sa8775p-qmp-usb3-uni-phy
              - qcom,sc8180x-qmp-usb3-uni-phy
              - qcom,sc8280xp-qmp-usb3-uni-phy
              - qcom,sm8150-qmp-usb3-uni-phy
              - qcom,sm8250-qmp-usb3-uni-phy
              - qcom,sm8350-qmp-usb3-uni-phy
              - qcom,x1e80100-qmp-usb3-uni-phy
    then:
      properties:
        clocks:
          maxItems: 4
        clock-names:
          items:
            - const: aux
            - const: ref
            - const: com_aux
            - const: pipe

  - if:
      properties:
        compatible:
          contains:
            enum:
              - qcom,sdm845-qmp-usb3-uni-phy
    then:
      properties:
        clocks:
          maxItems: 5
        clock-names:
          items:
            - const: aux
            - const: cfg_ahb
            - const: ref
            - const: com_aux
            - const: pipe

  - if:
      properties:
        compatible:
          contains:
            enum:
              - qcom,glymur-qmp-usb3-uni-phy
              - qcom,sa8775p-qmp-usb3-uni-phy
              - qcom,sc8180x-qmp-usb3-uni-phy
              - qcom,sc8280xp-qmp-usb3-uni-phy
              - qcom,x1e80100-qmp-usb3-uni-phy
    then:
      required:
        - power-domains

  - if:
      properties:
        compatible:
          contains:
            enum:
              - qcom,glymur-qmp-usb3-uni-phy
    then:
      required:
        - refgen-supply
    else:
      properties:
        refgen-supply: false

  - if:
      properties:
        compatible:
          contains:
            enum:
              - qcom,glymur-qmp-usb3-uni-phy
              - qcom,ipq5424-qmp-usb3-phy
              - qcom,ipq6018-qmp-usb3-phy
              - qcom,ipq8074-qmp-usb3-phy
              - qcom,ipq9574-qmp-usb3-phy
              - qcom,msm8996-qmp-usb3-phy
              - qcom,qcs8300-qmp-usb3-uni-phy
              - qcom,qdu1000-qmp-usb3-uni-phy
              - qcom,sa8775p-qmp-usb3-uni-phy
              - qcom,sc8180x-qmp-usb3-uni-phy
              - qcom,sc8280xp-qmp-usb3-uni-phy
              - qcom,sdm845-qmp-usb3-uni-phy
              - qcom,sdx55-qmp-usb3-uni-phy
              - qcom,sdx65-qmp-usb3-uni-phy
              - qcom,sdx75-qmp-usb3-uni-phy
              - qcom,sm8150-qmp-usb3-uni-phy
              - qcom,sm8250-qmp-usb3-uni-phy
              - qcom,sm8350-qmp-usb3-uni-phy
              - qcom,x1e80100-qmp-usb3-uni-phy
    then:
      properties:
        power-domains:
          maxItems: 1
      required:
        - clocks
        - clock-names
        - resets
        - reset-names
        - vdda-phy-supply
        - vdda-pll-supply
        - "#clock-cells"
        - clock-output-names

  - if:
      properties:
        compatible:
          contains:
            enum:
              - qcom,sa8255p-qmp-usb3-uni-phy
    then:
      properties:
        clocks: false
        clock-names: false
        resets: false
        reset-names: false
        vdda-phy-supply: false
        vdda-pll-supply: false
        "#clock-cells": false
        clock-output-names: false
        power-domains:
          minItems: 2
      required:
        - power-domains
        - power-domain-names

additionalProperties: false

examples:
  - |
    #include <dt-bindings/clock/qcom,gcc-sc8280xp.h>
    #include <dt-bindings/clock/qcom,rpmh.h>

    phy@88ef000 {
      compatible = "qcom,sc8280xp-qmp-usb3-uni-phy";
      reg = <0x088ef000 0x2000>;

      clocks = <&gcc GCC_USB3_MP_PHY_AUX_CLK>,
               <&gcc GCC_USB3_MP0_CLKREF_CLK>,
               <&gcc GCC_USB3_MP_PHY_COM_AUX_CLK>,
               <&gcc GCC_USB3_MP_PHY_PIPE_0_CLK>;
      clock-names = "aux", "ref", "com_aux", "pipe";

      power-domains = <&gcc USB30_MP_GDSC>;

      resets = <&gcc GCC_USB3_UNIPHY_MP0_BCR>,
               <&gcc GCC_USB3UNIPHY_PHY_MP0_BCR>;
      reset-names = "phy", "phy_phy";

      vdda-phy-supply = <&vreg_l3a>;
      vdda-pll-supply = <&vreg_l5a>;

      #clock-cells = <0>;
      clock-output-names = "usb2_phy0_pipe_clk";

      #phy-cells = <0>;
    };

  - |
    soc {
      #address-cells = <2>;
      #size-cells = <2>;

      phy@88e8000 {
        compatible = "qcom,sa8255p-qmp-usb3-uni-phy";
        reg = <0x0 0x088e8000 0x0 0x2000>;
        #phy-cells = <0>;

        power-domains = <&scmi12_pd 2>, <&scmi12_pd 3>;
        power-domain-names = "usb_transfer", "usb_core";
      };
    };
```

## Documentation/devicetree/bindings/phy/qcom,sdx75-qmp-usb3-uni-phy.yaml
```yaml
# SPDX-License-Identifier: (GPL-2.0 OR BSD-2-Clause)
%YAML 1.2
---
$id: http://devicetree.org/schemas/phy/qcom,sdx75-qmp-usb3-uni-phy.yaml#
$schema: http://devicetree.org/meta-schemas/core.yaml#

title: Qualcomm QMP PHY controller (USB, SDX75)

maintainers:
  - Vinod Koul <vkoul@kernel.org>

description:
  The QMP PHY controller supports physical layer functionality for a number of
  controllers on Qualcomm chipsets, such as, PCIe, UFS, and USB.

properties:
  compatible:
    enum:
      - qcom,sdx75-qmp-usb3-uni-phy

  reg:
    maxItems: 1

  clocks:
    maxItems: 4

  clock-names:
    items:
      - const: aux
      - const: cfg_ahb
      - const: ref
      - const: pipe

  power-domains:
    maxItems: 1

  resets:
    maxItems: 2

  reset-names:
    items:
      - const: phy
      - const: common

  vdda-phy-supply: true

  vdda-pll-supply: true

  "#clock-cells":
    const: 0

  clock-output-names:
    maxItems: 1

  "#phy-cells":
    const: 0

required:
  - compatible
  - reg
  - clocks
  - clock-names
  - power-domains
  - resets
  - reset-names
  - vdda-phy-supply
  - vdda-pll-supply
  - "#clock-cells"
  - clock-output-names
  - "#phy-cells"

additionalProperties: false

examples:
  - |
    #include <dt-bindings/clock/qcom,gcc-sdx75.h>
    #include <dt-bindings/clock/qcom,rpmh.h>

    phy@ff6000 {
      compatible = "qcom,sdx75-qmp-usb3-uni-phy";
      reg = <0x0ff6000 0x2000>;

      clocks = <&gcc GCC_USB3_PHY_AUX_CLK>,
               <&gcc GCC_USB_PHY_CFG_AHB2PHY_CLK>,
               <&gcc GCC_USB2_CLKREF_EN>,
               <&gcc GCC_USB3_PHY_PIPE_CLK>;
      clock-names = "aux",
                    "cfg_ahb",
                    "ref",
                    "pipe";

      power-domains = <&gcc GCC_USB3_PHY_GDSC>;

      resets = <&gcc GCC_USB3PHY_PHY_BCR>,
               <&gcc GCC_USB3_PHY_BCR>;
      reset-names = "phy",
                    "common";

      vdda-phy-supply = <&vreg_l4b_0p88>;
      vdda-pll-supply = <&vreg_l1b_1p2>;

      #clock-cells = <0>;
      clock-output-names = "usb3_uni_phy_pipe_clk_src";

      #phy-cells = <0>;
    };
```

## Documentation/devicetree/bindings/phy/qcom,uniphy-pcie.yaml
```yaml
# SPDX-License-Identifier: (GPL-2.0 OR BSD-2-Clause)
%YAML 1.2
---
$id: http://devicetree.org/schemas/phy/qcom,uniphy-pcie.yaml#
$schema: http://devicetree.org/meta-schemas/core.yaml#

title: Qualcomm UNIPHY PCIe 28LP PHY

maintainers:
  - Nitheesh Sekar <quic_nsekar@quicinc.com>
  - Varadarajan Narayanan <quic_varada@quicinc.com>

description:
  PCIe and USB combo PHY found in Qualcomm IPQ5332 SoC

properties:
  compatible:
    enum:
      - qcom,ipq5332-uniphy-pcie-gen3x1
      - qcom,ipq5332-uniphy-pcie-gen3x2

  reg:
    maxItems: 1

  clocks:
    minItems: 2

  resets:
    minItems: 2
    maxItems: 3

  reset-names:
    minItems: 2
    items:
      - const: phy
      - const: phy_ahb
      - const: phy_cfg

  "#phy-cells":
    const: 0

  "#clock-cells":
    const: 0

  clock-output-names:
    maxItems: 1

required:
  - compatible
  - reg
  - resets
  - reset-names
  - clocks
  - "#phy-cells"
  - "#clock-cells"
  - clock-output-names

additionalProperties: false

examples:
  - |
    #include <dt-bindings/clock/qcom,ipq5332-gcc.h>

    pcie0_phy: phy@4b0000 {
        compatible = "qcom,ipq5332-uniphy-pcie-gen3x1";
        reg = <0x004b0000 0x800>;

        clocks = <&gcc GCC_PCIE3X1_0_PIPE_CLK>,
                 <&gcc GCC_PCIE3X1_PHY_AHB_CLK>;

        resets = <&gcc GCC_PCIE3X1_0_PHY_BCR>,
                 <&gcc GCC_PCIE3X1_PHY_AHB_CLK_ARES>,
                 <&gcc GCC_PCIE3X1_0_PHY_PHY_BCR>;
        reset-names = "phy",
                      "phy_ahb",
                      "phy_cfg";

        #clock-cells = <0>;
        clock-output-names = "pcie0_pipe_clk_src";

        #phy-cells = <0>;
    };
```
