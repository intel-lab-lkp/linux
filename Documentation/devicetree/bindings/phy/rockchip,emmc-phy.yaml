## Documentation/devicetree/bindings/phy/rockchip,emmc-phy.yaml
```yaml
# SPDX-License-Identifier: (GPL-2.0 OR BSD-2-Clause)
%YAML 1.2
---
$id: http://devicetree.org/schemas/phy/rockchip,emmc-phy.yaml#
$schema: http://devicetree.org/meta-schemas/core.yaml#

title: Rockchip EMMC PHY

maintainers:
  - Shresth Prasad <shresthprasad7@gmail.com>

properties:
  "#phy-cells":
    const: 0

  compatible:
    const: rockchip,rk3399-emmc-phy

  reg:
    description:
      PHY register address offset and length in "general register files"
    maxItems: 1

  clock-names:
    description: |
      Although this is not a required property (because most boards can get
      basic functionality without having access to it), it is strongly
      suggested.
    const: emmcclk

  clocks:
    description:
      Should have a phandle to the card clock exported by the SDHCI driver.
    maxItems: 1

  drive-impedance-ohm:
    $ref: /schemas/types.yaml#/definitions/uint32
    description:
      Specifies the drive impedance in Ohm.
    enum: [33, 40, 50, 66, 100]
    default: 50

  rockchip,enable-strobe-pulldown:
    type: boolean
    description: |
      Enable internal pull-down for the strobe
      line.  If not set, pull-down is not used.

  rockchip,output-tapdelay-select:
    $ref: /schemas/types.yaml#/definitions/uint32
    description:
      Specifies the phyctrl_otapdlysec register.
    default: 0x4
    maximum: 0xf

required:
  - "#phy-cells"
  - compatible
  - reg

additionalProperties: false

examples:
  - |
    grf: syscon@ff770000 {
      compatible = "rockchip,rk3399-grf", "syscon", "simple-mfd";
      reg = <0x0 0xff770000 0x0 0x10000>;
      #address-cells = <1>;
      #size-cells = <1>;

      emmcphy: phy@f780 {
        #phy-cells = <0>;
        compatible = "rockchip,rk3399-emmc-phy";
        reg = <0xf780 0x20>;
        clocks = <&sdhci>;
        clock-names = "emmcclk";
        drive-impedance-ohm = <50>;
      };
    };
```

## Documentation/devicetree/bindings/phy/rockchip,rk3399-typec-phy.yaml
```yaml
# SPDX-License-Identifier: GPL-2.0-only OR BSD-2-Clause
%YAML 1.2
---
$id: http://devicetree.org/schemas/phy/rockchip,rk3399-typec-phy.yaml#
$schema: http://devicetree.org/meta-schemas/core.yaml#

title: Rockchip RK3399 USBDP Combo PHY

maintainers:
  - Frank Wang <frank.wang@rock-chips.com>
  - Zhang Yubing <yubing.zhang@rock-chips.com>

properties:
  compatible:
    items:
      - const: rockchip,rk3399-typec-phy

  reg:
    maxItems: 1

  clocks:
    maxItems: 2

  clock-names:
    items:
      - const: tcpdcore
      - const: tcpdphy-ref

  extcon:
    $ref: /schemas/types.yaml#/definitions/phandle
    description:
      extcon specifier for the Power Delivery

  power-domains:
    maxItems: 1

  resets:
    maxItems: 3

  reset-names:
    items:
      - const: uphy
      - const: uphy-pipe
      - const: uphy-tcphy

  rockchip,grf:
    $ref: /schemas/types.yaml#/definitions/phandle
    description:
      Some additional phy settings are access through GRF regs.

  dp-port:
    description: A sub-node to identify the dp phy provides.
    type: object
    additionalProperties: false
    properties:
      port:
        $ref: /schemas/graph.yaml#/properties/port
      "#phy-cells":
        const: 0

  usb3-port:
    description: A sub-node to identify the usb3 phy provides.
    type: object
    additionalProperties: false
    properties:
      port:
        $ref: /schemas/graph.yaml#/properties/port
      "#phy-cells":
        const: 0

required:
  - compatible
  - reg
  - clocks
  - clock-names
  - resets
  - reset-names
  - rockchip,grf

additionalProperties: false

examples:
  - |
    #include <dt-bindings/clock/rk3399-cru.h>
    #include <dt-bindings/interrupt-controller/arm-gic.h>
    #include <dt-bindings/power/rk3399-power.h>
    soc {
        #address-cells = <2>;
        #size-cells = <2>;

        phy@ff7c0000 {
            compatible = "rockchip,rk3399-typec-phy";
            reg = <0x0 0xff7c0000 0x0 0x40000>;
            extcon = <&fusb0>;
            clocks = <&cru SCLK_UPHY0_TCPDCORE>, <&cru SCLK_UPHY0_TCPDPHY_REF>;
            clock-names = "tcpdcore", "tcpdphy-ref";
            assigned-clocks = <&cru SCLK_UPHY0_TCPDCORE>;
            assigned-clock-rates = <50000000>;
            resets = <&cru SRST_UPHY0>, <&cru SRST_UPHY0_PIPE_L00>, <&cru SRST_P_UPHY0_TCPHY>;
            reset-names = "uphy", "uphy-pipe", "uphy-tcphy";
            rockchip,grf = <&grf>;

            tcphy0_dp: dp-port {
                #phy-cells = <0>;
            };

            tcphy0_usb3: usb3-port {
                #phy-cells = <0>;
            };
        };
    };
```

## Documentation/devicetree/bindings/phy/rockchip,rk3568-edp-phy.yaml
```yaml
# SPDX-License-Identifier: (GPL-2.0-only OR BSD-2-Clause)
%YAML 1.2
---
$id: http://devicetree.org/schemas/phy/rockchip,rk3568-edp-phy.yaml#
$schema: http://devicetree.org/meta-schemas/core.yaml#

title: Rockchip eDP Transmitter PHY with NaNeng IP block

maintainers:
  - Damon Ding <damon.ding@rock-chips.com>
  - Heiko Stuebner <heiko@sntech.de>

description:
  On the RK3568 SoC the eDP PHY is controlled through the eDP PHY GRF
  registers, therefore the PHY node is expected to be a child of the
  eDP PHY GRF syscon node.

properties:
  compatible:
    const: rockchip,rk3568-edp-phy

  clocks:
    maxItems: 1

  clock-names:
    const: refclk

  "#phy-cells":
    const: 0

required:
  - compatible
  - clocks
  - clock-names
  - "#phy-cells"

additionalProperties: false

examples:
  - |
    #include <dt-bindings/clock/rk3568-cru.h>

    soc {
      #address-cells = <2>;
      #size-cells = <2>;

      edp_phy_grf: syscon@fdcb0000 {
        compatible = "rockchip,rk3568-edp-phy-grf", "syscon", "simple-mfd";
        reg = <0x0 0xfdcb0000 0x0 0x100>;
        clocks = <&cru PCLK_EDPPHY_GRF>;

        edp_phy: edp-phy {
          compatible = "rockchip,rk3568-edp-phy";
          clocks = <&pmucru XIN_OSC0_EDPPHY_G>;
          clock-names = "refclk";
          #phy-cells = <0>;
        };
      };
    };
```

## Documentation/devicetree/bindings/phy/rockchip,rk3588-mipi-dcphy.yaml
```yaml
# SPDX-License-Identifier: (GPL-2.0-only OR BSD-2-Clause)
%YAML 1.2
---
$id: http://devicetree.org/schemas/phy/rockchip,rk3588-mipi-dcphy.yaml#
$schema: http://devicetree.org/meta-schemas/core.yaml#

title: Rockchip MIPI D-/C-PHY with Samsung IP block

maintainers:
  - Guochun Huang <hero.huang@rock-chips.com>
  - Heiko Stuebner <heiko@sntech.de>

properties:
  compatible:
    enum:
      - rockchip,rk3576-mipi-dcphy
      - rockchip,rk3588-mipi-dcphy

  reg:
    maxItems: 1

  "#phy-cells":
    const: 1
    description: |
      The block contains a MIPI transmitter and a MIPI receiver, which
      can be referenced independently. The argument selects one of
      them:
        - PHY_TYPE_DSI: the transmitter, for a MIPI DSI host
        - PHY_TYPE_CSI: the receiver, for a MIPI CSI-2 host
        - PHY_TYPE_DPHY: the transmitter in D-PHY mode; equivalent to
          PHY_TYPE_DSI and kept for existing device trees
        - PHY_TYPE_CPHY: the transmitter in C-PHY mode
      See include/dt-bindings/phy/phy.h for constants.

  clocks:
    maxItems: 2

  clock-names:
    items:
      - const: pclk
      - const: ref

  resets:
    maxItems: 4

  reset-names:
    items:
      - const: m_phy
      - const: apb
      - const: grf
      - const: s_phy

  rockchip,grf:
    $ref: /schemas/types.yaml#/definitions/phandle
    description:
      Phandle to the syscon managing the 'mipi dcphy general register files'.

required:
  - compatible
  - reg
  - clocks
  - clock-names
  - resets
  - reset-names
  - "#phy-cells"

additionalProperties: false

examples:
  - |
    #include <dt-bindings/clock/rockchip,rk3588-cru.h>
    #include <dt-bindings/reset/rockchip,rk3588-cru.h>

    soc {
      #address-cells = <2>;
      #size-cells = <2>;

      phy@feda0000 {
        compatible = "rockchip,rk3588-mipi-dcphy";
        reg = <0x0 0xfeda0000 0x0 0x10000>;
        clocks = <&cru PCLK_MIPI_DCPHY0>,
                 <&cru CLK_USBDPPHY_MIPIDCPPHY_REF>;
        clock-names = "pclk", "ref";
        resets = <&cru SRST_M_MIPI_DCPHY0>,
                 <&cru SRST_P_MIPI_DCPHY0>,
                 <&cru SRST_P_MIPI_DCPHY0_GRF>,
                 <&cru SRST_S_MIPI_DCPHY0>;
        reset-names = "m_phy", "apb", "grf", "s_phy";
        rockchip,grf = <&mipidcphy0_grf>;
        #phy-cells = <1>;
      };
    };
```

## Documentation/devicetree/bindings/phy/samsung,exynos-pcie-phy.yaml
```yaml
# SPDX-License-Identifier: GPL-2.0-only OR BSD-2-Clause
%YAML 1.2
---
$id: http://devicetree.org/schemas/phy/samsung,exynos-pcie-phy.yaml#
$schema: http://devicetree.org/meta-schemas/core.yaml#

title: Samsung SoC series PCIe PHY

maintainers:
  - Marek Szyprowski <m.szyprowski@samsung.com>
  - Jaehoon Chung <jh80.chung@samsung.com>

properties:
  "#phy-cells":
    const: 0

  compatible:
    enum:
      - samsung,exynos5433-pcie-phy
      - tesla,fsd-pcie-phy

  reg:
    minItems: 1
    maxItems: 2

  samsung,pmu-syscon:
    $ref: /schemas/types.yaml#/definitions/phandle
    description: phandle for PMU system controller interface, used to
                 control PMU registers bits for PCIe PHY

  samsung,fsys-sysreg:
    $ref: /schemas/types.yaml#/definitions/phandle
    description: phandle for FSYS sysreg interface, used to control
                 sysreg registers bits for PCIe PHY

allOf:
  - if:
      properties:
        compatible:
          contains:
            enum:
              - tesla,fsd-pcie-phy
    then:
      description:
        The PHY controller nodes are represented in the aliases node
        using the following format 'pciephy{n}'. Depending on whether
        n is 0 or 1, the phy init sequence is chosen.
      properties:
        reg:
          items:
            - description: PHY
            - description: PCS

required:
  - "#phy-cells"
  - compatible
  - reg
  - samsung,pmu-syscon
  - samsung,fsys-sysreg

additionalProperties: false

examples:
  - |
    pcie_phy: pcie-phy@15680000 {
        compatible = "samsung,exynos5433-pcie-phy";
        reg = <0x15680000 0x1000>;
        samsung,pmu-syscon = <&pmu_system_controller>;
        samsung,fsys-sysreg = <&syscon_fsys>;
        #phy-cells = <0>;
    };
...
```

## Documentation/devicetree/bindings/phy/samsung,exynos2200-usbcon-phy.yaml
```yaml
# SPDX-License-Identifier: (GPL-2.0 OR BSD-2-Clause)
%YAML 1.2
---
$id: http://devicetree.org/schemas/phy/samsung,exynos2200-usbcon-phy.yaml#
$schema: http://devicetree.org/meta-schemas/core.yaml#

title: Exynos2200 USB controller PHY

maintainers:
  - Ivaylo Ivanov <ivo.ivanov.ivanov1@gmail.com>

description:
  Exynos2200 USB controller PHY is an intermediary between a USB controller
  (typically DWC3) and other PHYs (UTMI, PIPE3).

properties:
  compatible:
    enum:
      - samsung,exynos2200-usbcon-phy

  reg:
    maxItems: 1

  clocks:
    items:
      - description: bus clock

  clock-names:
    items:
      - const: bus

  "#phy-cells":
    const: 0

  phys:
    maxItems: 1
    description:
      Phandle to eUSB2 PHY

  samsung,pmu-syscon:
    $ref: /schemas/types.yaml#/definitions/phandle-array
    maxItems: 1
    items:
      minItems: 1
      items:
        - description: phandle for PMU system controller interface, used to
                       control PMU registers bits for USBCON PHY
        - description: offset of the pmu control register
    description:
      Should be phandle/offset pair. The phandle to System Register syscon node
      and the offset for USBCON PHY.

required:
  - compatible
  - reg
  - clocks
  - clock-names
  - "#phy-cells"
  - phys
  - samsung,pmu-syscon

additionalProperties: false

examples:
  - |
    #include <dt-bindings/clock/samsung,exynos2200-cmu.h>

    usb_con_phy: phy@10aa0000 {
        compatible = "samsung,exynos2200-usbcon-phy";
        reg = <0x10aa0000 0x10000>;
        clocks = <&cmu_hsi0 CLK_MOUT_HSI0_NOC>;
        clock-names = "bus";
        #phy-cells = <0>;
        phys = <&usb_hs_phy>;
        samsung,pmu-syscon = <&pmu_system_controller 0x72c>;
    };
```

## Documentation/devicetree/bindings/phy/snps,dw-dphy-rx.yaml
```yaml
# SPDX-License-Identifier: (GPL-2.0-only OR BSD-2-Clause)
%YAML 1.2
---
$id: http://devicetree.org/schemas/phy/snps,mipi-dphy-rx.yaml#
$schema: http://devicetree.org/meta-schemas/core.yaml#

title: Synopsys Designware MIPI D-PHY RX

maintainers:
  - Karthik Poduval <kpoduval@lab126.com>
  - Jason Xiong <jyxiong@amazon.com>
  - Miguel Lopes <miguel.lopes@synopsys.com

description: |
  These are the bindings for Synopsys Designware MIPI DPHY RX phy driver.
  Currently only supported phy version is v1.2.

properties:
  compatible:
    const: snps,dw-dphy-1p2

  '#phy-cells':
    const: 0

  reg:
    - minItems: 2
    - maxItems: 2

required:
  - compatible
  - '#phy-cells'
  - reg

additionalProperties: false

examples:
  - |
    dw_dphy_rx: dw-dphy@900000040 {
        compatible = "snps,dw-dphy-1p2";
        #phy-cells = <0>;
        reg = <0x0 0x90000040 0x0 0x20>, <0x0 0x90001000 0x0 0x8>;
        status = "disabled";
    };
```

## Documentation/devicetree/bindings/phy/st,stm32-usb2phy.yaml
```yaml
# SPDX-License-Identifier: (GPL-2.0-only OR BSD-2-Clause)
%YAML 1.2
---
$id: http://devicetree.org/schemas/phy/st,stm32-usb2phy.yaml#
$schema: http://devicetree.org/meta-schemas/core.yaml#

title: STMicroelectronics STM32 MPU High-Speed USB PHY

description:
  USB2 PHY block in STM32 is attached to USB 2.0 Host controller and
  USB 2.0 side of DWC3 DRD controller, and provides the USB LS/FS/HS
  connectivity. Both PHYs are the FEMTO-PHY, but their configuration
  bits in the system control register are different for each variant.

maintainers:
  - Fabrice Gasnier <fabrice.gasnier@foss.st.com>
  - Marek Vasut <marex@nabladev.com>
  - Pankaj Dev <pankaj.dev@st.com>

properties:
  compatible:
    enum:
      - st,stm32mp25-usb2phy1
      - st,stm32mp25-usb2phy2

  "#phy-cells":
    const: 0

  clocks:
    maxItems: 1

  resets:
    maxItems: 1

  vdd33-supply:
    description: Phandle to regulator providing 3V3 power supply to the USB2 HS PHY

  st,syscfg:
    $ref: /schemas/types.yaml#/definitions/phandle-array
    description: Phandle to system configuration controller.
    items:
      - items:
          - description: phandle to syscfg
          - description: USB2PHY control offset within syscfg

  "#clock-cells":
    const: 1

required:
  - compatible
  - "#clock-cells"
  - "#phy-cells"
  - clocks
  - resets
  - st,syscfg
  - vdd33-supply

additionalProperties: false

examples:
  - |
    #include <dt-bindings/clock/st,stm32mp25-rcc.h>
    #include <dt-bindings/reset/st,stm32mp25-rcc.h>

    usb2_phy2: usb-phy {
        compatible = "st,stm32mp25-usb2phy1";
        #clock-cells = <1>;
        #phy-cells = <0>;
        clocks = <&rcc CK_KER_USB2PHY2>;
        resets = <&rcc USB2PHY2_R>;
        st,syscfg = <&syscfg 0x2800>;
        vdd33-supply = <&vdd33usb>;
    };
```
