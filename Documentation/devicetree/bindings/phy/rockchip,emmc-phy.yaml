## Documentation/devicetree/bindings/pinctrl/ambarella,cv75-pinctrl.yaml
```yaml
# SPDX-License-Identifier: GPL-2.0-only OR BSD-2-Clause
%YAML 1.2
---
$id: http://devicetree.org/schemas/pinctrl/ambarella,cv75-pinctrl.yaml#
$schema: http://devicetree.org/meta-schemas/core.yaml#

title: Ambarella CV75 Pin Controller

maintainers:
  - Long Zhao <longzhao@ambarella.com>

description:
  The Ambarella CV75 pin controller configures pin multiplexing, bias and
  drive strength for the main GPIO banks. Pin groups and their mux settings
  are defined by the pin controller driver and selected by function and group
  names.

allOf:
  - $ref: pinctrl.yaml#

properties:
  compatible:
    const: ambarella,cv75-pinctrl

  reg:
    maxItems: 1
    description: IOMUX registers

  ambarella,drive-strength-syscon:
    $ref: /schemas/types.yaml#/definitions/phandle
    description: RCT syscon containing the drive-strength registers.

  ambarella,pull-syscon:
    $ref: /schemas/types.yaml#/definitions/phandle
    description: Secure scratchpad syscon containing the pull registers.

  "#address-cells":
    const: 1

  "#size-cells":
    const: 1

  ranges: true

patternProperties:
  "^gpio@[0-9a-f]+$":
    type: object
    additionalProperties: false

    properties:
      reg:
        maxItems: 1

      interrupts:
        maxItems: 1

      gpio-controller: true

      "#gpio-cells":
        const: 2

      gpio-ranges:
        maxItems: 1

      interrupt-controller: true

      "#interrupt-cells":
        const: 2

    required:
      - reg
      - interrupts
      - gpio-controller
      - "#gpio-cells"
      - gpio-ranges
      - interrupt-controller
      - "#interrupt-cells"

  "^[a-z0-9-]+-pins$":
    type: object
    allOf:
      - $ref: pinmux-node.yaml#
      - $ref: pincfg-node.yaml#
    additionalProperties: false

    properties:
      function:
        const: uart0

      groups:
        $ref: /schemas/types.yaml#/definitions/string-array
        items:
          enum: [uart0tx, uart0rx]
        minItems: 2
        maxItems: 2
        uniqueItems: true

      bias-disable: true
      bias-pull-down: true
      bias-pull-up: true

      drive-strength:
        enum: [3, 4, 5, 6, 7, 8, 9, 12]

    required:
      - function
      - groups

required:
  - compatible
  - reg
  - ambarella,drive-strength-syscon
  - ambarella,pull-syscon
  - "#address-cells"
  - "#size-cells"
  - ranges

unevaluatedProperties: false

examples:
  - |
    #include <dt-bindings/interrupt-controller/arm-gic.h>

    rct: rct {
    };

    scratchpad: scratchpad {
    };

    pinctrl: pinctrl@e4010000 {
        compatible = "ambarella,cv75-pinctrl";
        #address-cells = <1>;
        #size-cells = <1>;
        reg = <0xe4010000 0x1000>;
        ranges;
        ambarella,drive-strength-syscon = <&rct>;
        ambarella,pull-syscon = <&scratchpad>;

        gpio0: gpio@e4013000 {
            reg = <0xe4013000 0x1000>;
            interrupts = <GIC_SPI 163 IRQ_TYPE_LEVEL_HIGH>;
            gpio-controller;
            #gpio-cells = <2>;
            gpio-ranges = <&pinctrl 0 0 32>;
            interrupt-controller;
            #interrupt-cells = <2>;
        };

        gpio1: gpio@e4014000 {
            reg = <0xe4014000 0x1000>;
            interrupts = <GIC_SPI 164 IRQ_TYPE_LEVEL_HIGH>;
            gpio-controller;
            #gpio-cells = <2>;
            gpio-ranges = <&pinctrl 0 32 32>;
            interrupt-controller;
            #interrupt-cells = <2>;
        };

        gpio2: gpio@e4015000 {
            reg = <0xe4015000 0x1000>;
            interrupts = <GIC_SPI 165 IRQ_TYPE_LEVEL_HIGH>;
            gpio-controller;
            #gpio-cells = <2>;
            gpio-ranges = <&pinctrl 0 64 32>;
            interrupt-controller;
            #interrupt-cells = <2>;
        };

        uart0-pins {
            function = "uart0";
            groups = "uart0tx", "uart0rx";
            bias-disable;
            drive-strength = <8>;
        };
    };
```

## Documentation/devicetree/bindings/pinctrl/amlogic,meson-pinctrl-a4.yaml
```yaml
# SPDX-License-Identifier: (GPL-2.0-only OR BSD-2-Clause)
%YAML 1.2
---
$id: http://devicetree.org/schemas/pinctrl/amlogic,meson-pinctrl-a4.yaml#
$schema: http://devicetree.org/meta-schemas/core.yaml#

title: Amlogic A4 pinmux controller

maintainers:
  - Neil Armstrong <neil.armstrong@linaro.org>
  - Xianwei Zhao <xianwei.zhao@amlogic.com>

allOf:
  - $ref: amlogic,meson-pinctrl-common.yaml#

properties:
  compatible:
    enum:
      - amlogic,a4-aobus-pinctrl
      - amlogic,a4-periphs-pinctrl

required:
  - compatible

patternProperties:
  "^bank@[0-9a-f]+$":
    $ref: amlogic,meson-pinctrl-common.yaml#/$defs/meson-gpio

    unevaluatedProperties: false

    properties:
      reg:
        maxItems: 2

      reg-names:
        items:
          - const: mux
          - const: gpio

      gpio-controller: true

      "#gpio-cells":
        const: 3

      gpio-line-names:
        minItems: 8
        maxItems: 73

unevaluatedProperties:
  type: object
  $ref: amlogic,meson-pinctrl-common.yaml#/$defs/meson-pins

examples:
  - |
    bus {
      #address-cells = <2>;
      #size-cells = <2>;

      periphs_pinctrl: pinctrl@4000 {
        compatible = "amlogic,a4-periphs-pinctrl";
        #address-cells = <2>;
        #size-cells = <2>;
        ranges = <0x0 0x0 0x0 0x4000 0x0 0x02e0>;

        bank@0 {
          reg = <0x0 0x0 0x0 0x0050>,
                <0x0 0xc0 0x0 0x0220>;
          reg-names = "mux", "gpio";
          gpio-controller;
          #gpio-cells = <3>;
          gpio-ranges = <&periphs_pinctrl 0 0 73>;
        };

        cec_ao_a_h_pins: cec_ao_a_h {
          mux {
            groups = "cec_ao_a_h";
            function = "cec_ao_a_h";
            bias-disable;
          };
        };
      };
    };
```

## Documentation/devicetree/bindings/pinctrl/amlogic,pinctrl-a4.yaml
```yaml
# SPDX-License-Identifier: (GPL-2.0-only OR BSD-2-Clause)
%YAML 1.2
---
$id: http://devicetree.org/schemas/pinctrl/amlogic,pinctrl-a4.yaml#
$schema: http://devicetree.org/meta-schemas/core.yaml#

title: Amlogic pinmux controller

maintainers:
  - Xianwei Zhao <xianwei.zhao@amlogic.com>

allOf:
  - $ref: pinctrl.yaml#

properties:
  compatible:
    const: amlogic,pinctrl-a4

  "#address-cells":
    const: 2

  "#size-cells":
    const: 2

  ranges: true

required:
  - compatible
  - "#address-cells"
  - "#size-cells"

patternProperties:
  "^gpio@[0-9a-f]+$":
    type: object

    properties:
      reg:
        minItems: 1
        items:
          - description: pin config register
          - description: pin mux setting register (some special pin fixed function)
          - description: pin drive strength register (optionanl)

      reg-names:
        minItems: 1
        items:
          - const: gpio
          - const: mux
          - const: ds

      gpio-controller: true

      "#gpio-cells":
        const: 2

      gpio-ranges:
        maxItems: 1

      bank-number:
        description: |
          bank-number are provided by the pin controller header file at:
          <include/dt-bindings/pinctrl/amlogic,pinctrl.h>
        $ref: /schemas/types.yaml#/definitions/uint32

    required:
      - reg
      - reg-names
      - gpio-controller
      - "#gpio-cells"
      - gpio-ranges
      - bank-number

    additionalProperties: false

  "^func-[0-9a-z-]+$":
    type: object
    patternProperties:
      "^group-[0-9a-z-]+$":
        type: object
        allOf:
          - $ref: /schemas/pinctrl/pincfg-node.yaml
          - $ref: /schemas/pinctrl/pinmux-node.yaml
    additionalProperties: false

additionalProperties: false

examples:
  - |
    #include <dt-bindings/pinctrl/amlogic,pinctrl.h>
    apb {
      #address-cells = <2>;
      #size-cells = <2>;
      periphs_pinctrl: pinctrl {
        compatible = "amlogic,pinctrl-a4";
        #address-cells = <2>;
        #size-cells = <2>;
        ranges;

        gpio@14 {
          reg = <0 0x14 0 0x10>,
                <0 0x14 0 0x10>;
          reg-names = "gpio", "mux";
          gpio-controller;
          #gpio-cells = <2>;
          bank-number = <AMLOGIC_GPIO_B>;
          gpio-ranges = <&periphs_pinctrl 0 8 10>;
        };

        func-uart-b {
          group-default {
            pinmux = <AML_PINMUX(AMLOGIC_GPIO_B, 1, 4)>;
            bias-pull-up;
            drive-strength-microamp = <4000>;
          };

          group-pins1 {
            pinmux = <AML_PINMUX(AMLOGIC_GPIO_B, 5, 2)>;
            bias-pull-up;
            drive-strength-microamp = <4000>;
          };
        };

        func-uart-c {
          group-default {
            pinmux = <AML_PINMUX(AMLOGIC_GPIO_B, 3, 1)>,
                     <AML_PINMUX(AMLOGIC_GPIO_B, 2, 1)>;
            bias-pull-up;
            drive-strength-microamp = <4000>;
          };
        };
      };
    };
```

## Documentation/devicetree/bindings/pinctrl/amlogic,pinctrl.yaml
```yaml
# SPDX-License-Identifier: (GPL-2.0-only OR BSD-2-Clause)
%YAML 1.2
---
$id: http://devicetree.org/schemas/pinctrl/amlogic,pinctrl.yaml#
$schema: http://devicetree.org/meta-schemas/core.yaml#

title: Amlogic pinmux controller

maintainers:
  - Xianwei Zhao <xianwei.zhao@amlogic.com>

allOf:
  - $ref: pinctrl.yaml#

properties:
  compatible:
    const: amlogic,pinctrl

  reg:
    minItems: 2

  reg-names:
    items:
      - const: mux
      - const: gpio

  "#address-cells":
    const: 2

  "#size-cells":
    const: 2

required:
  - compatible
  - reg
  - reg-names
  - "#address-cells"
  - "#size-cells"

patternProperties:
  "^gpio[a-z]":
    type: object

    properties:
      gpio-controller: true

      "#gpio-cells":
        const: 2

      bank-name:
        $ref: /schemas/types.yaml#/definitions/string

      npins:
        $ref: /schemas/types.yaml#/definitions/uint32
        minimum: 1
        maximum: 32

      bank-index:
        $ref: /schemas/types.yaml#/definitions/uint32
        minimum: 0
        maximum: 29

      reg-mux-offset:
        $ref: /schemas/types.yaml#/definitions/uint32

      bit-mux-offset:
        $ref: /schemas/types.yaml#/definitions/uint32

      reg-gpio-offset:
        $ref: /schemas/types.yaml#/definitions/uint32

    required:
      - gpio-controller
      - "#gpio-cells"
      - npins
      - bank-index
      - reg-mux-offset
      - reg-gpio-offset
      - bank-name

    additionalProperties: false
    unevaluatedProperties: false

  "^func-[0-9a-z]":
    type: object
    additionalProperties:
      type: object
      allOf:
        - $ref: pincfg-node.yaml#
        - $ref: pinmux-node.yaml#

additionalProperties: false

examples:
  - |
    apb {
      #address-cells = <2>;
      #size-cells = <2>;
      periphs_pinctrl: pinctrl@8e700 {
        compatible = "amlogic,pinctrl";
        #address-cells = <2>;
        #size-cells = <2>;
        reg = <0x0 0x8e700 0x0 0x04>,
              <0x0 0x8e704 0x0 0x60>;
        reg-names = "mux", "gpio";

        gpiob {
          gpio-controller;
          #gpio-cells = <2>;
          npins = <10>;
          bank-index = <1>;
          reg-mux-offset = <0x14>;
          bit-mux-offset = <0x14>;
          reg-gpio-offset = <0x30>;
          bank-name = "GPIOB";
        };

        gpioe {
          gpio-controller;
          #gpio-cells = <2>;
          npins = <10>;
          bank-index = <5>;
          reg-mux-offset = <0x14>;
          reg-gpio-offset = <0x30>;
          bank-name = "GPIOE";
        };

        func-uart-b {
          uart-b-default{
            pinmux = <3>;
            bias-pull-up;
            drive-strength-microamp = <4000>;
          };

          uart-c-default{
            pinmux = <4>;
            bias-pull-up;
            drive-strength-microamp = <4000>;
          };
        };

        func-uart-c {
          uart-c-default{
            pinmux = <3>;
            bias-pull-up;
            drive-strength-microamp = <4000>;
          };
        };
      };
    };
```

## Documentation/devicetree/bindings/pinctrl/aspeed,ast2700-soc0-pinctrl.yaml
```yaml
# SPDX-License-Identifier: (GPL-2.0-only OR BSD-2-Clause)
%YAML 1.2
---
$id: http://devicetree.org/schemas/pinctrl/aspeed,ast2700-soc0-pinctrl.yaml#
$schema: http://devicetree.org/meta-schemas/core.yaml#

title: ASPEED AST2700 SoC0 Pin Controller

maintainers:
  - Billy Tsai <billy_tsai@aspeedtech.com>

description:
  The AST2700 features a dual-SoC architecture with two interconnected SoCs,
  each having its own System Control Unit (SCU) for independent pin control.
  This pin controller manages the pin multiplexing for SoC0.

  The SoC0 pin controller manages pin functions including eMMC, VGA DDC,
  dual USB3/USB2 ports (A and B), JTAG, and PCIe root complex interfaces.

properties:
  compatible:
    const: aspeed,ast2700-soc0-pinctrl

patternProperties:
  '-state$':
    type: object
    allOf:
      - $ref: pinmux-node.yaml#
      - $ref: pincfg-node.yaml#
    additionalProperties: false

    properties:
      function:
        enum:
          - EMMC
          - JTAGDDR
          - JTAGM0
          - JTAGPCIEA
          - JTAGPCIEB
          - JTAGPSP
          - JTAGSSP
          - JTAGTSP
          - JTAGUSB3A
          - JTAGUSB3B
          - PCIERC0PERST
          - PCIERC1PERST
          - TSPRSTN
          - UFSCLKI
          - USB2AD0
          - USB2AD1
          - USB2AH
          - USB2AHP
          - USB2AHPD0
          - USB2AXH
          - USB2AXH2B
          - USB2AXHD1
          - USB2AXHP
          - USB2AXHP2B
          - USB2AXHPD1
          - USB2BD0
          - USB2BD1
          - USB2BH
          - USB2BHP
          - USB2BHPD0
          - USB2BXH
          - USB2BXH2A
          - USB2BXHD1
          - USB2BXHP
          - USB2BXHP2A
          - USB2BXHPD1
          - USB3AXH
          - USB3AXH2B
          - USB3AXHD
          - USB3AXHP
          - USB3AXHP2B
          - USB3AXHPD
          - USB3BXH
          - USB3BXH2A
          - USB3BXHD
          - USB3BXHP
          - USB3BXHP2A
          - USB3BXHPD
          - VB
          - VGADDC

      groups:
        enum:
          - EMMCCDN
          - EMMCG1
          - EMMCG4
          - EMMCG8
          - EMMCWPN
          - JTAG0
          - PCIERC0PERST
          - PCIERC1PERST
          - TSPRSTN
          - UFSCLKI
          - USB2A
          - USB2AAP
          - USB2ABP
          - USB2ADAP
          - USB2AH
          - USB2AHAP
          - USB2B
          - USB2BAP
          - USB2BBP
          - USB2BDBP
          - USB2BH
          - USB2BHBP
          - USB3A
          - USB3AAP
          - USB3ABP
          - USB3B
          - USB3BAP
          - USB3BBP
          - VB0
          - VB1
          - VGADDC

required:
  - compatible

allOf:
  - $ref: pinctrl.yaml#

additionalProperties: false
```
