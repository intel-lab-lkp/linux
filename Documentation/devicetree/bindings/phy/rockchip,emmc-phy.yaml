## Documentation/devicetree/bindings/pinctrl/brcm,nsp-gpio.yaml
```yaml
# SPDX-License-Identifier: (GPL-2.0-only OR BSD-2-Clause)
%YAML 1.2
---
$id: http://devicetree.org/schemas/pinctrl/brcm,nsp-gpio.yaml#
$schema: http://devicetree.org/meta-schemas/core.yaml#

title: Broadcom Northstar Plus (NSP) GPIO/PINCONF Controller

maintainers:
  - Ray Jui <rjui@broadcom.com>
  - Scott Branden <sbranden@broadcom.com>

description: |
  The chipCommonA GPIO block also provides generic pin configuration for the
  pins it controls: bias, pull up/down and drive strength. Pin configuration
  child nodes may be direct children of the controller, or grouped under a
  '-pins' node. In both cases the pin configuration nodes are referenced by
  the consuming device through the standard pinctrl-0/pinctrl-names
  properties. Child nodes named '*-hog' are treated as GPIO hogs.

properties:
  compatible:
    const: brcm,nsp-gpio-a

  reg:
    items:
      - description: GPIO base registers
      - description: IO control registers

  "#gpio-cells":
    const: 2
    description: |
      The first cell is the GPIO pin number (within the controller's pin
      space) and the second cell is used for the following:
      bit[0]: polarity (0 for active high and 1 for active low)

  gpio-controller: true

  ngpios:
    description: Number of GPIOs supported (58x25 supports 32 and 58x23 supports 24)
    maximum: 32

  interrupts:
    maxItems: 1

  "#interrupt-cells":
    const: 2

  interrupt-controller: true

  gpio-ranges: true

required:
  - compatible
  - reg
  - "#gpio-cells"
  - gpio-controller
  - ngpios

$defs:
  nsp-gpio-pinconf:
    type: object
    allOf:
      - $ref: pincfg-node.yaml#
      - $ref: pinmux-node.yaml#

    properties:
      pins:
        $ref: /schemas/types.yaml#/definitions/string-array
        items:
          pattern: '^gpio-'

      bias-disable: true
      bias-pull-up: true
      bias-pull-down: true

      drive-strength:
        $ref: /schemas/types.yaml#/definitions/uint32
        enum: [ 2, 4, 6, 8, 10, 12, 14, 16 ]

    required:
      - pins

    additionalProperties: false

patternProperties:
  '-pins$':
    oneOf:
      - $ref: '#/$defs/nsp-gpio-pinconf'
      - type: object
        additionalProperties:
          $ref: '#/$defs/nsp-gpio-pinconf'

  '-hog(-[0-9]+)?$':
    type: object
    required:
      - gpio-hog

additionalProperties:
  anyOf:
    - $ref: '#/$defs/nsp-gpio-pinconf'
    - not:
        type: object

examples:
  - |
    #include <dt-bindings/interrupt-controller/arm-gic.h>

    gpio@18000020 {
        compatible = "brcm,nsp-gpio-a";
        reg = <0x18000020 0x100>,
              <0x1803f1c4 0x1c>;
        #gpio-cells = <2>;
        gpio-controller;
        ngpios = <32>;
        gpio-ranges = <&pinctrl 0 0 31>;
        interrupt-controller;
        #interrupt-cells = <2>;
        interrupts = <GIC_SPI 85 IRQ_TYPE_LEVEL_HIGH>;

        /* Pin configuration node applied as a pinctrl state */
        pinctrl-names = "default";
        pinctrl-0 = <&led>;

        led: led {
            pins = "gpio-1";
            bias-pull-up;
        };

        /* Pin configuration nodes may also be grouped under a '-pins' node */
        pwm-pins {
            pwm {
                pins = "gpio-0";
                drive-strength = <16>;
            };
        };

        /* GPIO hog */
        pwr-hog {
            gpio-hog;
            gpios = <3 1>;
            output-high;
        };
    };
```

## Documentation/devicetree/bindings/pinctrl/cix,sky1-pinctrl.yaml
```yaml
# SPDX-License-Identifier: (GPL-2.0-only OR BSD-2-Clause)
%YAML 1.2
---
$id: http://devicetree.org/schemas/pinctrl/cix,sky1-pinctrl.yaml#
$schema: http://devicetree.org/meta-schemas/core.yaml#

title: Cix Sky1 Pin Controller

maintainers:
  - Gary Yang <gary.yang@cixtech.com>

description:
  The pin-controller is used to control Soc pins. There are two pin-controllers
  on Cix Sky1 platform. one is used under S0 state, the other one is used under
  S0 and S5 state.

properties:
  compatible:
    enum:
      - cix,sky1-iomuxc
      - cix,sky1-iomuxc-s5

  reg:
    items:
      - description: gpio base

required:
  - compatible
  - reg

# Client device subnode's properties
patternProperties:
  'pins$':
    type: object
    additionalProperties: false
    patternProperties:
      '(^pins|pins?$)':
        type: object
        additionalProperties: false
        description:
          A pinctrl node should contain at least one subnodes representing the
          pinctrl groups available on the machine. Each subnode will list the
          pins it needs, and how they should be configured, with regard to muxer
          configuration, pullups, and drive strength.

        properties:
          pinmux:
            description:
              Values are constructed from pin number and mux setting and are
              defined as macros in arch/arm64/boot/dts/cix/sky1-pinfunc.h directly.

          bias-disable: true

          bias-pull-up: true

          bias-pull-down: true

          drive-strength:
            description:
              Can support 15 levels, from DS_LEVEL1 to DS_LEVEL15.
              defined as macros in arch/arm64/boot/dts/cix/sky1-pinfunc.h.

        required:
          - pinmux

additionalProperties: false

examples:
  # Pinmux controller node
  - |
    #define CIX_PAD_GPIO012_FUNC_GPIO012 (11 << 8 | 0x0)
    #define DS_LEVEL4 (4)
    iomuxc: pinctrl@4170000 {
        compatible = "cix,sky1-iomuxc";
        reg = <0x4170000 0x1000>;

        wifi_vbat_gpio: wifi-vbat-gpio-pins {
            pins {
                pinmux = <CIX_PAD_GPIO012_FUNC_GPIO012>;
                bias-pull-up;
                drive-strength = <DS_LEVEL4>;
           };
        };
    };
```
