## Documentation/devicetree/bindings/pinctrl/aspeed,ast2700-soc1-pinctrl.yaml
```yaml
# SPDX-License-Identifier: (GPL-2.0-only OR BSD-2-Clause)
%YAML 1.2
---
$id: http://devicetree.org/schemas/pinctrl/aspeed,ast2700-soc1-pinctrl.yaml#
$schema: http://devicetree.org/meta-schemas/core.yaml#

title: ASPEED AST2700 SoC1 Pin Controller

maintainers:
  - Billy Tsai <billy_tsai@aspeedtech.com>

description:
  The AST2700 features a dual-SoC architecture with two interconnected SoCs,
  each having its own System Control Unit (SCU) for independent pin control.
  This pin controller manages the pin multiplexing for SoC1.

  The SoC1 pin controller manages pin functions including eSPI, LPC and I2C,
  among others.

properties:
  compatible:
    const: aspeed,ast2700-soc1-pinctrl

patternProperties:
  '-state$':
    type: object
    allOf:
      - $ref: pinmux-node.yaml#
      - $ref: pincfg-node.yaml#
    additionalProperties: false

    properties:
      function:
        enum:
          - ADC0
          - ADC1
          - ADC10
          - ADC11
          - ADC12
          - ADC13
          - ADC14
          - ADC15
          - ADC2
          - ADC3
          - ADC4
          - ADC5
          - ADC6
          - ADC7
          - ADC8
          - ADC9
          - AUXPWRGOOD0
          - AUXPWRGOOD1
          - CANBUS
          - DSGPM1
          - ESPI0
          - ESPI1
          - FSI0
          - FSI1
          - FSI2
          - FSI3
          - FWQSPI
          - FWSPIABR
          - FWWPN
          - HBLED
          - I2C0
          - I2C1
          - I2C10
          - I2C11
          - I2C12
          - I2C13
          - I2C14
          - I2C15
          - I2C2
          - I2C3
          - I2C4
          - I2C5
          - I2C6
          - I2C7
          - I2C8
          - I2C9
          - I2CF0
          - I2CF1
          - I2CF2
          - I3C0
          - I3C1
          - I3C10
          - I3C11
          - I3C12
          - I3C13
          - I3C14
          - I3C15
          - I3C2
          - I3C3
          - I3C4
          - I3C5
          - I3C6
          - I3C7
          - I3C8
          - I3C9
          - JTAGM1
          - LPC0
          - LPC1
          - LTPI
          - MACLINK0
          - MACLINK1
          - MACLINK2
          - MDIO0
          - MDIO1
          - MDIO2
          - OSCCLK
          - PCIERC
          - PWM0
          - PWM1
          - PWM10
          - PWM11
          - PWM12
          - PWM13
          - PWM14
          - PWM15
          - PWM2
          - PWM3
          - PWM4
          - PWM5
          - PWM6
          - PWM7
          - PWM8
          - PWM9
          - QSPI0
          - QSPI1
          - QSPI2
          - RGMII0
          - RGMII1
          - RMII0
          - RMII0RCKO
          - RMII1
          - RMII1RCKO
          - SALT0
          - SALT1
          - SALT10
          - SALT11
          - SALT12
          - SALT13
          - SALT14
          - SALT15
          - SALT2
          - SALT3
          - SALT4
          - SALT5
          - SALT6
          - SALT7
          - SALT8
          - SALT9
          - SD
          - SGMII
          - SGPM0
          - SGPM1
          - SGPS
          - SIOONCTRLN0
          - SIOONCTRLN1
          - SIOPBIN0
          - SIOPBIN1
          - SIOPBON0
          - SIOPBON1
          - SIOPWREQN0
          - SIOPWREQN1
          - SIOPWRGD1
          - SIOS3N0
          - SIOS3N1
          - SIOS5N0
          - SIOS5N1
          - SIOSCIN0
          - SIOSCIN1
          - SMON0
          - SMON1
          - SPI0
          - SPI0ABR
          - SPI0CS1
          - SPI0WPN
          - SPI1
          - SPI1ABR
          - SPI1CS1
          - SPI1WPN
          - SPI2
          - SPI2CS1
          - TACH0
          - TACH1
          - TACH10
          - TACH11
          - TACH12
          - TACH13
          - TACH14
          - TACH15
          - TACH2
          - TACH3
          - TACH4
          - TACH5
          - TACH6
          - TACH7
          - TACH8
          - TACH9
          - THRU0
          - THRU1
          - THRU2
          - THRU3
          - UART0
          - UART1
          - UART10
          - UART11
          - UART2
          - UART3
          - UART5
          - UART6
          - UART7
          - UART8
          - UART9
          - USB2C
          - USB2D
          - USBUART
          - VGA
          - VPI
          - WDTRST0N
          - WDTRST1N
          - WDTRST2N
          - WDTRST3N
          - WDTRST4N
          - WDTRST5N
          - WDTRST6N
          - WDTRST7N

      groups:
        enum:
          - ADC0
          - ADC1
          - ADC10
          - ADC11
          - ADC12
          - ADC13
          - ADC14
          - ADC15
          - ADC2
          - ADC3
          - ADC4
          - ADC5
          - ADC6
          - ADC7
          - ADC8
          - ADC9
          - AUXPWRGOOD0
          - AUXPWRGOOD1
          - CANBUS
          - DI2C0
          - DI2C1
          - DI2C10
          - DI2C11
          - DI2C12
          - DI2C13
          - DI2C14
          - DI2C15
          - DI2C2
          - DI2C3
          - DI2C8
          - DI2C9
          - DSGPM1
          - ESPI0
          - ESPI1
          - FSI0
          - FSI1
          - FSI2
          - FSI3
          - FWQSPI
          - FWSPIABR
          - FWWPN
          - HBLED
          - HVI3C0
          - HVI3C1
          - HVI3C12
          - HVI3C13
          - HVI3C14
          - HVI3C15
          - HVI3C2
          - HVI3C3
          - I2C0
          - I2C1
          - I2C10
          - I2C11
          - I2C12
          - I2C13
          - I2C14
          - I2C15
          - I2C2
          - I2C3
          - I2C4
          - I2C5
          - I2C6
          - I2C7
          - I2C8
          - I2C9
          - I2CF0
          - I2CF1
          - I2CF2
          - I3C10
          - I3C11
          - I3C4
          - I3C5
          - I3C6
          - I3C7
          - I3C8
          - I3C9
          - JTAGM1
          - LPC0
          - LPC1
          - LTPI
          - MACLINK0
          - MACLINK1
          - MACLINK2
          - MDIO0
          - MDIO1
          - MDIO2
          - OSCCLK
          - PE2SGRSTN
          - PWM0
          - PWM1
          - PWM10
          - PWM11
          - PWM12
          - PWM13
          - PWM14
          - PWM15
          - PWM2
          - PWM3
          - PWM4
          - PWM5
          - PWM6
          - PWM7
          - PWM8
          - PWM9
          - QSPI0
          - QSPI1
          - QSPI2
          - RGMII0
          - RGMII1
          - RMII0
          - RMII0RCKO
          - RMII1
          - RMII1RCKO
          - SALT0
          - SALT1
          - SALT10
          - SALT11
          - SALT12
          - SALT13
          - SALT14
          - SALT15
          - SALT2
          - SALT3
          - SALT4
          - SALT5
          - SALT6
          - SALT7
          - SALT8
          - SALT9
          - SD
          - SGMII
          - SGPM0
          - SGPM1
          - SGPS
          - SIOONCTRLN0
          - SIOONCTRLN1
          - SIOPBIN0
          - SIOPBIN1
          - SIOPBON0
          - SIOPBON1
          - SIOPWREQN0
          - SIOPWREQN1
          - SIOPWRGD1
          - SIOS3N0
          - SIOS3N1
          - SIOS5N0
          - SIOS5N1
          - SIOSCIN0
          - SIOSCIN1
          - SMON0
          - SMON1
          - SPI0
          - SPI0ABR
          - SPI0CS1
          - SPI0WPN
          - SPI1
          - SPI1ABR
          - SPI1CS1
          - SPI1WPN
          - SPI2
          - SPI2CS1
          - TACH0
          - TACH1
          - TACH10
          - TACH11
          - TACH12
          - TACH13
          - TACH14
          - TACH15
          - TACH2
          - TACH3
          - TACH4
          - TACH5
          - TACH6
          - TACH7
          - TACH8
          - TACH9
          - THRU0
          - THRU1
          - THRU2
          - THRU3
          - UART0
          - UART1
          - UART10
          - UART11
          - UART2
          - UART3
          - UART5
          - UART6
          - UART7
          - UART8
          - UART9
          - USB2CD
          - USB2CH
          - USB2CU
          - USB2CUD
          - USB2DD
          - USB2DH
          - USBUART
          - VGA
          - VPI
          - WDTRST0N
          - WDTRST1N
          - WDTRST2N
          - WDTRST3N
          - WDTRST4N
          - WDTRST5N
          - WDTRST6N
          - WDTRST7N

required:
  - compatible

allOf:
  - $ref: pinctrl.yaml#

additionalProperties: false
```

## Documentation/devicetree/bindings/pinctrl/atmel,sama5d2-pinctrl.yaml
```yaml
# SPDX-License-Identifier: (GPL-2.0-only OR BSD-2-Clause)
%YAML 1.2
---
$id: http://devicetree.org/schemas/pinctrl/atmel,sama5d2-pinctrl.yaml#
$schema: http://devicetree.org/meta-schemas/core.yaml#

title: Microchip PIO4 Controller

maintainers:
  - Balakrishnan Sambath <balakrishnan.s@microchip.com>

description:
  The Microchip PIO4 controller is used to select the function of a pin and to
  configure it.


properties:
  compatible:
    enum:
      - microchip,sama7g5-pinctrl
      - atmel,sama5d2-pinctrl

  reg:
    minItems: 1
    maxItems: 2

  interrupts:
    description:
      Interrupt outputs from the controller, one for each bank.

  interrupt-controller: true

  '#interrupt-cells':
    const: 2

  gpio-controller: true

  '#gpio-cells':
    const: 2

  clocks:
    maxItems: 1
if:
  properties:
    compatible:
      contains:
        const: microchip,sama7g5-pinctrl
then:
  patternProperties:
    '^.*([-_]default)?$':
      anyOf:
        - $ref: "#/$defs/mchp-pio4-pincfg-node-1"
        - patternProperties:
            '^[a-z_-][a-z_-]*$':
              $ref: "#/$defs/mchp-pio4-pincfg-node-1"
else:
  patternProperties:
    '^.*([-_]default)?$':
      anyOf:
        - $ref: "#/$defs/mchp-pio4-pincfg-node-2"
        - patternProperties:
            '^[a-z_-][a-z_-]*$':
              $ref: "#/$defs/mchp-pio4-pincfg-node-2"

$defs:
  mchp-pio4-pincfg-node-1:
    $ref: pincfg-node.yaml#properties
    properties:
      pinmux:
        $ref: pinmux-node.yaml#/properties/pinmux
      atmel,drive-strength:
        $ref: /schemas/types.yaml#/definitions/uint32
        enum: [0, 1, 2, 3]
        default: 0
    required:
      - pinmux

  mchp-pio4-pincfg-node-2:
    $ref: pincfg-node.yaml#properties
    properties:
      pinmux:
        $ref: pinmux-node.yaml#/properties/pinmux
    required:
      - pinmux

required:
  - compatible
  - reg
  - interrupts
  - interrupt-controller
  - '#interrupt-cells'
  - gpio-controller
  - '#gpio-cells'

unevaluatedProperties: false

examples:
  - |
    #include <dt-bindings/gpio/gpio.h>
    #include <dt-bindings/clock/at91.h>
    #include <dt-bindings/interrupt-controller/arm-gic.h>
    #include <dt-bindings/pinctrl/sama5d2-pinfunc.h>

    pinctrl@fc038000 {
        compatible = "atmel,sama5d2-pinctrl";
        reg = <0xfc038000 0x600>;
        interrupts = <18 IRQ_TYPE_LEVEL_HIGH 7>,
                     <68 IRQ_TYPE_LEVEL_HIGH 7>,
                     <69 IRQ_TYPE_LEVEL_HIGH 7>,
                     <70 IRQ_TYPE_LEVEL_HIGH 7>;
        interrupt-controller;
        #interrupt-cells = <2>;
        gpio-controller;
        #gpio-cells = <2>;
        clocks = <&pioA_clk>;

        pinctrl_i2c0_default: i2c0_default {
            pinmux = <PIN_PD21__TWD0>,
                     <PIN_PD22__TWCK0>;
            bias-disable;
        };

        pinctrl_sdmmc1_default: sdmmc1_default {
            cmd_data {
                pinmux = <PIN_PA28__SDMMC1_CMD>,
                         <PIN_PA18__SDMMC1_DAT0>,
                         <PIN_PA19__SDMMC1_DAT1>,
                         <PIN_PA20__SDMMC1_DAT2>,
                         <PIN_PA21__SDMMC1_DAT3>;
                bias-pull-up;
            };

            ck_cd {
                pinmux = <PIN_PA22__SDMMC1_CK>,
                         <PIN_PA30__SDMMC1_CD>;
                bias-disable;
            };
        };
    };
...
```

## Documentation/devicetree/bindings/pinctrl/brcm,bcm6846-pinctrl.yaml
```yaml
# SPDX-License-Identifier: GPL-2.0-only OR BSD-2-Clause
%YAML 1.2
---
$id: http://devicetree.org/schemas/pinctrl/brcm,bcm6846-pinctrl.yaml#
$schema: http://devicetree.org/meta-schemas/core.yaml#

title: Broadcom BCM6846 pin controller

maintainers:
  - Linus Walleij <linus.walleij@linaro.org>

description:
  Binding for pin controller present on BCM6846 family SoCs.

properties:
  compatible:
    const: brcm,bcm6846-pinctrl

  reg:
    maxItems: 1

patternProperties:
  '-pins$':
    type: object
    $ref: pinmux-node.yaml#
    additionalProperties: false

    properties:
      function:
        enum: [ led_0, led_1, led_2, led_3, led_4, led_5, led_6, led_7, led_8,
                led_9, led_10, led_11, led_12, led_13, led_14, led_15, led_16,
                led_17, ser_led, nand, emmc, spim, usb0_pwr, usb1_pwr, i2c,
                rgmii, mii, signal_detect, one_sec_pls, rogue_onu, wan, uart0,
                uart2 ]

      groups:
        minItems: 1
        # SPIM uses up to 5 groups for different select signals
        maxItems: 5
        items:
          enum: [ led_0_grp_a, led_0_grp_b, led_1_grp_a, led_1_grp_b,
                  led_2_grp_a, led_2_grp_b, led_3_grp_a, led_3_grp_b,
                  led_4_grp_a, led_4_grp_b, led_5_grp_a, led_5_grp_b,
                  led_6_grp_a, led_6_grp_b, led_7_grp_a, led_7_grp_b,
                  led_8_grp_a, led_8_grp_b, led_9_grp_a, led_9_grp_b,
                  led_10_grp_a, led_10_grp_b, led_11_grp_a, led_11_grp_b,
                  led_12_grp_a, led_12_grp_b, led_13_grp,
                  led_14_grp, led_15_grp, led_16_grp, led_17_grp,
                  ser_led_grp_a, ser_led_grp_b, nand_ctrl_grp, nand_data_grp,
                  nand_wp_grp, emmc_ctrl_grp, spim_grp_a, spim_ss0_grp_a,
                  spim_ss1_grp_a, spim_ss2_grp_a, spim_ss3_grp_a, spim_grp_b,
                  spim_ss0_grp_b, spim_ss1_grp_b, spim_ss2_grp_b, spim_ss3_grp_b,
                  spim_grp_c, spim_ss0_grp_c, spim_ss1_grp_c, spis_grp_a,
                  spis_ss_grp_a, spis_grp_b, spis_ss_grp_b, usb0_pwr_grp
                  usb1_pwr_grp, i2c_grp, rgmii_grp, rgmii_rx_ok_grp,
                  rgmii_start_stop_grp, mii_grp,
                  signal_detect_grp_a, signal_detect_grp_b, one_sec_pls_grp_a,
                  one_sec_pls_grp_b, rogue_onu_grp_a, rogue_onu_grp_b,
                  wan_mdio_grp, wan_nco_grp, wan_early_txen_grp_a,
                  wan_early_txen_grp_b, wan_nco_1pps_sig_grp_a,
                  wan_nco_1pps_sig_grp_b, uart0_grp, uart2_grp ]

allOf:
  - $ref: pinctrl.yaml#

required:
  - compatible
  - reg

unevaluatedProperties: false

examples:
  - |
    pinctrl@ff800550 {
        compatible = "brcm,bcm6846-pinctrl";
        reg = <0xff800550 0x10>;

        led-0-a-pins {
            function = "led_0";
            groups = "led_0_grp_a";
        };
    };
```
