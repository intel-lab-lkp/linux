## Documentation/devicetree/bindings/phy/starfive,jh7110-dphy-tx.yaml
```yaml
# SPDX-License-Identifier: (GPL-2.0 OR BSD-2-Clause)
%YAML 1.2
---
$id: http://devicetree.org/schemas/phy/starfive,jh7110-dphy-tx.yaml#
$schema: http://devicetree.org/meta-schemas/core.yaml#

title: Starfive SoC MIPI D-PHY Tx Controller

maintainers:
  - Keith Zhao <keith.zhao@starfivetech.com>
  - Shengyang Chen <shengyang.chen@starfivetech.com>

description:
  The Starfive SoC uses the MIPI DSI D-PHY based on M31 IP to transfer
  DSI data.

properties:
  compatible:
    const: starfive,jh7110-dphy-tx

  reg:
    maxItems: 1

  clocks:
    maxItems: 1

  clock-names:
    items:
      - const: dphy_txesc

  resets:
    items:
      - description: DSITX_TXBYTEHS reset
      - description: MIPITX_DPHY_SYS reset
      - description: MIPITX_DPHY_TXBYTEHS reset

  reset-names:
    items:
      - const: dsi_txbytehs
      - const: dphy_sys
      - const: dphy_txbytehs

  power-domains:
    maxItems: 1

  "#phy-cells":
    const: 0

required:
  - compatible
  - reg
  - clocks
  - clock-names
  - resets
  - reset-names
  - power-domains
  - "#phy-cells"

additionalProperties: false

examples:
  - |
    phy@295e0000 {
      compatible = "starfive,jh7110-dphy-tx";
      reg = <0x295e0000 0x10000>;
      clocks = <&voutcrg 14>;
      clock-names = "dphy_txesc";
      resets = <&syscrg 7>,
               <&syscrg 10>,
               <&syscrg 11>;
      reset-names = "dsi_txbytehs", "dphy_sys", "dphy_txbytehs";
      power-domains = <&aon_syscon 0>;
      #phy-cells = <0>;
    };
```

## Documentation/devicetree/bindings/phy/starfive,jh7110-inno-hdmi-phy.yaml
```yaml
# SPDX-License-Identifier: (GPL-2.0-only OR BSD-2-Clause)
%YAML 1.2
---
$id: http://devicetree.org/schemas/phy/starfive,jh7110-inno-hdmi-phy.yaml#
$schema: http://devicetree.org/meta-schemas/core.yaml#

title: StarFive JH7110 Innosilicon INNO HDMI PHY

maintainers:
  - Michal Wilczynski <m.wilczynski@samsung.com>

description:
  The PHY portion of the StarFive JH7110 INNO HDMI IP.

properties:
  compatible:
    const: starfive,jh7110-inno-hdmi-phy

  clocks:
    maxItems: 1
    description: Reference oscillator.

  '#clock-cells':
    const: 0

  '#phy-cells':
    const: 0

required:
  - compatible
  - clocks
  - '#clock-cells'
  - '#phy-cells'

additionalProperties: false

examples:
  # Shown as a child of the HDMI subsystem node; see
  # Documentation/devicetree/bindings/mfd/starfive,jh7110-hdmi-subsystem.yaml
  # for the full node.
  - |
    phy {
        compatible = "starfive,jh7110-inno-hdmi-phy";
        clocks = <&xin24m>;
        #clock-cells = <0>;
        #phy-cells = <0>;
    };

...
```

## Documentation/devicetree/bindings/phy/ti,control-phy-otghs.yaml
```yaml
# SPDX-License-Identifier: (GPL-2.0-only OR BSD-2-Clause)
%YAML 1.2
---
$id: http://devicetree.org/schemas/phy/ti,control-phy-otghs.yaml#
$schema: http://devicetree.org/meta-schemas/core.yaml#

title: TI OMAP Control PHY Module

maintainers:
  - Kishon Vijay Abraham I <kishon@ti.com>

description:
  The TI OMAP Control PHY module is a hardware block within the system
  control module (SCM) of Texas Instruments OMAP SoCs. It provides
  centralized control over power, configuration, and auxiliary features
  for multiple on-chip PHYs. This module is essential for proper PHY
  operation in power-constrained embedded systems.

properties:
  $nodename:
    pattern: "^control-phy(@[0-9a-f]+)?$"

  compatible:
    enum:
      - ti,control-phy-otghs
      - ti,control-phy-usb2
      - ti,control-phy-pipe3
      - ti,control-phy-pcie
      - ti,control-phy-usb2-dra7
      - ti,control-phy-usb2-am437

  reg:
    minItems: 1
    maxItems: 4

  reg-names:
    minItems: 1
    maxItems: 4
    items:
      enum: [otghs_control, power, pcie_pcs, control_sma]

allOf:
  - if:
      properties:
        compatible:
          contains:
            enum:
              - ti,control-phy-otghs
    then:
      properties:
        reg-names:
          const: otghs_control

  - if:
      properties:
        compatible:
          contains:
            enum:
              - ti,control-phy-pcie
    then:
      properties:
        reg-names:
          items:
            - enum: [power, pcie_pcs, control_sma]

  - if:
      properties:
        compatible:
          contains:
            enum:
              - ti,control-phy-usb2
              - ti,control-phy-usb2-dra7
              - ti,control-phy-usb2-am437
              - ti,control-phy-pipe3
    then:
      properties:
        reg-names:
          const: power

required:
  - reg
  - compatible
  - reg-names

unevaluatedProperties: false

examples:
  - |
    control-phy@4a00233c {
        compatible = "ti,control-phy-otghs";
        reg = <0x4a00233c 0x4>;
        reg-names = "otghs_control";
    };
...
```

## Documentation/devicetree/bindings/phy/ti,phy-usb3.yaml
```yaml
# SPDX-License-Identifier: (GPL-2.0-only OR BSD-2-Clause)
%YAML 1.2
---
$id: http://devicetree.org/schemas/phy/ti,phy-usb3.yaml#
$schema: http://devicetree.org/meta-schemas/core.yaml#

title: TI PIPE3 PHY Module

maintainers:
  - Kishon Vijay Abraham I <kishon@ti.com>

description:
  The TI PIPE3 PHY is a high-speed SerDes (Serializer/Deserializer)
  transceiver integrated in OMAP5, DRA7xx/AM57xx, and similar SoCs.
  It supports multiple protocols (USB3, SATA, PCIe) using the PIPE3
  interface standard, which defines a common physical layer for
  high-speed serial interfaces.

properties:
  $nodename:
    pattern: "^(pciephy|usb3phy|phy)(@[0-9a-f]+)?$"

  compatible:
    enum:
      - ti,phy-usb3
      - ti,phy-pipe3-sata
      - ti,phy-pipe3-pcie
      - ti,omap-usb3

  reg:
    minItems: 2
    maxItems: 3

  reg-names:
    minItems: 2
    maxItems: 3
    items:
      enum:
        - phy_rx
        - phy_tx
        - pll_ctrl

  "#phy-cells":
    const: 0

  clocks:
    minItems: 2
    maxItems: 7

  clock-names:
    minItems: 2
    maxItems: 7
    items:
      enum: [wkupclk, sysclk, refclk, dpll_ref,
             dpll_ref_m2, phy-div, div-clk]

  syscon-phy-power:
    $ref: /schemas/types.yaml#/definitions/phandle-array
    description:
      Phandle/offset pair to system control module register for PHY
      power on/off.

  syscon-pllreset:
    $ref: /schemas/types.yaml#/definitions/phandle-array
    description:
      Phandle/offset pair to CTRL_CORE_SMA_SW_0 register containing
      SATA_PLL_SOFT_RESET bit (SATA PHY only).

  syscon-pcs:
    $ref: /schemas/types.yaml#/definitions/phandle-array
    description:
      Phandle/offset pair to system control module for writing PCS delay value.

  ctrl-module:
    $ref: /schemas/types.yaml#/definitions/phandle
    description:
      Phandle of control module for PHY power on.
    deprecated: true

dependencies:
  syscon-pllreset:
    properties:
      compatible:
        contains:
          const: ti,phy-pipe3-sata

required:
  - reg
  - compatible
  - reg-names
  - "#phy-cells"
  - clocks
  - clock-names

unevaluatedProperties: false

examples:
  - |
    /* TI PIPE3 USB3 PHY */
    usb3phy@4a084400 {
        compatible = "ti,phy-usb3";
        reg = <0x4a084400 0x80>,
              <0x4a084800 0x64>,
              <0x4a084c00 0x40>;
        reg-names = "phy_rx", "phy_tx", "pll_ctrl";
        #phy-cells = <0>;
        clocks = <&usb_phy_cm_clk32k>,
                 <&sys_clkin>,
                 <&usb_otg_ss_refclk960m>;
        clock-names = "wkupclk", "sysclk", "refclk";
        ctrl-module = <&omap_control_usb>;
    };

  - |
    /* TI PIPE3 SATA PHY */
    phy@4a096000 {
        compatible = "ti,phy-pipe3-sata";
        reg = <0x4A096000 0x80>,  /* phy_rx */
              <0x4A096400 0x64>,  /* phy_tx */
              <0x4A096800 0x40>;  /* pll_ctrl */
        reg-names = "phy_rx", "phy_tx", "pll_ctrl";
        clocks = <&sys_clkin1>, <&sata_ref_clk>;
        clock-names = "sysclk", "refclk";
        syscon-pllreset = <&scm_conf 0x3fc>;
        #phy-cells = <0>;
    };
...
```

## Documentation/devicetree/bindings/phy/ti,tcan104x-can.yaml
```yaml
# SPDX-License-Identifier: (GPL-2.0-only OR BSD-2-Clause)
%YAML 1.2
---
$id: http://devicetree.org/schemas/phy/ti,tcan104x-can.yaml#
$schema: http://devicetree.org/meta-schemas/core.yaml#

title: TCAN104x CAN TRANSCEIVER PHY

maintainers:
  - Aswath Govindraju <a-govindraju@ti.com>

properties:
  $nodename:
    pattern: "^can-phy"

  compatible:
    oneOf:
      - items:
          - enum:
              - microchip,ata6561
          - const: ti,tcan1042
      - items:
          - enum:
              - nxp,tja1051
          - const: ti,tcan1043
      - enum:
          - ti,tcan1042
          - ti,tcan1043
          - nxp,tja1048
          - nxp,tjr1443

  '#phy-cells': true

  standby-gpios:
    description:
      gpio node to toggle standby signal on transceiver

  enable-gpios:
    description:
      gpio node to toggle enable signal on transceiver
    maxItems: 1

  max-bitrate:
    $ref: /schemas/types.yaml#/definitions/uint32
    description:
      max bit rate supported in bps
    minimum: 1

  mux-states:
    description:
      mux controller node to route the signals from controller to
      transceiver.
    maxItems: 1

required:
  - compatible
  - '#phy-cells'

allOf:
  - if:
      properties:
        compatible:
          contains:
            const: nxp,tja1048

    then:
      properties:
        '#phy-cells':
          const: 1
        standby-gpios:
          maxItems: 2
    else:
      properties:
        '#phy-cells':
          const: 0
        standby-gpios:
          maxItems: 1

additionalProperties: false

examples:
  - |
    #include <dt-bindings/gpio/gpio.h>

    transceiver1: can-phy {
      compatible = "ti,tcan1043";
      #phy-cells = <0>;
      max-bitrate = <5000000>;
      standby-gpios = <&wakeup_gpio1 16 GPIO_ACTIVE_LOW>;
      enable-gpios = <&main_gpio1 67 GPIO_ACTIVE_HIGH>;
      mux-states = <&mux0 1>;
    };
```

## Documentation/devicetree/bindings/phy/zte,zx297520v3-usb-phy.yaml
```yaml
# SPDX-License-Identifier: (GPL-2.0-only OR BSD-2-Clause)
%YAML 1.2
---
$id: http://devicetree.org/schemas/phy/zte,zx297520v3-usb-phy.yaml#
$schema: http://devicetree.org/meta-schemas/core.yaml#

title: ZTE zx297520v3 USB and HSIC PHY

maintainers:
  - Stefan Dösinger <stefandoesinger@gmail.com>

description: |
  This PHY is found on zx297520v3 boards. It has no configurability on its own,
  but it does require a correct reset and wait sequence to initialize. It can
  provide interrupt notification when USB is connected and disconnected.

  The phy is a component of the board's topcrm controller. The hardware needs to
  be declared as a child node of the zte,zx297520v3-topcrm node.

  The register space and IRQs always account for two PHYs: One USB 2.0 OTG phy
  and a HSIC PHY. Not all boards have both. If one is missing, the corresponding
  ready flag will never be set.

  The "include/dt-bindings/phy/phy-zte-zx297520v3-usb.h" header contains the
  definition for the PHY indices.

properties:
  compatible:
    const: zte,zx297520v3-usb-phy

  reg:
    maxItems: 1

  interrupts:
    items:
      - description: IRQ reporting USB connection
      - description: IRQ reporting USB disconnection
      - description: IRQ reporting HSIC connection
      - description: IRQ reporting HSIC disconnection

  interrupt-names:
    items:
      - const: usb-up
      - const: usb-down
      - const: hsic-up
      - const: hsic-down

  resets:
    items:
      - description: USB phy reset
      - description: HSIC phy reset

  reset-names:
    items:
      - const: usb
      - const: hsic

  "#phy-cells":
    const: 1

required:
  - compatible
  - reg
  - interrupts
  - interrupt-names
  - resets
  - reset-names
  - "#phy-cells"

additionalProperties: false

examples:
  - |
    #include <dt-bindings/interrupt-controller/arm-gic.h>
    #include <dt-bindings/phy/phy-zte-zx297520v3-usb.h>

    topcrm: clock-controller {
        compatible = "zte,zx297520v3-topcrm", "syscon";
        #address-cells = <1>;
        #size-cells = <0>;
        #reset-cells = <1>;

        usb-phy@84 {
          compatible = "zte,zx297520v3-usb-phy";
          reg = <0x84>;
          interrupts = <GIC_SPI 42 IRQ_TYPE_EDGE_RISING>,
            <GIC_SPI 43 IRQ_TYPE_EDGE_RISING>,
            <GIC_SPI 45 IRQ_TYPE_EDGE_RISING>,
            <GIC_SPI 46 IRQ_TYPE_EDGE_RISING>;
          interrupt-names = "usb-up", "usb-down", "hsic-up", "hsic-down";
          resets = <&topcrm 18>,
            <&topcrm 20>;
          reset-names = "usb", "hsic";
          #phy-cells = <1>;
        };
    };
```

## Documentation/devicetree/bindings/pinctrl/allwinner,sun8i-b288-pinctrl.yaml
```yaml
# SPDX-License-Identifier: (GPL-2.0-only OR BSD-2-Clause)
%YAML 1.2
---
$id: http://devicetree.org/schemas/pinctrl/allwinner,sun8i-b288-pinctrl.yaml#
$schema: http://devicetree.org/meta-schemas/core.yaml#

title: Allwinner B288 Pin Controller

maintainers:
  - Chen-Yu Tsai <wens@csie.org>
  - Jernej Skrabec <jernej.skrabec@gmail.com>

properties:
  compatible:
    const: allwinner,sun8i-b288-pinctrl

  reg:
    maxItems: 1

  interrupts:
    description:
      One interrupt per bank of external interrupt capable pins.
    maxItems: 4

  clocks:
    items:
      - description: Bus Clock
      - description: High Frequency Oscillator
      - description: Low Frequency Oscillator

  clock-names:
    items:
      - const: apb
      - const: hosc
      - const: losc

  gpio-controller: true
  interrupt-controller: true
  gpio-line-names: true

  "#gpio-cells":
    const: 3

  "#interrupt-cells":
    const: 3

patternProperties:
  "-pins$":
    type: object
    $ref: /schemas/pinctrl/pincfg-node.yaml#
    additionalProperties: false

    properties:
      pins: true
      function: true
      bias-pull-up: true
      bias-pull-down: true
      bias-disable: true
      drive-strength:
        enum: [10, 20, 30, 40]

    required:
      - pins
      - function

  "^vcc-p[bcdfg]-supply$":
    description:
      Power supplies for pin banks.

required:
  - compatible
  - reg
  - interrupts
  - clocks
  - clock-names
  - gpio-controller
  - "#gpio-cells"
  - interrupt-controller
  - "#interrupt-cells"

additionalProperties: false

examples:
  - |
    #include <dt-bindings/interrupt-controller/arm-gic.h>
    #include <dt-bindings/clock/sun8i-b288-ccu.h>

    pio: pinctrl@1c20800 {
        compatible = "allwinner,sun8i-b288-pinctrl";
        reg = <0x01c20800 0x400>;
        interrupts = <GIC_SPI 15 IRQ_TYPE_LEVEL_HIGH>,
                     <GIC_SPI 16 IRQ_TYPE_LEVEL_HIGH>,
                     <GIC_SPI 21 IRQ_TYPE_LEVEL_HIGH>,
                     <GIC_SPI 17 IRQ_TYPE_LEVEL_HIGH>;
        clocks = <&ccu CLK_BUS_PIO>, <&osc24M>, <&osc32k>;
        clock-names = "apb", "hosc", "losc";
        gpio-controller;
        #gpio-cells = <3>;
        interrupt-controller;
        #interrupt-cells = <3>;

        mmc0_pins: mmc0-pins {
            pins = "PF0", "PF1", "PF2", "PF3", "PF4", "PF5";
            function = "sdc0";
            drive-strength = <30>;
            bias-pull-up;
        };
    };
```
