## Documentation/devicetree/bindings/thunderbolt/qcom,usb4-hr.yaml
```yaml
# SPDX-License-Identifier: (GPL-2.0 OR BSD-2-Clause)
%YAML 1.2
---
$id: http://devicetree.org/schemas/thunderbolt/qcom,usb4-hr.yaml#
$schema: http://devicetree.org/meta-schemas/core.yaml#

title: Qualcomm USB4 Host Router

maintainers:
  - Konrad Dybcio <konrad.dybcio@oss.qualcomm.com>

description:
  The Qualcomm USB4 Host Router IP block implements the NHI standard
  as described in the USB4 specification.

properties:
  compatible:
    items:
      - enum:
          - qcom,x1e80100-usb4-hr # USB4v1
      - const: qcom,usb4-hr

  reg:
    maxItems: 17

  reg-names:
    items:
      - const: router
      - const: router_config
      - const: tmu_config
      - const: port_group
      - const: sideband
      - const: uc_ram
      - const: uc_per
      - const: uc_mbox
      - const: nhi
      - const: cfg
      - const: debug
      - const: usbap_config
      - const: pcieap_config
      - const: dpap0_aux
      - const: dpap0_config
      - const: dpap1_aux
      - const: dpap1_config

  interrupts:
    items:
      - description: Combined event interrupt for all three rings
      - description: OOB Firmware interrupt

  interrupt-names:
    items:
      - const: ring
      - const: fw

  clocks:
    maxItems: 10

  clock-names:
    items:
      - const: sys
      - const: tmu
      - const: ahb
      - const: axi
      - const: master
      - const: phy_rx0
      - const: phy_rx1
      - const: sb
      - const: dp0
      - const: dp1

  resets:
    maxItems: 13

  reset-names:
    items:
      - const: core
      - const: phy_nocsr
      - const: sys
      - const: rx0
      - const: rx1
      - const: usb_pipe
      - const: pcie_pipe
      - const: tmu
      - const: sideband_iface
      - const: hia_master
      - const: ahb
      - const: dp0
      - const: dp1

  power-domains:
    maxItems: 1

  required-opps:
    maxItems: 1

  phys:
    maxItems: 1

  phy-names:
    const: usb4

  iommus:
    maxItems: 1

  interconnects:
    maxItems: 2

  interconnect-names:
    items:
      - const: usb4-ddr
      - const: apps-usb4

  mode-switch: true

  wakeup-source: true

allOf:
  - $ref: /schemas/usb/usb-switch.yaml#

required:
  - compatible
  - reg
  - reg-names
  - interrupts
  - interrupt-names
  - clocks
  - clock-names
  - resets
  - reset-names
  - power-domains
  - phys
  - phy-names
  - iommus
  - interconnects
  - interconnect-names
  - mode-switch
  - port

unevaluatedProperties: false

examples:
  - |
    #include <dt-bindings/clock/qcom,x1e80100-gcc.h>
    #include <dt-bindings/interrupt-controller/arm-gic.h>
    #include <dt-bindings/interrupt-controller/irq.h>

    soc {
        #address-cells = <2>;
        #size-cells = <2>;

        usb4_router0: usb4-host-router@15600000 {
            compatible = "qcom,x1e80100-usb4-hr",
                         "qcom,usb4-hr";
            reg = <0x0 0x15600000 0x0 0x8000>,
                  <0x0 0x15608000 0x0 0x70>,
                  <0x0 0x15608070 0x0 0x500>,
                  <0x0 0x1560d000 0x0 0x1000>,
                  <0x0 0x15612000 0x0 0x1000>,
                  <0x0 0x15613000 0x0 0xe000>,
                  <0x0 0x15621000 0x0 0x2000>,
                  <0x0 0x15623000 0x0 0x2000>,
                  <0x0 0x1563f000 0x0 0x40000>,
                  <0x0 0x1567f000 0x0 0x1000>,
                  <0x0 0x15680000 0x0 0x1000>,
                  <0x0 0x15681000 0x0 0x1000>,
                  <0x0 0x15682000 0x0 0x1000>,
                  <0x0 0x15683000 0x0 0x1000>,
                  <0x0 0x15685000 0x0 0x1000>,
                  <0x0 0x15686000 0x0 0x1000>,
                  <0x0 0x15688000 0x0 0x1000>;
            reg-names = "router",
                        "router_config",
                        "tmu_config",
                        "port_group",
                        "sideband",
                        "uc_ram",
                        "uc_per",
                        "uc_mbox",
                        "nhi",
                        "cfg",
                        "debug",
                        "usbap_config",
                        "pcieap_config",
                        "dpap0_aux",
                        "dpap0_config",
                        "dpap1_aux",
                        "dpap1_config";

            interrupts = <GIC_SPI 472 IRQ_TYPE_LEVEL_HIGH>,
                         <GIC_SPI 579 IRQ_TYPE_LEVEL_HIGH>;
            interrupt-names = "ring",
                              "fw";

            clocks = <&gcc_usb4_0_sys_clk>,
                     <&gcc_usb4_0_tmu_clk>,
                     <&gcc_usb4_0_cfg_ahb_clk>,
                     <&gcc_aggre_usb4_0_axi_clk>,
                     <&gcc_usb4_0_master_clk>,
                     <&gcc_usb4_0_phy_rx0_clk>,
                     <&gcc_usb4_0_phy_rx1_clk>,
                     <&gcc_usb4_0_sb_if_clk>,
                     <&gcc_usb4_0_dp0_clk>,
                     <&gcc_usb4_0_dp1_clk>;
            clock-names = "sys",
                          "tmu",
                          "ahb",
                          "axi",
                          "master",
                          "phy_rx0",
                          "phy_rx1",
                          "sb",
                          "dp0",
                          "dp1";

            resets = <&gcc_usb4_0_bcr>,
                     <&gcc_usb4phy_phy_prim_bcr>,
                     <&gcc_usb4_0_misc_usb4_sys_bcr>,
                     <&gcc_usb4_0_misc_rx_clk_0_bcr>,
                     <&gcc_usb4_0_misc_rx_clk_1_bcr>,
                     <&gcc_usb4_0_misc_usb_pipe_bcr>,
                     <&gcc_usb4_0_misc_pcie_pipe_bcr>,
                     <&gcc_usb4_0_misc_tmu_bcr>,
                     <&gcc_usb4_0_misc_sb_if_bcr>,
                     <&gcc_usb4_0_misc_hia_mstr_bcr>,
                     <&gcc_usb4_0_misc_ahb_bcr>,
                     <&gcc_usb4_0_misc_dp0_max_pclk_bcr>,
                     <&gcc_usb4_0_misc_dp1_max_pclk_bcr>;
            reset-names = "core",
                          "phy_nocsr",
                          "sys",
                          "rx0",
                          "rx1",
                          "usb_pipe",
                          "pcie_pipe",
                          "tmu",
                          "sideband_iface",
                          "hia_master",
                          "ahb",
                          "dp0",
                          "dp1";

            power-domains = <&gcc GCC_USB4_0_GDSC>;

            phys = <&usb4_phy>;
            phy-names = "usb4";

            iommus = <&apps_smmu 0x1440 0x0>;

            interconnects = <&icc0 &icc1>,
                            <&icc2 &icc3>;
            interconnect-names = "usb4-ddr",
                                 "apps-usb4";

            mode-switch;

            port {
                usb4_0_mode_in: endpoint {
                };
            };
        };
    };
...
```

## Documentation/devicetree/bindings/timer/actions,owl-timer.yaml
```yaml
# SPDX-License-Identifier: GPL-2.0-only OR BSD-2-Clause
%YAML 1.2
---
$id: http://devicetree.org/schemas/timer/actions,owl-timer.yaml#
$schema: http://devicetree.org/meta-schemas/core.yaml#

title: Actions Semi Owl timer

maintainers:
  - Andreas Färber <afaerber@suse.de>

description: |
  Actions Semi Owl SoCs provide 32bit and 2Hz timers.
  The 32bit timers support dynamic irq, as well as one-shot mode.

properties:
  compatible:
    enum:
      - actions,s500-timer
      - actions,s700-timer
      - actions,s900-timer

  clocks:
    maxItems: 1

  interrupts:
    minItems: 1
    maxItems: 6

  interrupt-names:
    minItems: 1
    maxItems: 6
    items:
      enum:
        - 2hz0
        - 2hz1
        - timer0
        - timer1
        - timer2
        - timer3

  reg:
    maxItems: 1

required:
  - compatible
  - clocks
  - interrupts
  - interrupt-names
  - reg

additionalProperties: false
examples:
  - |
    #include <dt-bindings/interrupt-controller/arm-gic.h>
    #include <dt-bindings/interrupt-controller/irq.h>
    soc {
      #address-cells = <1>;
      #size-cells = <1>;
      timer@b0168000 {
        compatible = "actions,s500-timer";
        reg = <0xb0168000 0x100>;
        clocks = <&hosc>;
        interrupts = <GIC_SPI 8 IRQ_TYPE_LEVEL_HIGH>,
                     <GIC_SPI 9 IRQ_TYPE_LEVEL_HIGH>,
                     <GIC_SPI 10 IRQ_TYPE_LEVEL_HIGH>,
                     <GIC_SPI 11 IRQ_TYPE_LEVEL_HIGH>;
        interrupt-names = "2hz0", "2hz1", "timer0", "timer1";
      };
    };
...
```

## Documentation/devicetree/bindings/timer/andestech,plmt0.yaml
```yaml
# SPDX-License-Identifier: (GPL-2.0-only OR BSD-2-Clause)
%YAML 1.2
---
$id: http://devicetree.org/schemas/timer/andestech,plmt0.yaml#
$schema: http://devicetree.org/meta-schemas/core.yaml#

title: Andes machine timer

maintainers:
  - Ben Zong-You Xie <ben717@andestech.com>

properties:
  compatible:
    items:
      - enum:
          - andestech,qilai-aclint-mtimer
      - const: andestech,plmt0

  reg:
    maxItems: 1

  interrupts-extended:
    minItems: 1
    maxItems: 32

additionalProperties: false

required:
  - compatible
  - reg
  - interrupts-extended

examples:
  - |
    interrupt-controller@100000 {
      compatible = "andestech,qilai-aclint-mtimer", "andestech,plmt0";
      reg = <0x100000 0x100000>;
      interrupts-extended = <&cpu0intc 7>,
                            <&cpu1intc 7>,
                            <&cpu2intc 7>,
                            <&cpu3intc 7>;
    };
```

## Documentation/devicetree/bindings/timer/arm,sse_timer.yaml
```yaml
# SPDX-License-Identifier: (GPL-2.0-only OR BSD-2-Clause)
%YAML 1.2
---
$id: http://devicetree.org/schemas/timer/arm,sse_timer.yaml#
$schema: http://devicetree.org/meta-schemas/core.yaml#

title: ARM SSE(Subsystems for Embedded) system timer

maintainers:
  - Jisheng Zhang <jszhang@kernel.org>

description: |+
  ARM SSE(Subsystems for Embedded) system timer core may have a system counter
  to generate timestamp value, a system timer to raise an interrupt when a
  period has elapsed, and a System Watchdog to detect errant system behaviour
  then reset the system if a period elapses without ping.

properties:
  compatible:
    items:
      - enum:
          - arm,sse-timer

  reg:
    maxItems: 1
    description: The system counter control frame base

  clocks:
    maxItems: 1

  '#address-cells':
    enum: [1, 2]

  '#size-cells':
    const: 1

  ranges: true

patternProperties:
  '^frame@[0-9a-f]+$':
    type: object
    additionalProperties: false
    description: A timer node has some frame sub-nodes, each frame can be timer frame or watchdog frame. Each frame has the following properties.
    properties:
      interrupts:
        minItems: 1
        items:
          - description: timer irq

      reg:
        minItems: 1
        items:
          - description: 1st view base address
          - description: 2nd optional view base address if this is a watchdog frame

    required:
      - interrupts
      - reg

required:
  - compatible
  - reg
  - '#address-cells'
  - '#size-cells'

additionalProperties: false

examples:
  - |
    timer@f7f3e000 {
      compatible = "arm,sse-timer";
      #address-cells = <1>;
      #size-cells = <1>;
      ranges;
      reg = <0xf7f3e000 0x2000>;
      clocks = <&core_clk>;

      frame@f7f20000 {
        reg = <0xf7f20000 0x1000>;
        interrupts = <0 26 0x8>;
      };

      frame@f7f30000 {
        interrupts = <0 15 0x8>;
        reg = <0xf7f32000 0x1000>,
              <0xf7f33000 0x1000>;
      };
    };

...
```

## Documentation/devicetree/bindings/timer/econet,en751221-timer.yaml
```yaml
# SPDX-License-Identifier: (GPL-2.0 OR BSD-2-Clause)
%YAML 1.2
---
$id: http://devicetree.org/schemas/timer/econet,en751221-timer.yaml#
$schema: http://devicetree.org/meta-schemas/core.yaml#

title: EcoNet EN751221 High Precision Timer (HPT)

maintainers:
  - Caleb James DeLisle <cjd@cjdns.fr>

description:
  The EcoNet High Precision Timer (HPT) is a timer peripheral found in various
  EcoNet SoCs, including the EN751221 and EN751627 families. It provides per-VPE
  count/compare registers and a per-CPU control register. On EN751221 it uses a
  single interrupt line using a percpu-devid interrupt mechanism, and on
  EN751627 it uses an interrupt per VPE.

properties:
  compatible:
    enum:
      - econet,en751221-timer
      - econet,en751627-timer

  reg:
    minItems: 1
    maxItems: 2

  interrupts:
    minItems: 1
    maxItems: 4

  clocks:
    maxItems: 1

required:
  - compatible
  - reg
  - interrupts
  - clocks

allOf:
  - if:
      properties:
        compatible:
          contains:
            const: econet,en751627-timer
    then:
      properties:
        reg:
          items:
            - description: VPE timers 0 and 1
            - description: VPE timers 2 and 3
        interrupts:
          description: An interrupt for each timer (one per VPE)
          minItems: 4
    else:
      properties:
        reg:
          items:
            - description: VPE timers 0 and 1
        interrupts:
          description: A percpu-devid timer interrupt shared across timers
          maxItems: 1

additionalProperties: false

examples:
  - |
    #include <dt-bindings/interrupt-controller/mips-gic.h>
    timer@1fbf0400 {
        compatible = "econet,en751627-timer";
        reg = <0x1fbf0400 0x100>, <0x1fbe0000 0x100>;
        interrupt-parent = <&intc>;
        interrupts = <GIC_SHARED 30 IRQ_TYPE_LEVEL_HIGH>,
                     <GIC_SHARED 29 IRQ_TYPE_LEVEL_HIGH>,
                     <GIC_SHARED 37 IRQ_TYPE_LEVEL_HIGH>,
                     <GIC_SHARED 36 IRQ_TYPE_LEVEL_HIGH>;
        clocks = <&hpt_clock>;
    };
  - |
    timer@1fbf0400 {
        compatible = "econet,en751221-timer";
        reg = <0x1fbe0400 0x100>;
        interrupt-parent = <&intc>;
        interrupts = <30>;
        clocks = <&hpt_clock>;
    };
...
```

## Documentation/devicetree/bindings/timer/fsl,gtm.yaml
```yaml
# SPDX-License-Identifier: (GPL-2.0-only OR BSD-2-Clause)
%YAML 1.2
---
$id: http://devicetree.org/schemas/timer/fsl,gtm.yaml#
$schema: http://devicetree.org/meta-schemas/core.yaml#

title: Freescale General-purpose Timers Module

maintainers:
  - Rob Herring <robh@kernel.org>

properties:
  compatible:
    oneOf:
      - items:
          - enum:
              - fsl,mpc8308-gtm
              - fsl,mpc8313-gtm
              - fsl,mpc8315-gtm
          - const: fsl,gtm
      - items:
          - enum:
              - fsl,mpc8569-qe-gtm
              - fsl,mpc8360-qe-gtm
          - const: fsl,qe-gtm
          - const: fsl,gtm

  reg:
    maxItems: 1

  interrupts:
    maxItems: 4
    description:
      One interrupt for each timer

  clock-frequency:
    description: Specifies the frequency driving the timer.
    default: 0

required:
  - compatible
  - reg
  - interrupts
  - clock-frequency

additionalProperties: false

examples:
  - |
    timer@440 {
        compatible = "fsl,mpc8360-qe-gtm", "fsl,qe-gtm", "fsl,gtm";
        reg = <0x440 0x40>;
        interrupts = <12>, <13>, <14>, <15>;
        clock-frequency = <0>;
    };
```
