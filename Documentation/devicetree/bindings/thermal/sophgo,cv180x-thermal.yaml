## Documentation/devicetree/bindings/thermal/sophgo,cv180x-thermal.yaml
```yaml
# SPDX-License-Identifier: (GPL-2.0 OR BSD-2-Clause)
%YAML 1.2
---
$id: http://devicetree.org/schemas/thermal/sophgo,cv180x-thermal.yaml#
$schema: http://devicetree.org/meta-schemas/core.yaml#

title: Sophgo CV180x on-SoC Thermal Sensor

maintainers:
  - Haylen Chu <heylenay@outlook.com>

description: Binding for Sophgo CV180x on-SoC thermal sensor

properties:
  compatible:
    items:
      - enum:
          - sophgo,cv180x-thermal

  reg:
    maxItems: 1

  clocks:
    maxItems: 1

  '#thermal-sensor-cells':
    const: 0

required:
  - compatible
  - reg
  - clocks

additionalProperties: false

examples:
  - |
        #include <dt-bindings/clock/sophgo,cv1800.h>
        soc_temp: temperature_sensor@30e0000 {
                compatible = "sophgo,cv180x-thermal";
                reg = <0x30e0000 0x100>;
                clocks = <&clk CLK_TEMPSEN>;
                clock-names = "clk_tempsen";
                #thermal-sensor-cells = <0>;
        };
...
```

## Documentation/devicetree/bindings/thermal/st,stih407-thermal.yaml
```yaml
# SPDX-License-Identifier: (GPL-2.0-only OR BSD-2-Clause)
%YAML 1.2
---
$id: http://devicetree.org/schemas/thermal/st,stih407-thermal.yaml#
$schema: http://devicetree.org/meta-schemas/core.yaml#

title: STMicroelectronics STi digital thermal sensor (DTS)

maintainers:
  - Patrice Chotard <patrice.chotard@foss.st.com>
  - Lee Jones <lee@kernel.org>

description:
  Binding for Thermal Sensor device for STMicroelectronics STi SoCs series.

allOf:
  - $ref: thermal-sensor.yaml

properties:
  compatible:
    const: st,stih407-thermal

  clocks:
    maxItems: 1
    description: Phandle of the clock used by the thermal sensor.

  clock-names:
    items:
      - const: thermal

  reg:
    description:
      For non-sysconf based sensors, this should be the physical base
      address and length of the sensor's registers.

  interrupts:
    description: |
      Standard way to define interrupt number.
      For thermal sensor's for which no interrupt has been
      defined, a polling delay of 1000ms will be used to read the
      temperature from device.

required:
  - compatible
  - clocks
  - clock-names

unevaluatedProperties: false

examples:
  - |
    #include <dt-bindings/interrupt-controller/arm-gic.h>
    temp0@91a0000 {
        compatible = "st,stih407-thermal";
        reg = <0x91a0000 0x28>;
        clock-names = "thermal";
        clocks = <&CLK_SYSIN>;
        interrupts = <GIC_SPI 205 IRQ_TYPE_EDGE_RISING>;
        #thermal-sensor-cells = <0>;
    };
...
```

## Documentation/devicetree/bindings/thunderbolt/apple,t8103-usb4-acio.yaml
```yaml
# SPDX-License-Identifier: GPL-2.0 OR BSD-2-Clause
%YAML 1.2
---
$id: http://devicetree.org/schemas/thunderbolt/apple,t8103-usb4-acio.yaml#
$schema: http://devicetree.org/meta-schemas/core.yaml#

title: Apple Silicon USB4/Thunderbolt Host Router (ACIO)

maintainers:
  - Sven Peter <sven@kernel.org>

description: |
  Each Type-C port with USB4/Thunderbolt support on Apple Silicon SoCs has a
  host router complex called ACIO (Apple Converged I/O). It contains a
  Cortex-M3 co-processor, the hardware blocks implementing the USB4 router
  and its PCIe, USB3 and DisplayPort adapters.

  The co-processor exposes the Native Host Interface (NHI) and its DART IOMMU
  to the main SoC bus once it is running. They are therefore represented as
  child nodes. All child registers are located in a single 16 MiB MMIO window
  and use addresses relative to this window.

  ACIO can only be powered on after the Type-C PHY has been switched to
  USB4/Thunderbolt mode. Before the connection to the remote device can be
  established the Type-C PD controller has to pass the cable information
  through the thunderbolt-switch connection.

properties:
  compatible:
    oneOf:
      - const: apple,t8103-usb4-acio
      - items:
          - enum:
              - apple,t6000-usb4-acio
              - apple,t6020-usb4-acio
              - apple,t6030-usb4-acio
              - apple,t6031-usb4-acio
              - apple,t8112-usb4-acio
              - apple,t8122-usb4-acio
          - const: apple,t8103-usb4-acio

  reg:
    items:
      - description: Root complex and co-processor control registers
      - description: SRAM used for communication with the co-processor

  reg-names:
    items:
      - const: rc
      - const: sram

  mboxes:
    maxItems: 1
    description: Mailbox used for RTKit communication with the co-processor

  resets:
    maxItems: 1
    description: Reset used to start the ACIO block before booting the
      co-processor

  power-domains:
    maxItems: 3

  thunderbolt-switch: true

  apple,tunable-rc:
    $ref: /schemas/types.yaml#/definitions/uint32-matrix
    items:
      items:
        - description: Register offset
        - description: Mask of bits to clear
        - description: Bits to set
    description: |
      List of (register offset, mask, value) tuples copied from Apple's Device
      Tree, converted by the bootloader and used to configure the root complex
      after the co-processor has booted.

  '#address-cells':
    const: 1

  '#size-cells':
    const: 1

  ranges:
    maxItems: 1
    description: Single 16 MiB MMIO window containing all child registers

  nonposted-mmio: true

  ports:
    $ref: /schemas/graph.yaml#/properties/ports
    description:
      OF graph ports for the USB4 router. The port numbers correspond to the
      USB4 router adapter numbers.
    properties:
      port@1:
        $ref: /schemas/graph.yaml#/properties/port
        description: USB4 port connected to the USB Type-C connector

      # port@2 is the second, unused USB4 port of the host router

      port@3:
        $ref: /schemas/graph.yaml#/properties/port
        description: PCIe adapter

      port@4:
        $ref: /schemas/graph.yaml#/properties/port
        description: USB3 adapter

      port@5:
        $ref: /schemas/graph.yaml#/properties/port
        description: First DP IN adapter

      port@6:
        $ref: /schemas/graph.yaml#/properties/port
        description: Second DP IN adapter

    required:
      - port@1

  iommu@a80000:
    $ref: /schemas/iommu/apple,dart.yaml#
    description: DART IOMMU exposed by ACIO and used for DMA from the NHI

  nhi@f00000:
    $ref: /schemas/thunderbolt/apple,t8103-usb4-nhi.yaml#
    description: Native Host Interface exposed by ACIO

required:
  - compatible
  - reg
  - reg-names
  - mboxes
  - power-domains
  - resets
  - thunderbolt-switch
  - '#address-cells'
  - '#size-cells'
  - ranges
  - nonposted-mmio
  - ports
  - iommu@a80000
  - nhi@f00000

allOf:
  - $ref: /schemas/usb/usb-switch.yaml#

additionalProperties: false

examples:
  - |
    soc {
        #address-cells = <2>;
        #size-cells = <2>;

        cio@501ac0000 {
            compatible = "apple,t8103-usb4-acio";
            reg = <0x5 0x01ac0000 0x0 0xc000>,
                  <0x5 0x01080000 0x0 0x20000>;
            reg-names = "rc", "sram";
            ranges = <0x0 0x5 0x01000000 0x1000000>;
            #address-cells = <1>;
            mboxes = <&usb4_1_mbox>;
            nonposted-mmio;
            pinctrl-0 = <&acio1_pins>;
            pinctrl-names = "default";
            power-domains = <&ps_atc1_cio>,
                            <&ps_atc1_cio_pcie>,
                            <&ps_atc1_cio_usb>;
            resets = <&cio_reset 1>;
            #size-cells = <1>;
            thunderbolt-switch;

            ports {
                #address-cells = <1>;
                #size-cells = <0>;

                port@1 {
                    reg = <1>;

                    endpoint {
                        remote-endpoint = <&typec1_con_tbt>;
                    };
                };
            };

            usb4_1_dart: iommu@a80000 {
                compatible = "apple,t8103-dart";
                reg = <0xa80000 0x4000>;
                interrupt-parent = <&aic>;
                interrupts = <1 890 4>;
                #iommu-cells = <1>;
            };

            nhi@f00000 {
                compatible = "apple,t8103-usb4-nhi";
                reg = <0xf00000 0x100000>,
                      <0xdb0000 0x30004>;
                reg-names = "nhi", "pdf";
                interrupt-parent = <&aic>;
                interrupts = <1 863 4>, <1 864 4>, <1 865 4>, <1 866 4>,
                             <1 867 4>, <1 868 4>, <1 869 4>, <1 870 4>,
                             <1 871 4>, <1 872 4>, <1 873 4>, <1 874 4>,
                             <1 875 4>, <1 876 4>, <1 877 4>, <1 878 4>,
                             <1 879 4>, <1 880 4>, <1 881 4>, <1 882 4>,
                             <1 883 4>, <1 884 4>, <1 885 4>, <1 886 4>;
                interrupt-names = "txring0", "txring1", "txring2", "txring3",
                                  "txring4", "txring5", "txring6", "txring7",
                                  "txring8", "txring9", "txring10", "txring11",
                                  "rxring0", "rxring1", "rxring2", "rxring3",
                                  "rxring4", "rxring5", "rxring6", "rxring7",
                                  "rxring8", "rxring9", "rxring10", "rxring11";
                iommus = <&usb4_1_dart 1>;
                /* To be filled by the loader */
                apple,thunderbolt-drom = [00];
            };
        };
    };
```

## Documentation/devicetree/bindings/thunderbolt/apple,t8103-usb4-nhi.yaml
```yaml
# SPDX-License-Identifier: GPL-2.0 OR BSD-2-Clause
%YAML 1.2
---
$id: http://devicetree.org/schemas/thunderbolt/apple,t8103-usb4-nhi.yaml#
$schema: http://devicetree.org/meta-schemas/core.yaml#

title: Apple Silicon USB4/Thunderbolt Native Host Interface (NHI)

maintainers:
  - Sven Peter <sven@kernel.org>

description: |
  On Apple Silicon SoCs the Native Host Interface (NHI) is part of the ACIO
  host router. It provides the transmit and receive rings used by the software
  connection manager.

  The ACIO co-processor exposes its registers to the main SoC bus while it is
  running. The NHI is therefore represented as a child of the ACIO node.

properties:
  compatible:
    oneOf:
      - const: apple,t8103-usb4-nhi
      - items:
          - enum:
              - apple,t6000-usb4-nhi
              - apple,t6020-usb4-nhi
              - apple,t6030-usb4-nhi
              - apple,t6031-usb4-nhi
              - apple,t8112-usb4-nhi
              - apple,t8122-usb4-nhi
          - const: apple,t8103-usb4-nhi

  reg:
    items:
      - description: NHI registers with the transmit and receive rings
      - description:
          Protocol Defined Field (PDF) bitmasks selecting which frames are
          accepted by each receive ring

  reg-names:
    items:
      - const: nhi
      - const: pdf

  interrupts:
    description:
      One interrupt for each of the 12 transmit rings followed by one for each
      of the 12 receive rings.
    maxItems: 24

  interrupt-names:
    items:
      - const: txring0
      - const: txring1
      - const: txring2
      - const: txring3
      - const: txring4
      - const: txring5
      - const: txring6
      - const: txring7
      - const: txring8
      - const: txring9
      - const: txring10
      - const: txring11
      - const: rxring0
      - const: rxring1
      - const: rxring2
      - const: rxring3
      - const: rxring4
      - const: rxring5
      - const: rxring6
      - const: rxring7
      - const: rxring8
      - const: rxring9
      - const: rxring10
      - const: rxring11

  iommus:
    minItems: 1
    maxItems: 24
    description: |
      T8103 and T8112 use a single IOMMU for all DMA transactions.

      T6000 and T6020 use two IOMMUs: The first is used for transmit ring 0
      and receive ring 0 which carry control traffic. The second is shared by
      all other rings which are only used for XDomain connections to other
      hosts.

      T6030, T6031 and T8122 use 24 IOMMUs. These are most likely one DART
      stream for each of the 12 transmit and 12 receive rings.

  apple,thunderbolt-drom:
    $ref: /schemas/types.yaml#/definitions/uint8-array
    description:
      DROM of the host router built by the bootloader from Apple's Device Tree.

  apple,tunable-nhi:
    $ref: /schemas/types.yaml#/definitions/uint32-matrix
    items:
      items:
        - description: Register offset
        - description: Mask of bits to clear
        - description: Bits to set
    description: |
      List of (register offset, mask, value) tuples copied from Apple's Device
      Tree, converted by the bootloader and used to configure the NHI after
      the co-processor has booted.

required:
  - compatible
  - reg
  - reg-names
  - interrupts
  - interrupt-names
  - iommus
  - apple,thunderbolt-drom

allOf:
  - if:
      properties:
        compatible:
          contains:
            enum:
              - apple,t6030-usb4-nhi
              - apple,t6031-usb4-nhi
              - apple,t8122-usb4-nhi
    then:
      properties:
        iommus:
          minItems: 24
          maxItems: 24
    else:
      if:
        properties:
          compatible:
            contains:
              enum:
                - apple,t6000-usb4-nhi
                - apple,t6020-usb4-nhi
      then:
        properties:
          iommus:
            minItems: 2
            maxItems: 2
      else:
        properties:
          iommus:
            maxItems: 1

additionalProperties: false
```
