## Documentation/devicetree/bindings/timer/mips,p8700-gcru.yaml
```yaml
# SPDX-License-Identifier: (GPL-2.0-only OR BSD-2-Clause)
%YAML 1.2
---
$id: http://devicetree.org/schemas/timer/mips,p8700-gcru.yaml#
$schema: http://devicetree.org/meta-schemas/core.yaml#

title: GCR.U timer device for the MIPS P8700 platform

maintainers:
  - Aleksa Paunovic <aleksa.paunovic@htecgroup.com>

description:
  The GCR.U memory region contains memory mapped shadow copies of
  mtime and hrtime Global Configuration Registers,
  which software can choose to make accessible from user mode.

properties:
  compatible:
    const: mips,p8700-gcru

  reg:
    items:
      - description: Read-only shadow copy of the RISC-V mtime register.
      - description: Read-only shadow copy of the P8700 high resolution timer register.

required:
  - compatible
  - reg

additionalProperties: false

examples:
  - |
    timer@1617f000 {
        compatible = "mips,p8700-gcru";
        reg = <0x1617f050 0x8>,
              <0x1617f090 0x8>;
    };
```

## Documentation/devicetree/bindings/timer/realtek,otto-timer.yaml
```yaml
# SPDX-License-Identifier: (GPL-2.0-only OR BSD-2-Clause)
%YAML 1.2
---
$id: http://devicetree.org/schemas/timer/realtek,otto-timer.yaml#
$schema: http://devicetree.org/meta-schemas/core.yaml#

title: Realtek Otto SoCs Timer/Counter

description:
  Realtek SoCs support a number of timers/counters. These are used
  as a per CPU clock event generator and an overall CPU clocksource.

maintainers:
  - Chris Packham <chris.packham@alliedtelesis.co.nz>

properties:
  $nodename:
    pattern: "^timer@[0-9a-f]+$"

  compatible:
    items:
      - enum:
          - realtek,rtl9302-timer
      - const: realtek,otto-timer

  reg:
    maxItems: 5

  clocks:
    maxItems: 1

  interrupts:
    maxItems: 5

allOf:
  - if:
      properties:
        compatible:
          contains:
            const: realtek,rtl9302-timer
    then:
      properties:
        reg:
          minItems: 2
        interrupts:
          minItems: 2

required:
  - compatible
  - reg
  - clocks
  - interrupts

additionalProperties: false

examples:
  - |
    timer@3200 {
      compatible = "realtek,rtl9302-timer", "realtek,otto-timer";
      reg = <0x3200 0x10>, <0x3210 0x10>, <0x3220 0x10>,
            <0x3230 0x10>, <0x3240 0x10>;

      interrupt-parent = <&intc>;
      interrupts = <7>, <8>, <9>, <10>, <11>;
      clocks = <&lx_clk>;
    };
```

## Documentation/devicetree/bindings/timer/realtek,rtd1625-systimer.yaml
```yaml
# SPDX-License-Identifier: (GPL-2.0-only OR BSD-2-Clause)
%YAML 1.2
---
$id: http://devicetree.org/schemas/timer/realtek,rtd1625-systimer.yaml#
$schema: http://devicetree.org/meta-schemas/core.yaml#

title: Realtek System Timer

maintainers:
  - Hao-Wen Ting <haowen.ting@realtek.com>

description: |
  The Realtek SYSTIMER (System Timer) is a 64-bit timer that can be used as
  a tick broadcast timer on multi-core Realtek SoCs. It remains active during
  deep CPU idle states where local timers are powered off, allowing all CPUs
  to enter power-cut idle states simultaneously for better power efficiency.

  The timer operates at a fixed 1MHz frequency and supports oneshot mode
  for tick broadcast functionality.

  The SYSTIMER hardware for both RTD1625 and RTD1635 SoCs has identical register
  layout and IRQ configuration. The driver therefore matches both compatibles
  without special handling.

properties:
  compatible:
    items:
      - enum:
          - realtek,rtd1625-systimer
          - realtek,rtd1635-systimer
      - const: realtek,rtd1625-systimer

  reg:
    maxItems: 1

  interrupts:
    maxItems: 1

required:
  - compatible
  - reg
  - interrupts

additionalProperties: false

examples:
  - |
    #include <dt-bindings/interrupt-controller/arm-gic.h>

    timer@89420 {
        compatible = "realtek,rtd1635-systimer",
                     "realtek,rtd1625-systimer";
        reg = <0x89420 0x18>;
        interrupts = <GIC_SPI 112 IRQ_TYPE_LEVEL_HIGH>;
    };
```

## Documentation/devicetree/bindings/timer/realtek,systimer.yaml
```yaml
# SPDX-License-Identifier: (GPL-2.0-only OR BSD-2-Clause)
%YAML 1.2
---
$id: http://devicetree.org/schemas/timer/realtek,systimer.yaml#
$schema: http://devicetree.org/meta-schemas/core.yaml#

title: Realtek SYSTIMER

maintainers:
  - Hao-Wen Ting <hao-wen.ting@realtek.com>

description: |
  The Realtek SYSTIMER is a 64-bit timer that can be used as a tick
  broadcast timer on multi-core Realtek SoCs. It remains active during
  deep CPU idle states where local timers are powered off, allowing all
  CPUs to enter power-cut idle states simultaneously for better power
  efficiency.

  The timer operates at a fixed 1MHz frequency and supports oneshot mode
  for tick broadcast functionality.

properties:
  compatible:
    const: realtek,systimer

  reg:
    description: |
      Physical base address and length of the timer's memory mapped
      registers. The register range contains the 64-bit timestamp counter,
      compare value registers, control and status registers.
    maxItems: 1

  interrupts:
    description: |
      Timer interrupt specifier. This interrupt is triggered when the
      timer compare value matches the current timestamp counter.
    maxItems: 1

required:
  - compatible
  - reg
  - interrupts

additionalProperties: false

examples:
  - |
    #include <dt-bindings/interrupt-controller/arm-gic.h>

    systimer: systimer@89420 {
        compatible = "realtek,systimer";
        reg = <0x89420 0x18>;
        interrupts = <GIC_SPI 112 IRQ_TYPE_LEVEL_HIGH>;
    };
```

## Documentation/devicetree/bindings/timer/riscv,aclint-mtimer.yaml
```yaml
# SPDX-License-Identifier: (GPL-2.0-only OR BSD-2-Clause)
%YAML 1.2
---
$id: http://devicetree.org/schemas/timer/riscv,aclint-mtimer.yaml#
$schema: http://devicetree.org/meta-schemas/core.yaml#

title: RISC-V Advanced Core Local Interruptor (ACLINT) Machine-level Timer

maintainers:
  - Joel Stanley <jms@oss.tenstorrent.com>

description:
  The RISC-V machine-level timer exposes the memory-mapped mtime and per-hart
  mtimecmp registers defined in The RISC-V Instruction Set Manual, Volume II
  Privileged Architecture, 3.2.1. Machine Timer (mtime and mtimecmp) Registers.

properties:
  compatible:
    items:
      - enum:
          - tenstorrent,atlantis-aclint-mtimer
          - qemu,aclint-mtimer
      - const: riscv,aclint-mtimer

  reg:
    items:
      - description: MTIMECMP registers, one per hart
      - description: MTIME register

  reg-names:
    items:
      - const: mtimecmp
      - const: mtime

  interrupts-extended:
    minItems: 1
    maxItems: 4095

required:
  - compatible
  - reg

unevaluatedProperties: false

examples:
  - |
    timer@ac000000 {
      compatible = "tenstorrent,atlantis-aclint-mtimer", "riscv,aclint-mtimer";
      reg = <0xac000000 0x8000>, <0xac008000 0x8000>;
      reg-names = "mtimecmp", "mtime";
      interrupts-extended = <&cpu1intc 7>,
                            <&cpu2intc 7>,
                            <&cpu3intc 7>,
                            <&cpu4intc 7>;
    };
...
```

## Documentation/devicetree/bindings/timer/thead,c900-aclint-mtimer.yaml
```yaml
# SPDX-License-Identifier: (GPL-2.0-only OR BSD-2-Clause)
%YAML 1.2
---
$id: http://devicetree.org/schemas/timer/thead,c900-aclint-mtimer.yaml#
$schema: http://devicetree.org/meta-schemas/core.yaml#

title: ACLINT Machine-level Timer Device

maintainers:
  - Inochi Amaoto <inochiama@outlook.com>

properties:
  compatible:
    oneOf:
      - items:
          - enum:
              - sophgo,sg2042-aclint-mtimer
              - sophgo,sg2044-aclint-mtimer
          - const: thead,c900-aclint-mtimer
      - items:
          - const: gf,mips-p8700-aclint-mtimer
      - items:
          - enum:
              - anlogic,dr1v90-aclint-mtimer
          - const: nuclei,ux900-aclint-mtimer

  reg:
    minItems: 1
    maxItems: 2

  reg-names:
    minItems: 1
    maxItems: 2

  interrupts-extended:
    minItems: 1
    maxItems: 4095

additionalProperties: false

required:
  - compatible
  - reg
  - reg-names
  - interrupts-extended

allOf:
  - if:
      properties:
        compatible:
          contains:
            const: gf,mips-p8700-aclint-mtimer
    then:
      properties:
        reg:
          minItems: 2
        reg-names:
          items:
            - const: mtime
            - const: mtimecmp
    else:
      properties:
        reg:
          maxItems: 1
        reg-names:
          items:
            - const: mtimecmp

examples:
  - |
    timer@ac000000 {
      compatible = "sophgo,sg2042-aclint-mtimer", "thead,c900-aclint-mtimer";
      interrupts-extended = <&cpu1intc 7>,
                            <&cpu2intc 7>,
                            <&cpu3intc 7>,
                            <&cpu4intc 7>;
      reg = <0xac000000 0x00010000>;
      reg-names = "mtimecmp";
    };

  - |
    timer@16108050 {
      compatible = "gf,mips-p8700-aclint-mtimer";
      reg = <0x16108050 0x8>, <0x16154000 0x7ff8>;
      reg-names = "mtime", "mtimecmp";
      interrupts-extended = <&cpu1intc 7>,
                            <&cpu2intc 7>,
                            <&cpu3intc 7>,
                            <&cpu4intc 7>;
    };
...
```

## Documentation/devicetree/bindings/ufs/mediatek,ufs.yaml
```yaml
# SPDX-License-Identifier: GPL-2.0-only OR BSD-2-Clause
%YAML 1.2
---
$id: http://devicetree.org/schemas/ufs/mediatek,ufs.yaml#
$schema: http://devicetree.org/meta-schemas/core.yaml#

title: Mediatek Universal Flash Storage (UFS) Controller

maintainers:
  - Peter Wang <peter.wang@mediatek.com>
  - Chaotian Jing <chaotian.jing@mediatek.com>

properties:
  compatible:
    enum:
      - mediatek,mt8183-ufshci
      - mediatek,mt8192-ufshci
      - mediatek,mt8195-ufshci

  clocks:
    minItems: 1
    maxItems: 10

  clock-names:
    minItems: 1
    items:
      - const: main
      - const: aes
      - const: tick
      - const: unipro_sysclk
      - const: unipro_tick
      - const: unipro_mp_bclk
      - const: tx_symbol
      - const: mem_sub
      - const: rx_symbol0
      - const: rx_symbol1

  operating-points-v2: true

  freq-table-hz: false

  phys:
    maxItems: 1

  reg:
    maxItems: 1

  resets:
    items:
      - description: reset for the UniPro layer
      - description: reset for the cryptography engine
      - description: reset for the host controller

  reset-names:
    items:
      - const: unipro
      - const: crypto
      - const: hci

  avdd09-supply:
    description: Phandle to the 0.9V supply powering the AVDD09_UFS pin

  avdd12-supply:
    description: Phandle to the 1.2V supply powering the AVDD12_UFS pin

  avdd12-ckbuf-supply:
    description: Phandle to the 1.2V supply powering the AVDD12_CKBUF_UFS pin

  avdd18-supply:
    description: Phandle to the 1.8V supply powering the AVDD18_UFS pin

  vcc-supply: true

  vccq-supply: true

  vccq2-supply: true

  mediatek,ufs-disable-mcq:
    $ref: /schemas/types.yaml#/definitions/flag
    description: The mask to disable MCQ (Multi-Circular Queue) for UFS host.

required:
  - compatible
  - clocks
  - clock-names
  - phys
  - reg
  - vcc-supply

unevaluatedProperties: false

allOf:
  - $ref: ufs-common.yaml

  - if:
      properties:
        compatible:
          contains:
            const: mediatek,mt8183-ufshci
    then:
      properties:
        clocks:
          maxItems: 1
        clock-names:
          items:
            - const: main
        avdd12-ckbuf-supply: false
  - if:
      properties:
        compatible:
          contains:
            const: mediatek,mt8192-ufshci
    then:
      properties:
        clocks:
          minItems: 3
          maxItems: 3
        clock-names:
          minItems: 3
          maxItems: 3
        avdd09-supply: false
  - if:
      properties:
        compatible:
          contains:
            const: mediatek,mt8195-ufshci
    then:
      properties:
        clocks:
          minItems: 10
        clock-names:
          minItems: 10
        avdd09-supply: false

examples:
  - |
    #include <dt-bindings/clock/mt8183-clk.h>
    #include <dt-bindings/interrupt-controller/arm-gic.h>

    soc {
        #address-cells = <2>;
        #size-cells = <2>;

        ufs@ff3c0000 {
            compatible = "mediatek,mt8183-ufshci";
            reg = <0 0x11270000 0 0x2300>;
            interrupts = <GIC_SPI 104 IRQ_TYPE_LEVEL_LOW>;
            phys = <&ufsphy>;

            clocks = <&infracfg_ao CLK_INFRA_UFS>;
            clock-names = "main";

            vcc-supply = <&mt_pmic_vemc_ldo_reg>;
        };
    };
  - |
    ufshci@11270000 {
        compatible = "mediatek,mt8195-ufshci";
        reg = <0x11270000 0x2300>;
        interrupts = <GIC_SPI 137 IRQ_TYPE_LEVEL_HIGH>;
        phys = <&ufsphy>;
        clocks = <&infracfg_ao 63>, <&infracfg_ao 64>, <&infracfg_ao 65>,
                 <&infracfg_ao 54>, <&infracfg_ao 55>, <&infracfg_ao 56>,
                 <&infracfg_ao 90>, <&infracfg_ao 93>, <&topckgen 212>,
                 <&topckgen 215>;
        clock-names = "main", "aes", "tick", "unipro_sysclk", "unipro_tick",
                      "unipro_mp_bclk", "tx_symbol", "mem_sub", "rx_symbol0",
                      "rx_symbol1";

        operating-points-v2 = <&ufs_opp_table>;

        avdd12-supply = <&mt6359_vrf12_ldo_reg>;
        avdd12-ckbuf-supply = <&mt6359_vbbck_ldo_reg>;
        avdd18-supply = <&mt6359_vio18_ldo_reg>;
        vcc-supply = <&mt6359_vemc_1_ldo_reg>;
        vccq2-supply = <&mt6359_vufs_ldo_reg>;

        mediatek,ufs-disable-mcq;
    };
```

## Documentation/devicetree/bindings/ufs/nxp,s32n7-ufshc.yaml
```yaml
# SPDX-License-Identifier: GPL-2.0-only OR BSD-2-Clause
%YAML 1.2
---
$id: http://devicetree.org/schemas/ufs/nxp,s32n7-ufshc.yaml#
$schema: http://devicetree.org/meta-schemas/core.yaml#

title: NXP S32N79 Universal Flash Storage (UFS) Controller

maintainers:
  - Larisa Grigore <larisa.grigore@oss.nxp.com>

# Select only our matches, not all jedec,ufs
select:
  properties:
    compatible:
      contains:
        const: nxp,s32n79-ufshc
  required:
    - compatible

properties:
  compatible:
    items:
      - const: nxp,s32n79-ufshc
      - const: jedec,ufs-3.0

  reg:
    minItems: 1
    items:
      - description: UFS Host Controller registers
      - description: System Control Module registers

  reg-names:
    description: |
      Names for the register regions. The first entry must be "ufshc".
      The second entry "scm" is mandatory only when nxp,mphy-boot-mode
      property is present.
    minItems: 1
    items:
      - const: ufshc
      - const: scm

  clocks:
    maxItems: 1
    description: UFS core clock

  clock-names:
    items:
      - const: core_clk

  nxp,mphy-boot-mode:
    description: |
      MPHY initialization mode. Defines how the MPHY firmware should be
      initialized and executed during UFS controller startup.
      If this property is not specified, MPHY initialization will be skipped.
    $ref: /schemas/types.yaml#/definitions/string
    enum:
      - rom

required:
  - compatible
  - reg

allOf:
  - $ref: ufs-common.yaml
  - if:
      required:
        - nxp,mphy-boot-mode
    then:
      properties:
        reg:
          minItems: 2
        reg-names:
          minItems: 2
      required:
        - reg-names
        - clocks
        - clock-names
    else:
      properties:
        reg:
          maxItems: 1
        reg-names:
          maxItems: 1

unevaluatedProperties: false

examples:
  - |
    ufshc@4ac80000 {
        compatible = "nxp,s32n79-ufshc", "jedec,ufs-3.0";
        reg = <0x4ac80000 0x1000>, <0x4ac40000 0x1000>;
        reg-names = "ufshc", "scm";
        interrupt-parent = <&irqsteer_coss>;
        interrupts = <211>;
        clocks = <&sys_clk>;
        clock-names = "core_clk";
        nxp,mphy-boot-mode = "rom";
    };
```
