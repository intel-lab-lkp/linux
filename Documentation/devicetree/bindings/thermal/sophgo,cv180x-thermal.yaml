## Documentation/devicetree/bindings/ufs/nxp,s32n79-ufshc.yaml
```yaml
# SPDX-License-Identifier: GPL-2.0-only OR BSD-2-Clause
%YAML 1.2
---
$id: http://devicetree.org/schemas/ufs/nxp,s32n79-ufshc.yaml#
$schema: http://devicetree.org/meta-schemas/core.yaml#

title: NXP S32N79 Universal Flash Storage (UFS) Controller

maintainers:
  - Larisa Grigore <larisa.grigore@oss.nxp.com>

properties:
  compatible:
    const: nxp,s32n79-ufshc

  reg:
    items:
      - description: UFS Host Controller registers
      - description: System Control Module registers

  reg-names:
    items:
      - const: ufshc
      - const: scm

  clocks:
    maxItems: 1

  clock-names:
    items:
      - const: core

required:
  - compatible
  - reg
  - reg-names
  - clocks
  - clock-names
  - operating-points-v2

allOf:
  - $ref: ufs-common.yaml

unevaluatedProperties: false

examples:
  - |
    ufshc@4ac80000 {
        compatible = "nxp,s32n79-ufshc";
        reg = <0x4ac80000 0x1000>, <0x4ac40000 0x1000>;
        reg-names = "ufshc", "scm";
        interrupt-parent = <&irqsteer_coss>;
        interrupts = <211>;
        clocks = <&clks 0x92>;
        clock-names = "core";
        operating-points-v2 = <&ufs_opp_table>;

        ufs_opp_table: opp-table {
            compatible = "operating-points-v2";

            opp-0 {
                opp-hz = /bits/ 64 <0>;
            };
        };
    };
```

## Documentation/devicetree/bindings/ufs/starfive,jhb100-ufs.yaml
```yaml
# SPDX-License-Identifier: GPL-2.0-only OR BSD-2-Clause
%YAML 1.2
---
$id: http://devicetree.org/schemas/ufs/starfive,jhb100-ufs.yaml#
$schema: http://devicetree.org/meta-schemas/core.yaml#

title: Starfive Universal Flash Storage (UFS) Controller

maintainers:
  - Minda Chen <minda.chen@starfivetech.com>

allOf:
  - $ref: ufs-common.yaml

properties:
  compatible:
    const: starfive,jhb100-ufs

  reg:
    maxItems: 1

  clocks:
    maxItems: 1

  clock-names:
    items:
      - const: main

  resets:
    items:
      - description: UFS main reset
      - description: UFS PHY reset

  reset-names:
    items:
      - const: main
      - const: phy

  interrupts:
    maxItems: 1

  starfive,syscon:
    $ref: /schemas/types.yaml#/definitions/phandle
    description:
      The phandle to System Register Controller syscon node.

required:
  - compatible
  - reg
  - clocks
  - clock-names
  - resets
  - reset-names
  - interrupts
  - starfive,syscon

unevaluatedProperties: false

examples:
  - |
    ufs@11b10000 {
        compatible = "starfive,jhb100-ufs";
        reg = <0x11b10000 0x20000>;
        interrupts = <105>;
        clocks = <&syscrg 4>;
        clock-names = "main";
        resets = <&syscrg 10>,
                 <&syscrg 7>;
        reset-names = "main", "phy";
        starfive,syscon = <&syscon>;
    };
```

## Documentation/devicetree/bindings/ufs/starfive,ufs.yaml
```yaml
# SPDX-License-Identifier: GPL-2.0-only OR BSD-2-Clause
%YAML 1.2
---
$id: http://devicetree.org/schemas/ufs/starfive,ufs.yaml#
$schema: http://devicetree.org/meta-schemas/core.yaml#

title: Starfive Universal Flash Storage (UFS) Controller

maintainers:
  - Minda Chen <minda.chen@starfivetech.com>

allOf:
  - $ref: ufs-common.yaml

properties:
  compatible:
    const: starfive,jhb100-ufs

  reg:
    maxItems: 1

  clocks:
    items:
      - description: UFS reference clock
      - description: UFS main enable clock

  clock-names:
    items:
      - const: ref_clk
      - const: ufs

  resets:
    items:
      - description: UFS main reset
      - description: UFS PHY reset

  reset-names:
    items:
      - const: main
      - const: phy

  interrupts:
    maxItems: 1

  starfive,syscon:
    $ref: /schemas/types.yaml#/definitions/phandle-array
    description:
      The phandle to System Register Controller syscon node.

required:
  - compatible
  - reg
  - clocks
  - resets
  - reset-names
  - interrupts
  - starfive,syscon

unevaluatedProperties: false

examples:
  - |
    ufs@11b10000 {
        compatible = "starfive,jhb100-ufs";
        reg = <0x11b10000 0x20000>;
        interrupts = <105>;
        clocks = <&syscrg 4>,
                 <&syscrg 5>;
        clock-names = "ref_clk", "ufs";
        freq-table-hz = <26000000 26000000>,
                        <100000000 100000000>;
        resets = <&syscrg 10>,
                 <&syscrg 7>;
        reset-names = "main", "phy";
        starfive,syscon = <&syscon>;
    };
```

## Documentation/devicetree/bindings/ufs/ufs-common.yaml
```yaml
# SPDX-License-Identifier: GPL-2.0-only OR BSD-2-Clause
%YAML 1.2
---
$id: http://devicetree.org/schemas/ufs/ufs-common.yaml#
$schema: http://devicetree.org/meta-schemas/core.yaml#

title: Common properties for Universal Flash Storage (UFS) Host Controllers

maintainers:
  - Alim Akhtar <alim.akhtar@samsung.com>
  - Avri Altman <avri.altman@wdc.com>

properties:
  clocks: true

  clock-names: true

  freq-table-hz:
    items:
      items:
        - description: Minimum frequency for given clock in Hz
        - description: Maximum frequency for given clock in Hz
    deprecated: true
    description: |
      Preferred is operating-points-v2.

      Array of <min max> operating frequencies in Hz stored in the same order
      as the clocks property. If either this property or operating-points-v2 is
      not defined or a value in the array is "0" then it is assumed that the
      frequency is set by the parent clock or a fixed rate clock source.

  operating-points-v2:
    description:
      Preferred over freq-table-hz.
      If present, each OPP must contain array of frequencies stored in the same
      order for each clock.  If clock frequency in the array is "0" then it is
      assumed that the frequency is set by the parent clock or a fixed rate
      clock source.

  opp-table:
    type: object

  interrupts:
    maxItems: 1

  lanes-per-direction:
    $ref: /schemas/types.yaml#/definitions/uint32
    enum: [1, 2]
    default: 2
    description:
      Number of lanes available per direction.  Note that it is assumed that
      the same number of lanes are used in both directions at once.

  vdd-hba-supply:
    description:
      Phandle to UFS host controller supply regulator node.

  vcc-supply:
    description:
      Phandle to VCC supply regulator node.

  vccq-supply:
    description:
      Phandle to VCCQ supply regulator node.

  vccq2-supply:
    description:
      Phandle to VCCQ2 supply regulator node.

  vcc-supply-1p8:
    type: boolean
    description:
      For embedded UFS devices, valid VCC range is 1.7-1.95V or 2.7-3.6V. This
      boolean property when set, specifies to use low voltage range of
      1.7-1.95V. Note for external UFS cards this property is invalid and valid
      VCC range is always 2.7-3.6V.

  vcc-max-microamp:
    description:
      Specifies max. load that can be drawn from VCC supply.

  vccq-max-microamp:
    description:
      Specifies max. load that can be drawn from VCCQ supply.

  vccq2-max-microamp:
    description:
      Specifies max. load that can be drawn from VCCQ2 supply.

  msi-parent: true

  limit-hs-gear:
    $ref: /schemas/types.yaml#/definitions/uint32
    minimum: 1
    maximum: 6
    default: 6
    description:
      Restricts the maximum HS gear used in both TX and RX directions.

  limit-gear-rate:
    $ref: /schemas/types.yaml#/definitions/string
    enum: [rate-a, rate-b]
    default: rate-b
    description:
      Restricts the UFS controller to rate-a or rate-b for both TX and
      RX directions.

  tx-precode-g6-host-lanes:
    $ref: /schemas/types.yaml#/definitions/uint32-array
    minItems: 1
    maxItems: 2
    uniqueItems: true
    items:
      minimum: 0
      maximum: 1
    description: |
      Lane indices for static Host-side TX precode enable settings for HS-G6
      only. Listed lanes have precode enabled; unlisted lanes are disabled.

  tx-precode-g6-device-lanes:
    $ref: /schemas/types.yaml#/definitions/uint32-array
    minItems: 1
    maxItems: 2
    uniqueItems: true
    items:
      minimum: 0
      maximum: 1
    description: |
      Lane indices for static Device-side TX precode enable settings for HS-G6
      only. Listed lanes have precode enabled; unlisted lanes are disabled.

patternProperties:
  "^txeq-preshoot-g[1-6]$":
    $ref: /schemas/types.yaml#/definitions/uint32-array
    oneOf:
      - minItems: 2
        maxItems: 2
      - minItems: 4
        maxItems: 4
    items:
      minimum: 0
      maximum: 7
    description: |
      Static TX Equalization PreShoot settings for High Speed Gears. These
      values are programmed to the corresponding UniPro PA layer attribute
      PA_TxEQG[1-6]Setting. Each value selects a Pre-Shoot level as defined
      by the MIPI M-PHY specification (TX_HS_PreShoot_Setting).
      Values are specified as per-lane tuples:
      <Host_Lane0 Device_Lane0>, [<Host_Lane1 Device_Lane1>]

  "^txeq-deemphasis-g[1-6]$":
    $ref: /schemas/types.yaml#/definitions/uint32-array
    oneOf:
      - minItems: 2
        maxItems: 2
      - minItems: 4
        maxItems: 4
    items:
      minimum: 0
      maximum: 7
    description: |
      Static TX Equalization DeEmphasis settings for High Speed Gears. These
      values are programmed to the corresponding UniPro PA layer attribute
      PA_TxEQG[1-6]Setting. Each value selects a De-Emphasis level as defined
      by the MIPI M-PHY specification (TX_HS_DeEmphasis_Setting).
      Values are specified as per-lane tuples:
      <Host_Lane0 Device_Lane0>, [<Host_Lane1 Device_Lane1>]

dependencies:
  freq-table-hz: [ clocks ]
  operating-points-v2: [ clocks, clock-names ]

required:
  - interrupts

allOf:
  - if:
      required:
        - freq-table-hz
    then:
      properties:
        operating-points-v2: false
  - if:
      required:
        - operating-points-v2
    then:
      properties:
        freq-table-hz: false

additionalProperties: true
```

## Documentation/devicetree/bindings/usb/altr,agilex5-dwc3.yaml
```yaml
# SPDX-License-Identifier: (GPL-2.0 OR BSD-2-Clause)
%YAML 1.2
---
$id: http://devicetree.org/schemas/usb/altr,agilex5-dwc3.yaml#
$schema: http://devicetree.org/meta-schemas/core.yaml#

title: Altera Agilex5 DWC3 USB SoC Controller Wrapper

maintainers:
  - Adrian Ng <adrianhoyin.ng@altera.com>

description:
  The Altera Agilex5 SoCFPGA integrates a Synopsys DesignWare USB3 (DWC3)
  controller that supports host, device and DRD modes. This binding describes
  SoC integration including clocks, resets, PHY connections, and optional
  IOMMU support.

allOf:
  - $ref: snps,dwc3-common.yaml#

properties:
  compatible:
    const: altr,agilex5-dwc3

  reg:
    maxItems: 1

  clocks:
    items:
      - description: Controller suspend clock
      - description: Master/Core bus clock

  clock-names:
    items:
      - const: suspend_clk
      - const: bus_clk

  interrupts:
    maxItems: 1

  phys:
    items:
      - description: USB2 PHY
      - description: USB3 PHY

  phy-names:
    items:
      - const: usb2-phy
      - const: usb3-phy

  iommus:
    maxItems: 1

  resets:
    items:
      - description: DWC3 core reset
      - description: DWC3 ECC reset

  reset-names:
    items:
      - const: dwc3
      - const: dwc3-ecc

required:
  - compatible
  - reg
  - clocks
  - clock-names
  - interrupts
  - phys
  - phy-names
  - resets
  - reset-names

unevaluatedProperties: false

examples:
  - |
    #include <dt-bindings/interrupt-controller/arm-gic.h>
    #include <dt-bindings/reset/altr,rst-mgr-s10.h>
    #include <dt-bindings/clock/intel,agilex5-clkmgr.h>

    usb31: usb@11000000 {
        compatible = "altr,agilex5-dwc3";
        reg = <0x11000000 0x100000>;
        interrupts = <GIC_SPI 94 IRQ_TYPE_LEVEL_HIGH>;
        clocks = <&clkmgr AGILEX5_USB31_SUSPEND_CLK>,
                 <&clkmgr AGILEX5_USB31_BUS_CLK_EARLY>;
        clock-names = "suspend_clk", "bus_clk";
        phys = <&usbphy0>, <&usbphy1>;
        phy-names = "usb2-phy", "usb3-phy";
        resets = <&rst USB1_RESET>, <&rst USB1_OCP_RESET>;
        reset-names = "dwc3", "dwc3-ecc";
        iommus = <&smmu 7>;
        dr_mode = "host";
    };
```

## Documentation/devicetree/bindings/usb/atmel,at91rm9200-ohci.yaml
```yaml
# SPDX-License-Identifier: (GPL-2.0-only OR BSD-2-Clause)
%YAML 1.2
---
$id: http://devicetree.org/schemas/usb/atmel,at91rm9200-ohci.yaml#
$schema: http://devicetree.org/meta-schemas/core.yaml#

title: Atmel AT91RM9200 / AT91SAM9 style OHCI USB Host Controller

maintainers:
  - Nicolas Ferre <nicolas.ferre@microchip.com>
  - Alexandre Belloni <alexandre.belloni@bootlin.com>

description:
  The Atmel AT91RM9200 / AT91SAM9 OHCI USB Host Controller implements a
  USB 1.1 Open Host Controller Interface (OHCI) compliant host interface.
  It provides low-speed and full-speed USB host functionality and is
  integrated into Atmel AT91RM9200 and AT91SAM9 family SoCs.

allOf:
  - $ref: /schemas/usb/usb.yaml#

properties:
  compatible:
    oneOf:
      - items:
          - const: atmel,at91rm9200-ohci
          - const: usb-ohci

  reg:
    maxItems: 1

  interrupts:
    maxItems: 1

  clocks:
    minItems: 3
    maxItems: 3

  clock-names:
    items:
      - const: ohci_clk
      - const: hclk
      - const: uhpck

  num-ports:
    $ref: /schemas/types.yaml#/definitions/uint32
    description: Number of downstream ports supported by this OHCI controller
    minimum: 1
    maximum: 15

  atmel,vbus-gpio:
    description: GPIO used to control or sense the USB VBUS power.
    minItems: 1
    maxItems: 3

  atmel,oc-gpio:
    description: GPIO used to signal USB overcurrent condition.
    minItems: 1
    maxItems: 3

required:
  - compatible
  - reg
  - interrupts
  - clocks
  - clock-names

unevaluatedProperties: false

examples:
  - |
    #include <dt-bindings/clock/at91.h>
    #include <dt-bindings/interrupt-controller/irq.h>
    #include <dt-bindings/gpio/gpio.h>
    usb@500000 {
        compatible = "atmel,at91rm9200-ohci", "usb-ohci";
        reg = <0x500000 0x100000>;
        interrupts = <20 IRQ_TYPE_LEVEL_HIGH>;
        clocks = <&uhphs_clk>, <&uhphs_clk>, <&uhpck>;
        clock-names = "ohci_clk", "hclk", "uhpck";
        atmel,vbus-gpio = <&pioA 18 GPIO_ACTIVE_HIGH>;
        atmel,oc-gpio   = <&pioB 10 GPIO_ACTIVE_LOW>;
        num-ports = <2>;
    };
...
```
