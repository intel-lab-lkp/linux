## Documentation/devicetree/bindings/access-controllers/sifive,wgchecker2.yaml
```yaml
# SPDX-License-Identifier: (GPL-2.0-only OR BSD-2-Clause)
# Copyright (C) 2026 SiFive, Inc.
%YAML 1.2
---
$id: http://devicetree.org/schemas/access-controllers/sifive,wgchecker2.yaml#
$schema: http://devicetree.org/meta-schemas/core.yaml#

title: SiFive WorldGuard Checker

maintainers:
  - Yu-Chien Peter Lin <peter.lin@sifive.com>

description: |
  The RISC-V Worlds ISA extension defines World IDs (WIDs) as architectural
  identifiers that tag each system transaction with its originating context.
  System integrators assign WIDs to execution contexts such as privilege
  modes, trusted execution environments, or other isolation boundaries.

  The SiFive WorldGuard Checker is a hardware firewall positioned in the
  system interconnect fabric. It supports up to 32 WIDs and inspects every
  transaction, evaluating the WID against access control policies encoded
  in checker slots for each protected resource. Transactions from
  unauthorized WIDs are blocked and reported as bus errors, interrupts, or
  both.

  This enables spatial partitioning of memory regions and memory-mapped
  devices across execution contexts. Different address ranges can enforce
  distinct policies, allowing isolated workloads to coexist with
  hardware-enforced protection.

  The wgChecker acts as an access-controller provider as defined in the
  access-controllers framework. Protected devices are consumers that
  declare their access policy via the access-controllers property.

allOf:
  - $ref: /schemas/access-controllers/access-controllers.yaml#

properties:
  compatible:
    items:
      - enum:
          - qemu,wgchecker2
      - const: sifive,wgchecker2

  reg:
    maxItems: 1

  interrupts:
    maxItems: 1
    description:
      Interrupt line asserted when a WID access violation is detected and
      interrupt reporting is enabled in the slot configuration (IR or IW
      bits set).

  "#access-controller-cells":
    const: 1
    description: |
      Specifies the partition identifier to reference a partition child
      node that defines the access control region, WID permissions, and
      access failure configuration. The special ID 0xFFFFFFFF indicates
      unprotected mode, granting unrestricted access to the device.

  "#address-cells":
    const: 1

  "#size-cells":
    const: 0

patternProperties:
  "^partition@[0-9a-f]+$":
    type: object
    additionalProperties: false

    properties:
      reg:
        maximum: 0xFFFFFFFE
        description:
          Partition identifier. Must be unique within the wgChecker node.
          The value 0xFFFFFFFF is reserved for unprotected mode and must
          not be used.

      sifive,wg-region:
        $ref: /schemas/types.yaml#/definitions/uint32-array
        description:
          Protected memory region encoded as a base address and size.
        items:
          - description: Upper 32 bits of the base address
          - description: Lower 32 bits of the base address
          - description: Upper 32 bits of the region size
          - description: Lower 32 bits of the region size

      sifive,slot-permissions:
        $ref: /schemas/types.yaml#/definitions/uint64
        description: |
          64-bit WID permission bitmap. Each WID N uses two consecutive bits:
            - bit[2*N]  : Read  permission for WID N
            - bit[2*N+1]: Write permission for WID N
          Set bits grant access.

      sifive,slot-config:
        $ref: /schemas/types.yaml#/definitions/uint32
        maximum: 0x1F
        description: |
          Access failure configuration flags for this slot:
            bit[0] (ER): report read  violations as bus errors
            bit[1] (EW): report write violations as bus errors
            bit[2] (IR): report read  violations via interrupt
            bit[3] (IW): report write violations via interrupt
            bit[4] (L) : lock this slot against further modification
          Bits[5:31] are reserved and must be zero.

    required:
      - reg
      - sifive,wg-region
      - sifive,slot-permissions
      - sifive,slot-config

required:
  - compatible
  - reg
  - "#address-cells"
  - "#size-cells"
  - "#access-controller-cells"

additionalProperties: false

examples:
  - |
    // Example 1: Peripheral device protection

    access-controller@c1000 {
        compatible = "qemu,wgchecker2", "sifive,wgchecker2";
        reg = <0xc1000 0x1000>;
        #access-controller-cells = <1>;
        #address-cells = <1>;
        #size-cells = <0>;
        interrupts = <80 4>;

        partition@0 {
            reg = <0>;
            sifive,wg-region = <0x0 0x000c0000 0x0 0x00001000>;
            sifive,slot-permissions = <0x0 0x000000c3>;
            sifive,slot-config = <0x0f>;
        };
    };

  - |
    // Example 2: DRAM partitioning with multiple regions

    access-controller@40000000 {
        compatible = "qemu,wgchecker2", "sifive,wgchecker2";
        reg = <0x40000000 0x1000>;
        #access-controller-cells = <1>;
        #address-cells = <1>;
        #size-cells = <0>;
        interrupts = <82 4>;

        partition@0 {
            reg = <0>;
            sifive,wg-region = <0x0 0x80000000 0x0 0x40000000>;
            sifive,slot-permissions = <0x0 0x000000cf>;
            sifive,slot-config = <0x0f>;
        };

        partition@1 {
            reg = <1>;
            sifive,wg-region = <0x0 0xc0000000 0x0 0x01000000>;
            sifive,slot-permissions = <0x0 0x000000cc>;
            sifive,slot-config = <0x0f>;
        };

        partition@2 {
            reg = <2>;
            sifive,wg-region = <0x0 0xc1000000 0x0 0x3f000000>;
            sifive,slot-permissions = <0x0 0x000000cf>;
            sifive,slot-config = <0x0f>;
        };
    };
```

## Documentation/devicetree/bindings/arm/airoha,en7581-npu.yaml
```yaml
# SPDX-License-Identifier: (GPL-2.0 OR BSD-2-Clause)
%YAML 1.2
---
$id: http://devicetree.org/schemas/arm/airoha,en7581-npu.yaml#
$schema: http://devicetree.org/meta-schemas/core.yaml#

title: Airoha Network Processor Unit for EN7581 SoC

maintainers:
  - Lorenzo Bianconi <lorenzo@kernel.org>

description:
  The Airoha Network Processor Unit (NPU) provides a configuration interface
  to implement wired and wireless hardware flow offloading programming Packet
  Processor Engine (PPE) flow table.

properties:
  compatible:
    items:
      - enum:
          - airoha,en7581-npu
      - const: syscon

  reg:
    maxItems: 1

  interrupts:
    maxItems: 15

  memory-region:
    maxItems: 1
    description:
      Phandle to the node describing memory used to store NPU firmware binary.

required:
  - compatible
  - reg
  - interrupts
  - memory-region

additionalProperties: false

examples:
  - |
    #include <dt-bindings/interrupt-controller/arm-gic.h>
    #include <dt-bindings/interrupt-controller/irq.h>
    soc {
      #address-cells = <2>;
      #size-cells = <2>;

      npu@1e900000 {
        compatible = "airoha,en7581-npu", "syscon";
        reg = <0 0x1e900000 0 0x313000>;
        interrupts = <GIC_SPI 118 IRQ_TYPE_LEVEL_HIGH>,
                     <GIC_SPI 119 IRQ_TYPE_LEVEL_HIGH>,
                     <GIC_SPI 120 IRQ_TYPE_LEVEL_HIGH>,
                     <GIC_SPI 121 IRQ_TYPE_LEVEL_HIGH>,
                     <GIC_SPI 122 IRQ_TYPE_LEVEL_HIGH>,
                     <GIC_SPI 123 IRQ_TYPE_LEVEL_HIGH>,
                     <GIC_SPI 125 IRQ_TYPE_LEVEL_HIGH>,
                     <GIC_SPI 103 IRQ_TYPE_LEVEL_HIGH>,
                     <GIC_SPI 109 IRQ_TYPE_LEVEL_HIGH>,
                     <GIC_SPI 113 IRQ_TYPE_LEVEL_HIGH>,
                     <GIC_SPI 117 IRQ_TYPE_LEVEL_HIGH>,
                     <GIC_SPI 134 IRQ_TYPE_LEVEL_HIGH>,
                     <GIC_SPI 135 IRQ_TYPE_LEVEL_HIGH>,
                     <GIC_SPI 136 IRQ_TYPE_LEVEL_HIGH>,
                     <GIC_SPI 137 IRQ_TYPE_LEVEL_HIGH>;
        memory-region = <&npu_binary>;
      };
    };
```

## Documentation/devicetree/bindings/arm/altera/socfpga-clk-manager.yaml
```yaml
# SPDX-License-Identifier: GPL-2.0
%YAML 1.2
---
$id: http://devicetree.org/schemas/arm/altera/socfpga-clk-manager.yaml#
$schema: http://devicetree.org/meta-schemas/core.yaml#

title: Altera SOCFPGA Clock Manager

maintainers:
  - Dinh Nguyen <dinguyen@kernel.org>

description:
  This binding describes the Altera SOCFGPA Clock Manager and its associated
  tree of clocks, pll's, and clock gates for the Cyclone5, Arria5 and Arria10
  chip families.

properties:
  compatible:
    items:
      - const: altr,clk-mgr

  reg:
    maxItems: 1

  clocks:
    type: object
    additionalProperties: false

    properties:
      "#address-cells":
        const: 1

      "#size-cells":
        const: 0

    patternProperties:
      "^osc[0-9]$":
        type: object

      "^[a-z0-9,_]+(clk|pll|clk_gate|clk_divided)(@[a-f0-9]+)?$":
        type: object
        additionalProperties: false

        properties:

          compatible:
            enum:
              - altr,socfpga-pll-clock
              - altr,socfpga-perip-clk
              - altr,socfpga-gate-clk
              - altr,socfpga-a10-pll-clock
              - altr,socfpga-a10-perip-clk
              - altr,socfpga-a10-gate-clk
              - fixed-clock

          reg:
            maxItems: 1

          clocks:
            description: one or more phandles to input clock
            minItems: 1
            maxItems: 5

          "#address-cells":
            const: 1

          "#clock-cells":
            const: 0

          "#size-cells":
            const: 0

          clk-gate:
            $ref: '#/$defs/clk-gate'
            unevaluatedProperties: false

          div-reg:
            $ref: '#/$defs/div-reg'
            unevaluatedProperties: false

          fixed-divider:
            $ref: '#/$defs/fixed-divider'
            unevaluatedProperties: false

        patternProperties:
          "^[a-z0-9,_]+(clk|pll)(@[a-f0-9]+)?$":
            type: object
            additionalProperties: false

            properties:
              compatible:
                enum:
                  - altr,socfpga-perip-clk
                  - altr,socfpga-gate-clk
                  - altr,socfpga-a10-perip-clk
                  - altr,socfpga-a10-gate-clk

              reg:
                maxItems: 1

              "#clock-cells":
                const: 0

              clocks:
                description: one or more phandles to input clock
                minItems: 1
                maxItems: 4

              clk-gate:
                $ref: '#/$defs/clk-gate'
                unevaluatedProperties: false

              div-reg:
                $ref: '#/$defs/div-reg'
                unevaluatedProperties: false

              fixed-divider:
                $ref: '#/$defs/fixed-divider'
                unevaluatedProperties: false

            required:
              - compatible
              - clocks
              - "#clock-cells"

        required:
          - compatible
          - "#clock-cells"

required:
  - compatible
  - reg

additionalProperties: false

$defs:
  clk-gate:
    $ref: /schemas/types.yaml#/definitions/uint32-array
    items:
      - description: gating register offset
      - description: bit index

  div-reg:
    $ref: /schemas/types.yaml#/definitions/uint32-array
    items:
      - description: divider register offset
      - description: bit shift
      - description: bit width

  fixed-divider:
    $ref: /schemas/types.yaml#/definitions/uint32

examples:
  - |
    clkmgr@ffd04000 {
      compatible = "altr,clk-mgr";
      reg = <0xffd04000 0x1000>;
    };

...
```

## Documentation/devicetree/bindings/arm/altera/socfpga-sdram-edac.yaml
```yaml
# SPDX-License-Identifier: (GPL-2.0 OR BSD-2-Clause)
%YAML 1.2
---
$id: "http://devicetree.org/schemas/edac/altr,sdram-edac.yaml#"
$schema: "http://devicetree.org/meta-schemas/core.yaml#"

title: Altera SoCFPGA SDRAM EDAC Controller

maintainers:
  - name: Dinh Nguyen
    email: dinguyen@kernel.org

description: |
  EDAC-compatible controller for SDRAM error detection and correction on
  Altera (Intel) SoCFPGA platforms.

properties:
  compatible:
    oneOf:
      - const: altr,sdram-edac
      - const: altr,sdram-edac-a10
      - const: altr,sdram-edac-s10

  altr,sdr-syscon:
    $ref: /schemas/types.yaml#/definitions/phandle
    description:
      Phandle to the SDRAM system controller (SDR) syscon node.

  interrupts:
    minItems: 1
    maxItems: 2
    description: |
      One or two interrupt specifiers for ECC error interrupt(s).
      Arria 10 SoCs use two interrupt lines.

required:
  - compatible
  - altr,sdr-syscon
  - interrupts

$nodename:
  pattern: "^edac@[0-9a-f]+$"

unevaluatedProperties: false

examples:
  - |
    #include <dt-bindings/interrupt-controller/arm-gic.h>
    #include <dt-bindings/interrupt-controller/irq.h>

    edac@0 {
        compatible = "altr,sdram-edac-a10";
        altr,sdr-syscon = <&sdr>;
        interrupts = <GIC_SPI 45 IRQ_TYPE_LEVEL_HIGH>,
                     <GIC_SPI 46 IRQ_TYPE_LEVEL_HIGH>;
    };

  - |
    #include <dt-bindings/interrupt-controller/arm-gic.h>
    #include <dt-bindings/interrupt-controller/irq.h>

    edac@0 {
        compatible = "altr,sdram-edac-s10";
        altr,sdr-syscon = <&sdr>;
        interrupts = <GIC_SPI 39 IRQ_TYPE_LEVEL_HIGH>;
    };

  - |
    #include <dt-bindings/interrupt-controller/arm-gic.h>
    #include <dt-bindings/interrupt-controller/irq.h>

    edac@0 {
        compatible = "altr,sdram-edac";
        altr,sdr-syscon = <&sdr>;
        interrupts = <GIC_SPI 39 IRQ_TYPE_LEVEL_HIGH>;
    };
```

## Documentation/devicetree/bindings/arm/arm,sse710-host-base-sysctrl.yaml
```yaml
# SPDX-License-Identifier: (GPL-2.0-only OR BSD-2-Clause)
%YAML 1.2
---
$id: http://devicetree.org/schemas/arm/arm,sse710-host-base-sysctrl.yaml#
$schema: http://devicetree.org/meta-schemas/core.yaml#

title: SSE-710 Host Base System Control

maintainers:
  - Abdellatif El Khlifi <abdellatif.elkhlifi@arm.com>
  - Hugues Kamba Mpiana <hugues.kambampiana@arm.com>

description: |+
  The Host Base System Control has registers to control the clocks, power, and
  reset for SSE-710 subsystem. It resides within AONTOP power domain.
  The registers are mapped under the SSE-710 Host System memory map.

properties:
  compatible:
    items:
      - enum:
          - arm,sse710-host-base-sysctrl
      - const: simple-mfd
      - const: syscon

  reg:
    maxItems: 1

patternProperties:
  "^extsys[0-1]$":
    description:
      SSE-710 subsystem supports up to two External Systems.
    $ref: /schemas/remoteproc/arm,sse710-extsys.yaml#
    unevaluatedProperties: false

additionalProperties: false

required:
  - compatible
  - reg

examples:
  - |
    syscon@1a010000 {
        compatible = "arm,sse710-host-base-sysctrl", "simple-mfd", "syscon";
        reg = <0x1a010000 0x1000>;

        extsys0 {
            compatible = "arm,sse710-extsys";
            firmware-name = "es_flashfw.elf";
            #extsys-id = <0>;
            mbox-names = "txes0", "rxes0";
            mboxes = <&mhu0_hes0 0 1>, <&mhu0_es0h 0 1>;
            memory-region = <&extsys0_vring0>, <&extsys0_vring1>;
        };
    };
```
