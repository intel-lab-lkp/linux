## Documentation/devicetree/bindings/arm/arm,zena-css.yaml
```yaml
# SPDX-License-Identifier: (GPL-2.0-only OR BSD-2-Clause)
%YAML 1.2
---
$id: http://devicetree.org/schemas/arm/arm,zena-css.yaml#
$schema: http://devicetree.org/meta-schemas/core.yaml#

title: Arm Zena Compute Subsystem Platforms

maintainers:
  - Debbie Horsfall <debbie.horsfall@arm.com>

description:
  Arm Zena Compute Subsystem (CSS) is a compute platform targeting
  the automotive sector. Arm Zena CSS is a high-performance Arm
  Cortex-A720AE Application Processor system augmented with an Arm
  Cortex-R82AE based Safety Island and real-time domain.

properties:
  $nodename:
    const: '/'
  compatible:
    oneOf:
      - description: Arm Zena CSS Platforms
        items:
          - enum:
              - arm,zena-css-fvp
          - const: arm,zena-css

additionalProperties: true

...
```

## Documentation/devicetree/bindings/arm/aspeed/aspeed,video.yaml
```yaml
# SPDX-License-Identifier: (GPL-2.0-only OR BSD-2-Clause)
%YAML 1.2
---
$id: http://devicetree.org/schemas/arm/aspeed/aspeed,video.yaml#
$schema: http://devicetree.org/meta-schemas/core.yaml#

title: ASPEED Video Engine

maintainers:
  - Eddie James <eajames@linux.ibm.com>
  - Jammy Huang <jammy_huang@aspeedtech.com>

description: |
  The ASPEED video engine can be configured to capture and compress video
  data from digital or analog sources.

select:
  properties:
    compatible:
      pattern: "^aspeed,ast[0-9]+-video-engine$"
  required:
    - compatible

properties:
  compatible:
    oneOf:
      - description: Preferred naming style for compatibles of video components
        pattern: "^aspeed,ast[0-9]+-video-engine$"

      - enum:
          - aspeed,ast2400-video-engine
          - aspeed,ast2500-video-engine
          - aspeed,ast2600-video-engine

  reg:
    minItems: 1

  clocks:
    minItems: 2

  clock-names:
    items:
      - const: vclk
      - const: eclk

  interrupts:
    minItems: 1

  aspeed,scu:
    $ref: /schemas/types.yaml#/definitions/phandle
    description: |
      Specifies the scu node that is needed if video wants to capture
      from sources other than Host VGA.

  aspeed,gfx:
    $ref: /schemas/types.yaml#/definitions/phandle
    description: |
      Specifies the Soc Display(gfx) node that needs to be queried to get
      related information if video wants to use gfx as capture source.

required:
  - compatible
  - reg
  - clocks
  - clock-names
  - interrupts

additionalProperties: true

examples:
  - |
    video: video@1e700000 {
          	compatible = "aspeed,ast2600-video-engine";
          	reg = <0x1e700000 0x1000>;
          	clocks = <&syscon ASPEED_CLK_GATE_VCLK>,
          	         <&syscon ASPEED_CLK_GATE_ECLK>;
          	clock-names = "vclk", "eclk";
          	interrupts = <GIC_SPI 7 IRQ_TYPE_LEVEL_HIGH>;
          	aspeed,scu = <&syscon>;
          	aspeed,gfx = <&gfx>;
    };
```

## Documentation/devicetree/bindings/arm/atmel,at91rm9200-st.yaml
```yaml
# SPDX-License-Identifier: (GPL-2.0-only OR BSD-2-Clause)
%YAML 1.2
---
$id: http://devicetree.org/schemas/arm/atmel,at91rm9200-st.yaml#
$schema: http://devicetree.org/meta-schemas/core.yaml#

title: Atmel System Timer

maintainers:
  - Nicolas Ferre <nicolas.ferre@microchip.com>
  - Claudiu Beznea <claudiu@tuxon.dev>

description:
  The System Timer (ST) module in AT91RM9200 provides periodic tick and
  alarm capabilities. It is exposed as a simple multi-function device
  (simple-mfd + syscon) because it shares its register space and interrupt
  with other System Controller blocks.

properties:
  compatible:
    items:
      - const: atmel,at91rm9200-st
      - const: syscon
      - const: simple-mfd

  reg:
    maxItems: 1

  interrupts:
    maxItems: 1

  clocks:
    maxItems: 1

  watchdog:
    type: object
    description: Watchdog timer subnode.
    properties:
      compatible:
        const: atmel,at91rm9200-wdt
    required:
      - compatible

required:
  - compatible
  - reg
  - interrupts
  - clocks

unevaluatedProperties: false

examples:
  - |
    #include <dt-bindings/interrupt-controller/irq.h>
    timer@fffffd00 {
        compatible = "atmel,at91rm9200-st", "syscon", "simple-mfd";
        reg = <0xfffffd00 0x100>;
        interrupts = <1 IRQ_TYPE_LEVEL_HIGH 7>;
        clocks = <&slow_xtal>;

        watchdog {
                compatible = "atmel,at91rm9200-wdt";
        };
    };
...
```

## Documentation/devicetree/bindings/arm/axera.yaml
```yaml
# SPDX-License-Identifier: GPL-2.0-only OR BSD-2-Clause
%YAML 1.2
---
$id: http://devicetree.org/schemas/arm/axera.yaml#
$schema: http://devicetree.org/meta-schemas/core.yaml#

title: Axera platforms

maintainers:
  - Shi Zhicheng <shizhicheng@axera-tech.com>
  - Leng Honglin <lenghonglin@axera-tech.com>

properties:
  $nodename:
    const: '/'
  compatible:
    oneOf:
      - items:
          - const: axera,ax650-demo
          - const: axera,ax650

additionalProperties: true

...
```

## Documentation/devicetree/bindings/arm/axis.yaml
```yaml
# SPDX-License-Identifier: GPL-2.0-only OR BSD-2-Clause
%YAML 1.2
---
$id: http://devicetree.org/schemas/arm/axis.yaml#
$schema: http://devicetree.org/meta-schemas/core.yaml#

title: Axis ARTPEC platforms

maintainers:
  - Jesper Nilsson <jesper.nilsson@axis.com>
  - SeonGu Kang <ksk4725@coasia.com>
  - SungMin Park <smn1196@coasia.com>
  - Ravi Patel <ravi.patel@samsung.com>
  - linux-arm-kernel@axis.com

properties:
  $nodename:
    const: '/'
  compatible:
    oneOf:
      - description: Axis ARTPEC-6 Development board
        items:
          - enum:
              - axis,artpec6-dev-board
          - const: axis,artpec6

      - description: Axis ARTPEC-8 Grizzly board
        items:
          - enum:
              - axis,artpec8-grizzly
          - const: axis,artpec8

additionalProperties: true

...
```

## Documentation/devicetree/bindings/arm/bcm/brcm,bcm63138.yaml
```yaml
# SPDX-License-Identifier: (GPL-2.0-only OR BSD-2-Clause)
%YAML 1.2
---
$id: http://devicetree.org/schemas/arm/bcm/brcm,bcm63138.yaml#
$schema: http://devicetree.org/meta-schemas/core.yaml#

title: Broadcom BCM63138 DSL SoC

maintainers:
  - Shankari Anand <shankari.ak0208@gmail.com>

description: |
  The Broadcom BCM63138 DSL System-on-a-Chip is designed for DSL platforms.
  It supports multi-core ARM Cortex-A9 CPUs, a boot lookup table (BootLUT),
  and software-controlled resets using a system timer.

select:
  properties:
    compatible:
      contains:
        const: brcm,bcm63138
  required:
    - compatible

properties:
  compatible:
    const: brcm,bcm63138

patternProperties:
  "^bootlut(@[0-9a-f]+)?$":
    type: object
    properties:
      compatible:
        const: brcm,bcm63138-bootlut

      reg:
        maxItems: 1

    required:
      - compatible
      - reg

additionalProperties: true
```

## Documentation/devicetree/bindings/arm/cix.yaml
```yaml
# SPDX-License-Identifier: GPL-2.0-only OR BSD-2-Clause
%YAML 1.2
---
$id: http://devicetree.org/schemas/arm/cix.yaml#
$schema: http://devicetree.org/meta-schemas/core.yaml#

title: CIX platforms

maintainers:
  - Peter Chen <peter.chen@cixtech.com>
  - Fugang Duan <fugang.duan@cixtech.com>

properties:
  $nodename:
    const: '/'
  compatible:
    oneOf:

      - description: Radxa Orion O6 board
        items:
          - enum:
              - radxa,orion-o6
          - const: cix,sky1

      - description: Xunlong orangepi 6 plus board
        items:
          - enum:
              - xunlong,orangepi-6-plus
          - const: cix,sky1

additionalProperties: true

...
```

## Documentation/devicetree/bindings/arm/cortina-access.yaml
```yaml
# SPDX-License-Identifier: GPL-2.0-only OR BSD-2-Clause
%YAML 1.2
---
$id: http://devicetree.org/schemas/arm/cortina-access.yaml#
$schema: http://devicetree.org/meta-schemas/core.yaml#

title: Cortina-Access SoC boards

maintainers:
  - Jason Li <jason.li@cortina-access.com>

description:
  Boards based on Cortina-Access ARMv8 SoCs targeting networking and
  access applications.

properties:
  $nodename:
    const: /
  compatible:
    oneOf:
      - description: Cortina-Access CA8289 (Venus) engineering board
        const: cortina-access,ca8289-engboard

      - description: Cortina-Access CA8289 (Venus) reference board
        const: cortina-access,ca8289-refboard

additionalProperties: true

...
```

## Documentation/devicetree/bindings/arm/cortina.yaml
```yaml
# SPDX-License-Identifier: (GPL-2.0-only OR BSD-2-Clause)
%YAML 1.2
---
$id: http://devicetree.org/schemas/arm/cortina.yaml#
$schema: http://devicetree.org/meta-schemas/core.yaml#

title: Cortina Systems CS75xx platforms

maintainers:
  - Fil Dunsky <filipp.dunsky@gmail.com>

description:
  The CS75xx ("Goldengate G2") family are network processors from Cortina
  Systems. The CS7542 has two Cortex-A9 cores with an SCU, GIC, private
  timers and a PL310 L2 cache controller, a packet processing engine, three
  PCIe root ports, a NAND flash controller and low speed peripherals.

properties:
  $nodename:
    const: '/'
  compatible:
    oneOf:
      - description: CS7542 based boards
        items:
          - enum:
              - securifi,almondplus
          - const: cortina,cs7542

additionalProperties: true

...
```

## Documentation/devicetree/bindings/arm/firmware/qcom,tee.yaml
```yaml
# SPDX-License-Identifier: (GPL-2.0 OR BSD-2-Clause)
%YAML 1.2
---
$id: http://devicetree.org/schemas/arm/firmware/qcom,tee.yaml#
$schema: http://devicetree.org/meta-schemas/core.yaml#

title: Qualcomm TEE

maintainers:
  - Amirreza Zarrabi <quic_azarrabi@quicinc.com>

description: |
  QTEE is a piece of software provide a Trusted Execution Environment using ARM
  TrustZone for Qualcomm SoC.

properties:
  $nodename:
    const: qcom_tee

  compatible:
    const: qcom,tee

required:
  - compatible

additionalProperties: false

examples:
  - |
    firmware {
        qcom_tee {
            compatible = "qcom,tee";
        };
    };
```

## Documentation/devicetree/bindings/arm/google.yaml
```yaml
# SPDX-License-Identifier: GPL-2.0-only OR BSD-2-Clause
%YAML 1.2
---
$id: http://devicetree.org/schemas/arm/google.yaml#
$schema: http://devicetree.org/meta-schemas/core.yaml#

title: Google Tensor platforms

maintainers:
  - Peter Griffin <peter.griffin@linaro.org>

description: |
  ARM platforms using SoCs designed by Google branded "Tensor" used in Pixel
  devices.

  These bindings for older Pixel devices don't use device tree overlays so
  no separate SoC entry is added. This may change in the future.

  Newer Pixel devices are expected to have the SoC device tree as the base
  and specific board device trees as overlays.

properties:
  $nodename:
    const: '/'
  compatible:
    oneOf:
      # Google Tensor G1 AKA gs101 AKA whitechapel AKA Die ID S5P9845 boards
      - description: Google Pixel 6 or 6 Pro (Oriole or Raven)
        items:
          - enum:
              - google,gs101-oriole
              - google,gs101-raven
          - const: google,gs101

      # Google Tensor G5 AKA lga (laguna) SoC and boards
      - description: Tensor G5 SoC (laguna)
        items:
          - enum:
              - google,soc-id-0005-rev-00  # A0
              - google,soc-id-0005-rev-10  # B0
          - const: google,lga
      - description: Google Pixel 10 Board (Frankel)
        items:
          - enum:
              - google,pixel-id-070302-rev-000000  # Proto 0
              - google,pixel-id-070302-rev-010000  # Proto 1
              - google,pixel-id-070302-rev-010100  # Proto 1.1
              - google,pixel-id-070303-rev-010000  # EVT 1
              - google,pixel-id-070303-rev-010100  # EVT 1.1
              - google,pixel-id-070303-rev-010101  # EVT 1.1 Wingboard
              - google,pixel-id-070304-rev-010000  # DVT 1
              - google,pixel-id-070305-rev-010000  # PVT 1
              - google,pixel-id-070306-rev-010000  # MP 1
          - const: google,lga-frankel
          - const: google,lga
      - description: Google Pixel 10 Pro Board (Blazer)
        items:
          - enum:
              - google,pixel-id-070402-rev-000000  # Proto 0
              - google,pixel-id-070402-rev-010000  # Proto 1
              - google,pixel-id-070402-rev-010100  # Proto 1.1
              - google,pixel-id-070403-rev-010000  # EVT 1
              - google,pixel-id-070403-rev-010100  # EVT 1.1
              - google,pixel-id-070404-rev-010000  # DVT 1
              - google,pixel-id-070405-rev-010000  # PVT 1
              - google,pixel-id-070406-rev-010000  # MP 1
          - const: google,lga-blazer
          - const: google,lga
      - description: Google Pixel 10 Pro XL Board (Mustang)
        items:
          - enum:
              - google,pixel-id-070502-rev-000000  # Proto 0
              - google,pixel-id-070502-rev-010000  # Proto 1
              - google,pixel-id-070502-rev-010100  # Proto 1.1
              - google,pixel-id-070502-rev-010101  # Proto 1.1 Wingboard
              - google,pixel-id-070503-rev-010000  # EVT 1
              - google,pixel-id-070503-rev-010100  # EVT 1.1
              - google,pixel-id-070503-rev-010101  # EVT 1.1 Wingboard
              - google,pixel-id-070504-rev-010000  # DVT 1
              - google,pixel-id-070505-rev-010000  # PVT 1
              - google,pixel-id-070506-rev-010000  # MP 1
          - const: google,lga-mustang
          - const: google,lga

allOf:
  # Bootloader requires empty ect node to be present
  - if:
      properties:
        compatible:
          contains:
            const: google,gs101
    then:
      properties:
        ect:
          type: object
          additionalProperties: false

      required:
        - ect

additionalProperties: true

...
```

## Documentation/devicetree/bindings/arm/hpe,gsc.yaml
```yaml
# SPDX-License-Identifier: (GPL-2.0-only OR BSD-2-Clause)
%YAML 1.2
---
$id: http://devicetree.org/schemas/arm/hpe,gsc.yaml#
$schema: http://devicetree.org/meta-schemas/core.yaml#

title: HPE BMC GSC platforms

maintainers:
  - Nick Hawkins <nick.hawkins@hpe.com>

description:
  The HPE GSC is an ARM64 BMC SoC used on HPE ProLiant servers.
  It is the successor to the HPE GXP (ARM32) BMC.

properties:
  compatible:
    oneOf:
      - description: GSC Based Boards
        items:
          - enum:
              - hpe,gsc-dl380gen12
          - const: hpe,gsc

required:
  - compatible

additionalProperties: true

...
```

## Documentation/devicetree/bindings/arm/hpe,gxp.yaml
```yaml
# SPDX-License-Identifier: (GPL-2.0-only OR BSD-2-Clause)
%YAML 1.2
---
$id: http://devicetree.org/schemas/arm/hpe,gxp.yaml#
$schema: http://devicetree.org/meta-schemas/core.yaml#

title: HPE BMC GXP and GSC platforms

maintainers:
  - Nick Hawkins <nick.hawkins@hpe.com>
  - Jean-Marie Verdun <verdun@hpe.com>

properties:
  compatible:
    oneOf:
      - description: GXP Based Boards
        items:
          - enum:
              - hpe,gxp-dl360gen10
          - const: hpe,gxp
      - description: GSC Based Boards
        items:
          - enum:
              - hpe,gsc-dl340gen12
          - const: hpe,gsc

required:
  - compatible

additionalProperties: true

...
```
