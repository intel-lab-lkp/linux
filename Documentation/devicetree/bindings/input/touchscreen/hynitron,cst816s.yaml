## Documentation/devicetree/bindings/interrupt-controller/adi,adsp-pint.yaml
```yaml
# SPDX-License-Identifier: (GPL-2.0-only OR BSD-2-Clause)
%YAML 1.2
---
$id: http://devicetree.org/schemas/interrupt-controller/adi,adsp-pint.yaml#
$schema: http://devicetree.org/meta-schemas/core.yaml#

title: Analog Devices Port Pin Interrupt for SC5XX-family processors

maintainers:
  - Arturs Artamonovs <arturs.artamonovs@analog.com>
  - Utsav Agarwal <Utsav.Agarwal@analog.com>

description: |
  Analog Devices Port Pin Interrupt driver for SC5XX-family processors

properties:
  compatible:
    enum:
      - adi,adsp-pint

  reg:
    maxItems: 1

  interrupts:
    maxItems: 1

required:
  - compatible
  - reg
  - interrupts

additionalProperties: false

examples:
  - |
    #include <dt-bindings/interrupt-controller/arm-gic.h>
    #include <dt-bindings/interrupt-controller/irq.h>
    #include <dt-bindings/clock/adi-sc5xx-clock.h>

    pint0: pint@31005000 {
      compatible = "adi,adsp-pint";
      reg = <0x31005000 0xFF>;
      interrupts = <GIC_SPI 65 IRQ_TYPE_LEVEL_HIGH>;
    };

    pint1: pint@31005100 {
      compatible = "adi,adsp-pint";
      reg = <0x31005100 0xFF>;
      interrupts = <GIC_SPI 66 IRQ_TYPE_LEVEL_HIGH>;
    };
...
```

## Documentation/devicetree/bindings/interrupt-controller/andestech,plicsw.yaml
```yaml
# SPDX-License-Identifier: (GPL-2.0-only OR BSD-2-Clause)
%YAML 1.2
---
$id: http://devicetree.org/schemas/interrupt-controller/andestech,plicsw.yaml#
$schema: http://devicetree.org/meta-schemas/core.yaml#

title: Andes machine-level software interrupt controller

description:
  In the Andes platform such as QiLai SoC, the PLIC module is instantiated a
  second time with all interrupt sources tied to zero as the software interrupt
  controller (PLIC_SW). PLIC_SW can generate machine-level software interrupts
  through programming its registers.

maintainers:
  - Ben Zong-You Xie <ben717@andestech.com>

properties:
  compatible:
    items:
      - enum:
          - andestech,qilai-plicsw
      - const: andestech,plicsw

  reg:
    maxItems: 1

  interrupts-extended:
    minItems: 1
    maxItems: 15872

additionalProperties: false

required:
  - compatible
  - reg
  - interrupts-extended

examples:
  - |
    interrupt-controller@400000 {
      compatible = "andestech,qilai-plicsw", "andestech,plicsw";
      reg = <0x400000 0x400000>;
      interrupts-extended = <&cpu0intc 3>,
                            <&cpu1intc 3>,
                            <&cpu2intc 3>,
                            <&cpu3intc 3>;
    };
```

## Documentation/devicetree/bindings/interrupt-controller/arm,gic-v5.yaml
```yaml
# SPDX-License-Identifier: (GPL-2.0-only OR BSD-2-Clause)
%YAML 1.2
---
$id: http://devicetree.org/schemas/interrupt-controller/arm,gic-v5.yaml#
$schema: http://devicetree.org/meta-schemas/core.yaml#

title: ARM Generic Interrupt Controller, version 5

maintainers:
  - Lorenzo Pieralisi <lpieralisi@kernel.org>
  - Marc Zyngier <maz@kernel.org>

description: |
  The GICv5 architecture defines the guidelines to implement GICv5
  compliant interrupt controllers for AArch64 systems.

  The GICv5 specification can be found at
  https://developer.arm.com/documentation/aes0070

  The GICv5 architecture is composed of multiple components:
    - one or more IRS (Interrupt Routing Service)
    - zero or more ITS (Interrupt Translation Service)
    - zero or more IWB (Interrupt Wire Bridge)

  The architecture defines:
    - PE-Private Peripheral Interrupts (PPI)
    - Shared Peripheral Interrupts (SPI)
    - Logical Peripheral Interrupts (LPI)

allOf:
  - $ref: /schemas/interrupt-controller.yaml#

properties:
  compatible:
    const: arm,gic-v5

  interrupt-controller: true

  "#address-cells":
    enum: [ 1, 2 ]
  "#size-cells":
    enum: [ 1, 2 ]

  ranges: true

  "#interrupt-cells":
    description: |
      Specifies the number of cells needed to encode an interrupt source.
      Must be a single cell with a value 3.

      The 1st cell corresponds to the INTID.Type field in the INTID; 1 for PPI,
      3 for SPI. LPI interrupts must not be described in the bindings since
      they are allocated dynamically by the software component managing them.

      The 2nd cell contains the interrupt INTID.ID field.

      The 3rd cell is the flags, encoded as follows:
      bits[3:0] trigger type and level flags.

        1 = low-to-high edge triggered
        2 = high-to-low edge triggered
        4 = active high level-sensitive
        8 = active low level-sensitive

      Cells 4 and beyond are reserved for future use and must have a value
      of 0 if present.
    const: 3

  interrupts:
    description:
      Interrupt source of the VGIC maintenance interrupt.
    maxItems: 1

required:
  - compatible

patternProperties:
  "^irs@[0-9a-f]+$":
    type: object
    description:
      GICv5 has one or more Interrupt Routing Services (IRS) that are
      responsible for handling IRQ state and routing.

    additionalProperties: false
    properties:
      compatible:
        const: arm,gic-v5-irs

      "#address-cells":
        enum: [ 1, 2 ]
      "#size-cells":
        enum: [ 1, 2 ]

      ranges: true

      dma-noncoherent:
        description:
          Present if the GIC IRS permits programming shareability and
          cacheability attributes but is connected to a non-coherent
          downstream interconnect.

      reg:
        minItems: 1
        items:
          - description: IRS control frame
          - description: IRS setlpi frame

      cpus:
        $ref: /schemas/types.yaml#/definitions/phandle-array
        description:
          Should be a list of phandles to CPU nodes (as described in
          Documentation/devicetree/bindings/arm/cpus.yaml) corresponding to
          CPUs managed by the IRS.

      arm,iaffids:
        $ref: /schemas/types.yaml#/definitions/uint16-array
        description:
          Should be a list of u16 values representing IAFFID IDs associated
          with the CPU whose CPU node phandle is at the same index in the
          cpus array.

    patternProperties:
      "^msi-controller@[0-9a-f]+$":
        type: object
        description:
          GICv5 has zero or more Interrupt Translation Services (ITS) that are
          used to route Message Signalled Interrupts (MSI) to the CPUs. Each
          ITS is connected to an IRS.
        additionalProperties: false
        properties:
          compatible:
            const: arm,gic-v5-its

          dma-noncoherent:
            description:
              Present if the GIC ITS permits programming shareability and
              cacheability attributes but is connected to a non-coherent
              downstream interconnect.

          msi-controller: true

          "#msi-cells":
            description:
              The single msi-cell is the DeviceID of the device which will
              generate the MSI.
            const: 1

          reg:
            items:
              - description: ITS control frame
              - description: ITS translate frame

        required:
          - compatible
          - msi-controller
          - "#msi-cells"
          - reg

    required:
      - compatible
      - reg
      - cpus
      - arm,iaffids

  "^interrupt-controller@[0-9a-f]+$":
    type: object
    description:
      GICv5 has zero or more Interrupt Wire Bridges (IWB) that are responsible
      for translating wire signals into interrupt messages to the ITS.

    additionalProperties: false
    properties:
      compatible:
        const: arm,gic-v5-iwb

      interrupt-controller: true

      "#address-cells":
        const: 0

      "#interrupt-cells":
        description: |
          Specifies the number of cells needed to encode an interrupt source.
          Must be a single cell with a value 2.

          The 1st cell corresponds to the IWB wire.

          The 2nd cell is the flags, encoded as follows:
          bits[3:0] trigger type and level flags.

          1 = low-to-high edge triggered
          2 = high-to-low edge triggered
          4 = active high level-sensitive
          8 = active low level-sensitive

          Cells 3 and beyond are reserved for future use and must have a value
          of 0 if present.
        const: 2

      reg:
        items:
          - description: IWB control frame

      msi-parent: true

    required:
      - compatible
      - reg
      - msi-parent

additionalProperties: false

examples:
  - |
    interrupt-controller {
      compatible = "arm,gic-v5";
      #interrupt-cells = <3>;
      #address-cells = <2>;
      #size-cells = <2>;
      ranges;

      interrupt-controller;

      interrupts = <1 25 4>;

      irs@2f1a0000 {
        compatible = "arm,gic-v5-irs";
        #address-cells = <2>;
        #size-cells = <2>;
        ranges;

        reg = <0x0 0x2f1a0000 0x0 0x10000>;  // IRS_CONFIG_FRAME for NS

        arm,iaffids = /bits 16 <0 1 2 3 4 5 6 7>;
        cpus = <&{/cpus/cpu@0}>, <&{/cpus/cpu@100}>, <&{/cpus/cpu@200}>,
               <&{/cpus/cpu@300}>, <&{/cpus/cpu@10000}>, <&{/cpus/cpu@10100}>,
               <&{/cpus/cpu@10200}>, <&{/cpus/cpu@10300}>;

        msi-controller@2f120000 {
          compatible = "arm,gic-v5-its";

          msi-controller;
          #msi-cells = <1>;

          reg = <0x0 0x2f120000 0x0 0x10000    // ITS_CONFIG_FRAME for NS
                 0x0 0x2f130000 0x0 0x10000>;  // ITS_TRANSLATE_FRAME
        };
      };

      interrupt-controller@2f000000 {
        compatible = "arm,gic-v5-iwb";
        #address-cells = <0>;

        interrupt-controller;
        #interrupt-cells = <2>;

        reg = <0x0 0x2f000000 0x0 0x10000>;

        msi-parent = <&its0 64>;
      };
    };

    device@0 {
      reg = <0 4>;
      interrupts = <3 115 4>;
    };

...
```

## Documentation/devicetree/bindings/interrupt-controller/aspeed,ast2400-vic.yaml
```yaml
# SPDX-License-Identifier: (GPL-2.0-only OR BSD-2-Clause)
%YAML 1.2
---
$id: http://devicetree.org/schemas/interrupt-controller/aspeed,ast2400-vic.yaml#
$schema: http://devicetree.org/meta-schemas/core.yaml#

title: Aspeed Vectored Interrupt Controller

maintainers:
  - Andrew Jeffery <andrew@codeconstruct.com.au>

description:
  The AST2400 and AST2500 SoC families include a legacy register layout before
  a redesigned layout, but the bindings do not prescribe the use of one or the
  other.

properties:
  compatible:
    enum:
      - aspeed,ast2400-vic
      - aspeed,ast2500-vic

  interrupt-controller: true

  "#interrupt-cells":
    const: 1
    description:
      Specifies the number of cells needed to encode an interrupt source. It
      must be 1 as the VIC has no configuration options for interrupt sources.
      The single cell defines the interrupt number.

  valid-sources:
    $ref: /schemas/types.yaml#/definitions/uint32-array
    description:
      One cell, bitmap of support sources for the implementation.

  reg:
    maxItems: 1

  interrupts:
    maxItems: 1

required:
  - compatible
  - reg
  - interrupt-controller
  - "#interrupt-cells"

allOf:
  - $ref: /schemas/interrupt-controller.yaml

additionalProperties: false

examples:
  - |
    interrupt-controller@1e6c0080 {
         compatible = "aspeed,ast2400-vic";
         reg = <0x1e6c0080 0x80>;
         interrupt-controller;
         #interrupt-cells = <1>;
    };

...
```
