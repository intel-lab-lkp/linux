## Documentation/devicetree/bindings/input/touchscreen/hynitron,cst816s.yaml
```yaml
# SPDX-License-Identifier: (GPL-2.0-only OR BSD-2-Clause)
%YAML 1.2
---
$id: http://devicetree.org/schemas/input/touchscreen/hynitron,cst816s.yaml#
$schema: http://devicetree.org/meta-schemas/core.yaml#

title: Hynitron CST816S Touchscreen controller

description:
  The CST816S is a touchscreen controller from Hynitron, which supports gesture
  recognition for swipe directions, tap, and long-press actions. This binding
  document defines the necessary properties for integrating the CST816S with
  a Linux system.

maintainers:
  - Oleh Kuzhylnyi <kuzhylol@gmail.com>

properties:
  compatible:
    enum:
      - hynitron,cst816s

  reg:
    maxItems: 1

  interrupts:
    maxItems: 1

  reset-gpios:
    maxItems: 1
    description:
      Optional GPIO line used to reset the touchscreen controller.
    optional: true

  gestures:
    type: object
    description:
      A list of gestures supported by the CST816S touchscreen controller and
      their associated Linux input event codes.
    optional: true

    properties:
      "^.*$":
        type: object
        description:
          Each child node represents a gesture that the touchscreen controller
          can recognize.

        properties:
          cst816x,gesture:
            description:
              Numeric value representing the gesture ID recognized by the
              CST816S touchscreen controller.
            $ref: /schemas/types.yaml#/definitions/uint32

          linux,code:
            description:
              Linux input event code (from linux/input-event-codes.h) that
              corresponds to the gesture.
            $ref: /schemas/types.yaml#/definitions/uint32

        required:
          - cst816x,gesture
          - linux,code

        additionalProperties: false

required:
  - compatible
  - reg
  - interrupts

additionalProperties: false

examples:
  - |
    #include <dt-bindings/gpio/gpio.h>
    #include <dt-bindings/input/linux-event-codes.h>
    #include <dt-bindings/interrupt-controller/irq.h>

    i2c {
      #address-cells = <1>;
      #size-cells = <0>;

      touchscreen@15 {
        compatible = "hynitron,cst816s";
        reg = <0x15>;
        interrupt-parent = <&gpio0>;
        interrupts = <4 IRQ_TYPE_EDGE_RISING>;
        reset-gpios = <&gpio 17 GPIO_ACTIVE_LOW>;

        gestures {
          swipe_up {
            cst816x,gesture = <0x1>;
            linux,code = <BTN_FORWARD>;
          };

          swipe_down {
            cst816x,gesture = <0x2>;
            linux,code = <BTN_BACK>;
          };

          swipe_left {
            cst816x,gesture = <0x3>;
            linux,code = <BTN_LEFT>;
          };

          swipe_right {
            cst816x,gesture = <0x4>;
            linux,code = <BTN_RIGHT>;
          };

          single_tap {
            cst816x,gesture = <0x5>;
            linux,code = <BTN_TOUCH>;
          };

          long_press {
            cst816x,gesture = <0xC>;
            linux,code = <BTN_TOOL_TRIPLETAP>;
          };
        };
      };
    };

...
```

## Documentation/devicetree/bindings/input/touchscreen/melfas,mip4_ts.yaml
```yaml
# SPDX-License-Identifier: (GPL-2.0-only OR BSD-2-Clause)
%YAML 1.2
---
$id: http://devicetree.org/schemas/input/touchscreen/melfas,mip4_ts.yaml#
$schema: http://devicetree.org/meta-schemas/core.yaml#

title: MELFAS MIP4 touchscreen controller

maintainers:
  - Sangwon Jee <jeesw@melfas.com>

allOf:
  - $ref: touchscreen.yaml#

properties:
  $nodename:
    pattern: "^touchscreen(@.*)?$"

  compatible:
    const: melfas,mip4_ts

  reg:
    enum: [ 0x48, 0x34 ]
    description: I2C slave address of the chip

  interrupts:
    maxItems: 1

  ce-gpios:
    description: GPIO connected to the CE (chip enable) pin of the chip

additionalProperties: false

required:
  - compatible
  - reg
  - interrupts

examples:
  - |
    #include <dt-bindings/gpio/gpio.h>
    #include <dt-bindings/interrupt-controller/irq.h>
    i2c {
      #address-cells = <1>;
      #size-cells = <0>;
      touchscreen@48 {
        compatible = "melfas,mip4_ts";
        reg = <0x48>;
        interrupt-parent = <&gpio>;
        interrupts = <0 IRQ_TYPE_EDGE_FALLING>;
        ce-gpios = <&gpio 0 GPIO_ACTIVE_HIGH>;
      };
    };

...
```

## Documentation/devicetree/bindings/input/touchscreen/raspberrypi,firmware-ts.txt
```
Raspberry Pi firmware based 7" touchscreen
=====================================

Required properties:
 - compatible: "raspberrypi,firmware-ts"

Optional properties:
 - firmware: Reference to RPi's firmware device node
 - touchscreen-size-x: See touchscreen.yaml
 - touchscreen-size-y: See touchscreen.yaml
 - touchscreen-inverted-x: See touchscreen.yaml
 - touchscreen-inverted-y: See touchscreen.yaml
 - touchscreen-swapped-x-y: See touchscreen.yaml

Example:

firmware: firmware-rpi {
	compatible = "raspberrypi,bcm2835-firmware";
	mboxes = <&mailbox>;

	ts: touchscreen {
		compatible = "raspberrypi,firmware-ts";
		touchscreen-size-x = <800>;
		touchscreen-size-y = <480>;
	};
};
```

## Documentation/devicetree/bindings/input/touchscreen/raspberrypi,firmware-ts.yaml
```yaml
# SPDX-License-Identifier: (GPL-2.0-only OR BSD-2-Clause)
%YAML 1.2
---
$id: http://devicetree.org/schemas/input/touchscreen/raspberrypi,firmware-ts.yaml#
$schema: http://devicetree.org/meta-schemas/core.yaml#

title: Raspberry Pi firmware based 7" touchscreen

maintainers:
  - Dario Binacchi <dario.binacchi@amarulasolutions.com>

allOf:
  - $ref: touchscreen.yaml#

properties:
  compatible:
    enum:
      - raspberrypi,firmware-ts

  firmware:
    description: Phandle to RPi's firmware device node.

  touchscreen-size-x: true
  touchscreen-size-y: true
  touchscreen-inverted-x: true
  touchscreen-inverted-y: true
  touchscreen-swapped-x-y: true

additionalProperties: false

required:
  - compatible

examples:
  - |
    touchscreen {
        compatible = "raspberrypi,firmware-ts";
        touchscreen-size-x = <800>;
        touchscreen-size-y = <480>;
    };
```

## Documentation/devicetree/bindings/input/touchscreen/st,fts2ba61y.yaml
```yaml
# SPDX-License-Identifier: (GPL-2.0-only OR BSD-2-Clause)
%YAML 1.2
---
$id: http://devicetree.org/schemas/input/touchscreen/st,fts2ba61y.yaml#
$schema: http://devicetree.org/meta-schemas/core.yaml#

title: ST-Microelectronics FTS2BA61Y touchscreen controller

maintainers:
  - Ivaylo Ivanov <ivo.ivanov.ivanov1@gmail.com>

allOf:
  - $ref: touchscreen.yaml#

properties:
  compatible:
    const: st,fts2ba61y

  reg:
    maxItems: 1

  interrupts:
    maxItems: 1

  avdd-supply: true
  vdd-supply: true

required:
  - compatible
  - reg
  - interrupts
  - avdd-supply
  - vdd-supply

unevaluatedProperties: false

examples:
  - |
    #include <dt-bindings/interrupt-controller/irq.h>
    spi {
        #address-cells = <1>;
        #size-cells = <0>;

        touchscreen@0 {
            compatible = "st,fts2ba61y";
            reg = <0x0>;
            interrupt-parent = <&gpa2>;
            interrupts = <2 IRQ_TYPE_LEVEL_HIGH>;
            avdd-supply = <&ldo17_reg>;
            vdd-supply = <&ldo28_reg>;
        };
    };
```

## Documentation/devicetree/bindings/input/touchscreen/syna,s3908.yaml
```yaml
# SPDX-License-Identifier: (GPL-2.0-only OR BSD-2-Clause)
%YAML 1.2
---
$id: http://devicetree.org/schemas/input/touchscreen/syna,s3908.yaml#
$schema: http://devicetree.org/meta-schemas/core.yaml#

title: Synaptics S3908 TouchComm I2C Touchscreen

maintainers:
  - Vsevolod Nevorotov <sevanevorotov29@gmail.com>

description:
  Synaptics S3908 is a TouchComm generation-1 touchscreen controller connected
  over I2C.

allOf:
  - $ref: touchscreen.yaml#

properties:
  compatible:
    const: syna,s3908

  reg:
    maxItems: 1

  interrupts:
    maxItems: 1

  reset-gpios:
    maxItems: 1

  vdd-supply:
    description: Core / digital power supply regulator (VDD)

  avdd-supply:
    description: Analog power supply regulator (AVDD)

  wakeup-source: true

required:
  - compatible
  - reg
  - interrupts
  - reset-gpios
  - vdd-supply
  - avdd-supply

unevaluatedProperties: false

examples:
  - |
    #include <dt-bindings/interrupt-controller/irq.h>
    #include <dt-bindings/gpio/gpio.h>

    i2c {
        #address-cells = <1>;
        #size-cells = <0>;

        touchscreen@4b {
            compatible = "syna,s3908";
            reg = <0x4b>;
            interrupt-parent = <&tlmm>;
            interrupts = <23 IRQ_TYPE_LEVEL_LOW>;
            reset-gpios = <&tlmm 22 GPIO_ACTIVE_LOW>;
            vdd-supply = <&vreg_l3c_3p0>;
            avdd-supply = <&vreg_l8c_1p8>;
            wakeup-source;
        };
    };
```

## Documentation/devicetree/bindings/input/touchscreen/syna,tcm-oncell.yaml
```yaml
# SPDX-License-Identifier: (GPL-2.0-only OR BSD-2-Clause)
%YAML 1.2
---
$id: http://devicetree.org/schemas/input/touchscreen/syna,tcm-oncell.yaml#
$schema: http://devicetree.org/meta-schemas/core.yaml#

title: Synaptics TCM Oncell i2c touchscreen

maintainers:
  - Caleb Connolly <caleb@postmarketos.org>

allOf:
  - $ref: touchscreen.yaml#

properties:
  compatible:
    enum:
      - syna,s3908

  reg:
    maxItems: 1

  interrupts-extended:
    maxItems: 1

  reset-gpios:
    maxItems: 1
    description: Reset GPIO the chip is connected to.

  vdd-supply:
    description: a phandle for the regulator supplying 3V power.

  vcc-supply:
    description: a phandle for the regulator supplying IO power.

additionalProperties: false

required:
  - compatible
  - reg
  - interrupts-extended
  - reset-gpios
  - vdd-supply
  - vcc-supply

examples:
  - |
    #include <dt-bindings/interrupt-controller/irq.h>
    #include <dt-bindings/gpio/gpio.h>

    i2c {
      #address-cells = <1>;
      #size-cells = <0>;
      clock-frequency = <400000>;
      status = "okay";

      touchscreen@4b {
        compatible = "syna,s3908";
        reg = <0x4B>;

        interrupts-extended = <&tlmm 39 0x2008>;

        reset-gpios = <&tlmm 38 GPIO_ACTIVE_LOW>;

        vdd-supply = <&vreg_l13a_ts_3p0>;
        vcc-supply = <&vreg_l1c_1p8>;
      };
    };
```

## Documentation/devicetree/bindings/input/touchscreen/ti,ads7843.yaml
```yaml
# SPDX-License-Identifier: (GPL-2.0-only OR BSD-2-Clause)
%YAML 1.2
---
$id: http://devicetree.org/schemas/input/touchscreen/ti,ads7843.yaml#
$schema: http://devicetree.org/meta-schemas/core.yaml#

title: TI's SPI driven touch screen controllers.

maintainers:
  - Dmitry Torokhov <dmitry.torokhov@gmail.com>
  - Marek Vasut <marex@denx.de>
  - Alexander Stein <alexander.stein@ew.tq-group.com>

description:
  Device tree bindings for TI's ADS7843, ADS7845, ADS7846, ADS7873, TSC2046
  SPI driven touch screen controllers.

  The node for this driver must be a child node of a SPI controller, hence
  all mandatory properties described in

properties:
  compatible:
    enum:
      - ti,tsc2046
      - ti,ads7843
      - ti,ads7845
      - ti,ads7846
      - ti,ads7873

  interrupts:
    maxItems: 1

  vcc-supply:
    description: A regulator node for the supply voltage.

  ti,vref-delay-usecs:
    $ref: /schemas/types.yaml#/definitions/uint16
    description: vref supply delay in usecs, 0 for external vref (u16).

  ti,vref-mv:
    $ref: /schemas/types.yaml#/definitions/uint16
    description:
      The VREF voltage, in millivolts (u16).
      Set to 0 to use internal references (ADS7846).

  ti,keep-vref-on:
    $ref: /schemas/types.yaml#/definitions/flag
    description: set to keep vref on for differential measurements as well.

  ti,settle-delay-usec:
    $ref: /schemas/types.yaml#/definitions/uint16
    description:
      Settling time of the analog signals; a function of Vcc and the
      capacitance on the X/Y drivers.  If set to non-zero, two samples are
      taken with settle_delay us apart, and the second one is used. ~150
      uSec with 0.01uF caps (u16).

  ti,penirq-recheck-delay-usecs:
    $ref: /schemas/types.yaml#/definitions/uint16
    description:
      If set to non-zero, after samples are taken this delay is applied and
      penirq is rechecked, to help avoid false events.  This value is
      affected by the material used to build the touch layer (u16).

  ti,x-plate-ohms:
    $ref: /schemas/types.yaml#/definitions/uint16
    description: Resistance of the X-plate, in Ohms (u16).

  ti,y-plate-ohms:
    $ref: /schemas/types.yaml#/definitions/uint16
    description: Resistance of the Y-plate, in Ohms (u16).

  ti,x-min:
    $ref: /schemas/types.yaml#/definitions/uint16
    description: Minimum value on the X axis (u16).

  ti,y-min:
    $ref: /schemas/types.yaml#/definitions/uint16
    description: Minimum value on the Y axis (u16).

  ti,debounce-tol:
    $ref: /schemas/types.yaml#/definitions/uint16
    description: Tolerance used for filtering (u16).

  ti,debounce-rep:
    $ref: /schemas/types.yaml#/definitions/uint16
    description:
      Additional consecutive good readings required after the first two (u16).

  ti,pendown-gpio-debounce:
    $ref: /schemas/types.yaml#/definitions/uint32
    description: Platform specific debounce time for the pendown-gpio (u32).

  pendown-gpio:
    description:
      GPIO handle describing the pin the !PENIRQ line is connected to.

  ti,hsync-gpios:
    description:
      GPIO line to poll for hsync

  wakeup-source: true

  ti,swap-xy:
    deprecated: true
    $ref: /schemas/types.yaml#/definitions/flag
    description: swap x and y axis

  ti,x-max:
    deprecated: true
    $ref: /schemas/types.yaml#/definitions/uint16
    description: Maximum value on the X axis (u16).

  ti,y-max:
    deprecated: true
    $ref: /schemas/types.yaml#/definitions/uint16
    description: Maximum value on the Y axis (u16).

  ti,pressure-min:
    deprecated: true
    $ref: /schemas/types.yaml#/definitions/uint16
    description: Minimum reported pressure value (threshold) - u16.

  ti,pressure-max:
    deprecated: true
    $ref: /schemas/types.yaml#/definitions/uint16
    description: Maximum reported pressure value (u16).

  ti,debounce-max:
    deprecated: true
    $ref: /schemas/types.yaml#/definitions/uint16
    description: Max number of additional readings per sample (u16).

required:
  - compatible
  - reg
  - vcc-supply

allOf:
  - $ref: touchscreen.yaml#
  - $ref: /schemas/spi/spi-peripheral-props.yaml#

unevaluatedProperties: false

examples:
  - |
    spi{
        #address-cells = <1>;
        #size-cells = <0>;

        touchscreen@0 {
           compatible = "ti,tsc2046";
           reg = <0>;	/* CS0 */
           interrupt-parent = <&gpio1>;
           interrupts = <8 0>;	/* BOOT6 / GPIO 8 */
           spi-max-frequency = <1000000>;
           pendown-gpio = <&gpio1 8 0>;
           vcc-supply = <&reg_vcc3>;

           ti,x-min = /bits/ 16 <0>;
           ti,x-max = /bits/ 16 <8000>;
           ti,y-min = /bits/ 16 <0>;
           ti,y-max = /bits/ 16 <4800>;
           ti,x-plate-ohms = /bits/ 16 <40>;
           ti,pressure-max = /bits/ 16 <255>;

           wakeup-source;
       };
    };
```
