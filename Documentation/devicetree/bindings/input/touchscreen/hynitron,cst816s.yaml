## Documentation/devicetree/bindings/interrupt-controller/aspeed,ast2700-intc.yaml
```yaml
# SPDX-License-Identifier: GPL-2.0 OR BSD-2-Clause
%YAML 1.2
---
$id: http://devicetree.org/schemas/interrupt-controller/aspeed,ast2700-intc.yaml#
$schema: http://devicetree.org/meta-schemas/core.yaml#

title: Aspeed AST2700 Interrupt Controller

description:
  This interrupt controller hardware is second level interrupt controller that
  is hooked to a parent interrupt controller. It's useful to combine multiple
  interrupt sources into 1 interrupt to parent interrupt controller.
  Depend to which INTC0 or INTC1 used.
  INTC0 and INTC1 are two kinds of interrupt controller with enable and raw
  status registers for use.
  INTC0 is used to assert GIC if interrupt in INTC1 asserted.
  INTC1 is used to assert INTC0 if interrupt of modules asserted.
  +-----+   +---------+
  | GIC |---|  INTC0  |
  +-----+   +---------+
            +---------+
            |         |---module0
            | INTC0_0 |---module1
            |         |---...
            +---------+---module31
            |---....  |
            +---------+
            |         |     +---------+
            | INTC0_11| +---| INTC1   |
            |         |     +---------+
            +---------+     +---------+---module0
                            | INTC1_0 |---module1
                            |         |---...
                            +---------+---module31
                            ...
                            +---------+---module0
                            | INTC1_5 |---module1
                            |         |---...
                            +---------+---module31

maintainers:
  - Kevin Chen <kevin_chen@aspeedtech.com>

properties:
  compatible:
    enum:
      - aspeed,ast2700-intc0
      - aspeed,ast2700-intc1

  reg:
    maxItems: 1

  '#address-cells':
    const: 2

  '#size-cells':
    const: 2

  ranges: true

patternProperties:
  "^interrupt-controller@":
    type: object
    description: Interrupt group child nodes
    additionalProperties: false

    properties:
      compatible:
        enum:
          - aspeed,ast2700-intc-ic

      reg:
        maxItems: 1

      interrupt-controller: true

      '#interrupt-cells':
        const: 2
        description: |
          The first cell is the IRQ number, the second cell is the trigger
          type as defined in interrupt.txt in this directory.

      interrupts:
        minItems: 1
        maxItems: 6
        description: |
          The interrupts provided by this interrupt controller.

      interrupts-extended:
        minItems: 1
        maxItems: 6
        description: |
          This property is required when defining a cascaded interrupt controller
          that is connected under another interrupt controller. It specifies the
          parent interrupt(s) in the upstream controller to which this controller
          is connected.

    oneOf:
      - required: [interrupts]
      - required: [interrupts-extended]

    required:
      - compatible
      - reg
      - interrupt-controller
      - '#interrupt-cells'

required:
  - compatible
  - reg

additionalProperties: false

examples:
  - |
    #include <dt-bindings/interrupt-controller/arm-gic.h>

    bus {
      #address-cells = <2>;
      #size-cells = <2>;

      intc0: interrupt-controller@12100000 {
        compatible = "aspeed,ast2700-intc0";
        reg = <0 0x12100000 0 0x4000>;
        ranges = <0x0 0x0 0x0 0x12100000 0x0 0x4000>;
        #address-cells = <2>;
        #size-cells = <2>;

        intc0_11: interrupt-controller@1b00 {
          compatible = "aspeed,ast2700-intc-ic";
          reg = <0 0x12101b00 0 0x10>;
          #interrupt-cells = <2>;
          interrupt-controller;
          interrupts = <GIC_SPI 192 (GIC_CPU_MASK_SIMPLE(4) | IRQ_TYPE_LEVEL_HIGH)>,
                       <GIC_SPI 193 (GIC_CPU_MASK_SIMPLE(4) | IRQ_TYPE_LEVEL_HIGH)>,
                       <GIC_SPI 194 (GIC_CPU_MASK_SIMPLE(4) | IRQ_TYPE_LEVEL_HIGH)>,
                       <GIC_SPI 195 (GIC_CPU_MASK_SIMPLE(4) | IRQ_TYPE_LEVEL_HIGH)>,
                       <GIC_SPI 196 (GIC_CPU_MASK_SIMPLE(4) | IRQ_TYPE_LEVEL_HIGH)>,
                       <GIC_SPI 197 (GIC_CPU_MASK_SIMPLE(4) | IRQ_TYPE_LEVEL_HIGH)>;
        };
      };

      intc1: interrupt-controller@14c18000 {
        compatible = "aspeed,ast2700-intc1";
        reg = <0 0x14c18000 0 0x400>;
        ranges = <0x0 0x0 0x0 0x14c18000 0x0 0x400>;
        #address-cells = <2>;
        #size-cells = <2>;

        intc1_0: interrupt-controller@100 {
          compatible = "aspeed,ast2700-intc-ic";
          reg = <0x0 0x100 0x0 0x10>;
          #interrupt-cells = <2>;
          interrupt-controller;
          interrupts-extended = <&intc0_11 0 (GIC_CPU_MASK_SIMPLE(4) | IRQ_TYPE_LEVEL_HIGH)>;
        };
      };
    };
```

## Documentation/devicetree/bindings/interrupt-controller/aspeed,ast2700-intc0.yaml
```yaml
# SPDX-License-Identifier: (GPL-2.0-only OR BSD-2-Clause)
%YAML 1.2
---
$id: http://devicetree.org/schemas/interrupt-controller/aspeed,ast2700-intc0.yaml#
$schema: http://devicetree.org/meta-schemas/core.yaml#

maintainers:
  - Ryan Chen <ryan_chen@aspeedtech.com>

title: ASPEED AST2700 Interrupt Controller 0

description:
  This interrupt controller hardware is first level interrupt controller that
  is hooked to the GIC interrupt controller. It's useful to combine multiple
  interrupt sources into 1 interrupt to GIC interrupt controller.

properties:
  compatible:
    const: aspeed,ast2700-intc0

  reg:
    maxItems: 1

  '#address-cells':
    const: 1

  '#size-cells':
    const: 1

  ranges: true

patternProperties:
  "^interrupt-controller@":
    type: object
    description: A child interrupt controller node
    additionalProperties: false

    properties:
      compatible:
        enum:
          - aspeed,ast2700-intc0-ic

      reg:
        maxItems: 1

      '#interrupt-cells':
        const: 1

      interrupt-controller: true

      interrupts:
        minItems: 1
        maxItems: 10

    required:
      - compatible
      - reg
      - interrupt-controller
      - '#interrupt-cells'
      - interrupts

required:
  - compatible
  - reg
  - '#address-cells'
  - '#size-cells'

additionalProperties: false

examples:
  - |
    #include <dt-bindings/interrupt-controller/arm-gic.h>

    intc0: interrupt-controller@12100000 {
        compatible = "aspeed,ast2700-intc0";
        reg = <0x12100000 0x4000>;
        #address-cells = <1>;
        #size-cells = <1>;
        ranges = <0x0 0x12100000 0x4000>;

        intc0_11: interrupt-controller@1b00 {
            #interrupt-cells = <1>;
            interrupt-controller;
            compatible = "aspeed,ast2700-intc0-ic";
            reg = <0x1b00 0x10>;
            interrupts = <GIC_SPI 192 IRQ_TYPE_LEVEL_HIGH>,
                         <GIC_SPI 193 IRQ_TYPE_LEVEL_HIGH>,
                         <GIC_SPI 194 IRQ_TYPE_LEVEL_HIGH>,
                         <GIC_SPI 195 IRQ_TYPE_LEVEL_HIGH>,
                         <GIC_SPI 196 IRQ_TYPE_LEVEL_HIGH>,
                         <GIC_SPI 197 IRQ_TYPE_LEVEL_HIGH>,
                         <GIC_SPI 198 IRQ_TYPE_LEVEL_HIGH>,
                         <GIC_SPI 199 IRQ_TYPE_LEVEL_HIGH>,
                         <GIC_SPI 200 IRQ_TYPE_LEVEL_HIGH>,
                         <GIC_SPI 201 IRQ_TYPE_LEVEL_HIGH>;
        };
    };
```

## Documentation/devicetree/bindings/interrupt-controller/aspeed,ast2700-intc1.yaml
```yaml
# SPDX-License-Identifier: (GPL-2.0-only OR BSD-2-Clause)
%YAML 1.2
---
$id: http://devicetree.org/schemas/interrupt-controller/aspeed,ast2700-intc1.yaml#
$schema: http://devicetree.org/meta-schemas/core.yaml#

maintainers:
  - Ryan Chen <ryan_chen@aspeedtech.com>

title: ASPEED AST2700 Interrupt Controller 1

description:
  This interrupt controller hardware is second level interrupt controller that
  is hooked to a parent interrupt controller. It's useful to combine multiple
  interrupt sources into 1 interrupt to parent interrupt controller.

properties:
  compatible:
    const: aspeed,ast2700-intc1

  reg:
    maxItems: 1

  '#address-cells':
    const: 1

  '#size-cells':
    const: 1

  ranges: true

patternProperties:
  "^interrupt-controller@":
    type: object
    description: A child interrupt controller node
    additionalProperties: false

    properties:
      compatible:
        enum:
          - aspeed,ast2700-intc1-ic

      reg:
        maxItems: 1

      '#interrupt-cells':
        const: 1

      interrupt-controller: true

      interrupts-extended:
        minItems: 1
        maxItems: 1

    required:
      - compatible
      - reg
      - interrupt-controller
      - '#interrupt-cells'
      - interrupts-extended

required:
  - compatible
  - reg
  - '#address-cells'
  - '#size-cells'

additionalProperties: false

examples:
  - |
    intc1: interrupt-controller@14c18000 {
        compatible = "aspeed,ast2700-intc1";
        reg = <0x14c18000 0x400>;
        #address-cells = <1>;
        #size-cells = <1>;
        ranges = <0x0 0x14c18000 0x400>;

        intc1_0: interrupt-controller@100 {
            compatible = "aspeed,ast2700-intc1-ic";
            reg = <0x100 0x10>;
            #interrupt-cells = <1>;
            interrupt-controller;
            interrupts-extended = <&intc0_11 0>;
        };

        intc1_1: interrupt-controller@110 {
            compatible = "aspeed,ast2700-intc1-ic";
            reg = <0x110 0x10>;
            #interrupt-cells = <1>;
            interrupt-controller;
            interrupts-extended = <&intc0_11 1>;
        };
    };
```

## Documentation/devicetree/bindings/interrupt-controller/brcm,bcm2835-armctrl-ic.yaml
```yaml
# SPDX-License-Identifier: (GPL-2.0-only OR BSD-2-Clause)
%YAML 1.2
---
$id: http://devicetree.org/schemas/interrupt-controller/brcm,bcm2835-armctrl-ic.yaml#
$schema: http://devicetree.org/meta-schemas/core.yaml#

title: BCM2835 Top-Level ("ARMCTRL") Interrupt Controller

maintainers:
  - Stefan Wahren <wahrenst@gmx.net>
  - Raspberry Pi Kernel Maintenance <kernel-list@raspberrypi.com>

description:
  The BCM2835 contains a custom top-level interrupt controller, which supports
  72 interrupt sources using a 2-level register scheme. The interrupt
  controller, or the HW block containing it, is referred to occasionally
  as "armctrl" in the SoC documentation, hence naming of this binding.

  The BCM2836 contains the same interrupt controller with the same
  interrupts, but the per-CPU interrupt controller is the root, and an
  interrupt there indicates that the ARMCTRL has an interrupt to handle.

allOf:
  - $ref: /schemas/interrupt-controller.yaml#

properties:
  compatible:
    enum:
      - brcm,bcm2835-armctrl-ic
      - brcm,bcm2836-armctrl-ic

  reg:
    maxItems: 1

  interrupt-controller: true

  "#interrupt-cells":
    const: 2

  interrupts:
    maxItems: 1

required:
  - compatible
  - reg
  - interrupt-controller
  - "#interrupt-cells"

if:
  properties:
    compatible:
      contains:
        const: brcm,bcm2836-armctrl-ic
then:
  required:
    - interrupts

additionalProperties: false

examples:
  - |
    intc: interrupt-controller@7e00b200 {
        compatible = "brcm,bcm2835-armctrl-ic";
        reg = <0x7e00b200 0x200>;
        interrupt-controller;
        #interrupt-cells = <2>;
    };
```
