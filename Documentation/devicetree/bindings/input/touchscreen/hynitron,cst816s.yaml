## Documentation/devicetree/bindings/input/touchscreen/touchnetix,ax54a.yaml
```yaml
# SPDX-License-Identifier: (GPL-2.0-only OR BSD-2-Clause)
%YAML 1.2
---
$id: http://devicetree.org/schemas/input/touchscreen/touchnetix,ax54a.yaml#
$schema: http://devicetree.org/meta-schemas/core.yaml#

title: TouchNetix Axiom series touchscreen controller

maintainers:
  - Kamel Bouhara <kamel.bouhara@bootlin.com>

properties:
  compatible:
    const: touchnetix,ax54a

  reg:
    const: 0x66

  interrupts:
    maxItems: 1

  reset-gpios:
    maxItems: 1

  poll-interval:
    description: Poll interval time in milliseconds.

  VDDA-supply:
    description: Analog power supply regulator on VDDA pin

  VDDI-supply:
    description: I/O power supply regulator on VDDI pin

required:
  - compatible
  - reg

additionalProperties: false

examples:
  - |
    #include <dt-bindings/gpio/gpio.h>
    #include <dt-bindings/interrupt-controller/arm-gic.h>
    i2c {
      #address-cells = <1>;
      #size-cells = <0>;
      touchscreen@66 {
        compatible = "touchnetix,ax54a";
        reg = <0x66>;
        interrupt-parent = <&gpio2>;
        interrupts = <2 IRQ_TYPE_EDGE_FALLING>;
        reset-gpios = <&gpio1 1 GPIO_ACTIVE_HIGH>;
      };
    };

...
```

## Documentation/devicetree/bindings/input/touchscreen/touchnetix,axiom-ax54a.yaml
```yaml
# SPDX-License-Identifier: (GPL-2.0-only OR BSD-2-Clause)
%YAML 1.2
---
$id: http://devicetree.org/schemas/input/touchscreen/touchnetix,axiom-ax54a.yaml#
$schema: http://devicetree.org/meta-schemas/core.yaml#

title: TouchNetix Axiom series touchscreen controller

maintainers:
  - Kamel Bouhara <kamel.bouhara@bootlin.com>

properties:
  compatible:
    const: touchnetix,axiom-ax54a

  reg:
    const: 0x66

  interrupts:
    maxItems: 1

  irq-gpios:
    maxItems: 1

  reset-gpios:
    maxItems: 1

additionalProperties: false

required:
  - compatible
  - reg

examples:
  - |
    #include <dt-bindings/gpio/gpio.h>
    #include <dt-bindings/interrupt-controller/arm-gic.h>
    i2c {
      #address-cells = <1>;
      #size-cells = <0>;
      axiom@66 {
        compatible = "touchnetix,axiom-ax54a";
        reg = <0x66>;
        interrupt-parent = <&gpio2>;
        interrupts = <2 IRQ_TYPE_EDGE_FALLING>;
        irq-gpios = <&gpio2 0 GPIO_ACTIVE_LOW>;
        reset-gpios = <&gpio1 1 GPIO_ACTIVE_HIGH>;
      };
    };

...
```

## Documentation/devicetree/bindings/input/touchscreen/zet6223.txt
```
Zeitec ZET6223 I2C touchscreen controller

Required properties:
- compatible		  : "zeitec,zet6223"
- reg			  : I2C slave address of the chip (0x76)
- interrupts		  : interrupt specification for the zet6223 interrupt

Optional properties:

- vio-supply		  : Specification for VIO supply (1.8V or 3.3V,
			    depending on system interface needs).
- vcc-supply		  : Specification for 3.3V VCC supply.
- touchscreen-size-x	  : See touchscreen.yaml
- touchscreen-size-y	  : See touchscreen.yaml
- touchscreen-inverted-x  : See touchscreen.yaml
- touchscreen-inverted-y  : See touchscreen.yaml
- touchscreen-swapped-x-y : See touchscreen.yaml

Example:

i2c@00000000 {

	zet6223: touchscreen@76 {
		compatible = "zeitec,zet6223";
		reg = <0x76>;
		interrupt-parent = <&pio>;
		interrupts = <6 11 IRQ_TYPE_EDGE_FALLING>
	};

};
```

## Documentation/devicetree/bindings/interconnect/qcom,camnoc.yaml
```yaml
# SPDX-License-Identifier: (GPL-2.0-only OR BSD-2-Clause)
%YAML 1.2
---
$id: http://devicetree.org/schemas/interconnect/qcom,camnoc.yaml#
$schema: http://devicetree.org/meta-schemas/core.yaml#

title: Qualcomm Camera NOC (CAMNOC) Interconnect Provider

maintainers:
  - Aleksandar Filipov <quic_afilipov@quicinc.com>

description:
  The Camera Network-on-Chip (CAMNOC) is the internal AXI interconnect
  within the Qualcomm camera subsystem. It arbitrates AXI bandwidth
  between camera sub-devices (IFE, JPEG, BPS, etc.) and the external
  memory interconnect. Multiple consumers may independently request
  bandwidth; the CAMNOC ICC provider aggregates these requests and
  scales CAM_CC_CAMNOC_AXI_CLK accordingly.

properties:
  compatible:
    enum:
      - qcom,sm8250-cam-virt

  clocks:
    items:
      - description: CAMNOC AXI clock

  clock-names:
    items:
      - const: camnoc_axi

  '#interconnect-cells':
    const: 1

required:
  - compatible
  - clocks
  - clock-names
  - '#interconnect-cells'

additionalProperties: false

examples:
  - |
    #include <dt-bindings/clock/qcom,camcc-sm8250.h>
    #include <dt-bindings/interconnect/qcom,camnoc.h>

    camnoc_icc: interconnect {
        compatible = "qcom,sm8250-cam-virt";
        clocks = <&camcc CAM_CC_CAMNOC_AXI_CLK>;
        clock-names = "camnoc_axi";
        #interconnect-cells = <1>;
    };

    /* Example camera sub-device consuming the CAMNOC provider above */
    camera-subsystem@ac53000 {
        reg = <0x0ac53000 0x1000>;

        interconnects = <&camnoc_icc MASTER_CAMNOC_JPEG
                         &camnoc_icc SLAVE_CAMNOC_AXI>;
        interconnect-names = "camnoc";

        /*
         * Optional: an operating-points-v2 table lets the consumer
         * drive its CAMNOC bandwidth vote from the same OPP that
         * selects its core clock rate and RPMh performance state.
         */
        operating-points-v2 = <&camera_opp_table>;

        camera_opp_table: opp-table {
            compatible = "operating-points-v2";

            opp-100000000 {
                opp-hz = /bits/ 64 <100000000>;
                opp-peak-kBps = <22246>;
                required-opps = <&rpmhpd_opp_min_svs>;
            };

            opp-200000000 {
                opp-hz = /bits/ 64 <200000000>;
                opp-peak-kBps = <44492>;
                required-opps = <&rpmhpd_opp_low_svs>;
            };

            opp-400000000 {
                opp-hz = /bits/ 64 <400000000>;
                opp-peak-kBps = <88983>;
                required-opps = <&rpmhpd_opp_svs>;
            };

            opp-480000000 {
                opp-hz = /bits/ 64 <480000000>;
                opp-peak-kBps = <106780>;
                required-opps = <&rpmhpd_opp_svs_l1>;
            };
        };
    };
```

## Documentation/devicetree/bindings/interconnect/qcom,glymur-rpmh.yaml
```yaml
# SPDX-License-Identifier: (GPL-2.0 OR BSD-2-Clause)
%YAML 1.2
---
$id: http://devicetree.org/schemas/interconnect/qcom,glymur-rpmh.yaml#
$schema: http://devicetree.org/meta-schemas/core.yaml#

title: Qualcomm RPMh Network-On-Chip Interconnect on GLYMUR

maintainers:
  - Raviteja Laggyshetty <raviteja.laggyshetty@oss.qualcomm.com>

description: |
  RPMh interconnect providers support system bandwidth requirements through
  RPMh hardware accelerators known as Bus Clock Manager (BCM). The provider is
  able to communicate with the BCM through the Resource State Coordinator (RSC)
  associated with each execution environment. Provider nodes must point to at
  least one RPMh device child node pertaining to their RSC and each provider
  can map to multiple RPMh resources.

  See also: include/dt-bindings/interconnect/qcom,glymur-rpmh.h

properties:
  compatible:
    enum:
      - qcom,glymur-aggre1-noc
      - qcom,glymur-aggre2-noc
      - qcom,glymur-aggre3-noc
      - qcom,glymur-aggre4-noc
      - qcom,glymur-clk-virt
      - qcom,glymur-cnoc-cfg
      - qcom,glymur-cnoc-main
      - qcom,glymur-hscnoc
      - qcom,glymur-lpass-ag-noc
      - qcom,glymur-lpass-lpiaon-noc
      - qcom,glymur-lpass-lpicx-noc
      - qcom,glymur-mc-virt
      - qcom,glymur-mmss-noc
      - qcom,glymur-nsinoc
      - qcom,glymur-nsp-noc
      - qcom,glymur-oobm-ss-noc
      - qcom,glymur-pcie-east-anoc
      - qcom,glymur-pcie-east-slv-noc
      - qcom,glymur-pcie-west-anoc
      - qcom,glymur-pcie-west-slv-noc
      - qcom,glymur-system-noc

  reg:
    maxItems: 1

required:
  - compatible

allOf:
  - $ref: qcom,rpmh-common.yaml#
  - if:
      properties:
        compatible:
          contains:
            enum:
              - qcom,glymur-clk-virt
              - qcom,glymur-mc-virt
    then:
      properties:
        reg: false
    else:
      required:
        - reg

unevaluatedProperties: false

examples:
  - |
    clk_virt: interconnect-0 {
      compatible = "qcom,glymur-clk-virt";
      #interconnect-cells = <2>;
      qcom,bcm-voters = <&apps_bcm_voter>;
    };

    aggre1_noc: interconnect@16e0000 {
      compatible = "qcom,glymur-aggre1-noc";
      reg = <0x016e0000 0x14400>;
      #interconnect-cells = <2>;
      qcom,bcm-voters = <&apps_bcm_voter>;
    };
```

## Documentation/devicetree/bindings/interconnect/qcom,kuno-rpmh.yaml
```yaml
# SPDX-License-Identifier: (GPL-2.0 OR BSD-2-Clause)
%YAML 1.2
---
$id: http://devicetree.org/schemas/interconnect/qcom,kuno-rpmh.yaml#
$schema: http://devicetree.org/meta-schemas/core.yaml#

title: Qualcomm RPMh Network-On-Chip Interconnect on Kuno SoC

maintainers:
  - Hardeep Sharma <hardeep.sharma@oss.qualcomm.com>

description: |
  RPMh interconnect providers support system bandwidth requirements through
  RPMh hardware accelerators known as Bus Clock Manager (BCM). The provider is
  able to communicate with the BCM through the Resource State Coordinator (RSC)
  associated with each execution environment. Provider nodes must point to at
  least one RPMh device child node pertaining to their RSC and each provider
  can map to multiple RPMh resources.

  See also: include/dt-bindings/interconnect/qcom,kuno.h

properties:
  compatible:
    enum:
      - qcom,kuno-aggre-noc
      - qcom,kuno-clk-virt
      - qcom,kuno-cnoc-main
      - qcom,kuno-dc-noc
      - qcom,kuno-mc-virt
      - qcom,kuno-mem-noc
      - qcom,kuno-pcie-anoc
      - qcom,kuno-system-noc

  reg:
    maxItems: 1

  clocks:
    minItems: 1
    maxItems: 4

  clock-names:
    minItems: 1
    maxItems: 4

required:
  - compatible

allOf:
  - $ref: qcom,rpmh-common.yaml#
  - if:
      properties:
        compatible:
          contains:
            enum:
              - qcom,kuno-clk-virt
              - qcom,kuno-mc-virt
    then:
      properties:
        reg: false
        clocks: false
        clock-names: false
    else:
      required:
        - reg

unevaluatedProperties: false

examples:
  - |
    interconnect-clk-virt {
        compatible = "qcom,kuno-clk-virt";
        #interconnect-cells = <1>;
        qcom,bcm-voters = <&apps_bcm_voter>;
    };

    interconnect@1640000 {
        compatible = "qcom,kuno-aggre-noc";
        reg = <0x01640000 0x33400>;
        #interconnect-cells = <1>;
        qcom,bcm-voters = <&apps_bcm_voter>;
    };
...
```

## Documentation/devicetree/bindings/interconnect/qcom,sc8380xp-rpmh.yaml
```yaml
# SPDX-License-Identifier: (GPL-2.0 OR BSD-2-Clause)
%YAML 1.2
---
$id: http://devicetree.org/schemas/interconnect/qcom,sc8380xp-rpmh.yaml#
$schema: http://devicetree.org/meta-schemas/core.yaml#

title: Qualcomm RPMh Network-On-Chip Interconnect on SC8380XP

maintainers:
  - Rajendra Nayak <quic_rjendra@quicinc.com>
  - Abel Vesa <abel.vesa@linaro.org>

description: |
  RPMh interconnect providers support system bandwidth requirements through
  RPMh hardware accelerators known as Bus Clock Manager (BCM). The provider is
  able to communicate with the BCM through the Resource State Coordinator (RSC)
  associated with each execution environment. Provider nodes must point to at
  least one RPMh device child node pertaining to their RSC and each provider
  can map to multiple RPMh resources.

  See also:: include/dt-bindings/interconnect/qcom,sc8380xp-rpmh.h

properties:
  compatible:
    enum:
      - qcom,sc8380xp-aggre1-noc
      - qcom,sc8380xp-aggre2-noc
      - qcom,sc8380xp-clk-virt
      - qcom,sc8380xp-cnoc-cfg
      - qcom,sc8380xp-cnoc-main
      - qcom,sc8380xp-gem-noc
      - qcom,sc8380xp-lpass-ag-noc
      - qcom,sc8380xp-lpass-lpiaon-noc
      - qcom,sc8380xp-lpass-lpicx-noc
      - qcom,sc8380xp-mc-virt
      - qcom,sc8380xp-mmss-noc
      - qcom,sc8380xp-nsp-noc
      - qcom,sc8380xp-pcie-center-anoc
      - qcom,sc8380xp-pcie-north-anoc
      - qcom,sc8380xp-pcie-south-anoc
      - qcom,sc8380xp-system-noc
      - qcom,sc8380xp-usb-center-anoc
      - qcom,sc8380xp-usb-north-anoc
      - qcom,sc8380xp-usb-south-anoc

  reg:
    maxItems: 1

allOf:
  - $ref: qcom,rpmh-common.yaml#
  - if:
      properties:
        compatible:
          contains:
            enum:
              - qcom,sc8380xp-clk-virt
              - qcom,sc8380xp-mc-virt
    then:
      properties:
        reg: false
    else:
      required:
        - reg

required:
  - compatible

unevaluatedProperties: false

examples:
  - |
    clk_virt: interconnect-0 {
      compatible = "qcom,sc8380xp-clk-virt";
      #interconnect-cells = <2>;
      qcom,bcm-voters = <&apps_bcm_voter>;
    };

    aggre1_noc: interconnect@16e0000 {
      compatible = "qcom,sc8380xp-aggre1-noc";
      reg = <0x016e0000 0x14400>;
      #interconnect-cells = <2>;
      qcom,bcm-voters = <&apps_bcm_voter>;
    };
```

## Documentation/devicetree/bindings/interconnect/qcom,sm6115.yaml
```yaml
# SPDX-License-Identifier: (GPL-2.0 OR BSD-2-Clause)
%YAML 1.2
---
$id: http://devicetree.org/schemas/interconnect/qcom,sm6115.yaml#
$schema: http://devicetree.org/meta-schemas/core.yaml#

title: Qualcomm SM6115 Network-On-Chip interconnect

maintainers:
  - Konrad Dybcio <konradybcio@kernel.org>

description: |
  The Qualcomm SM6115 interconnect providers support adjusting the
  bandwidth requirements between the various NoC fabrics.

properties:
  reg:
    maxItems: 1

  compatible:
    enum:
      - qcom,sm6115-bimc
      - qcom,sm6115-cnoc
      - qcom,sm6115-snoc

# Child node's properties
patternProperties:
  '^interconnect-[a-z0-9]+$':
    type: object
    description:
      The interconnect providers do not have a separate QoS register space,
      but share parent's space.

    allOf:
      - $ref: qcom,rpm-common.yaml#

    properties:
      compatible:
        enum:
          - qcom,sm6115-clk-virt
          - qcom,sm6115-mmrt-virt
          - qcom,sm6115-mmnrt-virt

    required:
      - compatible

    unevaluatedProperties: false

required:
  - compatible
  - reg

unevaluatedProperties: false

allOf:
  - $ref: qcom,rpm-common.yaml#
  - if:
      properties:
        compatible:
          const: qcom,sm6115-cnoc

    then:
      properties:
        clocks:
          items:
            - description: USB-NoC AXI clock

        clock-names:
          items:
            - const: usb_axi

  - if:
      properties:
        compatible:
          const: qcom,sm6115-snoc

    then:
      properties:
        clocks:
          items:
            - description: CPU-NoC AXI clock.
            - description: UFS-NoC AXI clock.
            - description: USB-NoC AXI clock.
            - description: IPA clock.

        clock-names:
          items:
            - const: cpu_axi
            - const: ufs_axi
            - const: usb_axi
            - const: ipa

examples:
  - |
    #include <dt-bindings/clock/qcom,rpmcc.h>

    snoc: interconnect@1880000 {
        compatible = "qcom,sm6115-snoc";
        reg = <0x01880000 0x60200>;
        #interconnect-cells = <1>;

        qup_virt: interconnect-qup {
            compatible = "qcom,sm6115-qup-virt";
            #interconnect-cells = <1>;
        };

        mmnrt_virt: interconnect-mmnrt {
            compatible = "qcom,sm6115-mmnrt-virt";
            #interconnect-cells = <1>;
        };

        mmrt_virt: interconnect-mmrt {
            compatible = "qcom,sm6115-mmrt-virt";
            #interconnect-cells = <1>;
        };
    };

    cnoc: interconnect@1900000 {
        compatible = "qcom,sm6115-cnoc";
        reg = <0x01900000 0x8200>;
        #interconnect-cells = <1>;
    };

    bimc: interconnect@4480000 {
        compatible = "qcom,sm6115-bimc";
        reg = <0x04480000 0x80000>;
        #interconnect-cells = <1>;
    };
```
