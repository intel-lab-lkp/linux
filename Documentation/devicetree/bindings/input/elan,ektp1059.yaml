## Documentation/devicetree/bindings/input/elan,ektp1059.yaml
```yaml
# SPDX-License-Identifier: (GPL-2.0-only OR BSD-2-Clause)
%YAML 1.2
---
$id: http://devicetree.org/schemas/input/elan,ektp1059.yaml#
$schema: http://devicetree.org/meta-schemas/core.yaml#

title: Elantech SPI Touchpad

maintainers:
  - Andreas Kemnade <andreas@kemnade.info>

allOf:
  - $ref: touchscreen/touchscreen.yaml#

properties:
  compatible:
    const: elan,ektp1059

  reg:
    maxItems: 1

  interrupts:
    maxItems: 1

required:
  - compatible
  - reg
  - interrupts

additionalProperties: false

examples:
  - |
    #include <dt-bindings/interrupt-controller/irq.h>
    spi {
        #address-cells = <1>;
        #size-cells = <0>;

        touchpad@0 {
            compatible = "elan,ektp1059";
            reg = <0x0>;
            interrupt-parent = <&gpio4>;
            interrupts = <0x0 IRQ_TYPE_LEVEL_LOW>;
        };
    };
```

## Documentation/devicetree/bindings/input/goodix,gt7375p.yaml
```yaml
# SPDX-License-Identifier: (GPL-2.0-only OR BSD-2-Clause)
%YAML 1.2
---
$id: http://devicetree.org/schemas/input/goodix,gt7375p.yaml#
$schema: http://devicetree.org/meta-schemas/core.yaml#

title: Goodix GT7375P touchscreen

maintainers:
  - Douglas Anderson <dianders@chromium.org>
  - Charles Wang <charles.goodix@gmail.com>

description:
  The Goodix GT7375P and GT7986U touchscreens support both SPI and I2C interfaces.
  With the I2C interface, they use the i2c-hid protocol but require non-standard
  power sequencing. With the SPI interface, they use a custom HID protocol that
  is incompatible with Microsoft's HID-over-SPI protocol.

properties:
  compatible:
    oneOf:
      - items:
          - const: goodix,gt7375p
      - items:
          - const: goodix,gt7986u
          - const: goodix,gt7375p
      - items:
          - const: goodix,gt7986u

  reg:
    maxItems: 1

  interrupts:
    maxItems: 1

  panel: true

  reset-gpios:
    true

  vdd-supply:
    description: The 3.3V supply to the touchscreen.

  mainboard-vddio-supply:
    description:
      The supply on the main board needed to power up IO signals going
      to the touchscreen. This supply need not go to the touchscreen
      itself as long as it allows the main board to make signals compatible
      with what the touchscreen is expecting for its IO rails.

  goodix,no-reset-during-suspend:
    description:
      Set this to true to enforce the driver to not assert the reset GPIO
      during suspend.
      Due to potential touchscreen hardware flaw, back-powering could happen in
      suspend if the power supply is on and with active-low reset GPIO asserted.
      This property is used to avoid the back-powering issue.
    type: boolean

  goodix,hid-report-addr:
    $ref: /schemas/types.yaml#/definitions/uint32
    description:
      The register address for retrieving HID report data.
      This address is related to the device firmware and may
      change after a firmware update.

  spi-max-frequency: true

required:
  - compatible
  - reg
  - interrupts
  - reset-gpios
  - vdd-supply

allOf:
  - $ref: /schemas/input/touchscreen/touchscreen.yaml#
  - $ref: /schemas/spi/spi-peripheral-props.yaml#

  - if:
      properties:
        compatible:
          items:
            - const: goodix,gt7986u
    then:
      required:
        - goodix,hid-report-addr
    else:
      properties:
        goodix,hid-report-addr: false
        spi-max-frequency: false
        reg:
          enum: [0x5d, 0x14]

additionalProperties: false

examples:
  - |
    #include <dt-bindings/clock/qcom,rpmh.h>
    #include <dt-bindings/gpio/gpio.h>
    #include <dt-bindings/interrupt-controller/irq.h>

    i2c {
      #address-cells = <1>;
      #size-cells = <0>;

      ap_ts: touchscreen@5d {
        compatible = "goodix,gt7375p";
        reg = <0x5d>;

        interrupt-parent = <&tlmm>;
        interrupts = <9 IRQ_TYPE_LEVEL_LOW>;

        reset-gpios = <&tlmm 8 GPIO_ACTIVE_LOW>;
        vdd-supply = <&pp3300_ts>;
      };
    };

  - |
    #include <dt-bindings/interrupt-controller/irq.h>
    #include <dt-bindings/gpio/gpio.h>

    spi {
      #address-cells = <1>;
      #size-cells = <0>;

      touchscreen@0 {
        compatible = "goodix,gt7986u";
        reg = <0>;
        interrupt-parent = <&gpio>;
        interrupts = <25 IRQ_TYPE_LEVEL_LOW>;
        reset-gpios = <&gpio1 1 GPIO_ACTIVE_LOW>;
        spi-max-frequency = <10000000>;
        goodix,hid-report-addr = <0x22c8c>;
        vdd-supply = <&pp3300_ts>;
      };
    };
```

## Documentation/devicetree/bindings/input/goodix,gt7986u.yaml
```yaml
# SPDX-License-Identifier: (GPL-2.0-only OR BSD-2-Clause)
%YAML 1.2
---
$id: http://devicetree.org/schemas/input/goodix,gt7986u.yaml#
$schema: http://devicetree.org/meta-schemas/core.yaml#

title: Goodix GT7986U SPI HID Touchscreen

maintainers:
  - Charles Wang <charles.goodix@gmail.com>

description: Supports the Goodix GT7986U touchscreen.
  This touch controller reports data packaged according to the HID protocol
  over the SPI bus, but it is incompatible with Microsoft's HID-over-SPI protocol.

allOf:
  - $ref: /schemas/spi/spi-peripheral-props.yaml#

properties:
  compatible:
    description:
      Add the 'spifw' suffix to distinguish it from the general GT7986U I2C-HID
      touchscreen, as it runs a substantially different firmware than GT7986U
      I2C-HID touchscreens.
    enum:
      - goodix,gt7986u-spifw

  reg:
    maxItems: 1

  interrupts:
    maxItems: 1

  reset-gpios:
    maxItems: 1

  spi-max-frequency: true

unevaluatedProperties: false

required:
  - compatible
  - reg
  - interrupts
  - reset-gpios

examples:
  - |
    #include <dt-bindings/interrupt-controller/irq.h>
    #include <dt-bindings/gpio/gpio.h>

    spi {
      #address-cells = <1>;
      #size-cells = <0>;

      touchscreen@0 {
        compatible = "goodix,gt7986u-spifw";
        reg = <0>;
        interrupt-parent = <&gpio>;
        interrupts = <25 IRQ_TYPE_LEVEL_LOW>;
        reset-gpios = <&gpio1 1 GPIO_ACTIVE_LOW>;
        spi-max-frequency = <10000000>;
      };
    };

...
```

## Documentation/devicetree/bindings/input/gpio-charlieplex-keypad.yaml
```yaml
# SPDX-License-Identifier: (GPL-2.0-only OR BSD-2-Clause)
%YAML 1.2
---

$id: http://devicetree.org/schemas/input/gpio-charlieplex-keypad.yaml#
$schema: http://devicetree.org/meta-schemas/core.yaml#

title: GPIO charlieplex keypad

maintainers:
  - Hugo Villeneuve <hvilleneuve@dimonoff.com>

description:
  The charlieplex keypad supports N^2)-N different key combinations (where N is
  the number of lines). Key presses and releases are detected by configuring
  only one line as output at a time, and reading other line states. This process
  is repeated for each line.
  This mechanism doesn't allow to detect simultaneous key presses.

allOf:
  - $ref: input.yaml#
  - $ref: /schemas/input/matrix-keymap.yaml#

properties:
  compatible:
    const: gpio-charlieplex-keypad

  autorepeat: true

  line-scan-delay-us:
    description:
      Delay, measured in microseconds, that is needed
      before we can scan keypad after activating one line.
    default: 0

  line-gpios:
    description:
      List of GPIOs used as lines. The gpio specifier for this property
      depends on the gpio controller to which these lines are connected.

  linux,keymap: true

  debounce-delay-ms:
    description: Debounce interval in milliseconds.
    default: 5

  poll-interval: true

  wakeup-source: true

required:
  - compatible
  - line-gpios
  - linux,keymap
  - poll-interval

additionalProperties: false

examples:
  - |
    #include <dt-bindings/input/input.h>

    charlieplex-keypad {
        compatible = "gpio-charlieplex-keypad";
        debounce-delay-ms = <20>;
        poll-interval = <5>;
        line-scan-delay-us = <2>;

        line-gpios = <&gpio2 25 0
                      &gpio2 26 0
                      &gpio2 27 0>;

        /* MATRIX_KEY(output, input, key-code) */
        linux,keymap = <
            MATRIX_KEY(0, 1, KEY_F1)
            MATRIX_KEY(0, 2, KEY_F2)
            MATRIX_KEY(1, 0, KEY_F3)
            MATRIX_KEY(1, 2, KEY_F4)
            MATRIX_KEY(2, 0, KEY_F5)
            MATRIX_KEY(2, 1, KEY_F6)
        >;
    };
```

## Documentation/devicetree/bindings/input/hid-over-spi.yaml
```yaml
# SPDX-License-Identifier: (GPL-2.0-only OR BSD-2-Clause)
%YAML 1.2
---
$id: http://devicetree.org/schemas/input/hid-over-spi.yaml#
$schema: http://devicetree.org/meta-schemas/core.yaml#

title: HID over SPI Devices

maintainers:
  - Benjamin Tissoires <benjamin.tissoires@redhat.com>
  - Jiri Kosina <jkosina@suse.cz>

description: |+
  HID over SPI provides support for various Human Interface Devices over the
  SPI bus. These devices can be for example touchpads, keyboards, touch screens
  or sensors.

  The specification has been written by Microsoft and is currently available here:
  https://www.microsoft.com/en-us/download/details.aspx?id=103325

  If this binding is used, the kernel module spi-hid will handle the communication
  with the device and the generic hid core layer will handle the protocol.

allOf:
  - $ref: /schemas/input/touchscreen/touchscreen.yaml#

properties:
  compatible:
    oneOf:
      - items:
          - enum:
              - microsoft,g6-touch-digitizer
          - const: hid-over-spi
      - description: Just "hid-over-spi" alone is allowed, but not recommended.
        const: hid-over-spi

  reg:
    maxItems: 1

  interrupts:
    maxItems: 1

  reset-gpios:
    maxItems: 1
    description:
      GPIO specifier for the digitizer's reset pin (active low). The line must
      be flagged with GPIO_ACTIVE_LOW.

  vdd-supply:
    description:
      Regulator for the VDD supply voltage.

  input-report-header-address:
    $ref: /schemas/types.yaml#/definitions/uint32
    minimum: 0
    maximum: 0xffffff
    description:
      A value to be included in the Read Approval packet, listing an address of
      the input report header to be put on the SPI bus. This address has 24
      bits.

  input-report-body-address:
    $ref: /schemas/types.yaml#/definitions/uint32
    minimum: 0
    maximum: 0xffffff
    description:
     A value to be included in the Read Approval packet, listing an address of
      the input report body to be put on the SPI bus. This address has 24 bits.

  output-report-address:
    $ref: /schemas/types.yaml#/definitions/uint32
    minimum: 0
    maximum: 0xffffff
    description:
      A value to be included in the Output Report sent by the host, listing an
      address where the output report on the SPI bus is to be written to. This
      address has 24 bits.

  post-power-on-delay-ms:
    description:
      Optional time in ms required by the device after enabling its regulators
      or powering it on, before it is ready for communication.

  minimal-reset-delay-ms:
    description:
      Optional minimum amount of time in ms that device needs to be in reset
      state for the reset to take effect.

  read-opcode:
  $ref: /schemas/types.yaml#/definitions/uint8
    description:
      Value to be used in Read Approval packets. 1 byte.

  write-opcode:
  $ref: /schemas/types.yaml#/definitions/uint8
    description:
      Value to be used in Write Approval packets. 1 byte.

  hid-over-spi-flags:
  $ref: /schemas/types.yaml#/definitions/uint16
    description:
      16 bits.
      Bits 0-12 - Reserved (must be 0)
      Bit 13 - SPI Write Mode. Possible values -
        * 0b0- Writes are carried out in Single-SPI mode
        * 0b1- Writes are carried out in the Multi-SPI mode specified by bits
               14-15
      Bits 14-15 - Multi-SPI Mode. Possible values -
        * 0b00- Single SPI
        * 0b01- Dual SPI
        * 0b10- Quad SPI

required:
  - compatible
  - interrupts
  - reset-gpios
  - vdd-supply
  - input-report-header-address
  - input-report-body-address
  - output-report-address
  - read-opcode
  - write-opcode
  - hid-over-spi-flags

additionalProperties: false

examples:
  - |
    #include <dt-bindings/interrupt-controller/irq.h>
    #include <dt-bindings/gpio/gpio.h>

    spi {
      #address-cells = <1>;
      #size-cells = <0>;

      hid@0 {
        compatible = "hid-over-spi";
        reg = <0x0>;
        interrupts-extended = <&gpio 42 IRQ_TYPE_EDGE_FALLING>;
        reset-gpios = <&gpio 27 GPIO_ACTIVE_LOW>;
        vdd-supply = <&pm8350c_l3>;
        pinctrl-names = "default";
        pinctrl-0 = <&ts_d6_reset_assert &ts_d6_int_bias>;
        input-report-header-address = <0x1000>;
        input-report-body-address = <0x1004>;
        output-report-address = <0x2000>;
        read-opcode = <0x0b>;
        write-opcode = <0x02>;
        hid-over-spi-flags = <0x0000>;
        post-power-on-delay-ms = <5>;
        minimal-reset-delay-ms = <5>;
      };
    };
```
