## Documentation/devicetree/bindings/input/himax,hid.yaml
```yaml
# SPDX-License-Identifier: GPL-2.0-only OR BSD-2-Clause
%YAML 1.2
---
$id: http://devicetree.org/schemas/input/himax,hid.yaml#
$schema: http://devicetree.org/meta-schemas/core.yaml#

title: Himax TDDI devices using SPI to send HID packets

maintainers:
  - Tylor Yang <tylor_yang@himax.corp-partner.google.com>

description: |
  Support the Himax TDDI devices which using SPI interface to acquire
  HID packets from the device. The device needs to be initialized using
  Himax protocol before it start sending HID packets.

properties:
  compatible:
    const: himax,hid

  reg:
    maxItems: 1

  interrupts:
    maxItems: 1

  reset:
    maxItems: 1
    description: Reset device, active low signal.

  vccd-supply:
    description:
      Optional regulator for the 1.8V voltage.

  vcca-supply:
    description:
      Optional regulator for the analog 3.3V voltage.

  himax,id-gpios:
    maxItems: 8
    description: GPIOs to read physical Panel ID. Optional.

  spi-cpha: true
  spi-cpol: true

  himax,ic-det-delay-ms:
    description:
      Due to TDDI properties, the TPIC detection timing must after the
      display panel initialized. This property is used to specify the
      delay time when TPIC detection and display panel initialization
      timing are overlapped. How much milliseconds to delay before TPIC
      detection start.

  himax,ic-resume-delay-ms:
    description:
      Due to TDDI properties, the TPIC resume timing must after the
      display panel resumed. This property is used to specify the
      delay time when TPIC resume and display panel resume
      timing are overlapped. How much milliseconds to delay before TPIC
      resume start.

  panel:
    description:
      The node of the display panel device. The driver will use this
      node to get the project ID of the display panel. Optional.
    type: object
    additionalProperties: false

    properties:
      himax,pid:
        $ref: /schemas/types.yaml#/definitions/uint32-array
        minItems: 1
        maxItems: 8
        items:
          minimum: 0
          maximum: 65535
        description:
          When only one value exist, represent Project ID of the device.
          When multiple values exist, order in event number value represnet
          id value from id-gpios and odd number value represent Project ID
          relatives to prior id value. This is used to specify the firmware
          for the device.

    required:
      - himax,pid

required:
  - compatible
  - reg
  - interrupts
  - reset

unevaluatedProperties: false

allOf:
  - $ref: /schemas/spi/spi-peripheral-props.yaml#

examples:
  - |
    #include <dt-bindings/interrupt-controller/irq.h>
    #include <dt-bindings/gpio/gpio.h>

    spi {
        #address-cells = <1>;
        #size-cells = <0>;

        touchscreen@0 {
            compatible = "himax,hid";
            reg = <0x0>;
            interrupt-parent = <&gpio1>;
            interrupts = <7 IRQ_TYPE_LEVEL_LOW>;
            pinctrl-0 = <&touch_pins>;
            pinctrl-names = "default";

            spi-max-frequency = <12500000>;
            spi-cpha;
            spi-cpol;

            reset = <&gpio1 8 GPIO_ACTIVE_LOW>;
            himax,ic-det-delay-ms = <500>;
            himax,ic-resume-delay-ms = <100>;
        };
    };
```

## Documentation/devicetree/bindings/input/himax,hx83102j.yaml
```yaml
# SPDX-License-Identifier: (GPL-2.0-only OR BSD-2-Clause)
%YAML 1.2
---
$id: http://devicetree.org/schemas/input/himax,hx83102j.yaml#
$schema: http://devicetree.org/meta-schemas/core.yaml#

title: Himax hx83102j touchscreen

maintainers:
  - Allen Lin <allencl_lin@hotmail.com>

description:
  This Himax hx83102j touchscreen uses the spi-hid protocol.

allOf:
  - $ref: /schemas/input/touchscreen/touchscreen.yaml#
  - $ref: /schemas/spi/spi-peripheral-props.yaml#

properties:
  compatible:
    enum:
      - himax,hx83102j

  reg:
    maxItems: 1

  interrupts:
    maxItems: 1

  reset-gpios:
    maxItems: 1

  spi-cpha: true

  spi-cpol: true

  spi-max-frequency: true

required:
  - compatible
  - reg
  - interrupts
  - reset-gpios

additionalProperties: false

examples:
  - |
    #include <dt-bindings/gpio/gpio.h>
    #include <dt-bindings/interrupt-controller/irq.h>
    spi {
      #address-cells = <1>;
      #size-cells = <0>;
      hid-himax-spi@0 {
        compatible = "himax,hx83102j";
        reg = <0>;
        pinctrl-names = "default";
        pinctrl-0 = <&touch_int0 &touch_reset>;
        reset-gpios = <&gpio1 8 GPIO_ACTIVE_LOW>;
        spi-cpha;
        spi-cpol;
        interrupt-parent = <&gpio1>;
        interrupts = <7 IRQ_TYPE_LEVEL_LOW>;
      };
    };
```

## Documentation/devicetree/bindings/input/himax,hx8310xx.yaml
```yaml
# SPDX-License-Identifier: (GPL-2.0-only OR BSD-2-Clause)
%YAML 1.2
---
$id: http://devicetree.org/schemas/input/himax,hx8310xx.yaml#
$schema: http://devicetree.org/meta-schemas/core.yaml#

title: himax hx8310xx touchscreen

maintainers:
  - Allen Lin <allencl_lin@hotmail.com>

description:
  Supports the himax hx8310xx touchscreen.
  This touchscreen uses the spi-hid protocol but has some non-standard
  power sequencing required.

allOf:
  - $ref: /schemas/input/touchscreen/touchscreen.yaml#

properties:
  compatible:
    enum:
      - himax,hx83102j

  reg:
    maxItems: 1

  interrupts:
    maxItems: 1

  reset-gpios:
    maxItems: 1

  spi-cpha: true

  spi-cpol: true

  spi-max-frequency: true

required:
  - compatible
  - reg
  - interrupts
  - reset-gpios

additionalProperties: false

examples:
  - |
    #include <dt-bindings/clock/qcom,rpmh.h>
    #include <dt-bindings/gpio/gpio.h>
    #include <dt-bindings/interrupt-controller/irq.h>
    spi {
      #address-cells = <1>;
      #size-cells = <0>;

      hid_himax_spi@0 {
        pinctrl-names = "default";
        pinctrl-0 = <&touch_int0 &touch_reset>;
        reg = <0>;
        spi-max-frequency = <12500000>;
        status = "okay";
        compatible = "himax,hx83102j";
        reset-gpios = <&gpio1 8 GPIO_ACTIVE_LOW>;
        spi-cpha;
        spi-cpol;
        interrupt-parent = <&gpio1>;
        interrupts = <7 IRQ_TYPE_LEVEL_LOW>;
      };
    };
```

## Documentation/devicetree/bindings/input/max7360-keypad.yaml
```yaml
# SPDX-License-Identifier: (GPL-2.0-only OR BSD-2-Clause)
%YAML 1.2
---
$id: http://devicetree.org/schemas/input/max7360-keypad.yaml#
$schema: http://devicetree.org/meta-schemas/core.yaml#

title: Maxim MAX7360 Keypad Controller

maintainers:
  - Mathieu Dubois-Briand <mathieu.dubois-briand@bootlin.com>

description: |
  Maxim MAX7360 Keypad Controller, in MAX7360 MFD
  https://www.analog.com/en/products/max7360.html

allOf:
  - $ref: matrix-keymap.yaml#
  - $ref: input.yaml#

properties:
  compatible:
    enum:
      - maxim,max7360-keypad

  interrupts:
    description: The interrupt line the device is connected to.
    maxItems: 1

  debounce-delay-ms:
    description: Debounce delay in ms
    minimum: 9
    maximum: 40
    default: 9

  linux,input-no-autorepeat:
    description: If present, the keys will not autorepeat when pressed

required:
  - compatible
  - interrupts
  - linux,keymap

unevaluatedProperties: false

examples:
  - |
    #include <dt-bindings/interrupt-controller/arm-gic.h>
    #include <dt-bindings/input/input.h>

    max7360_keypad {
      compatible = "maxim,max7360-keypad";

      keypad,num-rows = <8>;
      keypad,num-columns = <4>;

      linux,keymap = <
        MATRIX_KEY(0x00, 0x00, KEY_F5)
        MATRIX_KEY(0x01, 0x00, KEY_F4)
        MATRIX_KEY(0x02, 0x01, KEY_F6)
        >;

      interrupt-parent = <&gpio1>;
      interrupts = <23 IRQ_TYPE_LEVEL_LOW>;

      debounce-delay-ms = <10>;
      linux,input-no-autorepeat;
    };
```

## Documentation/devicetree/bindings/input/max7360-rotary.yaml
```yaml
# SPDX-License-Identifier: (GPL-2.0-only OR BSD-2-Clause)
%YAML 1.2
---
$id: http://devicetree.org/schemas/input/max7360-rotary.yaml#
$schema: http://devicetree.org/meta-schemas/core.yaml#

title: Maxim MAX7360 Rotary Encoder

maintainers:
  - Mathieu Dubois-Briand <mathieu.dubois-briand@bootlin.com>

description: |
  Maxim MAX7360 Rotary Encoder, in MAX7360 MFD
  https://www.analog.com/en/products/max7360.html

properties:
  compatible:
    enum:
      - maxim,max7360-rotary

  interrupts:
    description: The interrupt line the device is connected to.
    maxItems: 1

  debounce-delay-ms:
    description: Debounce delay in ms
    minimum: 0
    maximum: 15
    default: 0

  linux,axis:
    description: The input subsystem axis to map to this rotary encoder.

required:
  - compatible
  - interrupts

additionalProperties: false

examples:
  - |
    #include <dt-bindings/interrupt-controller/arm-gic.h>

    max7360_rotary: max7360_rotary {
      compatible = "maxim,max7360-rotary";

      debounce-delay-ms = <2>;
      linux,axis = <0>; /* REL_X */

      interrupt-parent = <&gpio1>;
      interrupts = <23 IRQ_TYPE_LEVEL_LOW>;
    };
```

## Documentation/devicetree/bindings/input/maxim,max77705.yaml
```yaml
# SPDX-License-Identifier: (GPL-2.0-only OR BSD-2-Clause)
%YAML 1.2
---
$id: http://devicetree.org/schemas/input/maxim,max77705.yaml#
$schema: http://devicetree.org/meta-schemas/core.yaml#

title: Maxim MAX77705 Companion Power Management IC haptic

maintainers:
  - Dzmitry Sankouski <dsankouski@gmail.com>

description: |
  This is a part of device tree bindings for Maxim MAX77705 multi functional device.

  See also Documentation/devicetree/bindings/mfd/maxim,max77705.yaml for
  additional information and example.

properties:
  compatible:
    const: maxim,max77705-haptic

  haptic-supply: true

  pwms: true

required:
  - compatible
  - haptic-supply
  - pwms

additionalProperties: false
```

## Documentation/devicetree/bindings/input/nuvoton,ma35d1-keypad.yaml
```yaml
# SPDX-License-Identifier: (GPL-2.0 OR BSD-2-Clause)
%YAML 1.2
---
$id: http://devicetree.org/schemas/input/nuvoton,ma35d1-keypad.yaml#
$schema: http://devicetree.org/meta-schemas/core.yaml#

title: Nuvoton MA35D1 Keypad

maintainers:
  - Ming-jen Chen <mjchen0829@gmail.com>

allOf:
  - $ref: /schemas/input/matrix-keymap.yaml#

properties:
  compatible:
    const: nuvoton,ma35d1-kpi

  debounce-delay-ms:
    description: Debounce delay time in milliseconds.
    maxItems: 1

  scan-interval-ms:
    description: Scan interval time in milliseconds.
    maxItems: 1

  reg:
    maxItems: 1

  interrupts:
    maxItems: 1

  clocks:
    maxItems: 1

required:
  - compatible
  - reg
  - interrupts
  - clocks
  - linux,keymap
  - keypad,num-rows
  - keypad,num-columns
  - debounce-delay-ms
  - scan-interval-ms

unevaluatedProperties: false

examples:
  - |
    #include <dt-bindings/input/input.h>
    keypad@404A0000 {
      compatible = "nuvoton,ma35d1-kpi";
      reg = <0x404A0000 0x10000>;
      interrupts = <79>;
      clocks = <&clk>;
      keypad,num-rows = <2>;
      keypad,num-columns = <2>;

      linux,keymap = <
         MATRIX_KEY(0, 0, KEY_ENTER)
         MATRIX_KEY(0, 1, KEY_ENTER)
         MATRIX_KEY(1, 0, KEY_SPACE)
         MATRIX_KEY(1, 1, KEY_Z)
      >;

      debounce-delay-ms = <1>;
      scan-interval-ms = <20>;
    };
```

## Documentation/devicetree/bindings/input/nvt,ma35d1-keypad.yaml
```yaml
# SPDX-License-Identifier: (GPL-2.0 OR BSD-2-Clause)
%YAML 1.2
---
$id: http://devicetree.org/schemas/input/nvt,ma35d1-keypad.yaml#
$schema: http://devicetree.org/meta-schemas/core.yaml#

title: NVT MA35D1 Keypad

maintainers:
  - Ming-jen Chen <mjchen0829@gmail.com>

allOf:
  - $ref: /schemas/input/matrix-keymap.yaml#

properties:
  compatible:
    const: nuvoton,ma35d1-kpi

  debounce-period:
    $ref: /schemas/types.yaml#/definitions/uint32
    description: |
      key debounce period select
      0  = 0 clock
      1  = 0 clock
      2  = 0 clock
      3  = 8 clocks
      4  = 16 clocks
      5  = 32 clocks
      6  = 64 clocks
      7  = 128 clocks
      8  = 256 clocks
      9  = 512 clocks
      10 = 1024 clocks
      11 = 2048 clocks
      12 = 4096 clocks
      13 = 8192 clocks

  per-scale:
    $ref: /schemas/types.yaml#/definitions/uint32
    description: Row Scan Cycle Pre-scale Value (1 to 256).

  per-scalediv:
    $ref: /schemas/types.yaml#/definitions/uint32
    description: Per-scale divider (1 to 256).

  reg:
    maxItems: 1

  interrupts:
    maxItems: 1

  clocks:
    maxItems: 1

required:
  - compatible
  - reg
  - interrupts
  - clocks
  - linux,keymap
  - debounce-period
  - per-scale
  - per-scalediv

unevaluatedProperties: false

examples:
  - |
    #include <dt-bindings/input/input.h>
    keypad: keypad@404A0000 {
      compatible = "nuvoton,ma35d1-kpi";
      reg = <0x404A0000 0x10000>;
      interrupts = <79>;
      clocks = <&clk>;
      keypad,num-rows = <2>;
      keypad,num-columns = <2>;

      linux,keymap = <
         MATRIX_KEY(0,  0, KEY_ENTER)
         MATRIX_KEY(0,  1, KEY_ENTER)
         MATRIX_KEY(1,  0, KEY_SPACE)
         MATRIX_KEY(1,  1, KEY_Z)
     >;

     debounce-period = <1>;
     per-scale = <1>;
     per-scalediv = <24>;
    };
```

## Documentation/devicetree/bindings/input/parade,tc3408.yaml
```yaml
# SPDX-License-Identifier: (GPL-2.0-only OR BSD-2-Clause)
%YAML 1.2
---
$id: http://devicetree.org/schemas/input/parade,tc3408.yaml#
$schema: http://devicetree.org/meta-schemas/core.yaml#

title: Parade tc3408 touchscreen controller

maintainers:
  - Langyan Ye <yelangyan@huaqin.corp-partner.google.com>

description:
  Supports the Parade tc3408 touchscreen controller.
  This touchscreen controller uses the i2c-hid protocol with a reset GPIO.

allOf:
  - $ref: /schemas/input/touchscreen/touchscreen.yaml#

properties:
  compatible:
    const: parade,tc3408

  reg:
    const: 0x24

  interrupts:
    maxItems: 1

  panel: true

  reset-gpios:
    maxItems: 1
    description: Reset GPIO.

  vcc33-supply:
    description: The 3.3V supply to the touchscreen.

  vccio-supply:
    description: The 1.8V supply to the touchscreen.

required:
  - compatible
  - reg
  - interrupts
  - panel
  - vcc33-supply
  - vccio-supply

additionalProperties: false

examples:
  - |
    #include <dt-bindings/gpio/gpio.h>
    #include <dt-bindings/interrupt-controller/irq.h>

    i2c {
      #address-cells = <1>;
      #size-cells = <0>;

      touchscreen: touchscreen@24 {
        compatible = "parade,tc3408";
        reg = <0x24>;

        interrupt-parent = <&pio>;
        interrupts = <15 IRQ_TYPE_LEVEL_LOW>;

        panel = <&panel>;
        reset-gpios = <&pio 126 GPIO_ACTIVE_LOW>;
        vcc33-supply = <&pp3300_tchscr_x>;
        vccio-supply = <&pp1800_tchscr_report_disable>;
      };
    };
```

## Documentation/devicetree/bindings/input/pf1550_onkey.yaml
```yaml
# SPDX-License-Identifier: GPL-2.0
%YAML 1.2
---
$id: http://devicetree.org/schemas/input/pf1550_onkey.yaml#
$schema: http://devicetree.org/meta-schemas/core.yaml#

title: Onkey for PF1550 PMIC from NXP.

maintainers:
  - Samuel Kayode <samuel.kayode@savoirfairelinux.com>

description: |
  This module is part of the pf1550 MFD device. For more details
  see Documentation/devicetree/bindings/mfd/pf1550.yaml.

allOf:
  - $ref: input.yaml#

properties:
  compatible:
    const: fsl,pf1550-onkey

  linux,keycodes:
    description: Keycode to emit
    default: 116  # KEY_POWER

required:
  - compatible
additionalProperties: false

...
```
