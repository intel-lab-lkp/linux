## Documentation/devicetree/bindings/input/touchscreen/adi,ad7877.yaml
```yaml
# SPDX-License-Identifier: (GPL-2.0-only OR BSD-2-Clause)
%YAML 1.2
---
$id: http://devicetree.org/schemas/input/touchscreen/adi,ad7877.yaml#
$schema: http://devicetree.org/meta-schemas/core.yaml#

title: Analog Devices AD7877 Touch Screen Controller

maintainers:
  - Antoniu Miclaus <antoniu.miclaus@analog.com>

description: |
  Analog Devices Touch Screen Controller
  https://www.analog.com/media/en/technical-documentation/data-sheets/AD7877.pdf

allOf:
  - $ref: touchscreen.yaml#
  - $ref: /schemas/spi/spi-peripheral-props.yaml#

properties:
  compatible:
    enum:
      - adi,ad7877

  reg:
    maxItems: 1

  interrupts:
    maxItems: 1

  spi-max-frequency:
    description: AD7877 SPI bus clock frequency.
    minimum: 10000
    maximum: 20000000

  adi,stopacq-polarity:
    description: The polarity of the signal applied to the STOPACQ pin.
    $ref: /schemas/types.yaml#/definitions/string
    enum: [low, high]

  adi,first-conv-delay-ns:
    description: Delay in ns before the first conversion.
    enum: [500, 128000, 1000000, 8000000]

  adi,pen-down-acc-interval-us:
    description: Enable the ADC to repeatedly perform conversions.
    enum: [0, 500, 1000, 8000]
    default: 0

  adi,acquisition-time-us:
    description: Select acquisition times in us for the ADC.
    enum: [2, 4, 8, 16]
    default: 2

  adi,vref-delay-us:
    description: Delay required for the SPI transfers depending on the VREF used.
    default: 100

  touchscreen-average-samples:
    enum: [1, 4, 8, 16]

  touchscreen-x-plate-ohms:
    default: 400

  touchscreen-min-x: true
  touchscreen-min-y: true
  touchscreen-size-x: true
  touchscreen-size-y: true
  touchscreen-max-pressure: true

required:
  - compatible
  - reg
  - interrupts
  - touchscreen-average-samples

additionalProperties: false

examples:
  - |
    #include <dt-bindings/interrupt-controller/irq.h>
    spi {
      #address-cells = <1>;
      #size-cells = <0>;

      touchscreen@0 {
        compatible = "adi,ad7877";
        reg = <0>;
        spi-max-frequency = <20000000>;
        interrupts = <21 IRQ_TYPE_EDGE_FALLING>;
        interrupt-parent = <&gpio>;
        adi,vref-delay-us = <100>;
        adi,stopacq-polarity = "low";
        adi,first-conv-delay-ns = <500>;
        adi,pen-down-acc-interval-us = <0>;
        adi,acquisition-time-us = <2>;
        touchscreen-average-samples = <16>;
        touchscreen-x-plate-ohms = <400>;
        touchscreen-min-x = <0>;
        touchscreen-min-y = <0>;
        touchscreen-size-x = <800>;
        touchscreen-size-y = <480>;
        touchscreen-max-pressure = <4095>;
      };
    };
...
```

## Documentation/devicetree/bindings/input/touchscreen/apple,z2-multitouch.yaml
```yaml
# SPDX-License-Identifier: (GPL-2.0 OR BSD-2-Clause)
%YAML 1.2
---
$id: http://devicetree.org/schemas/input/touchscreen/apple,z2-multitouch.yaml#
$schema: http://devicetree.org/meta-schemas/core.yaml#

title: Apple touchscreens attached using the Z2 protocol

maintainers:
  - Sasha Finkelstein <fnkl.kernel@gmail.com>

description: A series of touschscreen controllers used in Apple products

allOf:
  - $ref: touchscreen.yaml#
  - $ref: /schemas/spi/spi-peripheral-props.yaml#

properties:
  compatible:
    items:
      - enum:
          - apple,j293-touchbar
          - apple,j493-touchbar
      - const: apple,z2-touchbar
      - const: apple,z2-multitouch

  interrupts:
    maxItems: 1

  reset-gpios:
    maxItems: 1

  cs-gpios:
    maxItems: 1
    description: |
      J293 has a hardware quirk where the CS line is unusable and has
      to the be driven by a GPIO pin instead

  firmware-name:
    maxItems: 1

  label:
    maxItems: 1

  touchscreen-size-x: true
  touchscreen-size-y: true

required:
  - compatible
  - interrupts
  - reset-gpios
  - firmware-name
  - label
  - touchscreen-size-x
  - touchscreen-size-y

unevaluatedProperties: false

examples:
  - |
    #include <dt-bindings/gpio/gpio.h>
    #include <dt-bindings/interrupt-controller/irq.h>

    spi {
        #address-cells = <1>;
        #size-cells = <0>;

        touchscreen@0 {
            compatible = "apple,j293-touchbar", "apple,z2-touchbar",
                         "apple,z2-multitouch";
            reg = <0>;
            spi-max-frequency = <11500000>;
            reset-gpios = <&pinctrl_ap 139 0>;
            cs-gpios = <&pinctrl_ap 109 0>;
            interrupts-extended = <&pinctrl_ap 194 IRQ_TYPE_EDGE_FALLING>;
            firmware-name = "apple/dfrmtfw-j293.bin";
            touchscreen-size-x = <23045>;
            touchscreen-size-y = <640>;
            label = "MacBookPro17,1 Touch Bar";
        };
    };

...
```

## Documentation/devicetree/bindings/input/touchscreen/eeti,exc3000.yaml
```yaml
# SPDX-License-Identifier: (GPL-2.0 OR BSD-2-Clause)
%YAML 1.2
---
$id: http://devicetree.org/schemas/input/touchscreen/eeti,exc3000.yaml#
$schema: http://devicetree.org/meta-schemas/core.yaml#

title: EETI EXC3000 series touchscreen controller

maintainers:
  - Dmitry Torokhov <dmitry.torokhov@gmail.com>

properties:
  compatible:
    oneOf:
      - const: eeti,exc3000
      - const: eeti,exc80h60
      - const: eeti,exc80h84
      - const: eeti,exc3000-i2c
      - items:
          - enum:
              - eeti,exc81w32
          - const: eeti,exc80h84
  reg:
    const: 0x2a
  interrupts:
    maxItems: 1
  reset-gpios:
    maxItems: 1
  vdd-supply:
    description: Power supply regulator for the chip
  attn-gpios:
    maxItems: 1
    description: Phandle to a GPIO to check whether interrupt is still
                 latched. This is necessary for platforms that lack
                 support for level-triggered IRQs.
  touchscreen-size-x: true
  touchscreen-size-y: true
  touchscreen-inverted-x: true
  touchscreen-inverted-y: true
  touchscreen-swapped-x-y: true

allOf:
  - $ref: touchscreen.yaml#
  - if:
      not:
        properties:
          compatible:
            contains:
              const: eeti,exc3000-i2c
    then:
      required:
        - touchscreen-size-x
        - touchscreen-size-y

required:
  - compatible
  - reg
  - interrupts

additionalProperties: false

examples:
  - |
    #include "dt-bindings/interrupt-controller/irq.h"
    i2c {
        #address-cells = <1>;
        #size-cells = <0>;

        touchscreen@2a {
                compatible = "eeti,exc3000";
                reg = <0x2a>;
                interrupt-parent = <&gpio1>;
                interrupts = <9 IRQ_TYPE_LEVEL_LOW>;
                touchscreen-size-x = <4096>;
                touchscreen-size-y = <4096>;
                touchscreen-inverted-x;
                touchscreen-swapped-x-y;
        };
    };

  - |
    #include <dt-bindings/gpio/gpio.h>
    #include "dt-bindings/interrupt-controller/irq.h"
    i2c {
        #address-cells = <1>;
        #size-cells = <0>;

        touchscreen@2a {
            compatible = "eeti,exc3000-i2c";
            reg = <0x2a>;
            interrupt-parent = <&gpio>;
            interrupts = <123 IRQ_TYPE_EDGE_RISING>;
            attn-gpios = <&gpio 123 GPIO_ACTIVE_HIGH>;
        };
    };
```

## Documentation/devicetree/bindings/input/touchscreen/eeti.yaml
```yaml
# SPDX-License-Identifier: (GPL-2.0-only OR BSD-2-Clause)
%YAML 1.2
---
$id: http://devicetree.org/schemas/input/touchscreen/eeti.yaml#
$schema: http://devicetree.org/meta-schemas/core.yaml#

title: EETI touchscreen controller

description:
  EETI I2C driven touchscreen controller.

maintainers:
  - Dario Binacchi <dario.binacchi@amarulasolutions.com>

allOf:
  - $ref: touchscreen.yaml#

properties:
  compatible:
    enum:
      - eeti,exc3000-i2c

  reg:
    maxItems: 1

  interrupts:
    maxItems: 1

  attn-gpios:
    maxItems: 1
    description: Phandle to a GPIO to check whether interrupt is still
                 latched. This is necessary for platforms that lack
                 support for level-triggered IRQs.

  touchscreen-inverted-x: true
  touchscreen-inverted-y: true
  touchscreen-swapped-x-y: true

additionalProperties: false

required:
  - compatible
  - reg
  - interrupts

examples:
  - |
    #include <dt-bindings/gpio/gpio.h>
    #include <dt-bindings/interrupt-controller/irq.h>
    i2c {
        #address-cells = <1>;
        #size-cells = <0>;

        touchscreen@a {
            compatible = "eeti,exc3000-i2c";
            reg = <0xa>;

            interrupt-parent = <&gpio>;
            interrupts = <123 IRQ_TYPE_EDGE_RISING>;
            attn-gpios = <&gpio 123 GPIO_ACTIVE_HIGH>;
        };
    };
```

## Documentation/devicetree/bindings/input/touchscreen/eswin,eph8621.yaml
```yaml
# SPDX-License-Identifier: GPL-2.0-only OR BSD-2-Clause
%YAML 1.2
---
$id: http://devicetree.org/schemas/input/touchscreen/eswin,eph8621.yaml#
$schema: http://devicetree.org/meta-schemas/core.yaml#

title: ESWIN EPH8621 touchscreen controller

maintainers:
  - Luca Weiss <luca.weiss@fairphone.com>

allOf:
  - $ref: touchscreen.yaml#
  - $ref: /schemas/spi/spi-peripheral-props.yaml#

properties:
  compatible:
    enum:
      - eswin,eph8621

  reg:
    maxItems: 1

  interrupts:
    maxItems: 1

  reset-gpios:
    maxItems: 1

  avdd-supply:
    description: Power supply regulator on AVDD pin

  vddio-supply:
    description: Power supply regulator on VDDIO pin

  spi-max-frequency: true
  touchscreen-inverted-x: true
  touchscreen-inverted-y: true
  touchscreen-size-x: true
  touchscreen-size-y: true
  touchscreen-swapped-x-y: true

additionalProperties: false

required:
  - compatible
  - reg
  - interrupts
  - avdd-supply
  - vddio-supply
  - touchscreen-size-x
  - touchscreen-size-y

examples:
  - |
    #include <dt-bindings/interrupt-controller/irq.h>
    #include <dt-bindings/gpio/gpio.h>
    spi {
      #address-cells = <1>;
      #size-cells = <0>;
      touchscreen@0 {
        compatible = "eswin,eph8621";
        reg = <0>;

        avdd-supply = <&vreg_l22b>;
        vddio-supply = <&vreg_l9b>;

        interrupts-extended = <&tlmm 19 IRQ_TYPE_LEVEL_LOW>;
        reset-gpios = <&tlmm 20 GPIO_ACTIVE_LOW>;

        spi-max-frequency = <2000000>;

        touchscreen-size-x = <1116>;
        touchscreen-size-y = <2484>;
        touchscreen-inverted-x;
      };
    };

...
```
