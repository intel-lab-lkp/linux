## Documentation/devicetree/bindings/input/pixart,paj7620.yaml
```yaml
# SPDX-License-Identifier: (GPL-2.0-only OR BSD-2-Clause)
%YAML 1.2
---
$id: http://devicetree.org/schemas/input/pixart,paj7620.yaml#
$schema: http://devicetree.org/meta-schemas/core.yaml#

title: PixArt PAJ7620 Gesture Sensor

maintainers:
  - Harpreet Saini <sainiharpreet29@yahoo.com>

description:
  The PixArt PAJ7620 is a gesture recognition sensor with an integrated
  infrared LED and CMOS array. It communicates over an I2C interface and
  provides gesture data via a dedicated interrupt pin. When operating in
  I2C mode, the unused SPI pins can be repurposed as GPIOs.

allOf:
  - $ref: input.yaml#
  - $ref: /schemas/spi/spi-peripheral-props.yaml#

properties:
  compatible:
    const: pixart,paj7620

  reg:
    maxItems: 1

  interrupts:
    maxItems: 1

  vdd-supply:
    description: Main power supply.

  vbus-supply:
    description: I/O and I2C bus power supply.

  vled-supply:
    description: Power for the integrated IR LED.

  linux,keycodes:
    minItems: 9
    maxItems: 9
    description:
      List of keycodes mapping to the 9 supported gestures.

  gpio-controller: true

  "#gpio-cells":
    const: 2

required:
  - compatible
  - reg
  - interrupts
  - vdd-supply
  - vbus-supply
  - vled-supply

unevaluatedProperties: false

examples:
  - |
    #include <dt-bindings/interrupt-controller/irq.h>
    #include <dt-bindings/input/input.h>
    i2c {
        #address-cells = <1>;
        #size-cells = <0>;

        gesture@73 {
            compatible = "pixart,paj7620";
            reg = <0x73>;
            interrupt-parent = <&gpio>;
            interrupts = <4 IRQ_TYPE_EDGE_FALLING>;
            vdd-supply = <&reg_3v3>;
            vbus-supply = <&reg_1v8>;
            vled-supply = <&reg_3v3>;
            linux,keycodes = <KEY_UP KEY_DOWN KEY_LEFT KEY_RIGHT
                             KEY_ENTER KEY_BACK KEY_NEXT KEY_PREVIOUS
                             KEY_MENU>;
            gpio-controller;
            #gpio-cells = <2>;
        };
    };
```

## Documentation/devicetree/bindings/input/qcom,spmi-haptics.yaml
```yaml
# SPDX-License-Identifier: GPL-2.0-only OR BSD-2-Clause
%YAML 1.2
---
$id: http://devicetree.org/schemas/input/qcom,spmi-haptics.yaml#
$schema: http://devicetree.org/meta-schemas/core.yaml#

title: Haptics device inside Qualcomm Technologies, Inc. PMIH010X

maintainers:
  - Fenglin Wu <fenglin.wu@oss.qualcomm.com>

description: |
  The Qualcomm PMIH010X PMIC integrates a haptics module (HAP530_HV) that
  drives an LRA (Linear Resonant Actuator) with output voltage up to 10 V.
  Two play modes are supported:

    DIRECT_PLAY: The hardware outputs sinusoidal waveforms whose period is
      defined by lra-period-us and whose peak voltage is defined by vmax-mv.
      The driving amplitude can be scaled in the range [0, 255] via a single
      register byte.  Hardware-based LRA auto-resonance tracking is enabled by
      default in this mode, allowing the haptics engine to follow the actual
      resonant frequency of the LRA and update the driving period accordingly
      to achieve stronger vibration magnitude.

    FIFO streaming: The hardware can play an arbitrary waveform composed of a
      sequence of 8-bit samples at a configurable play rate.  Samples are
      pre-filled into the internal FIFO memory of the haptics module and
      continuously replenished via the FIFO-empty IRQ until all samples have
      been played.  The following play rate values are accepted:
        -- 0(T_LRA): each FIFO byte drives one full sinusoidal cycle with the
          period defined in lra-period-us.
        -- 1/2/3(T_LRA_DIV_2/4/8): each FIFO byte drives a half/quarter/eighth
          sinusoidal cycle with the period defined in lra-period-us.
        -- 8/9/10/11/12/13(8KHz/16KHz/24KHz/32KHz/44.1KHz/48KHz): the FIFO
          data is treated as PCM samples and drives the output with an
          arbitrarily shaped waveform.  This mode is typically used to define
          custom driving waveforms for specific vibration effects such as fast
          attack, crisp brake, etc.

      In FIFO streaming mode, hardware-based LRA auto-resonance tracking is
      disabled by default.  Because this mode is intended to drive arbitrary
      waveforms that may not follow the resonant frequency, autonomous hardware
      resonance correction would interfere with the intended output.

      In the driver, FIFO streaming is implemented using an FF_PERIODIC effect
      with an FF_CUSTOM waveform.  The expected custom data layout is:
        custom_data[0]   = play rate code (see qcom,wf-play-rate values below)
        custom_data[1]   = vmax in mV; 0 = use device default (qcom,vmax-mv)
        custom_data[2..] = signed 8-bit PCM samples (at least one required)

properties:
  compatible:
    const: qcom,pmih010x-haptics

  reg:
    items:
      - description: HAP_CFG module base address
      - description: HAP_PTN module base address

  reg-names:
    items:
      - const: hap-cfg
      - const: hap-ptn

  interrupts:
    maxItems: 1

  interrupt-names:
    items:
      - const: fifo-empty

  qcom,vmax-mv:
    description:
      Maximum allowed output driving voltage in millivolts, rounded to the
      nearest 50 mV step. This is the peak driving voltage in DIRECT_PLAY mode
      which outputs sinusoidal waveforms. The value should be equal to the square
      root of 2 times the Vrms voltage of the LRA.
    $ref: /schemas/types.yaml#/definitions/uint32
    minimum: 50
    maximum: 10000

  qcom,lra-period-us:
    description:
      LRA actuator initial resonance period in microseconds
      (1,000,000 / resonant_freq_hz).  Used to configure T_LRA-based play
      rates and the auto-resonance zero-crossing window.
    minimum: 5
    maximum: 20475

required:
  - compatible
  - reg
  - reg-names
  - interrupts
  - interrupt-names
  - qcom,vmax-mv
  - qcom,lra-period-us

additionalProperties: false

examples:
  - |
    #include <dt-bindings/interrupt-controller/irq.h>

    pmic {
        #address-cells = <1>;
        #size-cells = <0>;

        haptics@f000 {
            compatible = "qcom,pmih010x-haptics";
            reg = <0xf000>, <0xf100>;
            reg-names = "hap-cfg", "hap-ptn";
            interrupts = <0x7 0xf0 0x1 IRQ_TYPE_EDGE_RISING>;
            interrupt-names = "fifo-empty";

            qcom,vmax-mv = <1300>;
            qcom,lra-period-us = <5880>;
        };
    };
```

## Documentation/devicetree/bindings/input/semtech,sx951x.yaml
```yaml
# SPDX-License-Identifier: (GPL-2.0 OR BSD-2-Clause)
%YAML 1.2
---
$id: http://devicetree.org/schemas/input/semtech,sx951x.yaml#
$schema: http://devicetree.org/meta-schemas/core.yaml#

title: Semtech SX9512/SX9513 based capacitive touch sensors

description: |
  The Semtech SX9512/SX9513 Family of capacitive touch controllers
  with integrated LED drivers. The device communication is using I2C only.

maintainers:
  - David Bauer <mail@david-bauer.net>

properties:
  compatible:
    enum:
      - semtech,sx9512
      - semtech,sx9513

  reg:
    maxItems: 1

  '#address-cells':
    const: 1

  '#size-cells':
    const: 0

  poll-interval:
    default: 100
    description: |
      The polling interval for touch events in milliseconds.

patternProperties:
  "^channel@[0-7]$":
    $ref: input.yaml#
    type: object
    description: |
      Each node represents a channel of the touch controller.
      Each channel provides a capacitive touch sensor input and
      an LED driver output.

    properties:
      reg:
        enum: [0, 1, 2, 3, 4, 5, 6, 7]

      linux,keycodes:
        maxItems: 1
        description: |
          Specifies an array of numeric keycode values to
          be used for the channels. If this property is
          omitted, the channel is not used as a key.

      semtech,cin-delta:
        $ref: /schemas/types.yaml#/definitions/uint32
        minimum: 0
        maximum: 3
        default: 3
        description: |
          The capacitance delta which is used to detect a touch
          or release event. The property value is mapped to a
          farad range between 7pF and 2.3pF internally. The delta
          becomes smaller the higher the value is.

      semtech,sense-threshold:
        $ref: /schemas/types.yaml#/definitions/uint32
        minimum: 0
        maximum: 255
        default: 4
        description: |
          The threshold value after which the channel detects a touch.
          Refer to the datasheet for the internal calculation of the
          resulting touch sensitivity.

      led:
        $ref: /schemas/leds/common.yaml#
        type: object
        unevaluatedProperties: false
        description: |
          Presence of this property indicates the channel
          is used as an LED driver.

    required:
      - reg

    additionalProperties: false


required:
  - compatible
  - reg

additionalProperties: false

examples:
  - |
    #include <dt-bindings/input/input.h>
    #include <dt-bindings/leds/common.h>
    i2c {
      #address-cells = <1>;
      #size-cells = <0>;

      touch@2b {
        compatible = "semtech,sx9512";

        reg = <0x2b>;

        #address-cells = <1>;
        #size-cells = <0>;

        poll-interval = <100>;

        channel@1 {
          reg = <1>;

          semtech,cin-delta = <0x3>;
          semtech,sense-threshold = <0xff>;

          linux,keycodes = <KEY_A>;
        };

        channel@2 {
          reg = <2>;

          semtech,cin-delta = <0x3>;
          semtech,sense-threshold = <0xff>;

          linux,keycodes = <KEY_B>;
        };

        channel@3 {
          reg = <3>;

          semtech,cin-delta = <0x3>;
          semtech,sense-threshold = <0xff>;

          linux,keycodes = <KEY_WPS_BUTTON>;
        };

        channel@4 {
          reg = <4>;

          led {
            color = <LED_COLOR_ID_RED>;
            function = LED_FUNCTION_WAN;
          };
        };

        channel@5 {
          reg = <5>;

          led {
            color = <LED_COLOR_ID_GREEN>;
            function = LED_FUNCTION_WAN;
          };
        };

        channel@6 {
          reg = <6>;

          led {
            color = <LED_COLOR_ID_GREEN>;
            function = LED_FUNCTION_WLAN;
            linux,default-trigger = "phy1tx";
          };
        };

        channel@7 {
          reg = <7>;

          led {
            color = <LED_COLOR_ID_GREEN>;
            function = LED_FUNCTION_WLAN;
            linux,default-trigger = "phy0tx";
          };
        };
      };
    };
```

## Documentation/devicetree/bindings/input/tca6416-keypad.yaml
```yaml
# SPDX-License-Identifier: (GPL-2.0 OR BSD-2-Clause)
%YAML 1.2
---
$id: http://devicetree.org/schemas/input/tca6416-keypad.yaml#
$schema: http://devicetree.org/meta-schemas/core.yaml#

title: TI TCA6416 keypad

maintainers:

description: |
  Texas Instruments TCA6416 IO expander as a keypad input device.

allOf:
  - $ref: input.yaml#

properties:
  compatible:
    enum:
      - ti,tca6416_keys
      - ti,tca6408_keys

  reg:
    maxItems: 1

  interrupts:
    maxItems: 1

  linux,gpio-keymap:
    $ref: /schemas/types.yaml#/definitions/uint32-array
    description: |
      Array of gpio keys provided by the driver instance. Each entry is a
      bitfield holding configuration of the input key. The bitfield looks like
      this:
      +------------------------------------------------------------+
      | Bits     | 31:18    |         17 | 16:14 | 13:10    | 9:0  |
      | Function | reserved | active_low | type  | reserved | code |
      +------------------------------------------------------------+
      code - Linux key code
      type - EV_KEY or EV_SW
      active_low - Key is active in low state

  linux,keycodes:
    minItems: 1
    maxItems: 16

  autorepeat:
    type: boolean
    description: |
      Enables the Linux input system's autorepeat feature on the input device.

  polling:
    type: boolean
    description: |
      Forces driver to use polling mode instead of IRQ.

  pinmask:
    description: |
      Allows to disable certain keys. By default are all inputs enabled.

required:
  - compatible
  - reg

additionalProperties: false

examples:
  - |
    #include <dt-bindings/interrupt-controller/irq.h>

    i2c {
      #address-cells = <1>;
      #size-cells = <0>;
      keypad@21 {
        compatible = "ti,tca6416_keys";
        reg = <0x21>;
        interrupt-parent = <&gpio>;
        interrupts = <26 IRQ_TYPE_EDGE_FALLING>;
        linux,gpio-keymap = <
                            0x24290, // active low, EV_KEY, 0, KEY_MACRO1
                            0x24291, // active low, EV_KEY, 1, KEY_MACRO2
                            0x24292, // active low, EV_KEY, 2, KEY_MACRO3
        >;
      };
    };

...
```

## Documentation/devicetree/bindings/input/ti,palmas-pwrbutton.yaml
```yaml
# SPDX-License-Identifier: (GPL-2.0-only OR BSD-2-Clause)
%YAML 1.2
---
$id: http://devicetree.org/schemas/input/ti,palmas-pwrbutton.yaml#
$schema: http://devicetree.org/meta-schemas/core.yaml#

title: Texas Instruments Palmas Power Button

maintainers:
  - Eduard Bostina <egbostina@gmail.com>

description:
  This module is part of the Palmas PMIC. It provides a simple power button
  event via an interrupt.

properties:
  compatible:
    const: ti,palmas-pwrbutton

  interrupts:
    maxItems: 1

  ti,palmas-long-press-seconds:
    $ref: /schemas/types.yaml#/definitions/uint32
    enum: [ 6, 8, 10, 12 ]
    description: |
      Duration in seconds which the power button should be kept pressed
      for Palmas to power off automatically. NOTE: This depends on OTP
      support and POWERHOLD signal configuration on platform.

  ti,palmas-pwron-debounce-milli-seconds:
    $ref: /schemas/types.yaml#/definitions/uint32
    enum: [ 15, 100, 500, 1000 ]
    description: |
      Duration in milliseconds which the power button should be kept
      pressed for Palmas to register a press for debouncing purposes.
      NOTE: This depends on specific Palmas variation capability.

  wakeup-source: true

required:
  - compatible
  - interrupts

additionalProperties: false

examples:
  - |
    #include <dt-bindings/interrupt-controller/irq.h>

    pmic {
        power-button {
            compatible = "ti,palmas-pwrbutton";
            interrupts = <1 IRQ_TYPE_EDGE_FALLING>;
            ti,palmas-long-press-seconds = <12>;
            ti,palmas-pwron-debounce-milli-seconds = <15>;
        };
    };
```
