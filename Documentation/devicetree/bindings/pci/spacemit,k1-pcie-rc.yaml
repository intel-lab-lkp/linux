## Documentation/devicetree/bindings/pci/zte,zx279128s-pcie.yaml
```yaml
# SPDX-License-Identifier: (GPL-2.0-only OR BSD-2-Clause)
%YAML 1.2
---
$id: http://devicetree.org/schemas/pci/zte,zx279128s-pcie.yaml#
$schema: http://devicetree.org/meta-schemas/core.yaml#

title: ZTE zx279128s PCIe host controller

maintainers:
  - Navid Ghahremani <ghahramani.navid@gmail.com>

description:
  The ZTE zx279128s has two PCIe host controllers based on the Synopsys
  DesignWare PCIe IP, each with one lane. Their clocks, resets and PHYs are
  controlled through the SoC's Top CRM blocks.

allOf:
  - $ref: /schemas/pci/snps,dw-pcie.yaml#

properties:
  compatible:
    const: zte,zx279128s-pcie

  reg:
    items:
      - description: Data Bus Interface (DBI) registers
      - description: Controller wrapper registers
      - description: PCIe configuration space region

  reg-names:
    items:
      - const: dbi
      - const: ctrl
      - const: config

  interrupts:
    maxItems: 1

  zte,crm:
    $ref: /schemas/types.yaml#/definitions/phandle-array
    description: The two Top CRM syscons that hold the clock, reset and PHY
      controls of this controller.
    items:
      - items:
          - description: phandle to Top CRM 1
      - items:
          - description: phandle to Top CRM 2

  reset-gpios:
    maxItems: 1
    description: Board reset line. A device connected to both controllers
      (the MT7915 Wi-Fi chip of the ZTE ZXHN H3600) has its lines listed in
      both nodes; the first controller to start resets and releases it.

  enable-gpios:
    maxItems: 1
    description: Second board line that is driven together with reset-gpios.

required:
  - reg
  - reg-names
  - interrupts
  - '#interrupt-cells'
  - interrupt-map
  - interrupt-map-mask
  - zte,crm

unevaluatedProperties: false

examples:
  - |
    #include <dt-bindings/gpio/gpio.h>
    #include <dt-bindings/interrupt-controller/arm-gic.h>

    pcie@f000000 {
        compatible = "zte,zx279128s-pcie";
        reg = <0x0f000000 0x4000>,
              <0x09500000 0x1000>,
              <0x1c000000 0x200000>;
        reg-names = "dbi", "ctrl", "config";
        #address-cells = <3>;
        #size-cells = <2>;
        device_type = "pci";
        bus-range = <0x00 0xff>;
        ranges = <0x82000000 0 0x10000000 0x10000000 0 0x08000000>;
        interrupts = <GIC_SPI 63 IRQ_TYPE_LEVEL_HIGH>;
        #interrupt-cells = <1>;
        interrupt-map-mask = <0 0 0 7>;
        interrupt-map = <0 0 0 1 &gic GIC_SPI 63 IRQ_TYPE_LEVEL_HIGH>,
                        <0 0 0 2 &gic GIC_SPI 63 IRQ_TYPE_LEVEL_HIGH>,
                        <0 0 0 3 &gic GIC_SPI 63 IRQ_TYPE_LEVEL_HIGH>,
                        <0 0 0 4 &gic GIC_SPI 63 IRQ_TYPE_LEVEL_HIGH>;
        linux,pci-domain = <0>;
        zte,crm = <&topcrm>, <&crm2>;
        reset-gpios = <&gpio3 5 GPIO_ACTIVE_LOW>;
        enable-gpios = <&gpio3 7 GPIO_ACTIVE_HIGH>;
    };
```

## Documentation/devicetree/bindings/peci/starfive,jhb100-peci.yaml
```yaml
# SPDX-License-Identifier: (GPL-2.0-only OR BSD-2-Clause)
%YAML 1.2
---
$id: http://devicetree.org/schemas/peci/starfive,jhb100-peci.yaml#
$schema: http://devicetree.org/meta-schemas/core.yaml#

title: StarFive JHB100 PECI Controller

maintainers:
  - Changhuang Liang <changhuang.liang@starfivetech.com>
  - Mason Huo <mason.huo@starfivetech.com>

allOf:
  - $ref: peci-controller.yaml#

properties:
  compatible:
    enum:
      - starfive,jhb100-peci

  reg:
    maxItems: 1

  interrupts:
    maxItems: 1

  clocks:
    maxItems: 1

  resets:
    maxItems: 1

  cmd-timeout-ms:
    minimum: 1
    maximum: 1000
    default: 1000

required:
  - compatible
  - reg
  - interrupts
  - clocks
  - resets

additionalProperties: false

examples:
  - |
    peci-controller@11c60000 {
      compatible = "starfive,jhb100-peci";
      reg = <0x11c60000 0x400>;
      interrupts = <222>;
      clocks = <&per3crg 34>;
      resets = <&per3crg 3>;
      cmd-timeout-ms = <1000>;
    };
...
```

## Documentation/devicetree/bindings/perf/arm,bus-monitor-unit.yaml
```yaml
# SPDX-License-Identifier: GPL-2.0-only OR BSD-2-Clause
%YAML 1.2
---
$id: http://devicetree.org/schemas/perf/arm,bus-monitor-unit.yaml#
$schema: http://devicetree.org/meta-schemas/core.yaml#

title: Arm Bus Monitor Unit

maintainers:
  - Robin Murphy <robin.murphy@arm.com>

properties:
  compatible:
    const: arm,bus-monitor-unit

  reg:
    items:
      - description: Full BMU register space

  interrupts:
    items:
      - description: PMU overflow interrupt

  label:
    description: BMU instance identifier (same as ACPI _UID), per the
      platform optimisation guide

required:
  - compatible
  - reg
  - label

additionalProperties: false
```

## Documentation/devicetree/bindings/perf/arm,coresight-pmu.yaml
```yaml
# SPDX-License-Identifier: GPL-2.0-only OR BSD-2-Clause
%YAML 1.2
---
$id: http://devicetree.org/schemas/perf/arm,coresight-pmu.yaml#
$schema: http://devicetree.org/meta-schemas/core.yaml#

title: Arm Coresight Performance Monitoring Unit Architecture

maintainers:
  - Robin Murphy <robin.murphy@arm.com>

properties:
  compatible:
    const: arm,coresight-pmu

  reg:
    items:
      - description: Register page 0
      - description: Register page 1 (if dual-page extension implemented)
    minItems: 1

  interrupts:
    items:
      - description: Overflow interrupt

  cpus:
    $ref: /schemas/types.yaml#/definitions/phandle-array
    minItems: 1
    description: List of CPUs with which the PMU is associated, if applicable

  arm,64-bit-atomic:
    type: boolean
    description: Register accesses are single-copy atomic at doubleword granularity

required:
  - compatible
  - reg

additionalProperties: false
```

## Documentation/devicetree/bindings/perf/hexin,c2000-arm-ni.yaml
```yaml
# SPDX-License-Identifier: (GPL-2.0-only OR BSD-2-Clause)
%YAML 1.2
---
$id: http://devicetree.org/schemas/perf/hexin,c2000-arm-ni.yaml#
$schema: http://devicetree.org/meta-schemas/core.yaml#

title: HX-C2000 NI (Network-on-chip Interconnect) Performance Monitors

maintainers:
  - Jialong Yang <jialong.yang@shingroup.cn>

properties:
  compatible:
    enum:
      - hexin,c2000-arm-ni

  reg:
    items:
      - description: Physical address of the base (PERIPHBASE) and
          size of the whole NI configuration address space.

  interrupts:
    minItems: 1
    items:
      - description: Overflow interrupt for clock domain 0
      - description: Overflow interrupt for clock domain 1
      - description: Overflow interrupt for clock domain 2
      - description: Generally, one interrupt line for one PMU. But this also
          support one interrupt line for a NI if merged.

required:
  - compatible
  - reg
  - interrupts

additionalProperties: false

examples:
  - |
    #include <dt-bindings/interrupt-controller/arm-gic.h>
    #include <dt-bindings/interrupt-controller/irq.h>

    aliases {
        ni-pmu0 = &nipmu0;
    };

    nipmu0: pmu@23ff0000 {
        compatible = "hexin,c2000-arm-ni";
        reg = <0x2b420000 0x10000>;
        interrupts = <GIC_SPI 80 IRQ_TYPE_LEVEL_HIGH>;
    };
```

## Documentation/devicetree/bindings/perf/marvell-cn10k-tad.yaml
```yaml
# SPDX-License-Identifier: (GPL-2.0-only OR BSD-2-Clause)
%YAML 1.2
---
$id: http://devicetree.org/schemas/perf/marvell-cn10k-tad.yaml#
$schema: http://devicetree.org/meta-schemas/core.yaml#

title: Marvell CN10K / CN20K LLC-TAD performance monitor

maintainers:
  - Bhaskara Budiredla <bbudiredla@marvell.com>
  - Geetha sowjanya <gakula@marvell.com>

description: |
  The Tag-and-Data units (TADs) maintain coherence and contain the
  shared on-chip last level cache (LLC) on Marvell CN10K and CN20K SoCs.
  The TAD PMU measures last-level cache performance. Each TAD PMU
  supports up to eight counters.

  The DT setup describes the number of TAD blocks, the sizes of PMU
  regions and TAD pages, and the overall MMIO base of the hardware.

properties:
  compatible:
    items:
      - enum:
          - marvell,cn10k-tad-pmu
          - marvell,cn20k-tad-pmu

  reg:
    maxItems: 1

  marvell,tad-cnt:
    description: specifies the number of tads on the soc
    $ref: /schemas/types.yaml#/definitions/uint32

  marvell,tad-page-size:
    description: specifies the size of each tad page
    $ref: /schemas/types.yaml#/definitions/uint32

  marvell,tad-pmu-page-size:
    description: specifies the size of page that the pmu uses
    $ref: /schemas/types.yaml#/definitions/uint32

required:
  - compatible
  - reg
  - marvell,tad-cnt
  - marvell,tad-page-size
  - marvell,tad-pmu-page-size

additionalProperties: false

examples:
  - |

    tad {
        #address-cells = <2>;
        #size-cells = <2>;

        tad_pmu@80000000 {
            compatible = "marvell,cn10k-tad-pmu";
            reg = <0x87e2 0x80000000 0x0 0x1000>;
            marvell,tad-cnt = <1>;
            marvell,tad-page-size = <0x1000>;
            marvell,tad-pmu-page-size = <0x1000>;
        };
    };
```

## Documentation/devicetree/bindings/perf/marvell-cn20k-ddr.yaml
```yaml
# SPDX-License-Identifier: (GPL-2.0-only OR BSD-2-Clause)
%YAML 1.2
---
$id: http://devicetree.org/schemas/perf/marvell-cn20k-ddr.yaml#
$schema: http://devicetree.org/meta-schemas/core.yaml#

title: Marvell CN20K DDR performance monitor

description:
  Performance Monitoring Unit (PMU) for the DDR controller
  in Marvell CN20K SoCs.

maintainers:
  - Geetha sowjanya <gakula@marvell.com>

properties:
  compatible:
    const: marvell,cn20k-ddr-pmu

  reg:
    maxItems: 1

required:
  - compatible
  - reg

additionalProperties: false

examples:
  - |
    bus {
        #address-cells = <2>;
        #size-cells = <2>;

	ddr-pmu@c200000000 {
            compatible = "marvell,cn20k-ddr-pmu";
            reg = <0xc200 0x00000000 0x0 0x100000>;
        };
    };
```

## Documentation/devicetree/bindings/perf/samsung,ppmu-v2.yaml
```yaml
# SPDX-License-Identifier: GPL-2.0-only OR BSD-2-Clause
%YAML 1.2
---
$id: http://devicetree.org/schemas/perf/samsung,ppmu-v2.yaml#
$schema: http://devicetree.org/meta-schemas/core.yaml#

title: Samsung PPMU (Platform Performance Monitoring Unit)

maintainers:
  - Vivek Yadav <vivek.2311@samsung.com>
  - Ravi Patel <ravi.patel@samsung.com>

description:
  PPMU (Platform Performance Monitoring Unit) provides performance statistics
  such as bandwidth, read and write request, transactions count for AXI masters
  like MFC.

properties:
  compatible:
    const: samsung,ppmu-v2

  reg:
    maxItems: 1
    description: Memory-mapped register address

  clocks:
    items:
      - description: AXI bus clock
      - description: Peripheral clock

  clock-names:
    items:
      - const: aclk
      - const: pclk

  interrupts:
    items:
      - description: Overflow interrupt for Counters
      - description: Conditional Interrupt Generation (CIG)

required:
  - compatible
  - reg
  - clocks
  - clock-names
  - interrupts

additionalProperties: false

examples:
  - |
    #include <dt-bindings/clock/fsd-clk.h>
    #include <dt-bindings/interrupt-controller/arm-gic.h>
    ppmu@12840000 {
        compatible = "samsung,ppmu-v2";
        reg = <0x12840000 0x1000>;
        interrupts = <GIC_SPI 133 IRQ_TYPE_LEVEL_HIGH>,
                     <GIC_SPI 134 IRQ_TYPE_LEVEL_HIGH>;
        clocks = <&clock_mfc MFC_PPMU_MFCD0_IPCLKPORT_ACLK>,
                 <&clock_mfc MFC_PPMU_MFCD0_IPCLKPORT_PCLK>;
        clock-names = "aclk", "pclk";
     };
```

## Documentation/devicetree/bindings/perf/st,stm32-ddr-pmu.yaml
```yaml
# SPDX-License-Identifier: (GPL-2.0-only OR BSD-2-Clause)
%YAML 1.2
---
$id: http://devicetree.org/schemas/perf/st,stm32-ddr-pmu.yaml#
$schema: http://devicetree.org/meta-schemas/core.yaml#

maintainers:
  - Clément Le Goffic <clement.legoffic@foss.st.com>

title: STMicroelectronics STM32 DDR Performance Monitor (DDRPERFM)

properties:
  compatible:
    enum:
      - st,stm32mp131-ddr-pmu
      - st,stm32mp151-ddr-pmu
      - st,stm32mp251-ddr-pmu

  reg:
    maxItems: 1

  clocks:
    description: Reference clock for the DDR Performance Monitor
    maxItems: 1

  resets:
    description: Reset control for the DDR Performance Monitor
    maxItems: 1

  access-controllers:
    minItems: 1
    maxItems: 2

  st,dram-type:
    description: |
      This property is used to specify the type of DRAM memory connected to the
      associated memory controller. It is required for the DDR Performance Monitor
      to correctly interpret the performance data.
      0 = LPDDR4,
      1 = LPDDR3,
      2 = DDR4,
      3 = DDR3
    $ref: /schemas/types.yaml#/definitions/uint32
    enum: [0, 1, 2, 3]

required:
  - compatible
  - reg

allOf:
  - if:
      properties:
        compatible:
          contains:
            enum:
              - st,stm32mp131-ddr-pmu
              - st,stm32mp151-ddr-pmu
    then:
      required:
        - clocks
        - resets

  - if:
      properties:
        compatible:
          contains:
            const: st,stm32mp251-ddr-pmu
    then:
      required:
        - access-controllers
        - st,dram-type

additionalProperties: false

examples:
  - |
    #include <dt-bindings/clock/stm32mp1-clks.h>
    #include <dt-bindings/reset/stm32mp1-resets.h>

    perf@5a007000 {
        compatible = "st,stm32mp151-ddr-pmu";
        reg = <0x5a007000 0x400>;
        clocks = <&rcc DDRPERFM>;
        resets = <&rcc DDRPERFM_R>;
    };

  - |
    perf@48041000 {
      compatible = "st,stm32mp251-ddr-pmu";
      reg = <0x48041000 0x400>;
      access-controllers = <&rcc 104>;
      st,dram-type = <2>;
    };
```

## Documentation/devicetree/bindings/perf/starfive,starlink-pmu.yaml
```yaml
# SPDX-License-Identifier: GPL-2.0-only OR BSD-2-Clause
%YAML 1.2
---
$id: http://devicetree.org/schemas/perf/starfive,starlink-pmu.yaml#
$schema: http://devicetree.org/meta-schemas/core.yaml#

title: StarFive StarLink PMU

maintainers:
  - Ji Sheng Teoh <jisheng.teoh@starfivetech.com>

description:
  StarFive's StarLink PMU integrates one or more CPU cores with a shared L3
  memory system. The PMU support overflow interrupt, up to 16 programmable
  64bit event counters, and an independent 64bit cycle counter.
  StarLink PMU is accessed via MMIO.

properties:
  compatible:
    const: starfive,starlink-500-pmu

  reg:
    maxItems: 1

  interrupts:
    maxItems: 1

required:
  - compatible
  - reg
  - interrupts

additionalProperties: false

examples:
  - |
    soc {
        #address-cells = <2>;
        #size-cells = <2>;

        l3_pmu: pmu@12900000 {
            compatible = "starfive,starlink-500-pmu";
            reg = <0x0 0x12900000 0x0 0x10000>;
            interrupts = <34>;
        };
    };
```
