## Documentation/devicetree/bindings/phy/airoha,an7581-usb-phy.yaml
```yaml
# SPDX-License-Identifier: GPL-2.0-only OR BSD-2-Clause
%YAML 1.2
---
$id: http://devicetree.org/schemas/phy/airoha,an7581-usb-phy.yaml#
$schema: http://devicetree.org/meta-schemas/core.yaml#

title: Airoha AN7581 SoC USB PHY

maintainers:
  - Christian Marangi <ansuelsmth@gmail.com>

description: >
  The Airoha AN7581 SoC USB PHY describes the USB PHY for the USB controller.

  Airoha AN7581 SoC support a maximum of 2 USB port. The USB 2.0 mode is
  always supported. The USB 3.0 mode is optional and depends on the Serdes
  mode currently configured on the system for the relevant USB port.

properties:
  compatible:
    const: airoha,an7581-usb-phy

  reg:
    maxItems: 1

  airoha,usb2-monitor-clk-sel:
    description: Describe what oscillator across the available 4
      should be selected for USB 2.0 Slew Rate calibration.
    $ref: /schemas/types.yaml#/definitions/uint32
    enum: [0, 1, 2, 3]

  phys:
    items:
      - description: phandle to Serdes PHY

  '#phy-cells':
    description: The cell contains the mode, PHY_TYPE_USB2 or PHY_TYPE_USB3,
      as defined in dt-bindings/phy/phy.h.
    const: 1

required:
  - compatible
  - reg
  - airoha,usb2-monitor-clk-sel
  - '#phy-cells'

additionalProperties: false

examples:
  - |
    #include <dt-bindings/soc/airoha,scu-ssr.h>

    phy@1fac0000 {
        compatible = "airoha,an7581-usb-phy";
        reg = <0x1fac0000 0x10000>;

        airoha,usb2-monitor-clk-sel = <1>;
        phys = <&scu AIROHA_SCU_SERDES_USB1>;

        #phy-cells = <1>;
    };
```

## Documentation/devicetree/bindings/phy/airoha,an7583-pcie-gen2-phy.yaml
```yaml
# SPDX-License-Identifier: GPL-2.0-only OR BSD-2-Clause
%YAML 1.2
---
$id: http://devicetree.org/schemas/phy/airoha,an7583-pcie-gen2-phy.yaml#
$schema: http://devicetree.org/meta-schemas/core.yaml#

title: Airoha AN7581 SoC PCIe Gen2 PHY

maintainers:
  - Christian Marangi <ansuelsmth@gmail.com>

description: >
  The Airoha AN7583 SoC PCIe Gen2 PHY describes the PCIe PHY for the
  Gen2 PCIe controller.

  This PCIe PHY makes use of a dedicated USB PHY for PCIe usage and
  can also be used for Ethernet usage for SGMII or HSGMII mode.

properties:
  compatible:
    const: airoha,an7583-pcie-phy

  reg:
    items:
      - description: ana register
      - description: pma register
      - description: dig register

  reg-names:
    items:
      - const: ana
      - const: pma
      - const: dig

  phys:
    items:
      - description: phandle to Serdes PHY

  '#phy-cells':
    const: 0

required:
  - compatible
  - reg
  - reg-names
  - phys
  - '#phy-cells'

additionalProperties: false

examples:
  - |
    phy@1fa5f000 {
        compatible = "airoha,an7583-pcie-phy";
        reg = <0x1fa5f000 0xff>,
              <0x1fa5e000 0x3ff>,
              <0x1fa5a000 0x8ff>;
        reg-names = "ana", "pma", "dig";

        phys = <&serdes_phy>;

        #phy-cells = <0>;
    };
```

## Documentation/devicetree/bindings/phy/airoha,an7583-pcie-phy.yaml
```yaml
# SPDX-License-Identifier: (GPL-2.0 OR BSD-2-Clause)
%YAML 1.2
---
$id: http://devicetree.org/schemas/phy/airoha,an7583-pcie-phy.yaml#
$schema: http://devicetree.org/meta-schemas/core.yaml#

title: Airoha AN7583 PCI-Express PHY

maintainers:
  - Christian Marangi <ansuelsmth@gmail.com>

description:
  The PCIe PHY supports physical layer functionality for PCIe Gen2/Gen3 port.

properties:
  compatible:
    const: airoha,an7583-pcie-phy

  reg:
    items:
      - description: PCIE G3 analog base address
      - description: PCIE G3 PMA base address
      - description: PCIE QPhy analog base address
      - description: PCIE QPhy PMA base address
      - description: PCIE QPhy diagnostic base address
      - description: PCIE detection time base address
      - description: PCIE Rx AEQ base address

  reg-names:
    items:
      - const: g3-ana
      - const: g3-pma
      - const: qp-ana
      - const: qp-pma
      - const: qp-dig
      - const: xr-dtime
      - const: rx-aeq

  "#phy-cells":
    const: 0

required:
  - compatible
  - reg
  - reg-names
  - "#phy-cells"

additionalProperties: false

examples:
  - |
    #include <dt-bindings/phy/phy.h>

    soc {
        #address-cells = <2>;
        #size-cells = <2>;

        phy@11e80000 {
            compatible = "airoha,an7583-pcie-phy";
            #phy-cells = <0>;
            reg = <0x0 0x1fc7f000 0x0 0xfff>,
                  <0x0 0x1fc7e000 0x0 0xfff>,
                  <0x0 0x1fa5f000 0x0 0xff>,
                  <0x0 0x1fa5e000 0x0 0x8ff>,
                  <0x0 0x1fa5a000 0x0 0x3ff>,
                  <0x0 0x1fc30044 0x0 0x4>,
                  <0x0 0x1fc35030 0x0 0x4>;
            reg-names = "g3-ana", "g3-pma",
                        "qp-ana", "qp-pma", "qp-dig",
                        "xr-dtime", "rx-aeq";
        };
    };
```

## Documentation/devicetree/bindings/phy/apple,atcphy.yaml
```yaml
# SPDX-License-Identifier: (GPL-2.0-only OR BSD-2-Clause)
%YAML 1.2
---
$id: http://devicetree.org/schemas/phy/apple,atcphy.yaml#
$schema: http://devicetree.org/meta-schemas/core.yaml#

title: Apple Type-C PHY (ATCPHY)

maintainers:
  - Sven Peter <sven@kernel.org>

description:
  The Apple Type-C PHY (ATCPHY) is a PHY for USB 2.0, USB 3.x,
  USB4/Thunderbolt, and DisplayPort connectivity found in Apple Silicon SoCs.

  The PHY handles muxing between these different protocols and also provides the
  reset controller for the attached DWC3 USB controller.

  The PHY is designed for USB4 operation and does not handle individual
  differential pairs as distinct DisplayPort lanes. Any reference to lane in
  this binding hence refers to two differential pairs (RX and TX) as used in USB
  terminology.

allOf:
  - $ref: /schemas/usb/usb-switch.yaml#

properties:
  compatible:
    oneOf:
      - items:
          - enum:
              - apple,t6000-atcphy
              - apple,t6020-atcphy
              - apple,t8112-atcphy
          - const: apple,t8103-atcphy
      - const: apple,t8103-atcphy

  reg:
    items:
      - description: Common controls for all PHYs (USB2/3/4, DisplayPort, Thunderbolt)
      - description: DisplayPort Alternate Mode PHY specific controls
      - description: AXI to Apple Fabric interconnect controls, only modified by tunables
      - description: USB2 PHY specific controls
      - description: USB3 PIPE interface controls

  reg-names:
    items:
      - const: core
      - const: lpdptx
      - const: axi2af
      - const: usb2phy
      - const: pipehandler

  "#phy-cells":
    const: 1

  "#reset-cells":
    const: 0

  mode-switch: true
  orientation-switch: true

  power-domains:
    maxItems: 1

  ports:
    $ref: /schemas/graph.yaml#/properties/ports
    properties:
      port@0:
        $ref: /schemas/graph.yaml#/properties/port
        description: Output endpoint of the PHY to the Type-C connector

      port@1:
        $ref: /schemas/graph.yaml#/properties/port
        description: Incoming endpoint from the USB3 controller

      port@2:
        $ref: /schemas/graph.yaml#/properties/port
        description: Incoming endpoint from the DisplayPort controller

      port@3:
        $ref: /schemas/graph.yaml#/properties/port
        description: Incoming endpoint from the USB4/Thunderbolt controller

  apple,tunable-axi2af:
    $ref: /schemas/types.yaml#/definitions/uint32-array
    description:
      AXI2AF tunables.

      This array is filled with 3-tuples each containing three 32-bit values
      <register offset>, <mask>, and <value> by the bootloader.
      The driver will use these to configure the PHY by reading from each
      register, ANDing it with <mask>, ORing it with <value>, and storing the
      result back to the register.
      These values slightly differ even between different chips of the same
      generation and are likely calibration values determined by Apple at
      manufacturing time.

  apple,tunable-common:
    $ref: /schemas/types.yaml#/definitions/uint32-array
    description:
      Common tunables required for all modes, see apple,tunable-axi2af for details.

  apple,tunable-fuses:
    $ref: /schemas/types.yaml#/definitions/uint32-array
    description:
      Fuse based tunables required for all modes, see apple,tunable-axi2af for details.

  apple,tunable-lane0-usb:
    $ref: /schemas/types.yaml#/definitions/uint32-array
    description:
      USB tunables on lane 0, see apple,tunable-axi2af for details.

  apple,tunable-lane1-usb:
    $ref: /schemas/types.yaml#/definitions/uint32-array
    description:
      USB tunables on lane 1, see apple,tunable-axi2af for details.

  apple,tunable-lane0-cio:
    $ref: /schemas/types.yaml#/definitions/uint32-array
    description:
      USB4/Thunderbolt ("converged IO") tunables on lane 0, see apple,tunable-axi2af for details.

  apple,tunable-lane1-cio:
    $ref: /schemas/types.yaml#/definitions/uint32-array
    description:
      USB4/Thunderbolt ("converged IO") tunables on lane 1, see apple,tunable-axi2af for details.

  apple,tunable-lane0-dp:
    $ref: /schemas/types.yaml#/definitions/uint32-array
    description:
      DisplayPort tunables on lane 0, see apple,tunable-axi2af for details.

      Note that lane here refers to a USB RX and TX pair re-used for DisplayPort
      and not to an individual DisplayPort differential lane.

  apple,tunable-lane1-dp:
    $ref: /schemas/types.yaml#/definitions/uint32-array
    description:
      DisplayPort tunables on lane 1, see apple,tunable-axi2af for details.

      Note that lane here refers to a USB RX and TX pair re-used for DisplayPort
      and not to an individual DisplayPort differential lane.

required:
  - compatible
  - reg
  - reg-names
  - "#phy-cells"
  - "#reset-cells"
  - orientation-switch
  - mode-switch
  - power-domains
  - ports

additionalProperties: false

examples:
  - |
    phy@83000000 {
      compatible = "apple,t8103-atcphy";
      reg = <0x83000000 0x4c000>,
            <0x83050000 0x8000>,
            <0x80000000 0x4000>,
            <0x82a90000 0x4000>,
            <0x82a84000 0x4000>;
      reg-names = "core", "lpdptx", "axi2af", "usb2phy",
                  "pipehandler";

      #phy-cells = <1>;
      #reset-cells = <0>;

      orientation-switch;
      mode-switch;
      power-domains = <&ps_atc0_usb>;

      ports {
        #address-cells = <1>;
        #size-cells = <0>;

        port@0 {
          reg = <0>;

          endpoint {
            remote-endpoint = <&typec_connector_ss>;
          };
        };

        port@1 {
          reg = <1>;

          endpoint {
            remote-endpoint = <&dwc3_ss_out>;
          };
        };

        port@2 {
          reg = <2>;

          endpoint {
            remote-endpoint = <&dcp_dp_out>;
          };
        };

        port@3 {
          reg = <3>;

          endpoint {
            remote-endpoint = <&acio_tbt_out>;
          };
        };
      };
    };
```

## Documentation/devicetree/bindings/phy/axiado,ax3000-emmc-phy.yaml
```yaml
# SPDX-License-Identifier: GPL-2.0-only OR BSD-2-Clause
%YAML 1.2
---
$id: http://devicetree.org/schemas/phy/axiado,ax3000-emmc-phy.yaml#
$schema: http://devicetree.org/meta-schemas/core.yaml#

title: Axiado AX3000 Arasan eMMC PHY

maintainers:
  - SriNavmani A <srinavmani@axiado.com>
  - Tzu-Hao Wei <twei@axiado.com>
  - Prasad Bolisetty <pbolisetty@axiado.com>

description: |+
  Bindings for eMMC PHY on Axiado AX3000 SoC.

  - compatible:         Should be one of the following:
                        "axiado,ax3000-emmc-phy"
  - reg:
      maxItems: 1

properties:
  compatible:
    enum:
      - axiado,ax3000-emmc-phy

  "#phy-cells":
    const: 0

  reg:
    maxItems: 1

required:
  - "#phy-cells"
  - compatible
  - reg

additionalProperties: false

examples:
  - |
    emmc_phy: emmc-phy@80801C00 {
        compatible = "axiado,ax3000-emmc-phy";
        reg = <0x80801C00 0x1000>;
        #phy-cells = <0>;
    };
```

## Documentation/devicetree/bindings/phy/cix,sky1-dp-phy.yaml
```yaml
# SPDX-License-Identifier: (GPL-2.0-only OR BSD-2-Clause)
%YAML 1.2
---
$id: http://devicetree.org/schemas/phy/cix,sky1-dp-phy.yaml#
$schema: http://devicetree.org/meta-schemas/core.yaml#

title: CIX Sky1 DisplayPort PHY

maintainers:
  - Luo Liu <Luo.Liu@cixtech.com>

description:
  The CIX Sky1 DP PHY provides the PMA/CDB register interface for the
  dedicated DisplayPort instance on CIX Sky1.

  The PHY APB clock is physically shared with the DPTx controller and is
  managed only by the DPTx driver.

properties:
  compatible:
    const: cix,sky1-dp-phy

  reg:
    maxItems: 1

  "#phy-cells":
    const: 0

  resets:
    maxItems: 1
    description: PHY hardware reset

  cix,edp:
    type: boolean
    description:
      Use the eDP voltage swing and equalization table. Without this
      property the default DisplayPort table is used.

required:
  - compatible
  - reg
  - "#phy-cells"
  - resets

additionalProperties: false

examples:
  - |
    #include <dt-bindings/reset/cix,sky1-s5-system-control.h>

    phy@1414c000 {
        compatible = "cix,sky1-dp-phy";
        reg = <0x1414c000 0x4000>;
        resets = <&s5_syscon SKY1_DP_PHY_RST_N>;
        #phy-cells = <0>;
    };
```

## Documentation/devicetree/bindings/phy/cix,sky1-usb3-phy.yaml
```yaml
# SPDX-License-Identifier: (GPL-2.0-only OR BSD-2-Clause)
%YAML 1.2
---
$id: http://devicetree.org/schemas/phy/cix,sky1-usb3-phy.yaml#
$schema: http://devicetree.org/meta-schemas/core.yaml#

title: CIX Sky1 USB3 PHY

maintainers:
  - Hongliang Yang <hongliang.yang@cixtech.com>

description:
  The CIX Sky1 USB3 PHY is a multi-port SuperSpeedPlus PHY that
  supports up to two USB3 lanes. Each port is represented as a
  child node of the PHY controller.

properties:
  compatible:
    const: cix,sky1-usb3-phy

  reg:
    maxItems: 1

  clocks:
    items:
      - description: APB register interface clock
      - description: PHY reference clock

  clock-names:
    items:
      - const: apb_clk
      - const: ref_clk

  resets:
    items:
      - description: PHY reset
      - description: PHY APB preset

  reset-names:
    items:
      - const: reset
      - const: preset

  "#address-cells":
    const: 1

  "#size-cells":
    const: 0

patternProperties:
  "^usb-port@[0-9a-f]+$":
    type: object
    description:
      A single USB3 PHY port/lane.

    properties:
      reg:
        maxItems: 1

      "#phy-cells":
        const: 0

    required:
      - reg
      - "#phy-cells"

    additionalProperties: false

required:
  - compatible
  - reg
  - clocks
  - clock-names
  - resets
  - reset-names
  - "#address-cells"
  - "#size-cells"

unevaluatedProperties: false

examples:
  - |
    #include <dt-bindings/clock/cix,sky1.h>
    #include <dt-bindings/reset/cix,sky1-s5-system-control.h>

    usb-phy@9210000 {
        compatible = "cix,sky1-usb3-phy";
        reg = <0x09210000 0x40000>;
        #address-cells = <1>;
        #size-cells = <0>;

        resets = <&s5_syscon SKY1_USBPHY_SS_RST_N>,
                 <&s5_syscon SKY1_USBPHY_SS_PST_N>;
        reset-names = "reset", "preset";

        clocks = <&scmi_clk CLK_TREE_USB3A_PHY3_GATE>,
                 <&scmi_clk CLK_TREE_USB3A_PHY_x2_REF>;
        clock-names = "apb_clk", "ref_clk";

        usb-port@0 {
            reg = <0>;
            #phy-cells = <0>;
        };

        usb-port@1 {
            reg = <1>;
            #phy-cells = <0>;
        };
    };
```
