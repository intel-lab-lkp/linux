## Documentation/devicetree/bindings/pci/spacemit,k1-pcie-rc.yaml
```yaml
# SPDX-License-Identifier: (GPL-2.0-only OR BSD-2-Clause)
%YAML 1.2
---
$id: http://devicetree.org/schemas/pci/spacemit,k1-pcie-rc.yaml#
$schema: http://devicetree.org/meta-schemas/core.yaml#

title: SpacemiT K1 PCI Express Root Complex

maintainers:
  - Alex Elder <elder@riscstar.com>

description:
  The SpacemiT K1 SoC PCIe root complex controller is based on the
  Synopsys DesignWare PCIe IP.

properties:
  compatible:
    const: spacemit,k1-pcie-rc.yaml

  reg:
    items:
      - description: DesignWare PCIe registers
      - description: ATU address space
      - description: PCIe configuration space
      - description: Link control registers

  reg-names:
    items:
      - const: dbi
      - const: atu
      - const: config
      - const: link

  clocks:
    items:
      - description: DWC PCIe Data Bus Interface (DBI) clock
      - description: DWC PCIe application AXI-bus Master interface clock
      - description: DWC PCIe application AXI-bus Slave interface clock.

  clock-names:
    items:
      - const: dbi
      - const: mstr
      - const: slv

  resets:
    items:
      - description: DWC PCIe Data Bus Interface (DBI) reset
      - description: DWC PCIe application AXI-bus Master interface reset
      - description: DWC PCIe application AXI-bus Slave interface reset.
      - description: Global reset; must be deasserted for PHY to function

  reset-names:
    items:
      - const: dbi
      - const: mstr
      - const: slv
      - const: global

  interrupts-extended:
    maxItems: 1

  spacemit,syscon-pmu:
    description:
      PHandle that refers to the APMU system controller, whose
      regmap is used in managing resets and link state.
    $ref: /schemas/types.yaml#/definitions/phandle

  device_type:
    const: pci

  max-link-speed:
    const: 2

  num-viewport:
    const: 8

required:
  - compatible
  - reg
  - clocks
  - clock-names
  - resets
  - reset-names
  - spacemit,syscon-pmu
  - "#address-cells"
  - "#size-cells"
  - device_type
  - max-link-speed
  - bus-range
  - num-viewport

additionalProperties: false

examples:
  - |
    #include <dt-bindings/clock/spacemit,k1-syscon.h>
    pcie0: pcie@ca000000 {
        compatible = "spacemit,k1-pcie-rc";
        reg = <0x0 0xca000000 0x0 0x00001000>,
              <0x0 0xca300000 0x0 0x0001ff24>,
              <0x0 0x8f000000 0x0 0x00002000>,
              <0x0 0xc0b20000 0x0 0x00001000>;
        reg-names = "dbi",
                    "atu",
                    "config",
                    "link";

        ranges = <0x01000000 0x8f002000 0x0 0x8f002000 0x0 0x100000>,
                 <0x02000000 0x80000000 0x0 0x80000000 0x0 0x0f000000>;

        clocks = <&syscon_apmu CLK_PCIE0_DBI>,
                 <&syscon_apmu CLK_PCIE0_MASTER>,
                 <&syscon_apmu CLK_PCIE0_SLAVE>;
        clock-names = "dbi",
                      "mstr",
                      "slv";

        resets = <&syscon_apmu RESET_PCIE0_DBI>,
                 <&syscon_apmu RESET_PCIE0_MASTER>,
                 <&syscon_apmu RESET_PCIE0_SLAVE>,
                 <&syscon_apmu RESET_PCIE0_GLOBAL>;
        reset-names = "dbi",
                      "mstr",
                      "slv",
                      "global";

        interrupts-extended = <&plic 141>;

        spacemit,syscon-pmu = <&syscon_apmu 0x03cc>;

        #address-cells = <3>;
        #size-cells = <2>;

        device_type = "pci";
        max-link-speed = <2>;
        bus-range = <0x00 0xff>;
        num-viewport = <8>;

        status = "disabled";
    };
```

## Documentation/devicetree/bindings/pci/st,stm32-pcie-ep.yaml
```yaml
# SPDX-License-Identifier: (GPL-2.0 OR BSD-2-Clause)
%YAML 1.2
---
$id: http://devicetree.org/schemas/pci/st,stm32-pcie-ep.yaml#
$schema: http://devicetree.org/meta-schemas/core.yaml#

title: STM32MP25 PCIe endpoint driver

maintainers:
  - Christian Bruel <christian.bruel@foss.st.com>

description:
  PCIe endpoint controller based on the Synopsys DesignWare PCIe core.

allOf:
  - $ref: /schemas/pci/snps,dw-pcie-common.yaml#

properties:
  compatible:
    const: st,stm32mp25-pcie-ep

  reg:
    items:
      - description: Data Bus Interface (DBI) registers.
      - description: PCIe configuration registers.

  reg-names:
    items:
      - const: dbi
      - const: addr_space

  clocks:
    maxItems: 1
    description: PCIe system clock

  clock-names:
    const: core

  resets:
    maxItems: 1

  reset-names:
    const: core

  phys:
    maxItems: 1

  phy-names:
    const: pcie-phy

  reset-gpios:
    description: GPIO controlled connection to PERST# signal
    maxItems: 1

  access-controllers:
    maxItems: 1

  power-domains:
    maxItems: 1

required:
  - resets
  - reset-names
  - clocks
  - clock-names
  - phys
  - phy-names
  - reset-gpios

unevaluatedProperties: false

examples:
  - |
    #include <dt-bindings/clock/st,stm32mp25-rcc.h>
    #include <dt-bindings/gpio/gpio.h>
    #include <dt-bindings/phy/phy.h>
    #include <dt-bindings/reset/st,stm32mp25-rcc.h>

    pcie-ep@48400000 {
        compatible = "st,stm32mp25-pcie-ep";
        num-lanes = <1>;
        reg = <0x48400000 0x400000>,
              <0x10000000 0x8000000>;
        reg-names = "dbi", "addr_space";
        clocks = <&rcc CK_BUS_PCIE>;
        clock-names = "core";
        phys = <&combophy PHY_TYPE_PCIE>;
        phy-names = "pcie-phy";
        resets = <&rcc PCIE_R>;
        reset-names = "core";
        pinctrl-names = "default", "init";
        pinctrl-0 = <&pcie_pins_a>;
        pinctrl-1 = <&pcie_init_pins_a>;
        reset-gpios = <&gpioj 8 GPIO_ACTIVE_LOW>;
        power-domains = <&CLUSTER_PD>;
        access-controllers = <&rifsc 68>;
    };
```

## Documentation/devicetree/bindings/pci/st,stm32-pcie-host.yaml
```yaml
# SPDX-License-Identifier: (GPL-2.0 OR BSD-2-Clause)
%YAML 1.2
---
$id: http://devicetree.org/schemas/pci/st,stm32-pcie-host.yaml#
$schema: http://devicetree.org/meta-schemas/core.yaml#

title: STM32MP25 PCIe root complex driver

maintainers:
  - Christian Bruel <christian.bruel@foss.st.com>

description:
  PCIe root complex controller based on the Synopsys DesignWare PCIe core.

allOf:
  - $ref: /schemas/pci/snps,dw-pcie.yaml#
  - $ref: /schemas/pci/st,stm32-pcie-common.yaml#

select:
  properties:
    compatible:
      const: st,stm32mp25-pcie-rc
  required:
    - compatible

properties:
  compatible:
    const: st,stm32mp25-pcie-rc

  reg:
    items:
      - description: Data Bus Interface (DBI) registers.
      - description: PCIe configuration registers.

  reg-names:
    items:
      - const: dbi
      - const: config

  num-lanes:
    const: 1

  msi-parent:
    maxItems: 1

  wake-gpios:
    description: GPIO controlled connection to WAKE# input signal
    maxItems: 1

  wakeup-source: true

dependentRequired:
  wakeup-source: [ wake-gpios ]

required:
  - interrupt-map
  - interrupt-map-mask
  - ranges

unevaluatedProperties: false

examples:
  - |
    #include <dt-bindings/clock/st,stm32mp25-rcc.h>
    #include <dt-bindings/gpio/gpio.h>
    #include <dt-bindings/interrupt-controller/arm-gic.h>
    #include <dt-bindings/phy/phy.h>
    #include <dt-bindings/reset/st,stm32mp25-rcc.h>

    pcie@48400000 {
        compatible = "st,stm32mp25-pcie-rc";
        device_type = "pci";
        num-lanes = <1>;
        reg = <0x48400000 0x400000>,
              <0x10000000 0x10000>;
        reg-names = "dbi", "config";
        #interrupt-cells = <1>;
        interrupt-map-mask = <0 0 0 7>;
        interrupt-map = <0 0 0 1 &intc 0 0 GIC_SPI 264 IRQ_TYPE_LEVEL_HIGH>,
                        <0 0 0 2 &intc 0 0 GIC_SPI 265 IRQ_TYPE_LEVEL_HIGH>,
                        <0 0 0 3 &intc 0 0 GIC_SPI 266 IRQ_TYPE_LEVEL_HIGH>,
                        <0 0 0 4 &intc 0 0 GIC_SPI 267 IRQ_TYPE_LEVEL_HIGH>;
        #address-cells = <3>;
        #size-cells = <2>;
        ranges = <0x01000000 0 0x10010000 0x10010000 0 0x10000>,
                 <0x02000000 0 0x10020000 0x10020000 0 0x7fe0000>,
                 <0x42000000 0 0x18000000 0x18000000 0 0x8000000>;
        clocks = <&rcc CK_BUS_PCIE>;
        phys = <&combophy PHY_TYPE_PCIE>;
        phy-names = "pcie-phy";
        resets = <&rcc PCIE_R>;
        msi-parent = <&v2m0>;
        wakeup-source;
        wake-gpios = <&gpioh 5 (GPIO_ACTIVE_LOW | GPIO_PULL_UP)>;
        reset-gpios = <&gpioj 8 GPIO_ACTIVE_LOW>;
        access-controllers = <&rifsc 68>;
        power-domains = <&CLUSTER_PD>;
    };
```

## Documentation/devicetree/bindings/pci/tesla,fsd-pcie.yaml
```yaml
# SPDX-License-Identifier: (GPL-2.0-only OR BSD-2-Clause)
%YAML 1.2
---
$id: http://devicetree.org/schemas/pci/tesla,fsd-pcie.yaml#
$schema: http://devicetree.org/meta-schemas/core.yaml#

title: Tesla FSD SoC series PCIe Host Controller

maintainers:
  - Shradha Todi <shradha.t@samsung.com>

description:
  Tesla FSD SoCs PCIe host controller inherits all the common
  properties defined in samsung,exynos-pcie.yaml

allOf:
  - $ref: /schemas/pci/samsung,exynos-pcie.yaml#

properties:
  compatible:
    const: tesla,fsd-pcie

  clocks:
    maxItems: 4

  clock-names:
    items:
      - const: aux
      - const: dbi
      - const: mstr
      - const: slv

  num-lanes:
    maximum: 4

  samsung,syscon-pcie:
    $ref: /schemas/types.yaml#/definitions/phandle-array
    description: phandle for system control registers, used to
                 control signals at system level

required:
  - samsung,syscon-pcie

unevaluatedProperties: false

examples:
  - |
    #include <dt-bindings/clock/fsd-clk.h>
    #include <dt-bindings/interrupt-controller/arm-gic.h>

    soc {
        #address-cells = <2>;
        #size-cells = <2>;

        pcierc1: pcie@16b00000 {
            compatible = "tesla,fsd-pcie";
            reg = <0x0 0x16b00000 0x0 0x2000>,
                  <0x0 0x168c0000 0x0 0x1000>,
                  <0x0 0x18000000 0x0 0x1000>;
            reg-names = "dbi", "elbi", "config";
            ranges =  <0x82000000 0x0 0x18001000 0x0 0x18001000 0x0 0xffefff>;
            clocks = <&clock_fsys1 PCIE_LINK1_IPCLKPORT_AUX_ACLK>,
                     <&clock_fsys1 PCIE_LINK1_IPCLKPORT_DBI_ACLK>,
                     <&clock_fsys1 PCIE_LINK1_IPCLKPORT_MSTR_ACLK>,
                     <&clock_fsys1 PCIE_LINK1_IPCLKPORT_SLV_ACLK>;
            clock-names = "aux", "dbi", "mstr", "slv";
            #address-cells = <3>;
            #size-cells = <2>;
            dma-coherent;
            device_type = "pci";
            interrupts = <GIC_SPI 117 IRQ_TYPE_EDGE_RISING>;
            num-lanes = <4>;
            phys = <&pciephy1>;
            samsung,syscon-pcie = <&sysreg_fsys1 0x510>;
        };
    };
...
```

## Documentation/devicetree/bindings/pci/toshiba,tc956x.yaml
```yaml
# SPDX-License-Identifier: (GPL-2.0-only OR BSD-2-Clause)
%YAML 1.2
---
$id: http://devicetree.org/schemas/pci/toshiba,tc956x.yaml#
$schema: http://devicetree.org/meta-schemas/core.yaml#

title: Toshiba TC956x PCIe switch

maintainers:
  - Krishna chaitanya chundru <quic_krichai@quicinc.com>

description: |
  Toshiba TC956x PCIe switch has one upstream and three downstream
  ports. The 3rd downstream port has integrated endpoint device of
  Ethernet MAC. Other two downstream ports are supposed to connect
  to external device.

  The TC956x PCIe switch can be configured through I2C interface before
  PCIe link is established to change FTS, ASPM related entry delays,
  tx amplitude etc for better power efficiency and functionality.

properties:
  compatible:
    items:
      - enum:
          - "pci1179,0623"
      - const: pciclass,0604

  reg:
    maxItems: 1

  i2c-parent:
    $ref: /schemas/types.yaml#/definitions/phandle-array
    description:
      A phandle to the parent I2C node and the slave address of the device
      used to do configure tc956x to change FTS, tx amplitude etc.
    items:
      - description: Phandle to the I2C controller node
      - description: I2C slave address

  vdd18-supply: true

  vdd09-supply: true

  vddc-supply: true

  vddio1-supply: true

  vddio2-supply: true

  vddio18-supply: true

  reset-gpios:
    maxItems: 1
    description:
      GPIO controlling the RESX# pin.

allOf:
  - $ref: "#/$defs/tc956x-node"

patternProperties:
  "^pcie@[1-3],0$":
    description:
      child nodes describing the internal downstream ports
      the tc956x switch.
    type: object
    $ref: "#/$defs/tc956x-node"
    unevaluatedProperties: false

$defs:
  tc956x-node:
    type: object

    properties:
      tc956x,tx-amplitude-microvolt:
        $ref: /schemas/types.yaml#/definitions/uint32
        description:
          Change Tx Margin setting for low power consumption.

      tc956x,no-dfe-support:
        type: boolean
        description:
          Disable DFE (Decision Feedback Equalizer), which mitigates
          intersymbol interference and some reflections caused by impedance mismatches.

    allOf:
      - $ref: /schemas/pci/pci-pci-bridge.yaml#

unevaluatedProperties: false

required:
  - vdd18-supply
  - vdd09-supply
  - vddc-supply
  - vddio1-supply
  - vddio2-supply
  - vddio18-supply
  - i2c-parent
  - reset-gpios

examples:
  - |
    #include <dt-bindings/gpio/gpio.h>

    pcie {
        #address-cells = <3>;
        #size-cells = <2>;

        pcie@0 {
            device_type = "pci";
            reg = <0x0 0x0 0x0 0x0 0x0>;

            #address-cells = <3>;
            #size-cells = <2>;
            ranges;
            bus-range = <0x01 0xff>;

            pcie@0,0 {
                compatible = "pci1179,0623", "pciclass,0604";

                reg = <0x10000 0x0 0x0 0x0 0x0>;
                device_type = "pci";
                #address-cells = <3>;
                #size-cells = <2>;
                ranges;
                bus-range = <0x02 0xff>;

                i2c-parent = <&qup_i2c 0x77>;

                vdd18-supply = <&vdd>;
                vdd09-supply = <&vdd>;
                vddc-supply = <&vdd>;
                vddio1-supply = <&vdd>;
                vddio2-supply = <&vdd>;
                vddio18-supply = <&vdd>;

                reset-gpios = <&gpio 1 GPIO_ACTIVE_LOW>;

                pcie@1,0 {
                    reg = <0x20800 0x0 0x0 0x0 0x0>;
                    #address-cells = <3>;
                    #size-cells = <2>;
                    device_type = "pci";
                    ranges;
                    bus-range = <0x03 0xff>;

                    tc956x,no-dfe-support;
                };

                pcie@2,0 {
                    reg = <0x21000 0x0 0x0 0x0 0x0>;
                    #address-cells = <3>;
                    #size-cells = <2>;
                    device_type = "pci";
                    ranges;
                    bus-range = <0x04 0xff>;
                };

                pcie@3,0 {
                    reg = <0x21800 0x0 0x0 0x0 0x0>;
                    #address-cells = <3>;
                    #size-cells = <2>;
                    device_type = "pci";
                    ranges;
                    bus-range = <0x05 0xff>;

                    tc956x,tx-amplitude-microvolt = <10>;
                    ethernet@0,0 {
                        reg = <0x50000 0x0 0x0 0x0 0x0>;
                    };

                    ethernet@0,1 {
                        reg = <0x50100 0x0 0x0 0x0 0x0>;
                    };
                };
            };
        };
    };
```
