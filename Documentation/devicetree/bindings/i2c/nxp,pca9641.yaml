## Documentation/devicetree/bindings/iio/adc/adi,ad7625.yaml
```yaml
# SPDX-License-Identifier: (GPL-2.0-only OR BSD-2-Clause)
%YAML 1.2
---
$id: http://devicetree.org/schemas/iio/adc/adi,ad7625.yaml#
$schema: http://devicetree.org/meta-schemas/core.yaml#

title: Analog Devices Fast PulSAR Analog to Digital Converters

maintainers:
  - Michael Hennerich <Michael.Hennerich@analog.com>
  - Nuno Sá <nuno.sa@analog.com>

description: |
  A family of single channel differential analog to digital converters
  in a LFCSP package. Note that these bindings are for the device when
  used with the PulSAR LVDS project:
  http://analogdevicesinc.github.io/hdl/projects/pulsar_lvds/index.html.

  * https://www.analog.com/en/products/ad7625.html
  * https://www.analog.com/en/products/ad7626.html
  * https://www.analog.com/en/products/ad7960.html
  * https://www.analog.com/en/products/ad7961.html

properties:
  compatible:
    enum:
      - adi,ad7625
      - adi,ad7626
      - adi,ad7960
      - adi,ad7961

  vdd1-supply:
    description: A supply that powers the analog and digital circuitry.

  vdd2-supply:
    description: A supply that powers the analog and digital circuitry.

  vio-supply:
    description: A supply for the inputs and outputs.

  ref-supply:
    description:
      Voltage regulator for the external reference voltage (REF).

  refin-supply:
    description:
      Voltage regulator for the reference buffer input (REFIN).

  clocks:
    description:
      The clock connected to the CLK pins, gated by the clk_gate PWM.
    maxItems: 1

  pwms:
    maxItems: 2

  pwm-names:
    maxItems: 2
    items:
      - const: cnv
        description: PWM connected to the CNV input on the ADC.
      - const: clk_gate
        description: PWM that gates the clock connected to the ADC's CLK input.

  io-backends:
    description:
      The AXI ADC IP block connected to the D+/- and DCO+/- lines of the ADC.
    maxItems: 1

  adi,en0-always-on:
    $ref: /schemas/types.yaml#/definitions/flag
    description:
      Indicates if EN0 is hard-wired to the high state. If neither this
      nor en0-gpios are present, then EN0 is hard-wired low.

  adi,en1-always-on:
    $ref: /schemas/types.yaml#/definitions/flag
    description:
      Indicates if EN1 is hard-wired to the high state. If neither this
      nor en1-gpios are present, then EN1 is hard-wired low.

  adi,en2-always-on:
    $ref: /schemas/types.yaml#/definitions/flag
    description:
      Indicates if EN2 is hard-wired to the high state. If neither this
      nor en2-gpios are present, then EN2 is hard-wired low.

  adi,en3-always-on:
    $ref: /schemas/types.yaml#/definitions/flag
    description:
      Indicates if EN3 is hard-wired to the high state. If neither this
      nor en3-gpios are present, then EN3 is hard-wired low.

  en0-gpios:
    description:
      Configurable EN0 pin.

  en1-gpios:
    description:
      Configurable EN1 pin.

  en2-gpios:
    description:
      Configurable EN2 pin.

  en3-gpios:
    description:
      Configurable EN3 pin.

required:
  - compatible
  - vdd1-supply
  - vdd2-supply
  - vio-supply
  - clocks
  - pwms
  - pwm-names
  - io-backends

- if:
  properties:
    compatible:
      contains:
        enum:
	  - adi,ad7625
	  - adi,ad7626
  then:
    properties:
      en2-gpios: false
      en3-gpios: false
      adi,en2-always-on: false
      adi,en3-always-on: false
    allOf:
      # ref-supply and refin-supply are mutually-exclusive (neither is also
      # valid)
      - if:
          required:
            - ref-supply
        then:
          properties:
            refin-supply: false
      - if:
          required:
            - refin-supply
        then:
          properties:
            ref-supply: false

- if:
  properties:
    compatible:
      contains:
        enum:
	  - adi,ad7960
	  - adi,ad7961
  then:
    oneOf:
      required:
        - ref-supply
      required:
        - refin-supply

additionalProperties: false

examples:
  - |
    adc {
        compatible = "adi,ad7625";
        vdd1-supply = <&supply_5V>;
        vdd2-supply = <&supply_2_5V>;
        vio-supply = <&supply_2_5V>;
        io-backends = <&axi_adc>;
        clock = <&ref_clk>;
        pwms = <&axi_pwm_gen 0 0>, <&axi_pwm_gen 1 0>;
        pwm-names = "cnv", "clk_gate";
    };
```

## Documentation/devicetree/bindings/iio/adc/adi,ad7768-1.yaml
```yaml
# SPDX-License-Identifier: GPL-2.0
%YAML 1.2
---
$id: http://devicetree.org/schemas/iio/adc/adi,ad7768-1.yaml#
$schema: http://devicetree.org/meta-schemas/core.yaml#

title: Analog Devices AD7768-1 ADC family

maintainers:
  - Michael Hennerich <michael.hennerich@analog.com>

description: |
  Analog Devices AD7768-1 24-Bit Single Channel Low Power sigma-delta ADC family

  https://www.analog.com/media/en/technical-documentation/data-sheets/ad7768-1.pdf
  https://www.analog.com/media/en/technical-documentation/data-sheets/adaq7767-1.pdf
  https://www.analog.com/media/en/technical-documentation/data-sheets/adaq7768-1.pdf
  https://www.analog.com/media/en/technical-documentation/data-sheets/adaq7769-1.pdf

properties:
  compatible:
    enum:
      - adi,ad7768-1
      - adi,adaq7767-1
      - adi,adaq7768-1
      - adi,adaq7769-1

  reg:
    minItems: 1
    maxItems: 4
    description:
      Chip select number. For multi-device setups, one entry per device.

  clocks:
    maxItems: 1

  clock-names:
    const: mclk

  trigger-sources:
    $ref: /schemas/types.yaml#/definitions/phandle-array
    minItems: 1
    maxItems: 2
    description: |
      A list of phandles referencing trigger source providers. Each entry
      represents a trigger source for the ADC:

        - First entry specifies the device responsible for driving the
          synchronization (SYNC_IN) pin, as an alternative to adi,sync-in-gpios.
          This can be a `gpio-trigger` or another `ad7768-1` device. If the
          device's own SYNC_OUT pin is internally connected to its SYNC_IN pin,
          reference the device itself or omit this property.
        - Second entry optionally defines a GPIO3 pin used as a START signal trigger.

      Use the accompanying trigger source cell to identify the type of each entry.

  interrupts:
    description:
      DRDY (Data Ready) pin, which signals conversion results are available.
    maxItems: 1

  '#address-cells':
    const: 1

  '#size-cells':
    const: 0

  vref-supply:
    description:
      ADC reference voltage supply

  adi,aaf-gain-bp:
    description: |
       Specifies the gain applied by the Analog Anti-Aliasing Filter (AAF)
       to the ADC input in basis points (one hundredth of a percent).
       The hardware gain is determined by which input pin(s) the signal goes
       through into the AAF. The possible connections are:
       * For the ADAQ7767-1: Input connected to IN1±, IN2± or IN3±.
       * For the ADAQ7769-1: OUT_PGA pin connected to IN1_AAF+, IN2_AAF+,
         or IN3_AAF+.
    enum: [1430, 3640, 10000]
    default: 10000

  pga-gpios:
    description:
      GAIN 0, GAIN1 and GAIN2 pins for gain selection. For devices that have
      PGA configuration input pins, pga-gpios must be defined.
    minItems: 3
    maxItems: 3

  adi,sync-in-gpios:
    maxItems: 1
    description:
      Enables synchronization of multiple devices that require simultaneous
      sampling. A pulse is always required if the configuration is changed
      in any way, for example if the filter decimation rate changes.
      As the line is active low, it should be marked GPIO_ACTIVE_LOW.

  regulators:
    type: object
    description:
      list of regulators provided by this controller.

    properties:
      vcm-output:
        $ref: /schemas/regulator/regulator.yaml#
        type: object
        unevaluatedProperties: false

    additionalProperties: false

  reset-gpios:
    maxItems: 1

  spi-rx-bus-width:
    description:
      Bus width per CS. For multi-device setups (multiple reg entries), one
      entry per device must be provided. Required when reg has more than
      one entry.

  spi-cpol: true

  spi-cpha: true

  "#io-channel-cells":
    const: 1

  "#trigger-source-cells":
    description: |
      Cell indicates the trigger output signal: 0 = SYNC_OUT, 1 = GPIO3,
      2 = DRDY.

      For better readability, macros for these values are available in
      dt-bindings/iio/adc/adi,ad7768-1.h.
    const: 1

  gpio-controller: true

  "#gpio-cells":
    const: 2
    description: |
      The first cell is for the GPIO number: 0 to 3.
      The second cell takes standard GPIO flags.

required:
  - compatible
  - reg
  - clocks
  - clock-names
  - vref-supply
  - spi-cpol
  - spi-cpha

dependencies:
  adi,sync-in-gpios:
    not:
      required:
        - trigger-sources
  trigger-sources:
    not:
      required:
        - adi,sync-in-gpios

patternProperties:
  "^channel@([0-9]|1[0-5])$":
    type: object
    description: |
      Represents the external channels which are connected to the device.

    properties:
      reg:
        maxItems: 1
        description: |
          The channel number.

      label:
        description: |
          Unique name to identify which channel this is.
    required:
      - reg
    additionalProperties: false

allOf:
  - $ref: /schemas/spi/spi-peripheral-props.yaml#

  # AAF Gain property only applies to ADAQ7767-1 and ADAQ7769-1 devices
  - if:
      properties:
        compatible:
          contains:
            enum:
              - adi,adaq7767-1
              - adi,adaq7769-1
    then:
      required:
        - adi,aaf-gain-bp
    else:
      properties:
        adi,aaf-gain-bp: false

  - if:
      properties:
        compatible:
          contains:
            enum:
              - adi,adaq7768-1
              - adi,adaq7769-1
    then:
      required:
        - pga-gpios
    else:
      properties:
        pga-gpios: false

  # spi-rx-bus-width is required for multi-device setups
  - if:
      properties:
        reg:
          minItems: 2
    then:
      required:
        - spi-rx-bus-width

unevaluatedProperties: false

examples:
  - |
    #include <dt-bindings/interrupt-controller/irq.h>
    #include <dt-bindings/gpio/gpio.h>
    spi {
        #address-cells = <1>;
        #size-cells = <0>;

        adc@0 {
            compatible = "adi,ad7768-1";
            reg = <0>;
            spi-max-frequency = <2000000>;
            spi-cpol;
            spi-cpha;
            gpio-controller;
            #gpio-cells = <2>;
            vref-supply = <&adc_vref>;
            interrupts = <25 IRQ_TYPE_EDGE_RISING>;
            interrupt-parent = <&gpio>;
            adi,sync-in-gpios = <&gpio 22 GPIO_ACTIVE_LOW>;
            reset-gpios = <&gpio 27 GPIO_ACTIVE_LOW>;
            clocks = <&ad7768_mclk>;
            clock-names = "mclk";

            #address-cells = <1>;
            #size-cells = <0>;

            channel@0 {
                reg = <0>;
                label = "channel_0";
            };

            regulators {
              vcm_reg: vcm-output {
                regulator-name = "ad7768-1-vcm";
              };
            };
        };
    };
  - |
    #include <dt-bindings/interrupt-controller/irq.h>
    #include <dt-bindings/gpio/gpio.h>
    #include <dt-bindings/iio/adc/adi,ad7768-1.h>
    /*
     * Four ADAQ7768-1 devices aggregated on a single SPI controller.
     * Each device occupies one CS and one data lane; DRDY and SYNC_IN
     * pins are wired together across all four devices.
     */
    spi {
        #address-cells = <1>;
        #size-cells = <0>;

        adc@0 {
            compatible = "adi,adaq7768-1";
            reg = <0>, <1>, <2>, <3>;
            spi-max-frequency = <2000000>;
            spi-rx-bus-width = <1>, <1>, <1>, <1>;
            spi-cpol;
            spi-cpha;
            vref-supply = <&adc_vref>;
            pga-gpios = <&gpio 10 GPIO_ACTIVE_HIGH>,
                        <&gpio 11 GPIO_ACTIVE_HIGH>,
                        <&gpio 12 GPIO_ACTIVE_HIGH>;
            interrupts = <25 IRQ_TYPE_EDGE_RISING>;
            interrupt-parent = <&gpio>;
            #trigger-source-cells = <1>;
            adi,sync-in-gpios = <&gpio 22 GPIO_ACTIVE_LOW>;
            reset-gpios = <&gpio 27 GPIO_ACTIVE_LOW>;
            clocks = <&ad7768_mclk>;
            clock-names = "mclk";
            gpio-controller;
            #gpio-cells = <2>;
            #io-channel-cells = <1>;
            #address-cells = <1>;
            #size-cells = <0>;

            channel@0 {
                reg = <0>;
                label = "channel_0";
            };

            channel@1 {
                reg = <1>;
                label = "channel_1";
            };

            channel@2 {
                reg = <2>;
                label = "channel_2";
            };

            channel@3 {
                reg = <3>;
                label = "channel_3";
            };
        };
    };
...
```

## Documentation/devicetree/bindings/iio/adc/adi,ad7816.yaml
```yaml
# SPDX-License-Identifier: (GPL-2.0-only OR BSD-2-Clause)
%YAML 1.2
---
$id: http://devicetree.org/schemas/iio/adc/adi,ad7816.yaml#
$schema: http://devicetree.org/meta-schemas/core.yaml#

title: Analog Devices ADC AD7816

maintainers:
  - Omer PALA <palaomer100@gmail.com>

description: |
  This schema defines devicetree rules for
  Analog Devices ADC AD7816

properties:
  compatible:
    enum:
      - adi,ad7816
      - adi,ad7817
      - adi,ad7818

  reg:
    maxItems: 1

  spi-max-frequency: true

  interrupts:
    maxItems: 1
    description: Base interrupt pin for AD7816

  rdwr-gpios:
    maxItems: 1
    description: I/O control pin

  convert-gpios:
    maxItems: 1
    description: Conversion start pin

  busy-gpios:
    maxItems: 1
    description: Busy pin

required:
  - compatible
  - reg
  - rdwr-gpios
  - convert-gpios

allOf:
  - $ref: /schemas/spi/spi-peripheral-props.yaml#

  - if:
      properties:
        compatible:
          contains:
            enum:
              - adi,ad7816
              - adi,ad7817

    then:
      required:
        - busy-gpios

unevaluatedProperties: false

examples:
  - |
    spi {
      #address-cells = <1>;
      #size-cells = <0>;

      adc@0 {
        compatible = "adi,ad7816";
        reg = <0>;
        spi-max-frequency = <1000000>;

        rdwr-gpios = <&gpio0 1 0>;
        convert-gpios = <&gpio0 2 0>;
        busy-gpios = <&gpio0 3 0>;
      };
    };
```
