## Documentation/devicetree/bindings/i2c/sprd,sc9860-i2c.yaml
```yaml
# SPDX-License-Identifier: (GPL-2.0-only OR BSD-2-Clause)
# Copyright 2020 Unisoc Inc.
%YAML 1.2
---
$id: http://devicetree.org/schemas/i2c/sprd,sc9860-i2c.yaml#
$schema: http://devicetree.org/meta-schemas/core.yaml#

title: Unisoc I2C Controller Device

maintainers:
  - Huangzheng Lai <laihuangzheng@gmail.com>

allOf:
  - $ref: /schemas/i2c/i2c-controller.yaml#

properties:
  compatible:
    const: sprd,sc9860-i2c

  reg:
    description: physical base address of the controller, length of memory mapped region.
    maxItems: 2

  interrupts:
    maxItems: 1

  clock-names:
    items:
      - const: i2c
      - const: source
      - const: enable

  clocks:
    maxItems: 3

  clock-frequency:
    description: Contains desired I2C bus clock frequency in Hz.
    minimum: 100000
    maximum: 3400000

  reset-names:
    const: i2c_rst

  resets:
    maxItems: 1

required:
  - compatible
  - reg
  - interrupts
  - clock-names
  - clocks

additionalProperties: false

examples:
  - |
    i2c0: i2c@2240000 {
            compatible = "sprd,sc9860-i2c";
            reg = <0 0x2240000 0 0x1000>;
            interrupts = <11>;
            clock-names = "i2c", "source", "enable";
            clocks = <&clk_i2c3>, <&ext_26m>, <&clk_ap_apb_gates 11>;
            clock-frequency = <400000>;
            #address-cells = <1>;
            #size-cells = <0>;
            reset-names = "i2c_rst";
            resets = <&apahb_gate 3>;

            charger@63 {
                    compatible = "sprd,sc2731-charger";
                    reg = <0x63>;
            };
    };
```

## Documentation/devicetree/bindings/i3c/aspeed,ast2600-i3c-global.yaml
```yaml
# SPDX-License-Identifier: GPL-2.0 OR BSD-2-Clause
%YAML 1.2
---
$id: http://devicetree.org/schemas/i3c/aspeed,ast2600-i3c-global.yaml#
$schema: http://devicetree.org/meta-schemas/core.yaml#

title: ASPEED AST2600 I3C Global Registers

description: |
  The AST2600 SoC provides a shared I3C global register block used by all
  I3C controller instances. This block contains per-instance global
  configuration fields, including controller instance ID and SDA pull-up
  configuration.
  Each I3C controller references this syscon node through the
  aspeed,global-regs property.

maintainers:
  - Dawid Glazik <dawid.glazik@linux.intel.com>

allOf:
  - $ref: /schemas/mfd/syscon-common.yaml#

properties:
  compatible:
    items:
      - const: aspeed,ast2600-i3c-global
      - const: syscon

  reg:
    maxItems: 1

  resets:
    maxItems: 1

required:
  - compatible
  - reg

unevaluatedProperties: false

examples:
  - |
    bus@1e7a0000 {
        compatible = "simple-bus";
        #address-cells = <1>;
        #size-cells = <1>;
        ranges = <0 0x1e7a0000 0x8000>;

        i3c-global@0 {
            compatible = "aspeed,ast2600-i3c-global", "syscon";
            reg = <0x0 0x1000>;
            resets = <&syscon ASPEED_RESET_I3C_DMA>;
        };
    };
...
```

## Documentation/devicetree/bindings/i3c/nuvoton,i3c-master.yaml
```yaml
# SPDX-License-Identifier: GPL-2.0-only OR BSD-2-Clause
%YAML 1.2
---
$id: http://devicetree.org/schemas/i3c/nuvoton,i3c-master.yaml#
$schema: http://devicetree.org/meta-schemas/core.yaml#

title: Nuvoton NPCM845 I3C master

maintainers:
  - Stanley Chu <yschu@nuvoton.com>
  - James Chiang <cpchiang1@nuvoton.com>

allOf:
  - $ref: i3c.yaml#

properties:
  compatible:
    const: nuvoton,npcm845-i3c

  reg:
    items:
      - description: I3C registers
      - description: GDMA registers
      - description: GDMA request control register

  reg-names:
    items:
      - const: i3c
      - const: dma
      - const: dma_ctl

  interrupts:
    maxItems: 1

  clocks:
    items:
      - description: system clock
      - description: bus clock

  clock-names:
    items:
      - const: pclk
      - const: fast_clk

  resets:
    maxItems: 1

  i3c-pp-scl-hi-period-ns:
    description: |
      If need to configure SCL with required duty cycle, specify the clock high/low period directly.
      i3c-pp-scl-hi-perios-ns specifies the high period ns of the SCL clock cycle in push pull mode
      When i3c-pp-scl-hi-period-ns and i3c-pp-scl-lo-period-ns are specified, the i3c pp frequency is
      decided by these two properties.

  i3c-pp-scl-lo-period-ns:
    description: |
      The low period ns of the SCL clock cycle in push pull mode. i3c-pp-scl-lo-period-ns should not
      be less than i3c-pp-scl-hi-period-ns and the maximal value is i3c-pp-scl-hi-period-ns + 150.

  i3c-pp-sda-rd-skew:
    $ref: /schemas/types.yaml#/definitions/uint32
    description: |
      The number of MCLK clock periods to delay the SDA transition from the SCL clock edge at push
      pull operation when transfers i3c private read.
    maximum: 7
    default: 0

  i3c-pp-sda-wr-skew:
    $ref: /schemas/types.yaml#/definitions/uint32
    description: |
      The number of MCLK clock periods to delay the SDA transition from the SCL clock edge at push
      pull operation when transfers i3c private write.
    maximum: 7
    default: 0

  i3c-od-scl-hi-period-ns:
    description: |
      The i3c open drain frequency is 1MHz by default.
      If need to use different frequency, specify the clock high/low period directly.
      i3c-od-scl-hi-perios-ns specifies the high period ns of the SCL clock cycle in open drain mode.
      When i3c-od-scl-hi-period-ns and i3c-od-scl-lo-period-ns are specified, the i3c od frequency is
      decided by these two properties.
      i3c-od-scl-hi-period-ns should be equal to i3c-pp-scl-hi-period-ns or i3c-od-scl-lo-period-ns.

  i3c-od-scl-lo-period-ns:
    description: |
      The low period ns of the SCL clock cycle in open drain mode. i3c-od-scl-lo-period-ns should be
      multiple of i3c-pp-scl-hi-period-ns.

  enable-hj:
    type: boolean
    description: |
      Enable SLVSTART interrupt for receiving hot-join request.

  use-dma:
    type: boolean
    description: |
      Enable the i3c private transfers using DMA.

required:
  - compatible
  - reg
  - interrupts
  - clock-names
  - clocks

additionalProperties: true

examples:
  - |
    i3c@fff10000 {
        compatible = "nuvoton,npcm845-i3c";
        clocks = <&clk 4>, <&clk 26>;
        clock-names = "pclk", "fast_clk";
        interrupts = <0 224 4>;
        reg = <0xfff10000 0x1000>,
              <0xf0850000 0x1000>,
              <0xf0800300 0x4>;
        reg-names = "i3c", "dma", "dma_ctl";
        resets = <&rstc 0x74 8>;
        #address-cells = <3>;
        #size-cells = <0>;
    };
```

## Documentation/devicetree/bindings/i3c/nxp,p3h2840.yaml
```yaml
# SPDX-License-Identifier: (GPL-2.0-only OR BSD-2-Clause)
# Copyright 2025 NXP
%YAML 1.2
---
$id: http://devicetree.org/schemas/i3c/nxp,p3h2840.yaml#
$schema: http://devicetree.org/meta-schemas/core.yaml#

title: NXP P3H2X4X I3C HUB

maintainers:
  - Aman Kumar Pandey <aman.kumarpandey@nxp.com>
  - Vikash Bansal <vikash.bansal@nxp.com>

description: |
  P3H2x4x (P3H2440/P3H2441/P3H2840/P3H2841) is a family of multiport I3C
  hub devices that connect to:-
  1. A host CPU via I3C/I2C/SMBus bus on upstream side and connect to multiple
     peripheral devices on the downstream  side.
  2. Have two Controller Ports which can support either
     I2C/SMBus or I3C buses and connect to a CPU, BMC or SOC.
  3. P3H2840/ P3H2841 are 8 port I3C hub with eight I3C/I2C Target Port.
  4. P3H2440/ P3H2441 are 4 port I3C hub with four I3C/I2C Target Port.
     Target ports can be configured as I2C/SMBus, I3C or GPIO and connect to
     peripherals.

allOf:
  - $ref: /schemas/i3c/i3c.yaml#

properties:
  compatible:
    const: nxp,p3h2840

  tp0145-pullup-ohms:
    description:
      Selects the pull up resistance for target Port 0/1/4/5, in ohms.
    enum: [250, 500, 1000, 2000]
    default: 500

  tp2367-pullup-ohms:
    description:
      Selects the pull up resistance for target Port 2/3/6/7, in ohms.
    enum: [250, 500, 1000, 2000]
    default: 500

  cp0-io-strength-ohms:
    description:
      Selects the IO drive strength for controller Port 0, in ohms.
    enum: [20, 30, 40, 50]
    default: 20

  cp1-io-strength-ohms:
    description:
      Selects the IO drive strength for controller Port 1, in ohms.
    enum: [20, 30, 40, 50]
    default: 20

  tp0145-io-strength-ohms:
    description:
      Selects the IO drive strength for target port 0/1/4/5, in ohms.
    enum: [20, 30, 40, 50]
    default: 20

  tp2367-io-strength-ohms:
    description:
      Selects the IO drive strength for target port 2/3/6/7, in ohms.
    enum: [20, 30, 40, 50]
    default: 20

  vcc1-supply:
    description: Controller port 0 power supply.

  vcc2-supply:
    description: Controller port 1 power supply.

  vcc3-supply:
    description: Target port 0/1/4/5 power supply.

  vcc4-supply:
    description: Target port 2/3/6/7 power supply.

  regulators:
    type: object
    additionalProperties: false

    properties:
      LDO_CP0:
        type: object
        $ref: /schemas/regulator/regulator.yaml#
        unevaluatedProperties: false

      LDO_CP1:
        type: object
        $ref: /schemas/regulator/regulator.yaml#
        unevaluatedProperties: false

      LDO_TPG0:
        type: object
        $ref: /schemas/regulator/regulator.yaml#
        unevaluatedProperties: false

      LDO_TPG1:
        type: object
        $ref: /schemas/regulator/regulator.yaml#
        unevaluatedProperties: false

patternProperties:
  "^i3c@[0-7]$":
    type: object
    $ref: /schemas/i3c/i3c.yaml#
    unevaluatedProperties: false

    properties:
      reg:
        description:
          The I3C HUB Target Port number.
        maxItems: 1

      pullup-enable:
        type: boolean
        description:
          Enables the on-die pull-up for Target Port.

  "^(i2c|smbus)@[0-7]$":
    type: object
    $ref: /schemas/i2c/i2c-controller.yaml#
    unevaluatedProperties: false

    properties:
      reg:
        description:
          The I3C HUB Target Port number.
        maxItems: 1

      pullup-enable:
        type: boolean
        description:
          Enables the on-die pull-up for Target Port.

unevaluatedProperties: false

examples:
  - |
    i3c {
        #address-cells = <3>;
        #size-cells = <0>;

        hub@70,236153000c2 {
            reg = <0x70 0x236 0x3000c2>;
            #address-cells = <1>;
            #size-cells = <0>;
            assigned-address = <0x50>;

            tp0145-pullup-ohm = <1000>;
            tp2367-pullup-ohm = <1000>;
            cp0-io-strength-ohm = <50>;
            cp1-io-strength-ohm = <50>;
            tp0145-io-strength-ohm = <50>;
            tp2367-io-strength-ohm = <50>;
            vcc3-supply = <&reg_tpg0>;
            vcc4-supply = <&reg_tpg1>;

            regulators {
                reg_cp0: LDO_CP0 {
                    regulator-name = "ldo_cp0";
                    regulator-min-microvolt = <1800000>;
                    regulator-max-microvolt = <1800000>;
                };

                reg_cp1: LDO_CP1 {
                    regulator-name = "ldo_cp1";
                    regulator-min-microvolt = <1800000>;
                    regulator-max-microvolt = <1800000>;
                };

                reg_tpg0: LDO_TPG0 {
                    regulator-name = "ldo_tpg0";
                    regulator-min-microvolt = <1800000>;
                    regulator-max-microvolt = <1800000>;
                };

                reg_tpg1: LDO_TPG1 {
                    regulator-name = "ldo_tpg1";
                    regulator-min-microvolt = <1800000>;
                    regulator-max-microvolt = <1800000>;
                };
            };

            smbus@0 {
                reg = <0x0>;
                #address-cells = <1>;
                #size-cells = <0>;
                pullup-enable;
            };

            i2c@1 {
                reg = <0x1>;
                #address-cells = <1>;
                #size-cells = <0>;
                pullup-enable;
            };

            i3c@2 {
                reg = <0x2>;
                #address-cells = <3>;
                #size-cells = <0>;
                pullup-enable;
            };
        };
    };
```
