## Documentation/devicetree/bindings/i2c/nxp,pca9641.yaml
```yaml
# SPDX-License-Identifier: GPL-2.0-only OR BSD-2-Clause
%YAML 1.2
---
$id: http://devicetree.org/schemas/i2c/nxp,pca9641.yaml#
$schema: http://devicetree.org/meta-schemas/core.yaml#

title: NXP PCA9641 2-to-1 I2C bus master arbiter

maintainers:
  - Shiv Prakash Gupta <shivprakash.gupta@nxp.com>

description: |
  The PCA9641 is a 2-to-1 I2C bus master arbiter that manages two upstream
  I2C masters competing for a single downstream slave bus. It uses a
  lock/grant ownership model: a master requests the downstream bus by setting
  LOCK_REQ, waits for the arbiter to assert LOCK_GRANT, then explicitly
  connects to the bus via BUS_CONNECT before issuing transactions.

  Key features compared to the PCA9541:
    - Lock/grant ownership model (LOCK_REQ + LOCK_GRANT bits in CONTR register)
    - BUS_CONNECT bit must be set explicitly after receiving LOCK_GRANT
    - Reserve Time register (RT): guarantees bus ownership for 1-255 ms
    - INT0 and INT1 interrupt outputs (one per upstream master) and INT_IN
      interrupt input that propagates downstream slave interrupts upstream
    - 16-bit shared mailbox (MB_LO + MB_HI) for inter-master communication
    - ID register (read-only, value 0x38) to distinguish from PCA9541
    - Four address pins (AD0-AD3) allowing up to 112 unique I2C addresses

properties:
  compatible:
    const: nxp,pca9641

  reg:
    maxItems: 1
    description:
      7-bit I2C slave address of the PCA9641 on the upstream bus. The address
      is set by hardware pins AD0-AD3 at power-on or hardware reset.

  interrupts:
    maxItems: 1
    description:
      Optional interrupt from the INT0 or INT1 output pin. When provided the
      driver uses interrupt-assisted arbitration (waits on LOCK_GRANT interrupt)
      instead of polling the CONTR register. Either INT0 or INT1 can be
      connected depending on which upstream master port is used.

  i2c-arb:
    type: object
    $ref: /schemas/i2c/i2c-controller.yaml
    unevaluatedProperties: false
    description:
      I2C bus node representing the downstream slave bus controlled by the
      PCA9641. Downstream slave devices are declared as child nodes here.

required:
  - compatible
  - reg
  - i2c-arb

additionalProperties: false

examples:
  - |
    /* Minimal example: polling mode (no interrupt wiring) */
    i2c {
        #address-cells = <1>;
        #size-cells = <0>;

        i2c-arbiter@74 {
            compatible = "nxp,pca9641";
            reg = <0x74>;

            i2c-arb {
                #address-cells = <1>;
                #size-cells = <0>;

                eeprom@50 {
                    compatible = "atmel,24c32";
                    reg = <0x50>;
                };
            };
        };
    };

  - |
    /* Interrupt mode: INT0 wired to SoC GPIO */
    #include <dt-bindings/interrupt-controller/irq.h>

    i2c {
        #address-cells = <1>;
        #size-cells = <0>;

        i2c-arbiter@70 {
            compatible = "nxp,pca9641";
            reg = <0x70>;
            interrupt-parent = <&gpio1>;
            interrupts = <5 IRQ_TYPE_EDGE_FALLING>;

            i2c-arb {
                #address-cells = <1>;
                #size-cells = <0>;

                temperature-sensor@48 {
                    compatible = "national,lm75";
                    reg = <0x48>;
                };
            };
        };
    };
```

## Documentation/devicetree/bindings/i2c/qcom,i2c-slave.yaml
```yaml
# SPDX-License-Identifier: (GPL-2.0-only OR BSD-2-Clause)
%YAML 1.2
---
$id: http://devicetree.org/schemas/i2c/qcom,i2c-slave.yaml#
$schema: http://devicetree.org/meta-schemas/core.yaml#

title: Qualcomm I2C Slave Controller

maintainers:
  - Mukesh Kumar Savaliya <mukesh.savaliya@oss.qualcomm.com>
  - Viken Dadhaniya <viken.dadhaniya@oss.qualcomm.com>

description:
  The Qualcomm I2C slave controller is a dedicated hardware IP found on
  Qualcomm SoCs that operates exclusively as an I2C slave device on the bus.
  It supports FIFO (PIO) mode for data transfer and does not function as an
  I2C master.

properties:
  compatible:
    const: qcom,i2c-slave

  reg:
    maxItems: 1

  interrupts:
    maxItems: 1

  clocks:
    items:
      - description: XO clock for I2C slave
      - description: AHB clock for I2C slave

  clock-names:
    items:
      - const: sm_bus_xo_clk
      - const: sm_bus_ahb_clk

  qcom,slave-addr:
    $ref: /schemas/types.yaml#/definitions/uint32
    description:
      The 7-bit I2C slave address programmed into the controller's device
      address register. This controller operates exclusively as an I2C slave
      and has no child nodes, so the standard 'reg' property cannot be used
      to convey the I2C address (it is already used for the MMIO register
      range). The address is configurable at runtime via a hardware register.
    minimum: 0x08
    maximum: 0x77

  interconnects:
    maxItems: 1

  interconnect-names:
    const: i2c-slave-config

  pinctrl-0: true
  pinctrl-1: true

  pinctrl-names:
    minItems: 1
    items:
      - const: default
      - const: sleep

required:
  - compatible
  - reg
  - interrupts
  - clocks
  - clock-names
  - qcom,slave-addr
  - interconnects
  - interconnect-names

additionalProperties: false

examples:
  - |
    #include <dt-bindings/interrupt-controller/arm-gic.h>
    #include <dt-bindings/clock/qcom,qdu1000-gcc.h>
    #include <dt-bindings/interconnect/qcom,qdu1000-rpmh.h>

    i2c-slave@88ca000 {
        compatible = "qcom,i2c-slave";
        reg = <0x88ca000 0x64>;
        clocks = <&gcc GCC_SM_BUS_XO_CLK>, <&gcc GCC_SM_BUS_AHB_CLK>;
        clock-names = "sm_bus_xo_clk", "sm_bus_ahb_clk";
        interrupts = <GIC_SPI 358 IRQ_TYPE_LEVEL_HIGH>;
        qcom,slave-addr = <0x30>;

        interconnect-names = "i2c-slave-config";
        interconnects = <&gem_noc MASTER_APPSS_PROC 0 &config_noc SLAVE_SMBUS_CFG 0>;
    };
...
```

## Documentation/devicetree/bindings/i2c/realtek,rtl9300-i2c.yaml
```yaml
# SPDX-License-Identifier: (GPL-2.0-only OR BSD-2-Clause)
%YAML 1.2
---
$id: http://devicetree.org/schemas/i2c/realtek,rtl9300-i2c.yaml#
$schema: http://devicetree.org/meta-schemas/core.yaml#

title: Realtek RTL I2C Controller

maintainers:
  - Chris Packham <chris.packham@alliedtelesis.co.nz>

description:
  The RTL9300 SoC has two I2C controllers. Each of these has an SCL line (which
  if not-used for SCL can be a GPIO). There are 8 common SDA lines that can be
  assigned to either I2C controller.

properties:
  compatible:
    items:
      - enum:
          - realtek,rtl9301-i2c
          - realtek,rtl9302b-i2c
          - realtek,rtl9302c-i2c
          - realtek,rtl9303-i2c
      - const: realtek,rtl9300-i2c

  reg:
    description: Register offset and size this I2C controller.

  "#address-cells":
    const: 1

  "#size-cells":
    const: 0

patternProperties:
  '^i2c@[0-7]$':
    $ref: /schemas/i2c/i2c-controller.yaml
    unevaluatedProperties: false

    properties:
      reg:
        description: The SDA pin associated with the I2C bus.
        maxItems: 1

    required:
      - reg

required:
  - compatible
  - reg

unevaluatedProperties: false

examples:
  - |
    i2c@36c {
      compatible = "realtek,rtl9302c-i2c", "realtek,rtl9300-i2c";
      reg = <0x36c 0x14>;
      #address-cells = <1>;
      #size-cells = <0>;

      i2c@0 {
        reg = <0>;
        #address-cells = <1>;
        #size-cells = <0>;
        gpio@20 {
          compatible = "nxp,pca9555";
          gpio-controller;
          #gpio-cells = <2>;
          reg = <0x20>;
        };
      };

      i2c@2 {
        reg = <2>;
        #address-cells = <1>;
        #size-cells = <0>;
        gpio@20 {
          compatible = "nxp,pca9555";
          gpio-controller;
          #gpio-cells = <2>;
          reg = <0x20>;
        };
      };
    };
    i2c@388 {
      compatible = "realtek,rtl9302c-i2c", "realtek,rtl9300-i2c";
      reg = <0x388 0x14>;
      #address-cells = <1>;
      #size-cells = <0>;

      i2c@7 {
        reg = <7>;
        #address-cells = <1>;
        #size-cells = <0>;
      };
    };
```

## Documentation/devicetree/bindings/i2c/realtek,rtl9301-i2c.yaml
```yaml
# SPDX-License-Identifier: (GPL-2.0-only OR BSD-2-Clause)
%YAML 1.2
---
$id: http://devicetree.org/schemas/i2c/realtek,rtl9301-i2c.yaml#
$schema: http://devicetree.org/meta-schemas/core.yaml#

title: Realtek RTL I2C Controller

maintainers:
  - Chris Packham <chris.packham@alliedtelesis.co.nz>

description:
  The RTL9300 SoCs have two I2C controllers. Each of these has an SCL line
  (which if not-used for SCL can be a GPIO). There are 8 common SDA lines
  that can be assigned to either I2C controller.
  The RTL9310 SoCs have equal capabilities but support 12 common SDA lines
  which can be assigned to either I2C controller.

properties:
  compatible:
    oneOf:
      - items:
          - enum:
              - realtek,rtl9302b-i2c
              - realtek,rtl9302c-i2c
              - realtek,rtl9303-i2c
          - const: realtek,rtl9301-i2c
      - items:
          - enum:
              - realtek,rtl9311-i2c
              - realtek,rtl9312-i2c
              - realtek,rtl9313-i2c
          - const: realtek,rtl9310-i2c
      - enum:
          - realtek,rtl9301-i2c
          - realtek,rtl9310-i2c

  reg:
    items:
      - description: Register offset and size this I2C controller.

  "#address-cells":
    const: 1

  "#size-cells":
    const: 0

  realtek,mst-id:
    $ref: /schemas/types.yaml#/definitions/uint32
    description:
      Realtek-internal ID of the I2C controller/master.
    minimum: 1
    maximum: 2

patternProperties:
  '^i2c@([0-9]|1[0-1])$':
    $ref: /schemas/i2c/i2c-controller.yaml
    unevaluatedProperties: false

    properties:
      reg:
        description: The SDA pin associated with the I2C bus.
        maxItems: 1

    required:
      - reg


allOf:
  - if:
      properties:
        compatible:
          contains:
            const: realtek,rtl9310-i2c
    then:
      required:
        - realtek,mst-id
  - if:
      properties:
        compatible:
          contains:
            const: realtek,rtl9301-i2c
    then:
      patternProperties:
        '^i2c@([8-9]|1[0-1])$': false

required:
  - compatible
  - reg

additionalProperties: false

examples:
  - |
    i2c@36c {
      compatible = "realtek,rtl9301-i2c";
      reg = <0x36c 0x14>;
      #address-cells = <1>;
      #size-cells = <0>;

      i2c@2 {
        reg = <2>;
        #address-cells = <1>;
        #size-cells = <0>;
      };
    };
  - |
    i2c@100c {
      compatible = "realtek,rtl9310-i2c";
      reg = <0x100c 0x18>;
      #address-cells = <1>;
      #size-cells = <0>;
      realtek,mst-id = <1>;

      i2c@0 {
        reg = <0>;
      };
    };
```

## Documentation/devicetree/bindings/i2c/snps,dwc-i2c.yaml
```yaml
# SPDX-License-Identifier: (GPL-2.0-only OR BSD-2-Clause)
# Copyright (C) 2024 StarFive Technology Co., Ltd.
%YAML 1.2
---
$id: http://devicetree.org/schemas/i2c/snps,dwc-i2c.yaml#
$schema: http://devicetree.org/meta-schemas/core.yaml#

title: Synopsys DWC I2C Controller

maintainers:
  - Lianfeng Ouyang <lianfeng.ouyang@starfivetech.com>

allOf:
  - $ref: /schemas/i2c/i2c-controller.yaml#

properties:
  compatible:
    oneOf:
      - description: Generic Synopsys DWC I2C controller
        const: snps,dwc-i2c
      - description: StarFive JHB100 I2C master controller
        items:
          - const: starfive,jhb100-dwc-i2c-master
          - const: snps,dwc-i2c
      - description: StarFive JHB100 I2C slave controller
        items:
          - const: starfive,jhb100-dwc-i2c-slave
          - const: snps,dwc-i2c

  reg:
    description: DWC I2C controller memory mapped registers

  interrupts:
    maxItems: 1

  clocks:
    minItems: 1
    items:
      - description: I2C controller reference clock source
      - description: APB interface clock source

  clock-names:
    minItems: 1
    items:
      - const: ref
      - const: pclk

  resets:
    maxItems: 1

  clock-frequency:
    description: Desired I2C bus clock frequency in Hz
    enum: [100000, 400000, 1000000, 3400000]
    default: 400000

  i2c-sda-hold-time-ns:
    description: |
      The property should contain the SDA hold time in nanoseconds.
      This value is used to compute value written into DW_IC_SDA_HOLD register.

  i2c-scl-falling-time-ns:
    description: |
      The property should contain the SCL falling time in nanoseconds.
      This value is used to compute the tLOW period.
    default: 300

  i2c-sda-falling-time-ns:
    description: |
      The property should contain the SDA falling time in nanoseconds.
      This value is used to compute the tHIGH period.
    default: 300

  starfive,mctp-i2c-ms:
    description: |
      The property should contain reference to the master node associated with the slave.
      This value is only used in slave mode, especially for MCTP application.

  dwc-i2c-tx-fifo-depth:
    $ref: /schemas/types.yaml#/definitions/uint32
    description: |
      The property describes the tx fifo depth.
    default: 8

  dwc-i2c-rx-fifo-depth:
    $ref: /schemas/types.yaml#/definitions/uint32
    description: |
      The property describes the rx fifo depth.
    default: 8

unevaluatedProperties: false

required:
  - compatible
  - reg
  - interrupts

examples:
  - |
    i2c@f0000 {
      compatible = "snps,dwc-i2c";
      reg = <0xf0000 0x1000>;
      interrupts = <11>;
      clock-frequency = <400000>;
    };
  - |
    i2c@2000 {
      compatible = "snps,dwc-i2c";
      reg = <0x2000 0x100>;
      #address-cells = <1>;
      #size-cells = <0>;
      clock-frequency = <400000>;
      clocks = <&i2cclk>;
      interrupts = <0>;

      eeprom@64 {
        compatible = "atmel,24c02";
        reg = <0x64>;
      };
    };
...
```

## Documentation/devicetree/bindings/i2c/spacemit,k1-i2c.yaml
```yaml
# SPDX-License-Identifier: (GPL-2.0-only OR BSD-2-Clause)
%YAML 1.2
---
$id: http://devicetree.org/schemas/i2c/spacemit,k1-i2c.yaml#
$schema: http://devicetree.org/meta-schemas/core.yaml#

title: I2C controller embedded in SpacemiT's K1 SoC

maintainers:
  - Troy Mitchell <troymitchell988@gmail.com>

properties:
  compatible:
    const: spacemit,k1-i2c

  reg:
    maxItems: 1

  interrupts:
    maxItems: 1

  clocks:
    maxItems: 1

  clock-frequency:
    description:
      Desired I2C bus clock frequency in Hz.
      K1 supports standard, fast, high-speed modes, from 1 to 3300000.
    default: 100000
    minimum: 1
    maximum: 3300000

required:
  - compatible
  - reg
  - interrupts
  - clocks

unevaluatedProperties: false

examples:
  - |
    i2c@d4010800 {
        compatible = "spacemit,k1-i2c";
        reg = <0xd4010800 0x38>;
        interrupt-parent = <&plic>;
        interrupts = <36>;
        clocks = <&ccu 90>;
        clock-frequency = <100000>;
    };

...
```
