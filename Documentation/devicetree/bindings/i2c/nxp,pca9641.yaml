## Documentation/devicetree/bindings/iio/adc/adi,ade9000.yaml
```yaml
# SPDX-License-Identifier: (GPL-2.0 OR BSD-2-Clause)
# Copyright 2025 Analog Devices Inc.
%YAML 1.2
---
$id: http://devicetree.org/schemas/bindings/iio/adc/adi,ade9000.yaml#
$schema: http://devicetree.org/meta-schemas/core.yaml#

title: Analog Devices ADE9000 High Performance, Polyphase Energy Metering driver

maintainers:
  - Antoniu Miclaus <antoniu.miclaus@analog.com>

description: |
  The ADE9000 s a highly accurate, fully integrated, multiphase energy and power
  quality monitoring device. Superior analog performance and a digital signal
  processing (DSP) core enable accurate energy monitoring over a wide dynamic
  range. An integrated high end reference ensures low drift over temperature
  with a combined drift of less than ±25 ppm/°C maximum for the entire channel
  including a programmable gain amplifier (PGA) and an analog-to- digital
  converter (ADC).

  https://www.analog.com/media/en/technical-documentation/data-sheets/ADE9000.pdf

properties:
  compatible:
    enum:
      - adi,ade9000

  reg:
    maxItems: 1

  '#address-cells':
    const: 1

  '#size-cells':
    const: 0

  spi-max-frequency:
    maximum: 20000000

  interrupts:
    maxItems: 2

  reset-gpios:
    description: |
      Must be the device tree identifier of the RESET pin. As the line is
      active low, it should be marked GPIO_ACTIVE_LOW.
    maxItems: 1

  interrupt-names:
    items:
      - const: irq0
      - const: irq1

  adi,wf-cap-en:
    description: Enable fixed data rate for waveform buffer instead of resampled data
    type: boolean

  adi,wf-mode:
    description: |
      Waveform buffer filling and trigger mode.
      0 - Stop when waveform buffer is full
      1 - Continuous fill, stop only on enabled trigger events
      2 - Continuous filling, center capture around enabled trigger events
      3 - Streaming mode
    $ref: /schemas/types.yaml#/definitions/uint32
    enum: [0, 1, 2, 3]

  adi,wf-src:
    description: |
      Waveform buffer data source selection.
      0 - Sinc4 output, at 16 kSPS
      1 - Reserved
      2 - Sinc4 + IIR LPF output, at 4 kSPS
      3 - Current and voltage channel waveform samples, processed by the DSP at 4 kSPS
    $ref: /schemas/types.yaml#/definitions/uint32
    enum: [0, 2, 3]

  adi,wf-in-en:
    description: Enable IN waveform samples readout from waveform buffer
    type: boolean

  adi,egy-time:
    description: Energy accumulation time setting for energy registers
    $ref: /schemas/types.yaml#/definitions/uint32

required:
  - compatible
  - reg
  - reset-gpios
  - interrupts
  - interrupt-names
  - adi,wf-mode
  - adi,wf-src

additionalProperties: false

patternProperties:
  "^phase@[0-2]$":
    type: object
    description: |
      Represents the external phases which are externally connected. Each phase
      has a current, voltage and power component

    properties:
      reg:
        description: |
          The phase represented by a number
          0 - Phase A
          1 - Phase B
          2 - Phase C
        $ref: /schemas/types.yaml#/definitions/uint32
        enum: [0, 1, 2]

    required:
      - reg

    additionalProperties: false

examples:
  - |
    #include <dt-bindings/gpio/gpio.h>
    #include <dt-bindings/interrupt-controller/irq.h>

    spi {
        #address-cells = <1>;
        #size-cells = <0>;

        adc@0 {
            compatible = "adi,ade9000";
            reg = <0>;
            spi-max-frequency = <7000000>;

            #address-cells = <1>;
            #size-cells = <0>;
            reset-gpios = <&gpio 4 GPIO_ACTIVE_LOW>;
            interrupts = <2 IRQ_TYPE_EDGE_FALLING>, <3 IRQ_TYPE_EDGE_FALLING>;
            interrupt-names = "irq0", "irq1";
            interrupt-parent = <&gpio>;

            adi,wf-cap-en;
            adi,wf-mode = <3>;
            adi,wf-src = <3>;
            adi,wf-in-en;

            phase@0 {
                reg = <0>;
            };
            phase@1 {
                reg = <1>;
            };
            phase@2 {
                reg = <2>;
            };
        };
    };
...
```

## Documentation/devicetree/bindings/iio/adc/adi,ltc2378.yaml
```yaml
# SPDX-License-Identifier: (GPL-2.0-only OR BSD-2-Clause)
%YAML 1.2
---
$id: http://devicetree.org/schemas/iio/adc/adi,ltc2378.yaml#
$schema: http://devicetree.org/meta-schemas/core.yaml#

title: Analog Devices LTC2378 and similar Analog to Digital Converters

maintainers:
  - Marcelo Schmitt <marcelo.schmitt@analog.com>

description: |
  Analog Devices LTC2378 series of ADCs.
  Specifications can be found at:
    https://www.analog.com/media/en/technical-documentation/data-sheets/233818fa.pdf
    https://www.analog.com/media/en/technical-documentation/data-sheets/236416fa.pdf
    https://www.analog.com/media/en/technical-documentation/data-sheets/236418f.pdf
    https://www.analog.com/media/en/technical-documentation/data-sheets/236716fa.pdf
    https://www.analog.com/media/en/technical-documentation/data-sheets/236718f.pdf
    https://www.analog.com/media/en/technical-documentation/data-sheets/236816f.pdf
    https://www.analog.com/media/en/technical-documentation/data-sheets/236818f.pdf
    https://www.analog.com/media/en/technical-documentation/data-sheets/236918fa.pdf
    https://www.analog.com/media/en/technical-documentation/data-sheets/237016fa.pdf
    https://www.analog.com/media/en/technical-documentation/data-sheets/237616fa.pdf
    https://www.analog.com/media/en/technical-documentation/data-sheets/237618fa.pdf
    https://www.analog.com/media/en/technical-documentation/data-sheets/237620fb.pdf
    https://www.analog.com/media/en/technical-documentation/data-sheets/237716fa.pdf
    https://www.analog.com/media/en/technical-documentation/data-sheets/237718fa.pdf
    https://www.analog.com/media/en/technical-documentation/data-sheets/237720fb.pdf
    https://www.analog.com/media/en/technical-documentation/data-sheets/237816fa.pdf
    https://www.analog.com/media/en/technical-documentation/data-sheets/237818fa.pdf
    https://www.analog.com/media/en/technical-documentation/data-sheets/237820fb.pdf
    https://www.analog.com/media/en/technical-documentation/data-sheets/237918fb.pdf
    https://www.analog.com/media/en/technical-documentation/data-sheets/238016fb.pdf

$ref: /schemas/spi/spi-peripheral-props.yaml#

properties:
  compatible:
    enum:
      - adi,ltc2338-18
      - adi,ltc2364-16
      - adi,ltc2364-18
      - adi,ltc2367-16
      - adi,ltc2367-18
      - adi,ltc2368-16
      - adi,ltc2368-18
      - adi,ltc2369-18
      - adi,ltc2370-16
      - adi,ltc2376-16
      - adi,ltc2376-18
      - adi,ltc2376-20
      - adi,ltc2377-16
      - adi,ltc2377-18
      - adi,ltc2377-20
      - adi,ltc2378-16
      - adi,ltc2378-18
      - adi,ltc2378-20
      - adi,ltc2379-18
      - adi,ltc2380-16

  reg:
    maxItems: 1

  spi-max-frequency:
    maximum: 100000000

  vdd-supply:
    description: A 2.5V supply that powers the chip (VDD).

  ovdd-supply:
    description:
      A 1.71V to 5.25V supply that sets the logic level for digital interface.

  ref-supply:
    description:
      A 2.5V to 5.1V supply for the reference input (REF).

  cnv-gpios:
    description:
      When provided, this property indicates the GPIO that is connected to the
      CNV pin.
    maxItems: 1

  interrupts:
    description:
      Interrupt for signaling the completion of conversion results. The active
      low signal provided on the BUSY pin asserts when ADC conversions finish.
    maxItems: 1

required:
  - compatible
  - reg
  - vdd-supply
  - ovdd-supply
  - ref-supply

unevaluatedProperties: false

examples:
  - |
    #include <dt-bindings/gpio/gpio.h>
    #include <dt-bindings/interrupt-controller/irq.h>
    spi {
        #address-cells = <1>;
        #size-cells = <0>;
        adc@0 {
            compatible = "adi,ltc2378-20";
            reg = <0>;
            spi-max-frequency = <71000000>;
            vdd-supply = <&supply_2_5V>;
            ovdd-supply = <&supply_3_3V>;
            ref-supply = <&supply_5V>;
            cnv-gpios = <&gpio0 88 GPIO_ACTIVE_HIGH>;
            interrupts = <7 IRQ_TYPE_EDGE_FALLING>;
            interrupt-parent = <&gpio>;
        };
    };
```
