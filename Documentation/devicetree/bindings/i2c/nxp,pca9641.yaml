## Documentation/devicetree/bindings/iio/adc/adi,ad4691.yaml
```yaml
# SPDX-License-Identifier: (GPL-2.0-only OR BSD-2-Clause)
%YAML 1.2
---
$id: http://devicetree.org/schemas/iio/adc/adi,ad4691.yaml#
$schema: http://devicetree.org/meta-schemas/core.yaml#

title: Analog Devices AD4691 Family Multichannel SAR ADCs

maintainers:
  - Radu Sabau <radu.sabau@analog.com>

description: |
  The AD4691 family are high-speed, low-power, multichannel successive
  approximation register (SAR) analog-to-digital converters (ADCs) with
  an SPI-compatible serial interface. The ADC supports CNV Clock Mode,
  where an external PWM drives the CNV pin, and Manual Mode, where CNV
  is directly tied to the SPI chip-select.

  Datasheets:
    * https://www.analog.com/en/products/ad4692.html
    * https://www.analog.com/en/products/ad4691.html
    * https://www.analog.com/en/products/ad4694.html
    * https://www.analog.com/en/products/ad4693.html

$ref: /schemas/spi/spi-peripheral-props.yaml#

properties:
  compatible:
    enum:
      - adi,ad4691
      - adi,ad4692
      - adi,ad4693
      - adi,ad4694

  reg:
    maxItems: 1

  spi-max-frequency:
    maximum: 40000000

  spi-cpol: true
  spi-cpha: true

  vio-supply:
    description: I/O voltage supply (1.71V to 1.89V or VDD).

  vref-supply:
    description: External reference voltage supply (2.4V to 5.25V).

  vrefin-supply:
    description: Internal reference buffer input supply.

  reset-gpios:
    description: GPIO connected to the RESET pin (active high).
    maxItems: 1

  clocks:
    description: Reference clock for PWM timing in CNV Clock Mode.
    maxItems: 1

  pwms:
    description:
      PWM connected to the CNV pin. When present, selects CNV Clock Mode where
      the PWM drives the conversion rate. When absent, Manual Mode is used
      (CNV tied to SPI CS).
    maxItems: 1

  pwm-names:
    items:
      - const: cnv

  interrupts:
    description:
      Interrupt line connected to the ADC GP0 pin. GP0 must be physically
      wired to an interrupt-capable input on the SoC. The ADC asserts GP0 as
      DATA_READY at end of conversion, used both for non-offload CNV Clock Mode
      operation and for SPI Engine offload triggering via '#trigger-source-cells'.
      Not used in Manual Mode, where CNV is tied to SPI CS and no DATA_READY
      signal is generated.
    maxItems: 1

  '#trigger-source-cells':
    description: |
      For SPI Engine offload operation, this node acts as a trigger source.
      Two cells are required:
        - First cell: Trigger event type (0 = BUSY, 1 = DATA_READY)
        - Second cell: GPIO pin number (only 0 = GP0 is supported)

      Macros are available in dt-bindings/iio/adc/adi,ad4691.h:
        AD4691_TRIGGER_EVENT_BUSY, AD4691_TRIGGER_EVENT_DATA_READY
        AD4691_TRIGGER_PIN_GP0
    const: 2

required:
  - compatible
  - reg
  - vio-supply
  - reset-gpios

allOf:
  # vref-supply and vrefin-supply are mutually exclusive, one is required
  - oneOf:
      - required:
          - vref-supply
      - required:
          - vrefin-supply

  # CNV Clock Mode requires a reference clock.
  - if:
      required:
        - pwms
    then:
      required:
        - clocks

  # CNV Clock Mode (pwms present) without SPI offload requires a DRDY interrupt.
  # Offload configurations expose '#trigger-source-cells' instead.
  - if:
      required:
        - pwms
      not:
        required:
          - '#trigger-source-cells'
    then:
      required:
        - interrupts

unevaluatedProperties: false

examples:
  - |
    #include <dt-bindings/gpio/gpio.h>

    /* Example: AD4692 in CNV Clock Mode (pwms present) with standard SPI */
    spi {
        #address-cells = <1>;
        #size-cells = <0>;

        adc@0 {
            compatible = "adi,ad4692";
            reg = <0>;
            spi-cpol;
            spi-cpha;
            spi-max-frequency = <40000000>;

            vio-supply = <&vio_supply>;
            vref-supply = <&vref_5v>;

            reset-gpios = <&gpio 10 GPIO_ACTIVE_HIGH>;

            clocks = <&ref_clk>;

            pwms = <&pwm_gen 0 0>;
            pwm-names = "cnv";

            interrupts = <12 4>;
        };
    };

  - |
    #include <dt-bindings/gpio/gpio.h>

    /* Example: AD4692 in Manual Mode (no pwms) with SPI Engine offload */
    spi {
        #address-cells = <1>;
        #size-cells = <0>;

        adc@0 {
            compatible = "adi,ad4692";
            reg = <0>;
            spi-cpol;
            spi-cpha;
            spi-max-frequency = <31250000>;

            vio-supply = <&vio_supply>;
            vrefin-supply = <&vrefin_supply>;

            reset-gpios = <&gpio 10 GPIO_ACTIVE_HIGH>;
        };
    };
```

## Documentation/devicetree/bindings/iio/adc/adi,ad4695.yaml
```yaml
# SPDX-License-Identifier: (GPL-2.0-only OR BSD-2-Clause)
%YAML 1.2
---
$id: http://devicetree.org/schemas/iio/adc/adi,ad4695.yaml#
$schema: http://devicetree.org/meta-schemas/core.yaml#

title: Analog Devices Easy Drive Multiplexed SAR Analog to Digital Converters

maintainers:
  - Michael Hennerich <Michael.Hennerich@analog.com>
  - Nuno Sá <nuno.sa@analog.com>

description: |
  A family of similar multi-channel analog to digital converters with SPI bus.

  * https://www.analog.com/en/products/ad4695.html
  * https://www.analog.com/en/products/ad4696.html
  * https://www.analog.com/en/products/ad4697.html
  * https://www.analog.com/en/products/ad4698.html

$ref: /schemas/spi/spi-peripheral-props.yaml#

properties:
  compatible:
    oneOf:
      - enum:
          - adi,ad4695
          - adi,ad4697
      # same chips in WLCSP package with more pins
      - items:
          - const: adi,ad4695-wlcsp
          - const: adi,ad4695
      - items:
          - const: adi,ad4697-wlcsp
          - const: adi,ad4697
      # same chips with higher max sample rate
      - items:
          - const: adi,ad4696
          - const: adi,ad4695
      - items:
          - const: adi,ad4698
          - const: adi,ad4697
      # same chips with higher max sample rate in WLCSP package
      - items:
          - const: adi,ad4696-wlcsp
          - const: adi,ad4696
          - const: adi,ad4695-wlcsp
          - const: adi,ad4695
      - items:
          - const: adi,ad4698-wlcsp
          - const: adi,ad4698
          - const: adi,ad4697-wlcsp
          - const: adi,ad4697

  reg:
    maxItems: 1

  spi-max-frequency:
    maximum: 80000000

  spi-cpol: true
  spi-cpha: true

  spi-rx-bus-width:
    minimum: 1
    maximum: 4

  avdd-supply:
    description: A 2.7 V to 5.5 V supply that powers the analog circuitry.

  ldo-in-supply:
    description: A 2.4 V to 5.5 V supply connected to the internal LDO input.

  vdd-supply:
    description: A 1.8V supply that powers the core circuitry.

  vio-supply:
    description: A 1.2V to 1.8V supply for the digital inputs and outputs.

  ref-supply:
    description: A 2.4 V to 5.1 V supply for the external reference voltage.

  refin-supply:
    description: A 2.4 V to 5.1 V supply for the internal reference buffer input.

  com-supply:
    description: Common voltage supply for pseudo-differential analog inputs.

  adi,no-ref-current-limit:
    $ref: /schemas/types.yaml#/definitions/flag
    description:
      When this flag is present, the REF Overvoltage Reduced Current protection
      is disabled.

  adi,no-ref-high-z:
    $ref: /schemas/types.yaml#/definitions/flag
    description:
      Enable this flag if the ref-supply requires Reference Input High-Z Mode
      to be disabled for proper operation.

  cnv-gpios:
    description: The Convert Input (CNV). If omitted, CNV is tied to SPI CS.
    maxItems: 1

  reset-gpios:
    description: The Reset Input (RESET). Should be configured GPIO_ACTIVE_LOW.
    maxItems: 1

  interrupts:
    minItems: 1
    items:
      - description:
          Signal coming from the BSY_ALT_GP0 or GP3 pin that indicates a busy
          condition.
      - description:
          Signal coming from the BSY_ALT_GP0 or GP2 pin that indicates an alert
          condition.

  interrupt-names:
    minItems: 1
    items:
      - const: busy
      - const: alert

  gpio-controller: true

  "#gpio-cells":
    const: 2
    description: |
      The first cell is the GPn number: 0 to 3.
      The second cell takes standard GPIO flags.

  "#address-cells":
    const: 1
  "#size-cells":
    const: 0

patternProperties:
  "^channel@[0-9a-f]$":
    type: object
    $ref: adc.yaml
    unevaluatedProperties: false
    description:
      Describes each individual channel. In addition the properties defined
      below, bipolar from adc.yaml is also supported.

    properties:
      reg:
        maximum: 15
        description: Input pin number (INx).

      adi,pin-pairing:
        description: |
          The input pin pairing for the negative input. This can be:
          - REFGND, normally 0V (single-ended)
          - COM, normally V_REF/2, see com-supply (pseudo-differential)
          - For even numbered pins, the next odd numbered pin (differential)
        $ref: /schemas/types.yaml#/definitions/string
        enum: [refgnd, com, next]
        default: refgnd

      adi,no-high-z:
        $ref: /schemas/types.yaml#/definitions/flag
        description: |
          Enable this flag if the input pin requires the Analog Input High-Z
          Mode to be disabled for proper operation.

    required:
      - reg

    allOf:
      # only even number pins can be paired with the next pin
      - if:
          properties:
            reg:
              not:
                multipleOf: 2
        then:
          properties:
            adi,pin-pairing:
              enum: [refgnd, com]
      # bipolar mode is not supported with REFGND pairing
      - if:
          not:
            required:
              - adi,pin-pairing
        then:
          properties:
            bipolar: false
        else:
          if:
            properties:
              adi,pin-pairing:
                const: refgnd
          then:
            properties:
              bipolar: false

required:
  - compatible
  - reg
  - avdd-supply
  - vio-supply

allOf:
  - oneOf:
      - required:
          - ref-supply
      - required:
          - refin-supply

  - oneOf:
      - required:
          - ldo-in-supply
      - required:
          - vdd-supply

  # LFSCP package has fewer pins, so a few things are not valid in that case
  - if:
      properties:
        compatible:
          not:
            contains:
              pattern: -wlcsp$
    then:
      properties:
        refin-supply: false
        spi-rx-bus-width:
          maximum: 2

  # the internal reference buffer always requires high-z mode
  - if:
      required:
        - refin-supply
    then:
      properties:
        adi,no-ref-high-z: false

  # limit channels for 8-channel chips
  - if:
      properties:
        compatible:
          contains:
            const: adi,ad4697
    then:
      patternProperties:
        "^channel@[0-7]$":
          properties:
            reg:
              maximum: 7
        "^channel@[8-9a-f]$": false

unevaluatedProperties: false

examples:
  - |
    #include <dt-bindings/gpio/gpio.h>

    spi {
        #address-cells = <1>;
        #size-cells = <0>;

        adc@0 {
            compatible = "adi,ad4695";
            reg = <0>;
            spi-cpol;
            spi-cpha;
            spi-max-frequency = <80000000>;
            avdd-supply = <&supply_2_5V>;
            vdd-supply = <&supply_1_8V>;
            vio-supply = <&supply_1_2V>;
            ref-supply = <&supply_5V>;
            reset-gpios = <&gpio 1 GPIO_ACTIVE_LOW>;

            #address-cells = <1>;
            #size-cells = <0>;

            /* Differential channel between IN0 and IN1. */
            channel@0 {
                reg = <0>;
                adi,pin-pairing = "next";
                bipolar;
            };

            /* Single-ended channel between IN2 and REFGND. */
            channel@2 {
                reg = <2>;
            };

            /* Pseudo-differential channel between IN3 and COM. */
            channel@f {
                reg = <3>;
                adi,pin-pairing = "com";
                bipolar;
            };
        };
    };
```
