## Documentation/devicetree/bindings/soc/samsung/exynos-speedy.yaml
```yaml
# SPDX-License-Identifier: (GPL-2.0-only OR BSD-2-Clause)
%YAML 1.2
---
$id: http://devicetree.org/schemas/soc/samsung/exynos-speedy.yaml#
$schema: http://devicetree.org/meta-schemas/core.yaml#

title: Samsung Exynos SPEEDY serial bus host controller

maintainers:
  - Markuss Broks <markuss.broks@gmail.com>

description:
  Samsung SPEEDY is a proprietary Samsung serial 1-wire bus.
  It is used on various Samsung Exynos chips. The bus can
  address at most 4 bit (16) devices. The devices on the bus
  have 8 bit long register line, and the registers are also
  8 bit long each. It is typically used for communicating with
  Samsung PMICs (s2mps17, s2mps18, ...) and other Samsung chips,
  such as RF parts.

properties:
  compatible:
    - items:
        - enum:
            - samsung,exynos9810-speedy
        - const: samsung,exynos-speedy

  reg:
    maxItems: 1

  clocks:
    maxItems: 1

  clock-names:
    - const: pclk

  interrupts:
    maxItems: 1

required:
  - compatible
  - reg
  - "#address-cells"
  - "#size-cells"

patternProperties:
  "^[a-z][a-z0-9]*@[0-9a-f]$":
    type: object
    additionalProperties: true

    properties:
      reg:
        maxItems: 1

    required:
      - reg

additionalProperties: false

examples:
  - |
    speedy0: speedy@141c0000 {
      compatible = "samsung,exynos9810-speedy",
                   "samsung-exynos-speedy";
      reg = <0x141c0000 0x2000>;
      #address-cells = <1>;
      #size-cells = <0>;

      pmic@0 {
        compatible = "samsung,s2mps18-pmic";
        reg = <0x0>;
      };

      regulator@1 {
        compatible = "samsung,s2mps18-regulator";
        reg = <0x1>;
      };
    };
```

## Documentation/devicetree/bindings/soc/samsung/samsung,exynos850-pmu-intr-gen.yaml
```yaml
# SPDX-License-Identifier: (GPL-2.0 OR BSD-2-Clause)
%YAML 1.2
---
$id: http://devicetree.org/schemas/soc/samsung/samsung,exynos850-pmu-intr-gen.yaml#
$schema: http://devicetree.org/meta-schemas/core.yaml#

title: Samsung Power Management Unit (PMU) Interrupt Generation

description: |
  PMU interrupt generator for handshaking between PMU through interrupts.

maintainers:
  - Peter Griffin <peter.griffin@linaro.org>

properties:
  compatible:
    items:
      - enum:
          - google,gs101-pmu-intr-gen
          - samsung,exynos850-pmu-intr-gen
      - const: syscon

  reg:
    maxItems: 1

required:
  - compatible
  - reg

additionalProperties: false

examples:
  - |
    pmu_intr_gen: syscon@17470000 {
      compatible = "google,gs101-pmu-intr-gen", "syscon";
      reg = <0x17470000 0x10000>;
    };
```

## Documentation/devicetree/bindings/soc/sophgo/sophgo,cv1800b-top-syscon.yaml
```yaml
# SPDX-License-Identifier: (GPL-2.0 OR BSD-2-Clause)
%YAML 1.2
---
$id: http://devicetree.org/schemas/soc/sophgo/sophgo,cv1800b-top-syscon.yaml#
$schema: http://devicetree.org/meta-schemas/core.yaml#

title: Sophgo CV18XX/SG200X SoC top system controller

maintainers:
  - Inochi Amaoto <inochiama@outlook.com>

description:
  The Sophgo CV18XX/SG200X SoC top misc system controller provides
  register access to configure related modules.

properties:
  compatible:
    oneOf:
      - items:
          - const: sophgo,cv1800b-top-syscon
          - const: syscon
          - const: simple-mfd

  reg:
    maxItems: 1

  "#address-cells":
    const: 1

  "#size-cells":
    const: 1

patternProperties:
  "dma-router@154":
    $ref: /schemas/dma/sophgo,cv1800b-dmamux.yaml#
    unevaluatedProperties: false

  "phy@48":
    $ref: /schemas/phy/sophgo,cv1800b-usb2-phy.yaml#
    unevaluatedProperties: false

required:
  - compatible
  - reg
  - "#address-cells"
  - "#size-cells"

additionalProperties: false

examples:
  - |
    syscon@3000000 {
      compatible = "sophgo,cv1800b-top-syscon", "syscon", "simple-mfd";
      reg = <0x03000000 0x1000>;
      #address-cells = <1>;
      #size-cells = <1>;
    };

...
```

## Documentation/devicetree/bindings/soc/spacemit/spacemit,k1-syscon.yaml
```yaml
# SPDX-License-Identifier: (GPL-2.0-only OR BSD-2-Clause)
%YAML 1.2
---
$id: http://devicetree.org/schemas/soc/spacemit/spacemit,k1-syscon.yaml#
$schema: http://devicetree.org/meta-schemas/core.yaml#

title: Spacemit K1 SoC System Controller

maintainers:
  - Haylen Chu <heylenay@4d2.org>

description:
  The Spacemit K1 SoC system controller provides access to shared register files
  for related SoC modules, such as clock controller and reset controller.

properties:
  compatible:
    items:
      - enum:
          - spacemit,k1-apbc-syscon
          - spacemit,k1-apbs-syscon
          - spacemit,k1-apmu-syscon
          - spacemit,k1-mpmu-syscon
      - const: syscon
      - const: simple-mfd

  reg:
    maxItems: 1

  clock-controller:
    $ref: /schemas/clock/spacemit,k1-ccu.yaml#
    type: object

  "#address-cells":
    const: 1

  "#size-cells":
    const: 1

additionalProperties: false

required:
  - compatible
  - reg

examples:
  - |
    osc_32k: clock-32k {
        compatible = "fixed-clock";
        clock-frequency = <32000>;
        clock-output-names = "osc_32k";
        #clock-cells = <0>;
    };

    vctcxo_1m: clock-1m {
        compatible = "fixed-clock";
        clock-frequency = <1000000>;
        clock-output-names = "vctcxo_1m";
        #clock-cells = <0>;
    };

    vctcxo_3m: clock-3m {
        compatible = "fixed-clock";
        clock-frequency = <3000000>;
        clock-output-names = "vctcxo_3m";
        #clock-cells = <0>;
    };

    vctcxo_24m: clock-24m {
        compatible = "fixed-clock";
        clock-frequency = <24000000>;
        clock-output-names = "vctcxo_24m";
        #clock-cells = <0>;
    };

    system-controller@d4050000 {
        compatible = "spacemit,k1-mpmu-syscon", "syscon", "simple-mfd";
        reg = <0xd4050000 0x209c>;

        clock-controller {
            compatible = "spacemit,k1-ccu-mpmu";
            clocks = <&osc_32k>, <&vctcxo_1m>, <&vctcxo_3m>, <&vctcxo_24m>;
            clock-names = "osc_32k", "vctcxo_1m", "vctcxo_3m", "vctcxo_24m";
            #clock-cells = <1>;
        };
    };
```

## Documentation/devicetree/bindings/soc/st/st,stm32mp25-risab.yaml
```yaml
# SPDX-License-Identifier: (GPL-2.0-only OR BSD-2-Clause)
%YAML 1.2
---
$id: http://devicetree.org/schemas/soc/st/st,stm32mp25-risab.yaml#
$schema: http://devicetree.org/meta-schemas/core.yaml#

title: STM32 Resource isolation peripheral unit for address space protection
       (block-based)

maintainers:
  - Gatien Chevallier <gatien.chevallier@foss.st.com>

description:
  The RIF (resource isolation framework) is a comprehensive set of hardware
  blocks designed to enforce and manage isolation of STM32 hardware resources,
  like memory and peripherals. The RISAB peripheral is part of the RIF and is
  used to protect internal RAMs by applying access rights per RISAB fixed-size
  page. Through RISAB registers, a trusted domain, or the domain to whom the
  page configuration has been delegated, assigns memory pages to one or more
  security domains (secure, privilege, compartment).

properties:
  compatible:
    const: st,stm32mp25-risab

  reg:
    maxItems: 1

  clocks:
    items:
      - description: RISAB bus clock

  memory-region:
    minItems: 1
    maxItems: 32
    description:
      Phandle to nodes describing memory regions to be configured in the RISAB
      by the trusted domain of at least a RISAB page size.
      These regions cannot overlap. A zone must be within st,mem-map range and
      can be represented by one or more pages.

  st,mem-map:
    $ref: /schemas/types.yaml#/definitions/uint32-array
    description: Memory address range covered by the RISAB.
    items:
      - description: Memory range base address
      - description: Memory range size

  st,srwiad:
    description:
      When set, the trusted domain configures the RISAB to allow secure
      read/write data accesses to non-secure blocks and pages. Secure execute
      remains illegal.
    type: boolean

required:
  - compatible
  - reg
  - clocks
  - st,mem-map

additionalProperties: false

examples:
  - |
    #include <dt-bindings/clock/st,stm32mp25-rcc.h>

    risab1: risab@420f0000 {
        compatible = "st,stm32mp25-risab";
        reg = <0x420f0000 0x1000>;
        clocks = <&rcc CK_ICN_LS_MCU>;
        st,mem-map = <0xa000000 0x20000>;
        st,srwiad;
    };
```

## Documentation/devicetree/bindings/soc/starfive/starfive,jh7110-vout-subsystem.yaml
```yaml
# SPDX-License-Identifier: (GPL-2.0-only OR BSD-2-Clause)
%YAML 1.2
---
$id: http://devicetree.org/schemas/soc/starfive/starfive,jh7110-vout-subsystem.yaml#
$schema: http://devicetree.org/meta-schemas/core.yaml#

title: StarFive JH7110 video output subsystem

maintainers:
  - Michal Wilczynski <m.wilczynski@samsung.com>

description:
  The JH7110 groups its display hardware into a video output subsystem, named
  dom_vout_top in the documentation. It covers the DC8200 display controller,
  the HDMI transmitter, the video output clock generator and the video output
  system controller, all behind one NoC port. That port's clock and reset gate
  access to every register in the region, and the region sits in the PD_VOUT
  power domain, so this node owns those resources on behalf of its children.

properties:
  compatible:
    const: starfive,jh7110-vout-subsystem

  reg:
    maxItems: 1

  clocks:
    maxItems: 1
    description: NoC display bus clock.

  resets:
    maxItems: 1
    description: NoC display bus reset.

  power-domains:
    maxItems: 1

  dma-noncoherent: true

  ranges: true

  "#address-cells":
    const: 2

  "#size-cells":
    const: 2

patternProperties:
  "^display@[0-9a-f]+$":
    type: object
    additionalProperties: true
    properties:
      compatible:
        contains:
          const: starfive,jh7110-dc8200

  "^hdmi@[0-9a-f]+$":
    type: object
    additionalProperties: true
    properties:
      compatible:
        const: starfive,jh7110-hdmi-subsystem

  "^syscon@[0-9a-f]+$":
    type: object
    additionalProperties: true
    properties:
      compatible:
        contains:
          const: starfive,jh7110-vout-syscon

  "^clock-controller@[0-9a-f]+$":
    type: object
    additionalProperties: true
    properties:
      compatible:
        const: starfive,jh7110-voutcrg

required:
  - compatible
  - reg
  - clocks
  - resets
  - power-domains
  - ranges
  - "#address-cells"
  - "#size-cells"

additionalProperties: false

examples:
  - |
    #include <dt-bindings/clock/starfive,jh7110-crg.h>
    #include <dt-bindings/power/starfive,jh7110-pmu.h>
    #include <dt-bindings/reset/starfive,jh7110-crg.h>

    soc {
        #address-cells = <2>;
        #size-cells = <2>;

        display-subsystem@29400000 {
            compatible = "starfive,jh7110-vout-subsystem";
            reg = <0x0 0x29400000 0x0 0x200000>;
            ranges;
            #address-cells = <2>;
            clocks = <&syscrg JH7110_SYSCLK_NOC_BUS_DISP_AXI>;
            dma-noncoherent;
            power-domains = <&pwrc JH7110_PD_VOUT>;
            resets = <&syscrg JH7110_SYSRST_NOC_BUS_DISP_AXI>;
            #size-cells = <2>;

            display@29400000 {
                compatible = "starfive,jh7110-dc8200", "verisilicon,dc";
                reg = <0x0 0x29400000 0x0 0x2800>;
                clocks = <&voutcrg JH7110_VOUTCLK_DC8200_CORE>,
                         <&voutcrg JH7110_VOUTCLK_DC8200_AXI>,
                         <&voutcrg JH7110_VOUTCLK_DC8200_AHB>,
                         <&voutcrg JH7110_VOUTCLK_DC8200_PIX0>,
                         <&voutcrg JH7110_VOUTCLK_DC8200_PIX1>;
                clock-names = "core", "axi", "ahb", "pix0", "pix1";
                interrupts = <95>;
                resets = <&voutcrg JH7110_VOUTRST_DC8200_CORE>,
                         <&voutcrg JH7110_VOUTRST_DC8200_AXI>,
                         <&voutcrg JH7110_VOUTRST_DC8200_AHB>;
                reset-names = "core", "axi", "ahb";

                ports {
                    #address-cells = <1>;
                    #size-cells = <0>;

                    port@0 {
                        reg = <0>;
                        #address-cells = <1>;
                        #size-cells = <0>;

                        dpu_out_dpi0: endpoint@0 {
                            reg = <0>;
                            remote-endpoint = <&hdmi_in>;
                        };
                    };

                    port@1 {
                        reg = <1>;
                    };
                };
            };

            hdmi@29590000 {
                compatible = "starfive,jh7110-hdmi-subsystem";
                reg = <0x0 0x29590000 0x0 0x4000>;

                controller {
                    compatible = "starfive,jh7110-inno-hdmi-controller";
                    clocks = <&voutcrg JH7110_VOUTCLK_HDMI_TX_SYS>,
                             <&voutcrg JH7110_VOUTCLK_HDMI_TX_MCLK>,
                             <&voutcrg JH7110_VOUTCLK_HDMI_TX_BCLK>,
                             <&hdmi_phy>;
                    clock-names = "pclk", "mclk", "bclk", "pixel";
                    interrupts = <99>;
                    phys = <&hdmi_phy>;
                    resets = <&voutcrg JH7110_VOUTRST_HDMI_TX_HDMI>;
                    starfive,vout-syscon = <&vout_syscon>;

                    ports {
                        #address-cells = <1>;
                        #size-cells = <0>;

                        port@0 {
                            reg = <0>;

                            hdmi_in: endpoint {
                                remote-endpoint = <&dpu_out_dpi0>;
                            };
                        };

                        port@1 {
                            reg = <1>;

                            endpoint {
                                remote-endpoint = <&hdmi_con_in>;
                            };
                        };
                    };
                };

                hdmi_phy: phy {
                    compatible = "starfive,jh7110-inno-hdmi-phy";
                    #clock-cells = <0>;
                    clocks = <&xin24m>;
                    #phy-cells = <0>;
                };
            };

            vout_syscon: syscon@295b0000 {
                compatible = "starfive,jh7110-vout-syscon", "syscon";
                reg = <0x0 0x295b0000 0x0 0x10000>;
            };

            voutcrg: clock-controller@295c0000 {
                compatible = "starfive,jh7110-voutcrg";
                reg = <0x0 0x295c0000 0x0 0x10000>;
                #clock-cells = <1>;
                clocks = <&syscrg JH7110_SYSCLK_VOUT_SRC>,
                         <&syscrg JH7110_SYSCLK_VOUT_TOP_AHB>,
                         <&syscrg JH7110_SYSCLK_VOUT_TOP_AXI>,
                         <&syscrg JH7110_SYSCLK_VOUT_TOP_HDMITX0_MCLK>,
                         <&syscrg JH7110_SYSCLK_I2STX0_BCLK>,
                         <&hdmi_phy>;
                clock-names = "vout_src", "vout_top_ahb",
                              "vout_top_axi", "vout_top_hdmitx0_mclk",
                              "i2stx0_bclk", "hdmitx0_pixelclk";
                power-domains = <&pwrc JH7110_PD_VOUT>;
                #reset-cells = <1>;
                resets = <&syscrg JH7110_SYSRST_VOUT_TOP_SRC>;
            };
        };
    };
...
```
