## Documentation/devicetree/bindings/soc/fsl/fsl,imx23-digctl.yaml
```yaml
# SPDX-License-Identifier: (GPL-2.0-only OR BSD-2-Clause)
%YAML 1.2
---
$id: http://devicetree.org/schemas//soc/fsl/fsl,imx23-digctl.yaml#
$schema: http://devicetree.org/meta-schemas/core.yaml#

title: Freescale mxs digctrl for i.MX23/i.MX28

maintainers:
  - Frank Li <Frank.Li@nxp.com>

properties:
  compatible:
    oneOf:
      - items:
          - enum:
              - fsl,imx28-digctl
          - const: fsl,imx23-digctl
      - const: fsl,imx23-digctl

  reg:
    maxItems: 1

  interrupts:
    maxItems: 1

required:
  - compatible
  - reg
  - interrupts

additionalProperties: false

examples:
  - |
    digctl@8001c000 {
        compatible = "fsl,imx28-digctl", "fsl,imx23-digctl";
        reg = <0x8001c000 0x2000>;
        interrupts = <89>;
    };
```

## Documentation/devicetree/bindings/soc/google/google,gs101-dtzpc.yaml
```yaml
# SPDX-License-Identifier: (GPL-2.0 OR BSD-2-Clause)
%YAML 1.2
---
$id: http://devicetree.org/schemas/soc/google/google,gs101-dtzpc.yaml#
$schema: http://devicetree.org/meta-schemas/core.yaml#

title: Samsung Exynos Distributed TruztZone Protection Control.

description:
  Distributed TrustZone Protection Control (D_TZPC) provides an interface to the
  protection bits that are included in the TrustZone design in a secure system.
  It configures each area of the memory as secure or non-secure.

maintainers:
  - André Draszik <andre.draszik@linaro.org>

properties:
  compatible:
    const: google,gs101-dtzpc

  clocks:
    maxItems: 1

  reg:
    maxItems: 1

required:
  - compatible
  - clocks
  - reg

additionalProperties: false

examples:
  - |
    #include <dt-bindings/clock/google,gs101.h>

    dtzpc_hsi0: dtzpc@11010000 {
      compatible = "google,gs101-dtzpc";
      reg = <0x11010000 0x10000>;
      clocks = <&cmu_hsi0 CLK_GOUT_HSI0_D_TZPC_HSI0_PCLK>;
    };
```

## Documentation/devicetree/bindings/soc/google/google,gs101-pmu.yaml
```yaml
# SPDX-License-Identifier: GPL-2.0-only OR BSD-2-Clause
%YAML 1.2
---
$id: http://devicetree.org/schemas/soc/google/google,gs101-pmu.yaml#
$schema: http://devicetree.org/meta-schemas/core.yaml#

title: Google GS101 Power Management Unit (PMU)

maintainers:
  - André Draszik <andre.draszik@linaro.org>

properties:
  compatible:
    const: google,gs101-pmu

  reg:
    maxItems: 1

  reboot-mode:
    $ref: /schemas/power/reset/syscon-reboot-mode.yaml
    type: object
    description:
      Reboot mode to alter bootloader behavior for the next boot

  syscon-poweroff:
    $ref: /schemas/power/reset/syscon-poweroff.yaml#
    type: object
    description:
      Node for power off method

  syscon-reboot:
    $ref: /schemas/power/reset/syscon-reboot.yaml#
    type: object
    description:
      Node for reboot method

  google,pmu-intr-gen-syscon:
    $ref: /schemas/types.yaml#/definitions/phandle
    description:
      Phandle to PMU interrupt generation interface.

required:
  - compatible
  - reg
  - google,pmu-intr-gen-syscon

additionalProperties: false

examples:
  - |
    system-controller@17460000 {
        compatible = "google,gs101-pmu";
        reg = <0x17460000 0x10000>;

        google,pmu-intr-gen-syscon = <&pmu_intr_gen>;
    };
```

## Documentation/devicetree/bindings/soc/google/google,modemsmem.yaml
```yaml
# SPDX-License-Identifier: GPL-2.0-only
%YAML 1.2
---
$id: http://devicetree.org/schemas/soc/google/google,modemsmem.yaml#
$schema: http://devicetree.org/meta-schemas/core.yaml#

title: Google Modem Shared Memory

maintainers:
  - Richard Acayan <mailingradian@gmail.com>

description:
  The modem firmware on Google Pixel devices (Pixel 3 through Pixel 5a)
  expects the application processor to publish SoC information (platform
  type and revision) in a vendor-defined Qualcomm Shared Memory (SMEM)
  item before the modem boots.

properties:
  compatible:
    const: google,modemsmem

  qcom,smem-id:
    $ref: /schemas/types.yaml#/definitions/uint32
    description:
      Identifier of the SMEM item the SoC information is written to. Google
      firmware uses the first vendor-reserved item.

required:
  - compatible
  - qcom,smem-id

additionalProperties: false

examples:
  - |
    modemsmem {
        compatible = "google,modemsmem";
        qcom,smem-id = <134>;
    };
```

## Documentation/devicetree/bindings/soc/imx/fsl,imx93-media-blk-ctrl.yaml
```yaml
# SPDX-License-Identifier: (GPL-2.0-only OR BSD-2-Clause)
%YAML 1.2
---
$id: http://devicetree.org/schemas/soc/imx/fsl,imx93-media-blk-ctrl.yaml#
$schema: http://devicetree.org/meta-schemas/core.yaml#

title: NXP i.MX93 Media blk-ctrl

maintainers:
  - Peng Fan <peng.fan@nxp.com>

description:
  The i.MX93 MEDIAMIX domain contains control and status registers known
  as MEDIAMIX Block Control (MEDIAMIX BLK_CTRL). These registers include
  clocking, reset, and miscellaneous top-level controls for peripherals
  within the MEDIAMIX domain

properties:
  compatible:
    items:
      - const: fsl,imx93-media-blk-ctrl
      - const: syscon

  reg:
    maxItems: 1

  ranges: true

  '#address-cells':
    const: 1

  '#size-cells':
    const: 1

  '#power-domain-cells':
    const: 1

  power-domains:
    maxItems: 1

  clocks:
    maxItems: 10

  clock-names:
    items:
      - const: apb
      - const: axi
      - const: nic
      - const: disp
      - const: cam
      - const: pxp
      - const: lcdif
      - const: isi
      - const: csi
      - const: dsi

  bridge@20:
    type: object
    additionalProperties: true
    properties:
      compatible:
        contains:
          const: fsl,imx93-ldb

required:
  - compatible
  - reg
  - ranges
  - '#address-cells'
  - '#size-cells'
  - power-domains
  - clocks
  - clock-names

additionalProperties: false

examples:
  - |
    #include <dt-bindings/clock/imx93-clock.h>
    #include <dt-bindings/power/fsl,imx93-power.h>

    system-controller@4ac10000 {
      compatible = "fsl,imx93-media-blk-ctrl", "syscon";
      reg = <0x4ac10000 0x10000>;
      power-domains = <&mediamix>;
      clocks = <&clk IMX93_CLK_MEDIA_APB>,
               <&clk IMX93_CLK_MEDIA_AXI>,
               <&clk IMX93_CLK_NIC_MEDIA_GATE>,
               <&clk IMX93_CLK_MEDIA_DISP_PIX>,
               <&clk IMX93_CLK_CAM_PIX>,
               <&clk IMX93_CLK_PXP_GATE>,
               <&clk IMX93_CLK_LCDIF_GATE>,
               <&clk IMX93_CLK_ISI_GATE>,
               <&clk IMX93_CLK_MIPI_CSI_GATE>,
               <&clk IMX93_CLK_MIPI_DSI_GATE>;
               clock-names = "apb", "axi", "nic", "disp", "cam",
                             "pxp", "lcdif", "isi", "csi", "dsi";
      #power-domain-cells = <1>;
      #address-cells = <1>;
      #size-cells = <1>;
      ranges = <0x0 0x4ac10000 0x10000>;

      bridge@20 {
          compatible = "fsl,imx93-ldb";
          reg = <0x20 0x4>, <0x24 0x4>;
          reg-names = "ldb", "lvds";
          clocks = <&clk IMX93_CLK_LVDS_GATE>;
          clock-names = "ldb";

          ports {
              #address-cells = <1>;
              #size-cells = <0>;

              port@0 {
                  reg = <0>;

                  ldb_from_lcdif2: endpoint {
                      remote-endpoint = <&lcdif2_to_ldb>;
                  };
              };

              port@1 {
                  reg = <1>;

                  ldb_lvds: endpoint {
                      remote-endpoint = <&ldb_to_panel>;
                  };
              };
          };
        };
    };
```

## Documentation/devicetree/bindings/soc/mediatek/mediatek,mt8196-jpeg-smmu.yaml
```yaml
# SPDX-License-Identifier: (GPL-2.0 OR BSD-2-Clause)
%YAML 1.2
---
$id: http://devicetree.org/schemas/soc/mediatek/mediatek,mt8196-jpeg-smmu.yaml#
$schema: http://devicetree.org/meta-schemas/core.yaml#

title: MediaTek MT8196 JPEG SMMU configuration registers

maintainers:
  - Kyrie Wu <kyrie.wu@mediatek.corp-partner.google.com>

description:
  The MT8196 JPEG SMMU configuration register block contains the GUSER_ID
  fields used by the JPEG decoder and encoder hardware.

properties:
  compatible:
    items:
      - const: mediatek,mt8196-jpeg-smmu
      - const: syscon

  reg:
    maxItems: 1

required:
  - compatible
  - reg

additionalProperties: false

examples:
  - |
    soc {
        #address-cells = <2>;
        #size-cells = <2>;

        jpeg_smmu: syscon@38d0000 {
            compatible = "mediatek,mt8196-jpeg-smmu", "syscon";
            reg = <0 0x38d0000 0 0x1000>;
        };
    };
```
