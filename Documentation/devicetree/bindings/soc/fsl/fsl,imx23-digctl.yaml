## Documentation/devicetree/bindings/soc/qcom/qcom,cdsp-power.yaml
```yaml
# SPDX-License-Identifier: GPL-2.0-only OR BSD-2-Clause
%YAML 1.2
---
$id: http://devicetree.org/schemas/soc/qcom/qcom,cdsp-power.yaml#
$schema: http://devicetree.org/meta-schemas/core.yaml#

title: Qualcomm CDSP Power Management

maintainers:
  - Vignesh Viswanathan <vignesh.viswanathan@oss.qualcomm.com>

description:
  The CDSP Power Management driver provides power management services for the
  Qualcomm Compute DSP (CDSP) subsystem. It handles Dynamic Clock and Voltage
  Scaling (DCVS) requests via SMEM, manages Low Power Mode (LPM) transitions
  via MPM handshake, and provides virtual regulators that are consumed by the
  CDSP remoteproc driver.

properties:
  compatible:
    const: qcom,cdsp-power

  reg:
    items:
      - description: MPM (Modem Power Manager) register region
      - description: RSCC (RSC Configuration) register region

  reg-names:
    items:
      - const: mpm
      - const: rscc

  interrupts-extended:
    items:
      - description: LPM (Low Power Mode) interrupt from MPM
      - description: DCVS (Dynamic Clock and Voltage Scaling) interrupt from IPCC

  interrupt-names:
    items:
      - const: lpm
      - const: dcvs

  mboxes:
    maxItems: 1
    description: IPCC mailbox channel for sending DCVS responses to CDSP

  qcom,smem-item:
    $ref: /schemas/types.yaml#/definitions/uint32
    description:
      SMEM item ID used for DCVS communication channel between APSS and CDSP.
      This is a platform-specific value that identifies the shared memory region.

  vdd-cx-supply:
    description:
      Phandle to the CX voltage regulator. This is the actual hardware regulator
      (e.g., from MP8899 PMIC) that supplies power to the CDSP CX rail.

  vdd-mx-supply:
    description:
      Phandle to the MX voltage regulator. This is the actual hardware regulator
      (e.g., from MP8899 PMIC) that supplies power to the CDSP MX rail. Optional
      on boards where MX rail is always-on or not present.

  regulators:
    type: object
    description:
      Virtual regulators provided by this driver for consumption by the CDSP
      remoteproc driver. These virtual regulators pass through enable/disable
      requests to the actual hardware regulators (vdd-cx-supply, vdd-mx-supply).

    properties:
      cdsp-vdd-cx:
        type: object
        $ref: /schemas/regulator/regulator.yaml#
        description: Virtual CX regulator for CDSP
        unevaluatedProperties: false

      cdsp-vdd-mx:
        type: object
        $ref: /schemas/regulator/regulator.yaml#
        description: Virtual MX regulator for CDSP
        unevaluatedProperties: false

    additionalProperties: false

required:
  - compatible
  - reg
  - reg-names
  - interrupts-extended
  - interrupt-names
  - mboxes
  - qcom,smem-item
  - vdd-cx-supply
  - regulators

additionalProperties: false

examples:
  - |
    #include <dt-bindings/interrupt-controller/arm-gic.h>
    #include <dt-bindings/interrupt-controller/irq.h>
    #include <dt-bindings/mailbox/qcom-ipcc.h>

    soc {
        #address-cells = <2>;
        #size-cells = <2>;

        cdsp_power: cdsp-power@4ae000 {
            compatible = "qcom,cdsp-power";
            reg = <0x0 0x004ae000 0x0 0x1000>,
                  <0x0 0x26018018 0x0 0x4>;
            reg-names = "mpm", "rscc";

            interrupts-extended = <&intc GIC_SPI 65 IRQ_TYPE_EDGE_RISING 0>,
                                  <&ipcc IPCC_CLIENT_CDSP
                                         IPCC_MPROC_SIGNAL_PING
                                         IRQ_TYPE_EDGE_RISING>;
            interrupt-names = "lpm", "dcvs";

            mboxes = <&ipcc IPCC_CLIENT_CDSP IPCC_MPROC_SIGNAL_PING>;

            qcom,smem-item = <503>;

            vdd-cx-supply = <&ipq9650_s2>;
            vdd-mx-supply = <&ipq9650_s4>;

            regulators {
                cdsp_vdd_cx: cdsp-vdd-cx {
                    regulator-name = "cdsp-vdd-cx";
                };

                cdsp_vdd_mx: cdsp-vdd-mx {
                    regulator-name = "cdsp-vdd-mx";
                };
            };
        };
    };
```

## Documentation/devicetree/bindings/soc/qcom/qcom,crypto-virt.yaml
```yaml
# SPDX-License-Identifier: (GPL-2.0-only OR BSD-2-Clause)
%YAML 1.2
---
$id: http://devicetree.org/schemas/soc/qcom/qcom,crypto-virt.yaml#
$schema: http://devicetree.org/meta-schemas/core.yaml#

title: QCOM GVM Crypto Virt driver

description: |
  GVM-side hardware-wrapped-key SCM operations backing virtio_blk's inline
  crypto layer. The host does not report a wrapped key size over virtio, so
  it is provided here instead.

maintainers:
  - Linlin Zhang <linlin.zhang@oss.qualcomm.com>

properties:
  compatible:
    const: qcom,crypto-virt

  qcom,wrapped-key-size:
    description: |
      Size, in bytes, of the hardware-wrapped key generated/prepared/imported
      via SCM calls.
    $ref: /schemas/types.yaml#/definitions/uint32
    minimum: 64
    maximum: 128

required:
  - compatible

additionalProperties: false

examples:
  - |
    crypto_virt {
        compatible = "qcom,crypto-virt";
        qcom,wrapped-key-size = <100>;
    };
```

## Documentation/devicetree/bindings/soc/qcom/qcom,mem-dump.yaml
```yaml
# SPDX-License-Identifier: GPL-2.0-only OR BSD-2-Clause
%YAML 1.2
---
$id: "http://devicetree.org/schemas/soc/qcom/qcom,mem-dump.yaml#"
$schema: "http://devicetree.org/meta-schemas/core.yaml#"

title: Qualcomm memory dump

description: |
  Qualcomm memory dump driver dynamically reserves memory and provides hints(id and size)
  of debugging information based on specified protocols with firmware. Firmware then does
  the real data capture. The debugging information includes cache contents, internal
  memory, registers. After crash and warm reboot, firmware scans ids,
  sizes and stores contents into reserved memory accordingly. Firmware then enters into full
  dump mode which dumps whole DDR to PC through USB.

maintainers:
  - Zhenhua Huang <quic_zhenhuah@quicinc.com>

properties:
  compatible:
    const: qcom,mem-dump

  memory-region:
    maxItems: 1
    description: phandle to memory reservation for qcom,mem-dump region.

required:
  - compatible
  - memory-region

additionalProperties: false

examples:
  # minimum memory dump definition.
  - |
    mem-dump {
        compatible = "qcom,mem-dump";
        memory-region = <&dump_mem>;
    };

...
```

## Documentation/devicetree/bindings/soc/realtek/realtek,rtd1625-io-detect.yaml
```yaml
# SPDX-License-Identifier: (GPL-2.0 OR BSD-2-Clause)
# Copyright 2026 Realtek Semiconductor Corporation
%YAML 1.2
---
$id: http://devicetree.org/schemas/soc/realtek/realtek,rtd1625-io-detect.yaml#
$schema: http://devicetree.org/meta-schemas/core.yaml#

title: Realtek DHC I/O Level Detector

maintainers:
  - Tzuyi Chang <tychang@realtek.com>

description: |
  The Realtek DHC I/O Level Detector is a hardware block that detects I/O
  signaling levels (such as 1.8V or 3.3V) to determine the correct pad
  configurations for specific IP blocks.

properties:
  compatible:
    const: realtek,rtd1625-io-detect

  pinctrl-names:
    items:
      - const: rgmii_1v8
      - const: rgmii_3v3
      - const: sdio_1v8
      - const: sdio_3v3
      - const: csi_1v8
      - const: csi_3v3
      - const: sd_1v8
      - const: sd_3v3
      - const: uart1_1v8
      - const: uart1_3v3
      - const: aio_1v8
      - const: aio_3v3
      - const: emmc_1v8
      - const: emmc_3v3

  realtek,iso-pinctrl:
    $ref: /schemas/types.yaml#/definitions/phandle
    description:
      Pinctrl phandle containing I/O detection registers.

required:
  - compatible
  - pinctrl-names
  - realtek,iso-pinctrl

additionalProperties: false

examples:
  - |
    io-detect {
        compatible = "realtek,rtd1625-io-detect";
        pinctrl-names = "rgmii_1v8", "rgmii_3v3",
                        "sdio_1v8", "sdio_3v3",
                        "csi_1v8", "csi_3v3",
                        "sd_1v8", "sd_3v3",
                        "uart1_1v8", "uart1_3v3",
                        "aio_1v8", "aio_3v3",
                        "emmc_1v8", "emmc_3v3";
        pinctrl-0 = <&rgmii_vsel_1v8_pins>;
        pinctrl-1 = <&rgmii_vsel_3v3_pins>;
        pinctrl-2 = <&sdio_vsel_1v8_pins>;
        pinctrl-3 = <&sdio_vsel_3v3_pins>;
        pinctrl-4 = <&csi_vsel_1v8_pins>;
        pinctrl-5 = <&csi_vsel_3v3_pins>;
        pinctrl-6 = <&sd_vsel_1v8_pins>;
        pinctrl-7 = <&sd_vsel_3v3_pins>;
        pinctrl-8 = <&uart1_vsel_1v8_pins>;
        pinctrl-9 = <&uart1_vsel_3v3_pins>;
        pinctrl-10 = <&aio_vsel_1v8_pins>;
        pinctrl-11 = <&aio_vsel_3v3_pins>;
        pinctrl-12 = <&emmc_vsel_1v8_pins>;
        pinctrl-13 = <&emmc_vsel_3v3_pins>;
        realtek,iso-pinctrl = <&iso_pinctrl>;
    };
```

## Documentation/devicetree/bindings/soc/renesas/renesas-soc.yaml
```yaml
# SPDX-License-Identifier: GPL-2.0-only OR BSD-2-Clause
%YAML 1.2
---
$id: http://devicetree.org/schemas/soc/renesas/renesas-soc.yaml#
$schema: http://devicetree.org/meta-schemas/core.yaml#

title: Renesas SoC compatibles naming convention

maintainers:
  - Geert Uytterhoeven <geert+renesas@glider.be>
  - Niklas Söderlund <niklas.soderlund@ragnatech.se>

description: |
  Guidelines for new compatibles for SoC blocks/components.
  When adding new compatibles in new bindings, use the format::
    renesas,SoC-IP

  For example::
   renesas,r8a77965-csi2

  When adding new compatibles to existing bindings, use the format in the
  existing binding, even if it contradicts the above.

select:
  properties:
    compatible:
      pattern: "^renesas,.*-.*$"
  required:
    - compatible

properties:
  compatible:
    oneOf:
      # Preferred naming style for compatibles of SoC components:
      - pattern: "^renesas,emev2-[a-z0-9-]+$"
      - pattern: "^renesas,r7s[0-9]+-[a-z0-9-]+$"
      - pattern: "^renesas,r8a[a-z0-9]+-[a-z0-9-]+$"
      - pattern: "^renesas,r9a[0-9]+g[a-z0-9]+-[a-z0-9-]+$"
      - pattern: "^renesas,rcar-[a-z0-9-]+$"
      - pattern: "^renesas,rz-[a-z0-9-]+$"
      - pattern: "^renesas,rza-[a-z0-9-]+$"
      - pattern: "^renesas,rza1-[a-z0-9-]+$"
      - pattern: "^renesas,rza2-[a-z0-9-]+$"
      - pattern: "^renesas,rzg2l-[a-z0-9-]+$"
      - pattern: "^renesas,rzn1[a-z0-9]*-[a-z0-9-]+$"
      - pattern: "^renesas,rzv2m-[a-z0-9-]+$"
      - pattern: "^renesas,sh-[a-z0-9-]+$"
      - pattern: "^renesas,sh7[a-z0-9]+-[a-z0-9-]+$"

      # SoC agnostic compatibles - new compatibles are OK:
      - enum:
          - renesas,cpg-div6-clock
          - renesas,cpg-mstp-clocks
          - renesas,intc-irqpin
          - renesas,smp-sram

      # Legacy namings - variations of existing patterns/compatibles are OK,
      # but do not add completely new entries to these:
      - pattern: "^renesas,can-[a-z0-9]+$"
      - pattern: "^renesas,dmac-[a-z0-9]+$"
      - pattern: "^renesas,du-[a-z0-9]+$"
      - pattern: "^renesas,ether-[a-z0-9]+$"
      - pattern: "^renesas,etheravb-[a-z0-9]+$"
      - pattern: "^renesas,etheravb-rcar-gen[0-9]$"
      - pattern: "^renesas,gether-[a-z0-9]+$"
      - pattern: "^renesas,gpio-[a-z0-9]+$"
      - pattern: "^renesas,hscif-[a-z0-9]+$"
      - pattern: "^renesas,i2c-[a-z0-9]+$"
      - pattern: "^renesas,iic-[a-z0-9]+$"
      - pattern: "^renesas,intc-ex-[a-z0-9]+$"
      - pattern: "^renesas,intc-irqpin-[a-z0-9]+$"
      - pattern: "^renesas,ipmmu-[a-z0-9]+$"
      - pattern: "^renesas,irqc-[a-z0-9]+$"
      - pattern: "^renesas,jpu-[a-z0-9]+$"
      - pattern: "^renesas,mmcif-[a-z0-9]+$"
      - pattern: "^renesas,msiof-[a-z0-9]+$"
      - pattern: "^renesas,pci-[a-z0-9]+$"
      - pattern: "^renesas,pci-rcar-gen[0-9]$"
      - pattern: "^renesas,pcie-[a-z0-9]+$"
      - pattern: "^renesas,pcie-rcar-gen[0-9]$"
      - pattern: "^renesas,pfc-[a-z0-9]+$"
      - pattern: "^renesas,pwm-[a-z0-9]+$"
      - pattern: "^renesas,qspi-[a-z0-9]+$"
      - pattern: "^renesas,rcar_sound-[a-z0-9]+$"
      - pattern: "^renesas,riic-[a-z0-9]+$"
      - pattern: "^renesas,rspi-[a-z0-9]+$"
      - pattern: "^renesas,sata-[a-z0-9]+(-es1)?$"
      - pattern: "^renesas,scif-[a-z0-9]+$"
      - pattern: "^renesas,scifa-[a-z0-9]+$"
      - pattern: "^renesas,scifb-[a-z0-9]+$"
      - pattern: "^renesas,sdhi-[a-z0-9]+$"
      - pattern: "^renesas,thermal-[a-z0-9]+$"
      - pattern: "^renesas,tmu-[a-z0-9]+$"
      - pattern: "^renesas,tpu-[a-z0-9]+$"
      - pattern: "^renesas,usb-phy-[a-z0-9]+$"
      - pattern: "^renesas,usb2-phy-[a-z0-9]+$"
      - pattern: "^renesas,usbhs-[a-z0-9]+$"
      - pattern: "^renesas,vin-[a-z0-9]+$"
      - pattern: "^renesas,xhci-[a-z0-9]+$"

      # Legacy compatibles - list cannot grow with new bindings:
      - enum:
          - renesas,bsc-r8a73a4
          - renesas,bsc-sh73a0
          - renesas,dbsc-r8a73a4
          - renesas,dbsc3-r8a7740
          - renesas,em-gio
          - renesas,em-sti
          - renesas,em-uart
          - renesas,fsi2-r8a7740
          - renesas,fsi2-sh73a0
          - renesas,hspi-r8a7778
          - renesas,hspi-r8a7779
          - renesas,imr-lx4
          - renesas,mtu2-r7s72100
          - renesas,rmobile-iic
          - renesas,sbsc-sh73a0
          - renesas,sdhi-mmc-r8a77470
          - renesas,shmobile-flctl-sh7372
          - renesas,sysc-r8a73a4
          - renesas,sysc-r8a7740
          - renesas,sysc-rmobile
          - renesas,sysc-sh73a0
          - renesas,usb-dmac

additionalProperties: true
```

## Documentation/devicetree/bindings/soc/renesas/sh.yaml
```yaml
# SPDX-License-Identifier: (GPL-2.0-only OR BSD-2-Clause)
%YAML 1.2
---
$id: http://devicetree.org/schemas/soc/renesas/sh.yaml#
$schema: http://devicetree.org/meta-schemas/core.yaml#

title: Renesas SuperH Platform

maintainers:
  - Yoshinori Sato <ysato@users.sourceforge.jp>

properties:
  $nodename:
    const: '/'
  compatible:
    oneOf:
      - description: RTS7751R2D Plus
        items:
          - enum:
              - renesas,rts7751r2d # Renesas SH4 2D graphics board
          - const: renesas,sh7751r

      - description: Julian board
        items:
          - enum:
              - iodata,landisk  # LANDISK HDL-U
              - iodata,usl-5p   # USL-5P
          - const: renesas,sh7751r

additionalProperties: true

...
```
