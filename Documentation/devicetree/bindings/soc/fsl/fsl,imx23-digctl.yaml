## Documentation/devicetree/bindings/soc/tegra/nvidia,tegra-modem-pwrseq.yaml
```yaml
# SPDX-License-Identifier: (GPL-2.0 OR BSD-2-Clause)
%YAML 1.2
---
$id: http://devicetree.org/schemas/soc/tegra/nvidia,tegra-modem-pwrseq.yaml#
$schema: http://devicetree.org/meta-schemas/core.yaml#

title: Nvidia Tegra modem power sequence

description:
  A configuration sequence used in Tegra SoCs to provide proper interaction
  between the application processor and the modem, as well as control over
  one of the SoC's USB lines for the modem.

maintainers:
  - Svyatoslav Ryhel <clamor95@gmail.com>

properties:
  compatible:
    const: nvidia,tegra-modem-pwrseq

  enable-gpios:
    description: GPIO connected to the modem EINT1 pin
    maxItems: 1

  nvidia,usb-bus:
    description:
      Contains phandle pointing to the Host's USB controller
    $ref: /schemas/types.yaml#/definitions/phandle

  power-supply: true

required:
  - compatible
  - nvidia,usb-bus

additionalProperties: false

examples:
  - |
    #include <dt-bindings/gpio/gpio.h>

    pwrseq-modem {
        compatible = "nvidia,tegra-modem-pwrseq";

        enable-gpios = <&gpio 165 GPIO_ACTIVE_HIGH>;
        power-supply = <&vdd_3v3_vbat>;

        nvidia,usb-bus = <&usb2>;
    };
```

## Documentation/devicetree/bindings/soc/tenstorrent/tenstorrent,atlantis-syscon.yaml
```yaml
# SPDX-License-Identifier: (GPL-2.0-only OR BSD-2-Clause)
%YAML 1.2
---
$id: http://devicetree.org/schemas/soc/tenstorrent/tenstorrent,atlantis-syscon.yaml#
$schema: http://devicetree.org/meta-schemas/core.yaml#

title: Tenstorrent Atlantis SoC Syscon

maintainers:
  - Anirudh Srinivasan <asrinivasan@oss.tenstorrent.com>

description:
  Multifunctional register block found in Tenstorrent Atlantis SoC whose main function
  is to control clocks and resets. This Block is instantiated multiple times in the SoC,
  each block controls clock and resets for a different subsystem.

  RCPU syscon serves low speed IO interfaces on chip
  PCIe syscon serves all PCIe related functions
  HSIO syscon serves high speed IO interfaces (Ethernet, USB)
  MM syscon serves GPU, display and video processing functions

properties:
  compatible:
    enum:
      - tenstorrent,atlantis-syscon-rcpu
      - tenstorrent,atlantis-syscon-pcie
      - tenstorrent,atlantis-syscon-mm
      - tenstorrent,atlantis-syscon-hsio

  reg:
    maxItems: 1

  clocks:
    maxItems: 1

  "#clock-cells":
    const: 1
    description:
      See <dt-bindings/clock/tenstorrent,atlantis-syscon.h> for valid indices.

  "#reset-cells":
    const: 1

  tenstorrent,syscon-rcpu:
    $ref: /schemas/types.yaml#/definitions/phandle
    description:
      Phandle reference to RCPU syscon, needed by other 3 syscons (PCIe, MM, HSIO)
      as the control registers for the PLLs that drive these subsystems are in RCPU
      syscon's range

required:
  - compatible
  - reg
  - clocks
  - "#clock-cells"
  - "#reset-cells"

allOf:
  - if:
      properties:
        compatible:
          contains:
            enum:
              - tenstorrent,atlantis-syscon-pcie
              - tenstorrent,atlantis-syscon-mm
              - tenstorrent,atlantis-syscon-hsio
    then:
      required:
        - tenstorrent,syscon-rcpu

additionalProperties: false

examples:
  - |
    syscon_rcpu: system-controller@a8000000 {
      compatible = "tenstorrent,atlantis-syscon-rcpu";
      reg = <0xa8000000 0x10000>;
      clocks = <&osc_24m>;
      #clock-cells = <1>;
      #reset-cells = <1>;
    };
  - |
    syscon_hsio: system-controller@e00c0000 {
      compatible = "tenstorrent,atlantis-syscon-hsio";
      reg = <0xe00c0000 0x500>;
      clocks = <&osc_24m>;
      #clock-cells = <1>;
      #reset-cells = <1>;
      tenstorrent,syscon-rcpu = <&syscon_rcpu>;
    };
```

## Documentation/devicetree/bindings/soc/ti/ti,iva.yaml
```yaml
# SPDX-License-Identifier: (GPL-2.0-only OR BSD-2-Clause)
%YAML 1.2
---
$id: http://devicetree.org/schemas/soc/ti/ti,iva.yaml#
$schema: http://devicetree.org/meta-schemas/core.yaml#

title: Texas Instruments IVA (Imaging and Video Accelerator)

maintainers:
  - Eduard Bostina <egbostina@gmail.com>

properties:
  compatible:
    enum:
      - ti,iva1
      - ti,iva2.1
      - ti,iva2.2
      - ti,ivahd

  ti,hwmods:
    description: Name of the hwmod associated to the iva
    $ref: /schemas/types.yaml#/definitions/string
    const: iva

required:
  - compatible

additionalProperties: false

examples:
  - |
    iva {
        compatible = "ti,ivahd";
        ti,hwmods = "iva";
    };
```

## Documentation/devicetree/bindings/soc/vt8500/via,scc-id.yaml
```yaml
# SPDX-License-Identifier: (GPL-2.0-only OR BSD-2-Clause)
%YAML 1.2
---
$id: http://devicetree.org/schemas/soc/vt8500/via,scc-id.yaml#
$schema: http://devicetree.org/meta-schemas/core.yaml#

title: VIA/WonderMedia SoC system configuration information

maintainers:
  - Alexey Charkov <alchark@gmail.com>

description:
  The system configuration controller on VIA/WonderMedia SoC's contains a chip
  identifier and revision used to differentiate between different hardware
  versions of on-chip IP blocks having their own peculiarities which may or
  may not be captured by their respective DT compatible strings

properties:
  compatible:
    items:
      - const: via,scc-id

  reg:
    maxItems: 1

required:
  - compatible
  - reg

additionalProperties: false

examples:
  - |
    system-configuration@d8120000 {
        compatible = "via,scc-id";
        reg = <0xd8120000 0x4>;
    };
```

## Documentation/devicetree/bindings/soc/xilinx/xlnx,ai-engine.yaml
```yaml
# SPDX-License-Identifier: (GPL-2.0 OR BSD-2-Clause)
%YAML 1.2
---
$id: http://devicetree.org/schemas/soc/xilinx/xlnx,ai-engine.yaml#
$schema: http://devicetree.org/meta-schemas/core.yaml#

title: AMD AI Engine

maintainers:
  - Gregory Williams <gregory.williams@amd.com>

description:
  The AMD AI Engine is a tile processor with many cores (up to 400) that
  can run in parallel. The data routing between cores is configured through
  internal switches, and shim tiles interface with external interconnect, such
  as memory or PL. One AI engine device can have multiple apertures, each
  has its own address space and interrupt. At runtime application can create
  multiple partitions within an aperture which are groups of columns of AI
  engine tiles. Each AI engine partition is the minimum resetable unit for an
  AI engine application.

properties:
  compatible:
    const: xlnx,ai-engine-v2.0

  reg:
    maxItems: 1

  '#address-cells':
    const: 2

  '#size-cells':
    const: 2

  power-domains:
    description:
      Platform management node id used to request power management services
      from the firmware driver.

  xlnx,aie-gen:
    $ref: /schemas/types.yaml#/definitions/uint8
    description:
      Hardware generation of AI engine device. E.g. the current values supported
      are 1 (AIE) and 2 (AIEML).

  xlnx,shim-rows:
    $ref: /schemas/types.yaml#/definitions/uint8-array
    description:
      start row and the number of rows of SHIM tiles of the AI engine device

  xlnx,core-rows:
    $ref: /schemas/types.yaml#/definitions/uint8-array
    description:
      start row and the number of rows of core tiles of the AI engine device

  xlnx,mem-rows:
    $ref: /schemas/types.yaml#/definitions/uint8-array
    description:
      start row and the number of rows of memory tiles of the AI engine device

required:
  - compatible
  - reg
  - power-domains
  - xlnx,aie-gen
  - xlnx,shim-rows
  - xlnx,core-rows
  - xlnx,mem-rows

patternProperties:
  "^aperture@[0-9]+$":
    type: object
    description:
      AI engine aperture which is a group of column based tiles of the
      AI engine device. Each AI engine apertures isolated from the
      other AI engine apertures. An AI engine aperture is defined by
      AMD/Xilinx platform design tools.

    properties:
      compatible:
        const: xlnx,ai-engine-aperture

      reg:
        description:
          Physical base address and length of the aperture registers.
          The AI engine address space assigned to Linux is defined by
          Xilinx/AMD platform design tool.

      interrupts:
        maxItems: 3

      interrupt-names:
        items:
          - const: interrupt1
          - const: interrupt2
          - const: interrupt3

      xlnx,columns:
        $ref: /schemas/types.yaml#/definitions/uint32-array
        description:
          It describes the location of the aperture. It specifies the start
          column and the number of columns. E.g. an aperture starts from
          column 0 and there are 50 columns, it will be presented as <0 50>.

      xlnx,node-id:
        $ref: /schemas/types.yaml#/definitions/uint32
        description:
          AI engine aperture node ID, which is defined by AMD/Xilinx platform
          design tool to identify the AI engine aperture in the firmware.

    required:
      - compatible
      - reg
      - xlnx,columns
      - xlnx,node-id

    additionalProperties: false

additionalProperties: false

examples:
  - |
    #include <dt-bindings/power/xlnx-versal-power.h>
    bus {
      #address-cells = <2>;
      #size-cells = <2>;
      ai_engine: ai-engine@20000000000 {
        compatible = "xlnx,ai-engine-v2.0";
        reg = <0x200 0x00 0x01 0x00>;
        #address-cells = <2>;
        #size-cells = <2>;
        power-domains = <&versal_firmware PM_DEV_AI>;
        xlnx,aie-gen = /bits/ 8 <0x1>;
        xlnx,core-rows = /bits/ 8 <1 8>;
        xlnx,mem-rows = /bits/ 8 <0 0>;
        xlnx,shim-rows = /bits/ 8 <0 1>;

        aperture0: aperture@200000000000 {
          /* 50 columns and 8 core tile rows + 1 SHIM row */
          compatible = "xlnx,ai-engine-aperture";
          reg = <0x200 0x0 0x1 0x0>;
          interrupts = <0x0 0x94 0x4>,
                       <0x0 0x95 0x4>,
                       <0x0 0x96 0x4>;
          interrupt-names = "interrupt1", "interrupt2", "interrupt3";
          interrupt-parent = <&gic>;
          xlnx,columns = <0 50>;
          xlnx,node-id = <1>;
        };
      };
    };
```
