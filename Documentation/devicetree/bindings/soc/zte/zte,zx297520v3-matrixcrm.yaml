## Documentation/devicetree/bindings/sound/amlogic,meson-gx-audin-fifo.yaml
```yaml
# SPDX-License-Identifier: (GPL-2.0-only OR BSD-2-Clause)
%YAML 1.2
---
$id: http://devicetree.org/schemas/sound/amlogic,meson-gx-audin-fifo.yaml#
$schema: http://devicetree.org/meta-schemas/core.yaml#

title: Amlogic GX AUDIN FIFO controller

maintainers:
  - Valerio Setti <vsetti@baylibre.com>

allOf:
  - $ref: dai-common.yaml#

properties:
  $nodename:
    pattern: "^audio-controller@.*"

  "#sound-dai-cells":
    const: 0

  compatible:
    items:
      - enum:
          - amlogic,meson-gxbb-audin-fifo
      - const: amlogic,meson-gx-audin-fifo

  clocks:
    items:
      - description: AUDIN peripheral clock

  clock-names:
    items:
      - const: i2s_input_clk

  reg:
    maxItems: 1

  sound-name-prefix: true

required:
  - "#sound-dai-cells"
  - compatible
  - clocks
  - clock-names
  - reg

additionalProperties: false

examples:
  - |
    #include <dt-bindings/clock/gxbb-clkc.h>

    audio-controller@a080 {
      compatible = "amlogic,meson-gxbb-audin-fifo",
                   "amlogic,meson-gx-audin-fifo";
      #sound-dai-cells = <0>;
      sound-name-prefix = "FIFO0";
      reg = <0xa080 0x1c>;
      status = "disabled";
      clocks = <&clkc CLKID_I2S_SPDIF>;
      clock-names = "i2s_input_clk";
    };
```

## Documentation/devicetree/bindings/sound/amlogic,t9015.yaml
```yaml
# SPDX-License-Identifier: GPL-2.0
%YAML 1.2
---
$id: http://devicetree.org/schemas/sound/amlogic,t9015.yaml#
$schema: http://devicetree.org/meta-schemas/core.yaml#

title: Amlogic T9015 Internal Audio DAC

maintainers:
  - Jerome Brunet <jbrunet@baylibre.com>

properties:
  $nodename:
    pattern: "^audio-controller@.*"

  "#sound-dai-cells":
    const: 0

  compatible:
    items:
      - enum:
          - amlogic,t9015
          - amlogic,t9015-a1

  clocks:
    items:
      - description: Peripheral clock

  clock-names:
    items:
      - const: pclk

  reg:
    maxItems: 1

  resets:
    maxItems: 1

  AVDD-supply:
    description:
      Analogue power supply.

  sound-name-prefix: true

  lineout-left:
    $ref: /schemas/types.yaml#/definitions/string
  lineout-right:
    $ref: /schemas/types.yaml#/definitions/string
  linein-left:
    $ref: /schemas/types.yaml#/definitions/string
  linein-right:
    $ref: /schemas/types.yaml#/definitions/string
  micbias:
    $ref: /schemas/types.yaml#/definitions/string

required:
  - "#sound-dai-cells"
  - compatible
  - reg
  - clocks
  - clock-names
  - resets
  - AVDD-supply


allOf:
  - $ref: dai-common.yaml#
  - if:
      properties:
        compatible:
          contains:
            const: amlogic,t9015-a1
    then:
      properties:
        lineout-left:
          items:
            - enum:
                - none
                - right
                - left-inverted
        lineout-right:
          items:
            - enum:
                - none
                - left
                - right-inverted
        linein-left:
          items:
            - enum:
                - none
                - differential
                - positive
                - negative
        linein-right:
          items:
            - enum:
                - none
                - differential
                - positive
                - negative
        micbias:
          items:
            - enum:
                - 2.0V
                - 2.1V
                - 2.3V
                - 2.5V
                - 2.8V
    else:
      lineout-left: false
      lineout-right: false
      linein-left: false
      linein-right: false
      micbias: false

additionalProperties: false

examples:
  - |
    #include <dt-bindings/clock/g12a-clkc.h>
    #include <dt-bindings/reset/amlogic,meson-g12a-reset.h>

    acodec: audio-controller@32000 {
        compatible = "amlogic,t9015";
        reg = <0x32000 0x14>;
        #sound-dai-cells = <0>;
        clocks = <&clkc CLKID_AUDIO_CODEC>;
        clock-names = "pclk";
        resets = <&reset RESET_AUDIO_CODEC>;
        AVDD-supply = <&vddao_1v8>;
    };
```

## Documentation/devicetree/bindings/sound/asahi-kasei,ak4104.yaml
```yaml
# SPDX-License-Identifier: GPL-2.0-only OR BSD-2-Clause
%YAML 1.2
---
$id: http://devicetree.org/schemas/sound/asahi-kasei,ak4104.yaml#
$schema: http://devicetree.org/meta-schemas/core.yaml#

title: AK4104 S/PDIF transmitter

allOf:
  - $ref: dai-common.yaml#

maintainers:
  - Liam Girdwood <lgirdwood@gmail.com>
  - Mark Brown <broonie@kernel.org>
  - Rob Herring <robh@kernel.org>
  - Krzysztof Kozlowski <krzk+dt@kernel.org>
  - Conor Dooley <conor+dt@kernel.org>

properties:
  compatible:
    const: asahi-kasei,ak4104

  reg:
    description: Chip select number on the SPI bus 
    maxItems: 1

  vdd-supply:
    description: A regulator node providing between 2.7V and 3.6V.

  reset-gpios:
    maxItems: 1
    description: Optional GPIO spec for the reset pin, deasserted before communication starts.
    
required:
  - compatible
  - reg
  - vdd-supply

additionalProperties: false

examples:
  - |
   i2c {
     #address-cells = <1>;
     #size-cells = <0>;
     codec@0 {
       compatible = "asahi-kasei,ak4104";
       reg = <0>;
       vdd-supply = <&vdd_3v3_reg>;
     };
   };
```

## Documentation/devicetree/bindings/sound/asahi-kasei,ak4118.yaml
```yaml
# SPDX-License-Identifier: (GPL-2.0-only OR BSD-2-Clause)
%YAML 1.2
---
$id: http://devicetree.org/schemas/sound/asahi-kasei,ak4118.yaml#
$schema: http://devicetree.org/meta-schemas/core.yaml#

title: Asahi Kasei AK4118 Digital Audio Transceiver

maintainers:
  - Clément Péron <peron.clem@gmail.com>

allOf:
  - $ref: dai-common.yaml#

properties:
  compatible:
    const: asahi-kasei,ak4118

  reg:
    maxItems: 1
    description: I2C address of the device

  "#sound-dai-cells":
    const: 0

  irq-gpios:
    maxItems: 1
    description: GPIO used for IRQ pin

  reset-gpios:
    maxItems: 1
    description: GPIO used for the Reset pin

required:
  - compatible
  - reg
  - "#sound-dai-cells"
  - irq-gpios
  - reset-gpios

unevaluatedProperties: false

examples:
  - |
    #include <dt-bindings/gpio/gpio.h>

    i2c {
        #address-cells = <1>;
        #size-cells = <0>;

        audio-codec@13 {
            compatible = "asahi-kasei,ak4118";
            reg = <0x13>;
            #sound-dai-cells = <0>;
            reset-gpios = <&gpio1 0 GPIO_ACTIVE_LOW>;
            irq-gpios = <&gpio1 1 GPIO_ACTIVE_HIGH>;
        };
    };
```

## Documentation/devicetree/bindings/sound/asahi-kasei,ak5386.yaml
```yaml
# SPDX-License-Identifier: (GPL-2.0-only OR BSD-2-Clause)
%YAML 1.2
---
$id: http://devicetree.org/schemas/sound/asahi-kasei,ak5386.yaml#
$schema: http://devicetree.org/meta-schemas/core.yaml#

title: Asahi Kasei AK5386 ADC

maintainers:
  - Daniel Mack <zonque@gmail.com>

description:
  The Asahi Kasei AK5386 is a single-ended 24-Bit 192kHz delta-sigma
  analog-to-digital converter (ADC). This device has no control interface.

allOf:
  - $ref: dai-common.yaml#

properties:
  compatible:
    const: asahi-kasei,ak5386

  "#sound-dai-cells":
    const: 0

  reset-gpios:
    maxItems: 1
    description: A GPIO spec for the reset/power down pin.

  reset-gpio:
    maxItems: 1
    deprecated: true
    description: Legacy property, use reset-gpios instead.

  va-supply:
    description: Power supply for the analog section.

  vd-supply:
    description: Power supply for the digital section.

required:
  - compatible

unevaluatedProperties: false

examples:
  - |
    #include <dt-bindings/gpio/gpio.h>

    adc {
        compatible = "asahi-kasei,ak5386";
        #sound-dai-cells = <0>;
        reset-gpios = <&gpio0 23 GPIO_ACTIVE_LOW>;
        va-supply = <&vdd_5v0_reg>;
        vd-supply = <&vdd_3v3_reg>;
    };
```

## Documentation/devicetree/bindings/sound/atmel,at91sam9263-ac97c.yaml
```yaml
# SPDX-License-Identifier: (GPL-2.0-only OR BSD-2-Clause)
%YAML 1.2
---
$id: http://devicetree.org/schemas/sound/atmel,at91sam9263-ac97c.yaml#
$schema: http://devicetree.org/meta-schemas/core.yaml#

title: Atmel AC97 Controller

maintainers:
  - Nicolas Ferre <nicolas.ferre@microchip.com>
  - Alexandre Belloni <alexandre.belloni@bootlin.com>

allOf:
  - $ref: dai-common.yaml#

properties:
  compatible:
    const: atmel,at91sam9263-ac97c

  reg:
    maxItems: 1
    description: Address and length of the register set for the device.

  interrupts:
    maxItems: 1
    description: Should contain the AC97 interrupt.

  ac97-gpios:
    minItems: 3
    maxItems: 4
    description: |
      AC97 link GPIOs- sync, sdata_out, reset, and optional sdata_in.
      The driver primarily uses the reset pin.

  pinctrl-0: true

  pinctrl-names:
    const: default

required:
  - compatible
  - reg
  - interrupts
  - ac97-gpios

unevaluatedProperties: false

examples:
  - |
    #include <dt-bindings/interrupt-controller/irq.h>
    #include <dt-bindings/gpio/gpio.h>

    sound@fffa0000 {
        compatible = "atmel,at91sam9263-ac97c";
        reg = <0xfffa0000 0x4000>;
        interrupts = <18 IRQ_TYPE_LEVEL_HIGH 5>;
        pinctrl-names = "default";
        pinctrl-0 = <&pinctrl_ac97>;
        ac97-gpios = <&pioB 0 0>, <&pioB 2 0>, <&pioC 29 GPIO_ACTIVE_LOW>;
    };
```
