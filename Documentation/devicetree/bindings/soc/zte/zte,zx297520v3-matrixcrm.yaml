## Documentation/devicetree/bindings/sound/audio-gpio-amp.yaml
```yaml
# SPDX-License-Identifier: (GPL-2.0-only OR BSD-2-Clause)
%YAML 1.2
---
$id: http://devicetree.org/schemas/sound/audio-gpio-amp.yaml#
$schema: http://devicetree.org/meta-schemas/core.yaml#

title: Audio amplifier driven by GPIOs

maintainers:
  - Herve Codina <herve.codina@bootlin.com>

description: |
  Audio GPIO amplifiers are driven by GPIO in order to control the gain value
  of the amplifier, its mute function and/or its bypass function.

  Those amplifiers are based on discrete components (analog switches, op-amps
  and more) where some of them, mostly analog switches, are controlled by GPIOs
  to adjust the gain value of the whole amplifier and/or to control
  the mute and/or bypass function.

  For instance, the following piece of hardware is a GPIO amplifier

                                         +5VA
                                           ^
                                        |\ |
                                        | \
        Vin >---------------------------|+ \
                                        |   +-------+-----> Vout
                .--\/\/\/--+------------|- /        |
                |          |            | /         |
                v          |            |/ |        |
               GND         o               v        |
                            \             GND       |
       gpio >----------->    \                      |
                         o    o                     |
                         |    |                     |
                         |    '--\/\/\/--.          |
                         |               +--\/\/\/--'
                         '---------------'

  A GPIO driven amplifier can work in several mode depending on the electronic
  design.
    - points defined:
        The values of GPIOs used to control gain set a specific gain value
        without any specific relationship between each value. For instance,
        using 2 GPIOS:
          0b00 <-> -10.0 dB
          0b01 <-> +3.0 dB
          0b10 <-> 0 dB
          0b11 <-> +6.0 dB

        This can be described using the gain-points property.

    - range defined:
        The values of GPIOs used to control gain set a specific gain value
        following a linear dB range from a minimum dB value to a maximum dB
        value. For instance, using 2 GPIOS:
          0b00 <-> -3.0 dB
          0b01 <-> 0 db
          0b10 <-> +3.0 dB
          0b11 <-> +6.0 dB

        This can be described using the gain-range property.

    - labels defined:
        Some electronic design are not meant to a specific dB gain value. In
        that case it is relevant to use labels to describe them. For instance,
        using 2 GPIOS:
          0b00 <-> Low boost
          0b01 <-> Middle boost
          0b10 <-> High boost
          0b11 <-> Max boost

        This can be described using the gain-labels property

properties:
  compatible:
    const: audio-gpio-amp

  vdd-supply:
    description: Main power supply of the amplifier

  vddio-supply:
    description: Power supply related to the control path

  vdda1-supply:
    description: Analog power supply

  vdda2-supply:
    description: Additional analog power supply

  mute-gpios:
    description: GPIO to control the mute function
    maxItems: 1

  bypass-gpios:
    description: GPIO to control the bypass function
    maxItems: 1

  gain-gpios:
    description: |
      GPIOs to control the amplifier gain

      The gain value is computed from GPIOs value from 0 to 2^N-1 with N the
      number of GPIO described. The first GPIO described is the lsb of the gain
      value.

      For instance assuming 2 gpios
         gain-gpios = <&gpio1 GPIO_ACTIVE_HIGH> <&gpio2 GPIO_ACTIVE_HIGH>;
      The gain value will be the following:

          gpio1 | gpio2 | gain
          ------+-------+-----
            0   |    0  | 0b00 -> 0
            1   |    0  | 0b01 -> 1
            0   |    1  | 0b10 -> 2
            1   |    1  | 0b11 -> 3
          ------+-------+-----

      Note: The gain value, bits set to 1 or 0, indicate the state active (bit
            set) or the state inactive (bit unset) of the related GPIO. The
            physical voltage corresponding to this active/inactive state is
            given by the GPIO_ACTIVE_HIGH and GPIO_ACTIVE_LOW flags.

    minItems: 1
    maxItems: 32

  gain-points:
    $ref: /schemas/types.yaml#/definitions/int32-matrix
    items:
      items:
        - description: The GPIOs value
        - description: The related amplifier gain in 0.01 dB unit
    minItems: 2
    description: |
      List of the GPIOs value / Gain value in dB pair defining the gain
      set on each GPIOs value.

      With 2 GPIOs controlling the gain, GPIOs value can be 0, 1, 2 and 3.
      Assuming that GPIOs values set the hardware gains according to the
      following table:

         GPIOs | Hardware
         value | amplification
         ------+--------------
           0   | -10.0 dB
           1   | +3.0 dB
           2   | 0 dB
           3   | +6.0 dB
         ------+--------------

      The description using gain points can be:
        gain-points = <0 (-1000)>, <1 300>, <2 0>, <3 600>;

  gain-range:
    $ref: /schemas/types.yaml#/definitions/int32-array
    items:
      - description: Gain in 0.01 dB unit when all GPIOs are inactive
      - description: Gain in 0.01 dB unit when all GPIOs are active
    description: |
      Gains (in 0.01 dB unit) set by the extremum (minimal and maximum) value
      of GPIOs. The following formula must be satisfied.

               gain-range[1] - gain-range[0]
      Gain  = ------------------------------- x GPIO_value + gain-range[0]
                        2^N - 1

      With N, the number of GPIOs used to control the gain and Gain computed in
      0.01 dB unit.

      With 2 GPIOs controlling the gain, GPIOs value can be 0, 1, 2 and 3.
      Assuming that gain value set the hardware according to the following
      table:

         GPIOs | Hardware 1    | Hardware 2
         value | amplification | amplification
         ------+---------------+---------------
           0   | -3.0 dB       |  +10.0 dB
           1   | 0 dB          |  +5.0 dB
           2   | +3.0 dB       |  0 dB
           3   | +6.0 dB       |  -5.0 dB
         ------+---------------+---------------

      The description for hardware 1 using a gain range can be:
        gain-range = <(-300) 600>;

      The description for hardware 2 using a gain range can be:
        gain-range = <1000 (-500)>;

  gain-labels:
    $ref: /schemas/types.yaml#/definitions/string-array
    description: |
      List of the gain labels attached to the combination of GPIOs controlling
      the gain. The first label is related to the gain value 0, the second label
      is related to the gain value 1 and so on.

      With 2 GPIOs controlling the gain, GPIOs value can be 0, 1, 2 and 3.
      Assuming that gain value set the hardware according to the following
      table:

         GPIOs | Hardware
         value | amplification
         ------+--------------
           0   | Low
           1   | Middle
           2   | High
           3   | Max
         ------+--------------

      The description using gain labels can be:
        gain-labels = "Low", "Middle", "High", "Max";

dependencies:
  gain-points: [ gain-gpios ]
  gain-range: [ gain-gpios ]
  gain-labels: [ gain-gpios ]

required:
  - compatible
  - vdd-supply

anyOf:
  - required:
      - gain-gpios
  - required:
      - mute-gpios
  - required:
      - bypass-gpios

allOf:
  - $ref: dai-common.yaml#
  - if:
      required:
        - gain-points
    then:
      properties:
        gain-range: false
        gain-labels: false
  - if:
      required:
        - gain-range
    then:
      properties:
        gain-points: false
        gain-labels: false
  - if:
      required:
        - gain-labels
    then:
      properties:
        gain-points: false
        gain-range: false

unevaluatedProperties: false

examples:
  - |
    #include <dt-bindings/gpio/gpio.h>

    /* Gain controlled by gpios */
    amplifier0 {
        compatible = "audio-gpio-amp";
        vdd-supply = <&regulator>;
        gain-gpios = <&gpio 0 GPIO_ACTIVE_HIGH>, <&gpio 1 GPIO_ACTIVE_HIGH>;
    };

    /* Gain controlled by gpio using range */
    amplifier1 {
        compatible = "audio-gpio-amp";
        vdd-supply = <&regulator>;
        gain-gpios = <&gpio 0 GPIO_ACTIVE_HIGH>, <&gpio 1 GPIO_ACTIVE_HIGH>;
        gain-range = <(-300) 600>;
    };

    /* Gain controlled by gpio using points */
    amplifier2 {
        compatible = "audio-gpio-amp";
        vdd-supply = <&regulator>;
        gain-gpios = <&gpio 0 GPIO_ACTIVE_HIGH>, <&gpio 1 GPIO_ACTIVE_HIGH>;
        gain-points = <0 (-1000)>, <1 300>, <2 0>, <3 600>;
    };

    /* Gain controlled by gpio with labels */
    amplifier3 {
        compatible = "audio-gpio-amp";
        vdd-supply = <&regulator>;
        gain-gpios = <&gpio 0 GPIO_ACTIVE_HIGH>;
        gain-labels = "Low", "High";
    };

    /* A mutable amplifier without any gain control */
    amplifier4 {
        compatible = "audio-gpio-amp";
        vdd-supply = <&regulator>;
        mute-gpios = <&gpio 0 GPIO_ACTIVE_HIGH>;
    };

    /*  Several supplies, gain controlled using range, mute and bypass */
    amplifier5 {
        compatible = "audio-gpio-amp";
        vdd-supply = <&regulator>;
        vddio-supply = <&regulator1>;
        vdda1-supply = <&regulator2>;
        gain-gpios = <&gpio 0 GPIO_ACTIVE_HIGH>, <&gpio 1 GPIO_ACTIVE_HIGH>;
        gain-range = <(-300) 600>;
        mute-gpios = <&gpio 2 GPIO_ACTIVE_HIGH>;
        bypass-gpios = <&gpio 3 GPIO_ACTIVE_HIGH>;
    };
...
```

## Documentation/devicetree/bindings/sound/axentia,tse850-pcm5142.yaml
```yaml
# SPDX-License-Identifier: (GPL-2.0-only OR BSD-2-Clause)
%YAML 1.2
---
$id: http://devicetree.org/schemas/sound/axentia,tse850-pcm5142.yaml#
$schema: http://devicetree.org/meta-schemas/core.yaml#

title: Axentia TSE-850 audio complex

maintainers:
  - Peter Rosin <peda@axentia.se>

description: |
  The TSE-850 is an FM Transmitter Station Equipment, designed to generate
  baseband signals for FM, mainly the DARC subcarrier, but other signals
  are also possible.

  The schematics explaining the gpios are as follows::

                 loop1 relays
     IN1 +---o  +------------+  o---+ OUT1
              \                /
               +              +
               |   /          |
               +--o  +--.     |
               |  add   |     |
               |        V     |
               |      .---.   |
     DAC +----------->|Sum|---+
               |      '---'   |
               |              |
               +              +
     IN2 +---o--+------------+--o---+ OUT2
                 loop2 relays

  The 'loop1' gpio pin controls two relays, which are either in loop
  position, meaning that input and output are directly connected, or
  they are in mixer position, meaning that the signal is passed through
  the 'Sum' mixer. Similarly for 'loop2'.

  In the above, the 'loop1' relays are inactive, thus feeding IN1 to the
  mixer (if 'add' is active) and feeding the mixer output to OUT1. The
  'loop2' relays are active, short-cutting the TSE-850 from channel 2.
  IN1, IN2, OUT1 and OUT2 are TSE-850 connectors and DAC is the PCB name
  of the (filtered) output from the PCM5142 codec.

properties:
  compatible:
    const: axentia,tse850-pcm5142

  axentia,cpu-dai:
    $ref: /schemas/types.yaml#/definitions/phandle
    description:
      The phandle of the cpu dai.

  axentia,audio-codec:
    $ref: /schemas/types.yaml#/definitions/phandle
    description:
      The phandle of the PCM5142 codec.

  axentia,add-gpios:
    maxItems: 1
    description:
      gpio specifier that controls the mixer.

  axentia,loop1-gpios:
    maxItems: 1
    description:
      gpio specifier that controls loop relays on channel 1.

  axentia,loop2-gpios:
    maxItems: 1
    description:
      gpio specifier that controls loop relays on channel 2.

  axentia,ana-supply:
    description:
      Regulator that supplies the output amplifier. Must support voltages in
      the 2V - 20V range, in 1V steps.

required:
  - compatible
  - axentia,cpu-dai
  - axentia,audio-codec
  - axentia,add-gpios
  - axentia,loop1-gpios
  - axentia,loop2-gpios
  - axentia,ana-supply

additionalProperties: false

examples:
  - |
    #include <dt-bindings/gpio/gpio.h>
    #include <dt-bindings/pwm/pwm.h>

    sound {
        compatible = "axentia,tse850-pcm5142";
        axentia,cpu-dai = <&ssc0>;
        axentia,audio-codec = <&codec>;
        axentia,add-gpios = <&pioA 8 GPIO_ACTIVE_LOW>;
        axentia,loop1-gpios = <&pioA 10 GPIO_ACTIVE_LOW>;
        axentia,loop2-gpios = <&pioA 11 GPIO_ACTIVE_LOW>;
        axentia,ana-supply = <&regulator_ana>;
    };
```

## Documentation/devicetree/bindings/sound/cdns,jh8100-i2s.yaml
```yaml
# SPDX-License-Identifier: (GPL-2.0 OR BSD-2-Clause)
%YAML 1.2
---
$id: http://devicetree.org/schemas/sound/cdns,jh8100-i2s.yaml#
$schema: http://devicetree.org/meta-schemas/core.yaml#

title: Cadence multi-channel I2S controller for StarFive JH8100 SoC

description: |
  The Cadence I2S Controller implements a function of the multi-channel
  (up to 8-channel) bus. It combines functions of a transmitter and a receiver.
  It is used in the StarFive JH8100 SoC.

maintainers:
  - Xingyu Wu <xingyu.wu@starfivetech.com>
  - Walker Chen <walker.chen@starfivetech.com>

properties:
  compatible:
    const: starfive,jh8100-i2s

  reg:
    maxItems: 1

  interrupts:
    description: |
      The interrupt line number for the I2S controller. Add this
      parameter if the I2S controller that you are using does not
      support DMA.
    maxItems: 1

  clocks:
    items:
      - description: Bit clock
      - description: Main ICG clock
      - description: Inner master clock

  clock-names:
    items:
      - const: bclk
      - const: icg
      - const: mclk_inner

  resets:
    maxItems: 1

  dmas:
    items:
      - description: TX DMA Channel
      - description: RX DMA Channel
    minItems: 1

  dma-names:
    items:
      - const: tx
      - const: rx
    minItems: 1

  cdns,i2s-max-channels:
    description: |
      Number of I2S max stereo channels supported by the hardware.
    $ref: /schemas/types.yaml#/definitions/uint32
    minimum: 1
    maximum: 8

  "#sound-dai-cells":
    const: 0

required:
  - compatible
  - reg
  - clocks
  - clock-names
  - resets

oneOf:
  - required:
      - dmas
      - dma-names
  - required:
      - interrupts

unevaluatedProperties: false

examples:
  - |
    i2s@122b0000 {
      compatible = "starfive,jh8100-i2s";
      reg = <0x122b0000 0x1000>;
      clocks = <&syscrg_ne 133>,
               <&syscrg_ne 170>,
               <&syscrg 50>;
      clock-names = "bclk", "icg",
                    "mclk_inner";
      resets = <&syscrg_ne 43>;
      dmas = <&dma 7>, <&dma 6>;
      dma-names = "tx", "rx";
      cdns,i2s-max-channels = <2>;
      #sound-dai-cells = <0>;
    };
```
