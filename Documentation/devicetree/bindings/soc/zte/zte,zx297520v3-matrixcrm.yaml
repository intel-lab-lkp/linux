## Documentation/devicetree/bindings/sound/cirrus,cs35l36.yaml
```yaml
# SPDX-License-Identifier: GPL-2.0-only
%YAML 1.2
---
$id: http://devicetree.org/schemas/cirrus,cs35l36.yaml#
$schema: http://devicetree.org/meta-schemas/core.yaml#

title: Cirrus Logic CS35L36 Speaker Amplifier

maintainers:
  - patches@opensource.cirrus.com
  - Bjorn Helgaas <bhelgaas@google.com>

description: |
  CS35L36 is a boosted mono Class D amplifier

allOf:
  - $ref: /schemas/sound/dai-common.yaml#

properties:
  compatible:
    enum:
      - cirrus,cs35l36

  reg:
    maxItems: 1

  interrupts:
    maxItems: 1

  VA-supply:
    description: Voltage regulator of analog internal section

  VP-supply:
    description: Voltage regulator of boost converter

  reset-gpios:
    maxItems: 1

  cirrus,boost-ctl-millivolt:
    description: Boost converter output voltage in millivolts (step 50)
    $ref: /schemas/types.yaml#/definitions/uint32
    minimum: 2550
    maximum: 12000

  cirrus,boost-peak-milliamp:
    description: Boost-converter peak current limit in mA (step 50)
    $ref: /schemas/types.yaml#/definitions/uint32
    default: 4500
    minimum: 1600
    maximum: 4500

  cirrus,boost-ind-nanohenry:
    description: Initial inductor estimation reference value in nanohenry (1000=1μH, 1200=1.2μH)
    $ref: /schemas/types.yaml#/definitions/uint32
    default: 1000

  cirrus,multi-amp-mode:
    description: Hi-Z ASP port when more than one amplifier in system.
    type: boolean

  cirrus,boost-ctl-select:
    description: Boost converter control source selection
    $ref: /schemas/types.yaml#/definitions/uint32
    default: 0x01
    enum:
      - 0x00 # Control Port
      - 0x01 # Class
      - 0x10 # Sync

  cirrus,amp-pcm-inv:
    description: Invert incoming PCM data when true.
    type: boolean

  cirrus,imon-pol-inv:
    description: Invert polarity of outbound IMON feedback when true.
    type: boolean

  cirrus,vmon-pol-inv:
    description: Invert polarity of outbound VMON feedback when true.
    type: boolean

  cirrus,dcm-mode-enable:
    description: Enable boost converter automatic Discontinuous Conduction Mode.
    type: boolean

  cirrus,weak-fet-disable:
    description: Reduce output driver strength in Weak-FET Drive Mode when true.
    type: boolean

  cirrus,classh-wk-fet-delay:
    description: Weak-FET entry delay in ms
    $ref: /schemas/types.yaml#/definitions/uint32
    default: 100
    enum:
      - 0 # 0
      - 1 # 5
      - 2 # 10
      - 3 # 50
      - 4 # 100
      - 5 # 200
      - 6 # 500
      - 7 # 1000

  cirrus,classh-weak-fet-thld-millivolt:
    description: Weak-FET drive threshold in mV
    $ref: /schemas/types.yaml#/definitions/uint32
    enum: [50, 100, 150, 200, 250, 300, 350, 400, 450, 500, 550, 600, 650, 700]

  cirrus,temp-warn-threshold:
    description: Overtemperature warning threshold
    $ref: /schemas/types.yaml#/definitions/uint32
    default: 2
    enum:
      - 0 # 105°C
      - 1 # 115°C
      - 2 # 125°C
      - 3 # 135°C

  cirrus,irq-drive-select:
    description: Interrupt output driver type
    $ref: /schemas/types.yaml#/definitions/uint32
    default: 1
    enum:
      - 0 # open-drain
      - 1 # push-pull

  cirrus,irq-gpio-select:
    description: Programmable IRQ pin selection
    $ref: /schemas/types.yaml#/definitions/uint32
    enum:
      - 0 # PDM_DATA/SWIRE_SD/INT
      - 1 # GPIO

  cirrus,vpbr-config:
    description: Brownout prevention configuration sub-node
    type: object
    additionalProperties: false

    properties:
      cirrus,vpbr-en:
        description: VBST brownout prevention enable
        $ref: /schemas/types.yaml#/definitions/uint32
        default: 0
        enum:
          - 0 # disabled
          - 1 # enabled

      cirrus,vpbr-thld:
        description: Initial VPBR threshold voltage
        $ref: /schemas/types.yaml#/definitions/uint32

      cirrus,vpbr-atk-rate:
        description: Attenuation attack step rate
        $ref: /schemas/types.yaml#/definitions/uint32

      cirrus,vpbr-atk-vol:
        description: VP brownout prevention step size
        $ref: /schemas/types.yaml#/definitions/uint32

      cirrus,vpbr-max-attn:
        description: Maximum attenuation during VP brownout prevention
        $ref: /schemas/types.yaml#/definitions/uint32

      cirrus,vpbr-wait:
        description: Delay between brownout clearance and attenuation release
        $ref: /schemas/types.yaml#/definitions/uint32

      cirrus,vpbr-rel-rate:
        description: Attenuation release step rate
        $ref: /schemas/types.yaml#/definitions/uint32

      cirrus,vpbr-mute-en:
        description: Mute audio if maximum attenuation reached
        $ref: /schemas/types.yaml#/definitions/uint32

required:
  - compatible
  - reg
  - interrupts
  - VA-supply

unevaluatedProperties: false

examples:
  - |
    #include <dt-bindings/gpio/gpio.h>
    #include <dt-bindings/interrupt-controller/irq.h>

    i2c {
        #address-cells = <1>;
        #size-cells = <0>;

        codec@40 {
            compatible = "cirrus,cs35l36";
            reg = <0x40>;
            VA-supply = <&dummy_vreg>;
            VP-supply = <&dummy_vreg>;
            reset-gpios = <&gpio0 54 GPIO_ACTIVE_HIGH>;
            interrupts = <3 IRQ_TYPE_LEVEL_LOW>;

            cirrus,boost-ind-nanohenry = <1000>;
            cirrus,boost-ctl-millivolt = <10000>;
            cirrus,boost-peak-milliamp = <4500>;
            cirrus,boost-ctl-select = <0x00>;
            cirrus,weak-fet-delay = <4>;
            cirrus,weak-fet-thld = <0x01>;
            cirrus,temp-warn-threshold = <1>;
            cirrus,multi-amp-mode;
            cirrus,irq-drive-select = <1>;
            cirrus,irq-gpio-select = <0x01>;

            cirrus,vpbr-config {
                cirrus,vpbr-en = <0>;
                cirrus,vpbr-thld = <0x05>;
                cirrus,vpbr-atk-rate = <0x02>;
                cirrus,vpbr-atk-vol = <0x01>;
                cirrus,vpbr-max-attn = <0x09>;
                cirrus,vpbr-wait = <0x01>;
                cirrus,vpbr-rel-rate = <0x05>;
                cirrus,vpbr-mute-en = <0x00>;
            };
        };
    };
...
```

## Documentation/devicetree/bindings/sound/cix,ipbloq-hda.yaml
```yaml
# SPDX-License-Identifier: (GPL-2.0-only OR BSD-2-Clause)
%YAML 1.2
---
$id: http://devicetree.org/schemas/sound/cix,ipbloq-hda.yaml#
$schema: http://devicetree.org/meta-schemas/core.yaml#

title: CIX IPBLOQ HDA controller

description:
  CIX IPBLOQ High Definition Audio (HDA) Controller

maintainers:
  - Joakim Zhang <joakim.zhang@cixtech.com>

properties:
  compatible:
    const: cix,ipbloq-hda

  reg:
    maxItems: 1

  interrupts:
    maxItems: 1

  clocks:
    maxItems: 2

  clock-names:
    items:
      - const: sysclk
      - const: clk48m

  resets:
    maxItems: 1

  reset-names:
    items:
      - const: hda

  cix,model:
    $ref: /schemas/types.yaml#/definitions/string
    description:
      The user-visible name of this sound complex. If this property is
      not specified then boards can use default name provided in hda driver.

required:
  - compatible
  - reg
  - interrupts
  - clocks
  - clock-names
  - resets
  - reset-names

additionalProperties: false

examples:
  - |
    #include<dt-bindings/interrupt-controller/arm-gic.h>

    hda@70c0000 {
        compatible = "cix,ipbloq-hda";
        reg = <0x70c0000 0x10000>;
        interrupts = <GIC_SPI 234 IRQ_TYPE_LEVEL_HIGH>;
        clocks = <&audss_clk 7>,
                 <&audss_clk 8>;
        clock-names = "sysclk", "clk48m";
        resets = <&audss_rst 14>;
        reset-names = "hda";
        cix,model = "CIX EVB HDA";
    };
```

## Documentation/devicetree/bindings/sound/cml,cmx655d.yaml
```yaml
# SPDX-License-Identifier: GPL-2.0-only OR BSD-2-Clause
%YAML 1.2
---
$id: http://devicetree.org/schemas/sound/cml,cmx655d.yaml#
$schema: http://devicetree.org/meta-schemas/core.yaml#

title: CML Micro CMX655D codec

maintainers:
  - Richard Walton <rwalton@cmlmicro.com>
  - Nikola Jelic <nikola.jelic83@gmail.com>

description:
  The CMX655D is an ultra-low power voice codec.

allOf:
  - $ref: dai-common.yaml#

properties:
  compatible:
    enum:
      - cml,cmx655d

  reg:
    description: Local bus address
    maxItems: 1

  "#sound-dai-cells":
    description: The first cell indicating the audio interface
    const: 0

  reset-gpios:
    description: GPIO used for codec reset, negative logic
    maxItems: 1

  interrupts:
    description: Interrupt for the CMX655D IRQ line
    maxItems: 1

  interrupt-names:
    description: Interrupt name for the CMX655D IRQ line
    maxItems: 1

  cml,classd-oc-reset-attempts:
    description: Maximum number of times to reset CMX655 class-D
      following a overcurrent event.
      >10000 = disable limit.
    $ref: /schemas/types.yaml#/definitions/uint32
    minimum: 1
    maximum: 10001
    default: 5

required:
  - compatible
  - reg

unevaluatedProperties: false

examples:
  - |
    #include <dt-bindings/interrupt-controller/irq.h>
    #include <dt-bindings/gpio/gpio.h>
    i2c {
        #address-cells = <1>;
        #size-cells = <0>;
        status = "okay";
        audio-codec@54 {
            compatible = "cml,cmx655d";
            #sound-dai-cells = <0>;
            reg = <0x54>;
            reset-gpios = <&gpio 24 GPIO_ACTIVE_LOW>;
            interrupt-parent = <&gpio>;
            interrupts = <25 IRQ_TYPE_EDGE_RISING>;
            cml,classd-oc-reset-attempts = <5>;
        };

    };
...
```

## Documentation/devicetree/bindings/sound/esstech,es9039q2m.yaml
```yaml
# SPDX-License-Identifier: (GPL-2.0-only OR BSD-2-Clause)
%YAML 1.2
---
$id: http://devicetree.org/schemas/sound/esstech,es9039q2m.yaml#
$schema: http://devicetree.org/meta-schemas/core.yaml#

title: ESS Technology ES9039Q2M audio DAC

maintainers:
  - Karl Asseily <karl@asseily.com>

description:
  The ES9039Q2M is a 32-bit two-channel audio DAC supporting PCM to 768 kHz,
  DSD64 to DSD1024, DoP and S/PDIF. It is controlled over I2C or SPI when the
  MODE pin selects software mode; this binding covers the I2C interface. The
  part contains an asynchronous sample rate converter, so the system clock need
  not be synchronous with the audio bit or frame clocks.

allOf:
  - $ref: dai-common.yaml#

properties:
  compatible:
    const: esstech,es9039q2m

  reg:
    description:
      I2C address, selected by the ADDR0 and ADDR1 pins - 0x48, 0x49, 0x4a or
      0x4b for GND/GND, GND/AVDD, AVDD/GND and AVDD/AVDD respectively.
    enum: [ 0x48, 0x49, 0x4a, 0x4b ]

  clocks:
    maxItems: 1

  clock-names:
    const: mclk

  "#sound-dai-cells":
    const: 0

required:
  - compatible
  - reg
  - "#sound-dai-cells"

unevaluatedProperties: false

examples:
  - |
    i2c {
        #address-cells = <1>;
        #size-cells = <0>;

        audio-codec@48 {
            compatible = "esstech,es9039q2m";
            reg = <0x48>;
            #sound-dai-cells = <0>;
            clocks = <&dac_mclk>;
            clock-names = "mclk";
        };
    };
```

## Documentation/devicetree/bindings/sound/everest,es7243e.yaml
```yaml
# SPDX-License-Identifier: (GPL-2.0-only OR BSD-2-Clause)
%YAML 1.2
---
$id: http://devicetree.org/schemas/sound/everest,es7243e.yaml#
$schema: http://devicetree.org/meta-schemas/core.yaml#

title: Everest ES7243E audio ADC

maintainers:
  - Igor Prusov <ivprusov@salutedevices.com>

allOf:
  - $ref: dai-common.yaml#

properties:
  compatible:
    const: everest,es7243e

  reg:
    maxItems: 1

  "#sound-dai-cells":
    const: 0

  clocks:
    minItems: 2
    maxItems: 2

  clock-names:
    items:
      - const: sclk
      - const: lrclk

required:
  - compatible
  - reg
  - "#sound-dai-cells"
  - clocks
  - clock-names

unevaluatedProperties: false

examples:
  - |
    i2c {
      #address-cells = <1>;
      #size-cells = <0>;
      es7243e: audio-codec@14 {
        compatible = "everest,es7243e";
        reg = <0x14>;
        #sound-dai-cells = <0>;
        clocks = <&clk_audio_sclk>,
                 <&clk_audio_lrclk>;
        clock-names = "sclk", "lrclk";
      };
    };
```

## Documentation/devicetree/bindings/sound/everest,es8311.yaml
```yaml
# SPDX-License-Identifier: (GPL-2.0-only OR BSD-2-Clause)
%YAML 1.2
---
$id: http://devicetree.org/schemas/sound/everest,es8311.yaml#
$schema: http://devicetree.org/meta-schemas/core.yaml#

title: Everest ES8311 audio CODEC

maintainers:
  - Matteo Martelli <matteomartelli3@gmail.com>

allOf:
  - $ref: dai-common.yaml#

properties:
  compatible:
    const: everest,es8311

  reg:
    maxItems: 1

  clocks:
    items:
      - description: clock for master clock (MCLK)

  clock-names:
    items:
      - const: mclk

  "#sound-dai-cells":
    const: 0

required:
  - compatible
  - reg
  - "#sound-dai-cells"

unevaluatedProperties: false

examples:
  - |
    i2c {
      #address-cells = <1>;
      #size-cells = <0>;
      es8316: codec@18 {
        compatible = "everest,es8311";
        reg = <0x18>;
        clocks = <&clks 10>;
        clock-names = "mclk";
        #sound-dai-cells = <0>;
      };
    };
```

## Documentation/devicetree/bindings/sound/everest,es8323.yaml
```yaml
# SPDX-License-Identifier: (GPL-2.0-only OR BSD-2-Clause)
%YAML 1.2
---
$id: http://devicetree.org/schemas/sound/everest,es8323.yaml#
$schema: http://devicetree.org/meta-schemas/core.yaml#

title: Everest ES8323 audio CODECs

maintainers:
  - Binbin Zhou <zhoubinbin@loongson.cn>

allOf:
  - $ref: dai-common.yaml#

properties:
  compatible:
    const: everest,es8323

  reg:
    maxItems: 1

  clocks:
    description: clock for master clock (MCLK)
    maxItems: 1

  clock-names:
    const: mclk

  '#sound-dai-cells':
    const: 0

required:
  - compatible
  - reg
  - '#sound-dai-cells'

unevaluatedProperties: false

examples:
  - |
    i2c {
      #address-cells = <1>;
      #size-cells = <0>;
      codec@10 {
        compatible = "everest,es8323";
        reg = <0x10>;
        #sound-dai-cells = <0>;
      };
    };
```

## Documentation/devicetree/bindings/sound/everest,es8375.yaml
```yaml
# SPDX-License-Identifier: (GPL-2.0-only OR BSD-2-Clause)
%YAML 1.2
---
$id: http://devicetree.org/schemas/sound/everest,es8375.yaml#
$schema: http://devicetree.org/meta-schemas/core.yaml#

title: Everest ES8375 audio CODEC

maintainers:
  - Michael Zhang <zhangyi@everest-semi.com>

allOf:
  - $ref: dai-common.yaml#

properties:
  compatible:
    const: everest,es8375

  reg:
    maxItems: 1

  clocks:
    items:
      - description: clock for master clock (MCLK)

  clock-names:
    items:
      - const: mclk

  vdda-supply:
    description:
      Analogue power supply.

  vddd-supply:
    description:
      Interface power supply.

  "#sound-dai-cells":
    const: 0

required:
  - compatible
  - reg
  - "#sound-dai-cells"
  - vdda-supply
  - vddd-supply

additionalProperties: false

examples:
  - |
    i2c {
      #address-cells = <1>;
      #size-cells = <0>;
      es8375: codec@10 {
        compatible = "everest,es8375";
        reg = <0x18>;
        vdda-supply = <&vdd3v3>;
        vddd-supply = <&vdd3v3>;
        #sound-dai-cells = <0>;
      };
    };
```
