## Documentation/devicetree/bindings/soc/zte/zte,zx297520v3-matrixcrm.yaml
```yaml
# SPDX-License-Identifier: (GPL-2.0-only OR BSD-2-Clause)
%YAML 1.2
---
$id: http://devicetree.org/schemas/soc/zte/zte,zx297520v3-matrixcrm.yaml#
$schema: http://devicetree.org/meta-schemas/core.yaml#

title: ZTE zx297520v3 SoC matrix clock and reset controller

maintainers:
  - Stefan Dösinger <stefandoesinger@gmail.com>

description: |
  This controller contains clock and reset controls for high speed devices on
  the zx297520v3 board: The CPU, RAM, SDIO and Ethernet clocks and resets are
  found here. This controller requires PLL-generated clocks from Topcrm as well
  as the fixed 26 MHz and 32 KHz oscillators found on this board.

  This controller also contains hardware mutex registers for synchronization
  with different processors on this board.

  All available clocks are defined as preprocessor macros in the
  'dt-bindings/clock/zte,zx297520v3-clk.h' header. Resets are defined in the
  'dt-bindings/reset/zte,zx297520v3-reset.h' header.

properties:
  compatible:
    items:
      - const: zte,zx297520v3-matrixcrm
      - const: syscon

  reg:
    maxItems: 1

  clocks:
    items:
      - description: 26 MHz external oscillator
      - description: 32 KHz external oscillator
      - description: Main PLL output from topcrm (usually 624 MHz)
      - description: Main PLL subdivision factor 2
      - description: Main PLL subdivision factor 3
      - description: Main PLL subdivision factor 4
      - description: Main PLL subdivision factor 5
      - description: Main PLL subdivision factor 6
      - description: Main PLL subdivision factor 8
      - description: Main PLL subdivision factor 12
      - description: Main PLL subdivision factor 16
      - description: Main PLL subdivision factor 26
      - description: Upll output from topcrm (Usually 480 MHz)
      - description: Upll subdivision factor 2
      - description: Upll subdivision factor 3
      - description: Upll subdivision factor 4
      - description: Upll subdivision factor 5
      - description: Upll subdivision factor 6
      - description: Upll subdivision factor 8
      - description: Upll subdivision factor 12
      - description: Upll subdivision factor 16
      - description: Dpll output from topcrm (usually 492.88 MHz)
      - description: Dpll subdivision factor 2
      - description: Dpll subdivision factor 3
      - description: Dpll subdivision factor 4
      - description: Dpll subdivision factor 5
      - description: Dpll subdivision factor 6
      - description: Dpll subdivision factor 8
      - description: Dpll subdivision factor 12
      - description: Dpll subdivision factor 16
      - description: Gpll output from topcrm (usually 200 MHz)
      - description: Gpll subdivision factor 2
      - description: Gpll subdivision factor 3
      - description: Gpll subdivision factor 4
      - description: Gpll subdivision factor 5
      - description: Gpll subdivision factor 6
      - description: Gpll subdivision factor 8
      - description: Gpll subdivision factor 12
      - description: Gpll subdivision factor 16

  clock-names:
    items:
      - const: osc26m
      - const: osc32k
      - const: mpll
      - const: mpll_d2
      - const: mpll_d3
      - const: mpll_d4
      - const: mpll_d5
      - const: mpll_d6
      - const: mpll_d8
      - const: mpll_d12
      - const: mpll_d16
      - const: mpll_d26
      - const: upll
      - const: upll_d2
      - const: upll_d3
      - const: upll_d4
      - const: upll_d5
      - const: upll_d6
      - const: upll_d8
      - const: upll_d12
      - const: upll_d16
      - const: dpll
      - const: dpll_d2
      - const: dpll_d3
      - const: dpll_d4
      - const: dpll_d5
      - const: dpll_d6
      - const: dpll_d8
      - const: dpll_d12
      - const: dpll_d16
      - const: gpll
      - const: gpll_d2
      - const: gpll_d3
      - const: gpll_d4
      - const: gpll_d5
      - const: gpll_d6
      - const: gpll_d8
      - const: gpll_d12
      - const: gpll_d16

  "#clock-cells":
    const: 1

  "#hwlock-cells":
    const: 1

  "#reset-cells":
    const: 1

required:
  - compatible
  - reg
  - clocks
  - clock-names
  - '#clock-cells'
  - "#hwlock-cells"
  - '#reset-cells'

additionalProperties: false

examples:
  - |
    #include <dt-bindings/clock/zte,zx297520v3-clk.h>
    #include <dt-bindings/reset/zte,zx297520v3-reset.h>

    clock-controller@1306000 {
        compatible = "zte,zx297520v3-matrixcrm", "syscon";
        reg = <0x01306000 0x400>;
        clocks = <&osc26m>, <&osc32k>,
                 <&topcrm ZX297520V3_MPLL>, <&topcrm ZX297520V3_MPLL_D2>,
                 <&topcrm ZX297520V3_MPLL_D3>, <&topcrm ZX297520V3_MPLL_D4>,
                 <&topcrm ZX297520V3_MPLL_D5>, <&topcrm ZX297520V3_MPLL_D6>,
                 <&topcrm ZX297520V3_MPLL_D8>, <&topcrm ZX297520V3_MPLL_D12>,
                 <&topcrm ZX297520V3_MPLL_D16>, <&topcrm ZX297520V3_MPLL_D26>,
                 <&topcrm ZX297520V3_UPLL>, <&topcrm ZX297520V3_UPLL_D2>,
                 <&topcrm ZX297520V3_UPLL_D3>, <&topcrm ZX297520V3_UPLL_D4>,
                 <&topcrm ZX297520V3_UPLL_D5>, <&topcrm ZX297520V3_UPLL_D6>,
                 <&topcrm ZX297520V3_UPLL_D8>, <&topcrm ZX297520V3_UPLL_D12>,
                 <&topcrm ZX297520V3_UPLL_D16>,
                 <&topcrm ZX297520V3_DPLL>, <&topcrm ZX297520V3_DPLL_D2>,
                 <&topcrm ZX297520V3_DPLL_D3>, <&topcrm ZX297520V3_DPLL_D4>,
                 <&topcrm ZX297520V3_DPLL_D5>, <&topcrm ZX297520V3_DPLL_D6>,
                 <&topcrm ZX297520V3_DPLL_D8>, <&topcrm ZX297520V3_DPLL_D12>,
                 <&topcrm ZX297520V3_DPLL_D16>,
                 <&topcrm ZX297520V3_GPLL>, <&topcrm ZX297520V3_GPLL_D2>,
                 <&topcrm ZX297520V3_GPLL_D3>, <&topcrm ZX297520V3_GPLL_D4>,
                 <&topcrm ZX297520V3_GPLL_D5>, <&topcrm ZX297520V3_GPLL_D6>,
                 <&topcrm ZX297520V3_GPLL_D8>, <&topcrm ZX297520V3_GPLL_D12>,
                 <&topcrm ZX297520V3_GPLL_D16>;
        clock-names = "osc26m", "osc32k", "mpll", "mpll_d2", "mpll_d3",
                      "mpll_d4", "mpll_d5", "mpll_d6", "mpll_d8", "mpll_d12",
                      "mpll_d16", "mpll_d26", "upll", "upll_d2", "upll_d3",
                      "upll_d4", "upll_d5", "upll_d6", "upll_d8", "upll_d12",
                      "upll_d16", "dpll", "dpll_d2", "dpll_d3", "dpll_d4",
                      "dpll_d5", "dpll_d6", "dpll_d8", "dpll_d12", "dpll_d16",
                      "gpll", "gpll_d2", "gpll_d3", "gpll_d4", "gpll_d5",
                      "gpll_d6", "gpll_d8", "gpll_d12", "gpll_d16";
        #clock-cells = <1>;
        #hwlock-cells = <1>;
        #reset-cells = <1>;
    };
```

## Documentation/devicetree/bindings/soc/zte/zte,zx297520v3-topcrm.yaml
```yaml
# SPDX-License-Identifier: (GPL-2.0-only OR BSD-2-Clause)
%YAML 1.2
---
$id: http://devicetree.org/schemas/soc/zte/zte,zx297520v3-topcrm.yaml#
$schema: http://devicetree.org/meta-schemas/core.yaml#

title: ZTE zx297520v3 SoC top clock and reset controller

maintainers:
  - Stefan Dösinger <stefandoesinger@gmail.com>

description: |
  The zx297520v3's top clock and reset controller generates clocks for core
  devices on the board like the main bus, USB and timers. In addition to clocks
  it has reset controls for peripherals, a global board reset, watchdog reset
  controls and a USB status register.

  The controller has two clock inputs: a 26 MHz and a 32 KHz external
  oscillator. They need to be provided as input clocks. The controller provides
  clocks to the downstream Matrix clock controller.

  All available clocks are defined as preprocessor macros in the
  'dt-bindings/clock/zte,zx297520v3-clk.h' header. The resets are defined in the
  'dt-bindings/reset/zte,zx297520v3-reset.h' header.

properties:
  compatible:
    items:
      - const: zte,zx297520v3-topcrm
      - const: syscon

  reg:
    maxItems: 1

  clocks:
    items:
      - description: 26 MHz external oscillator
      - description: 32 KHz external oscillator

  clock-names:
    items:
      - const: osc26m
      - const: osc32k

  "#clock-cells":
    const: 1

  "#reset-cells":
    const: 1

  syscon-reboot:
    type: object
    $ref: /schemas/power/reset/syscon-reboot.yaml#
    description:
      Reboot method for the SoC.

required:
  - compatible
  - reg
  - clocks
  - clock-names
  - '#clock-cells'
  - '#reset-cells'

additionalProperties: false

examples:
  - |
    #include <dt-bindings/clock/zte,zx297520v3-clk.h>
    #include <dt-bindings/reset/zte,zx297520v3-reset.h>

    clock-controller@13b000 {
        compatible = "zte,zx297520v3-topcrm", "syscon";
        reg = <0x0013b000 0x400>;
        clocks = <&osc26m>, <&osc32k>;
        clock-names = "osc26m", "osc32k";
        #clock-cells = <1>;
        #reset-cells = <1>;

        syscon-reboot {
          compatible = "syscon-reboot";
          offset = <0x0>;
          mask = <0x1>;
          value = <0x1>;
        };
    };
```

## Documentation/devicetree/bindings/sound/adi,ssm2305.yaml
```yaml
# SPDX-License-Identifier: GPL-2.0-only OR BSD-2-Clause
%YAML 1.2
---
$id: http://devicetree.org/schemas/sound/adi,ssm2305.yaml#
$schema: http://devicetree.org/meta-schemas/core.yaml#

title: Analog Devices SSM2305 Speaker Amplifier

maintainers:
  - Liam Girdwood <lgirdwood@gmail.com>
  - Mark Brown <broonie@kernel.org>
  - Rob Herring <robh@kernel.org>
  - Krzysztof Kozlowski <krzk+dt@kernel.org>
  - Conor Dooley <conor+dt@kernel.org>

properties:
  compatible:
    const: adi,ssm2305

  shutdown-gpios:
    maxItems: 1
    description: The gpio connected to the shutdown pin. The gpio signal is ACTIVE_LOW.

required:
  - compatible
  - shutdown-gpios

additionalProperties: false

examples:
  - |
   analog-amplifier {
     compatible = "adi,ssm2305";
     shutdown-gpios = <&gpio3 20 0>;
   };
```

## Documentation/devicetree/bindings/sound/adi,ssm260x.yaml
```yaml
# SPDX-License-Identifier: GPL-2.0-only OR BSD-2-Clause
%YAML 1.2
---
$id: http://devicetree.org/schemas/sound/adi,ssm2602.yaml#
$schema: http://devicetree.org/meta-schemas/core.yaml#

title: Analog Devices SSM2602, SSM2603 and SSM2604 I2S audio CODEC devices

description:
  SSM2602 support both I2C and SPI as the configuration interface,
  
  the selection is made by the MODE strap-in pin.

  SSM2603 and SSM2604 only support I2C as the configuration interface.

maintainers:
  - Liam Girdwood <lgirdwood@gmail.com>
  - Mark Brown <broonie@kernel.org>
  - Rob Herring <robh@kernel.org>
  - Krzysztof Kozlowski <krzk+dt@kernel.org>
  - Conor Dooley <conor+dt@kernel.org>

properties:
  compatible:
    description: One of "adi,ssm2602", "adi,ssm2603" or "adi,ssm2604"
    enum:
      - adi,ssm2602
      - adi,ssm2603
      - adi,ssm2604

  reg:
    description: the I2C address of the device for I2C, the chip select number for SPI.
    maxItems: 1

required:
  - compatible
  - reg

additionalProperties: false

examples:
  - |
   i2c {
     #address-cells = <1>;
     #size-cells = <0>;
     ssm2602@1a {
       compatible = "adi,ssm2602";
       reg = <0x1a>;
     };
   };
```

## Documentation/devicetree/bindings/sound/airoha,an7581-pcm.yaml
```yaml
# SPDX-License-Identifier: (GPL-2.0-only OR BSD-2-Clause)
%YAML 1.2
---
$id: http://devicetree.org/schemas/sound/airoha,an7581-pcm.yaml#
$schema: http://devicetree.org/meta-schemas/core.yaml#

title: Airoha PCM controller for AN7581 SoC

maintainers:
  - Christian Marangi <ansuelsmth@gmail.com>

properties:
  compatible:
    const: airoha,an7581-pcm

  reg:
    maxItems: 1

  interrupts:
    maxItems: 1

  resets:
    maxItems: 1

  reset-names:
    const: pcm1

required:
  - compatible
  - reg
  - interrupts
  - resets
  - reset-names

additionalProperties: false

examples:
  - |
    #include <dt-bindings/interrupt-controller/arm-gic.h>
    #include <dt-bindings/interrupt-controller/irq.h>
    #include <dt-bindings/reset/airoha,en7581-reset.h>

    pcm@1fbd0000 {
        compatible = "airoha,an7581-pcm";
        reg = <0x1fbd0000 0x10000>;

        interrupts = <GIC_SPI 27 IRQ_TYPE_LEVEL_HIGH>;
        resets = <&scuclk EN7581_PCM1_RST>;
        reset-names = "pcm1";
    };

...
```

## Documentation/devicetree/bindings/sound/amlogic,audin.yaml
```yaml
# SPDX-License-Identifier: GPL-2.0
%YAML 1.2
---
$id: http://devicetree.org/schemas/sound/amlogic,audin.yaml#
$schema: http://devicetree.org/meta-schemas/core.yaml#

title: Amlogic AUDIN audio output controller

maintainers:
	- Valerio Setti <vsetti@baylibre.com>

allOf:
	- $ref: dai-common.yaml#

properties:
	$nodename:
		pattern: "^audio-input-controller@.*"

	"#sound-dai-cells":
		const: 1

	compatible:
		items:
			- enum:
					- amlogic,audin-gxbb
			- const: amlogic,audin

	clocks:
		items:
      - description: AIU peripheral clock
      - description: I2S peripheral clock
      - description: I2S output clock
      - description: I2S master clock
      - description: I2S mixer clock
			- description: AUDIN peripheral clock
			- description: I2S bit clock gate
			- description: I2S bit clock basic divider
			- description: I2S bit clock more divider
			- description: I2S L/R clock divider

	clock-names:
		items:
			- const: pclk
			- const: i2s_pclk
			- const: i2s_aoclk
			- const: i2s_mclk
			- const: i2s_mixer
			- const: i2s_input_clk
			- const: i2s_aoclk_div_gate
			- const: i2s_aoclk_basic_div
			- const: i2s_aoclk_more_div
			- const: i2s_lrclk_div

	reg:
		maxItems: 1

	resets:
		maxItems: 1

	sound-name-prefix: true

required:
	- "#sound-dai-cells"
	- compatible
	- clocks
	- clock-names
	- reg
	- resets

additionalProperties: false

examples:
	- |
		#include <dt-bindings/clock/gxbb-clkc.h>
		#include <dt-bindings/sound/meson-gxbb.h>
		#include <dt-bindings/reset/amlogic,meson-gxbb-reset.h>

		audin: audio-input-controller@a000 {
			compatible = "amlogic,audin-gxbb", "amlogic,audin";
			#sound-dai-cells = <1>;
			sound-name-prefix = "AUDIN";
			reg = <0x0 0xa000 0x0 0x308>;
			clocks = <&clkc CLKID_AIU_GLUE>,
							 <&clkc CLKID_I2S_OUT>,
							 <&clkc CLKID_AOCLK_GATE>,
							 <&clkc CLKID_CTS_AMCLK>,
							 <&clkc CLKID_MIXER_IFACE>,
							 <&clkc CLKID_I2S_SPDIF>,
							 <&aiu AIU_AOCLK_DIV_GATE>,
							 <&aiu AIU_AOCLK_BASIC_DIV>,
							 <&aiu AIU_AOCLK_MORE_DIV>,
							 <&aiu AIU_LRCLK_DIV>;
			clock-names = "pclk",
										"i2s_pclk",
										"i2s_aoclk",
										"i2s_mclk",
										"i2s_mixer",
										"i2s_input_clk",
										"i2s_aoclk_div_gate",
										"i2s_aoclk_basic_div",
										"i2s_aoclk_more_div",
										"i2s_lrclk_div";
			resets = <&reset RESET_AIU>;
		};
```

## Documentation/devicetree/bindings/sound/amlogic,meson-gx-audin-decoder-i2s.yaml
```yaml
# SPDX-License-Identifier: (GPL-2.0-only OR BSD-2-Clause)
%YAML 1.2
---
$id: http://devicetree.org/schemas/sound/amlogic,meson-gx-audin-decoder-i2s.yaml#
$schema: http://devicetree.org/meta-schemas/core.yaml#

title: Amlogic GX AUDIN I2S Input Decoder

maintainers:
  - Valerio Setti <vsetti@baylibre.com>

allOf:
  - $ref: dai-common.yaml#

properties:
  $nodename:
    pattern: "^audio-controller@.*"

  "#sound-dai-cells":
    const: 0

  compatible:
    items:
      - enum:
          - amlogic,meson-gxbb-audin-decoder-i2s
      - const: amlogic,meson-gx-audin-decoder-i2s

  reg:
    maxItems: 1

  sound-name-prefix: true

required:
  - "#sound-dai-cells"
  - compatible
  - reg

additionalProperties: false

examples:
  - |
    audio-controller@a040 {
      compatible = "amlogic,meson-gxbb-audin-decoder-i2s",
                   "amlogic,meson-gx-audin-decoder-i2s";
      #sound-dai-cells = <0>;
      sound-name-prefix = "AUDIN I2S Decoder";
      reg = <0xa040 0x4>;
      status = "disabled";
    };
```
