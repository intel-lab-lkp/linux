## Documentation/devicetree/bindings/interrupt-controller/renesas,sh7751-irl-ext.yaml
```yaml
# SPDX-License-Identifier: GPL-2.0-only OR BSD-2-Clause
%YAML 1.2
---
$id: http://devicetree.org/schemas/interrupt-controller/renesas,sh7751-irl-ext.yaml#
$schema: http://devicetree.org/meta-schemas/core.yaml#

title: Renesas SH7751 IRL external encoder with enable regs.

maintainers:
  - Yoshinori Sato <ysato@users.sourceforge.jp>

description: |
  This is the generally used external interrupt encoder on SH7751 based boards.

properties:
  compatible:
    items:
      - const: renesas,sh7751-irl-ext

  reg:
    minItems: 1

  interrupt-controller: true

  '#interrupt-cells':
    const: 1

  '#address-cells':
    const: 0

  '#size-cells':
    const: 0

  renesas,width:
    description: Enable register width
    $ref: /schemas/types.yaml#/definitions/uint32

  renesas,regtype:
    description: Enable register type
    $ref: /schemas/types.yaml#/definitions/string
    oneOf:
      - description:
          1 is interrupt enable / 0 is interrupt disable.
        const: enable
      - description:
          1 is interrupt mask / 0 is interrupt unmask.
        const: mask

  renesas,irqbit:
    description: IRQ to enable register bit mapping
    $ref: /schemas/types.yaml#/definitions/uint32-array


required:
  - compatible
  - reg
  - interrupt-controller
  - '#interrupt-cells'
  - renesas,width
  - renesas,regtype
  - renesas,irqbit

additionalProperties: false

examples:
  - |
    r2dintc: sh7751irl_encoder@a4000000 {
        compatible = "renesas,sh7751-irl-ext";
        reg = <0xa4000000 0x02>;
        interrupt-controller;
        #address-cells = <0>;
        #size-cells = <0>;
        #interrupt-cells = <1>;
        renesas,width = <16>;
        renesas,regtype = "enable";
        renesas,irqbit =  <11>,         /* PCI INTD */
                          <9>,          /* CF IDE */
                          <8>,          /* CF CD */
                          <12>,         /* PCI INTC */
                          <10>,         /* SM501 */
                          <6>,          /* KEY */
                          <5>,          /* RTC ALARM */
                          <4>,          /* RTC T */
                          <7>,          /* SDCARD */
                          <14>,         /* PCI INTA */
                          <13>,         /* PCI INTB */
                          <0>,          /* EXT */
                          <15>;         /* TP */
    };
```

## Documentation/devicetree/bindings/interrupt-controller/riscv,aclint-sswi.yaml
```yaml
# SPDX-License-Identifier: (GPL-2.0-only OR BSD-2-Clause)
%YAML 1.2
---
$id: http://devicetree.org/schemas/interrupt-controller/riscv,aclint-sswi.yaml#
$schema: http://devicetree.org/meta-schemas/core.yaml#

title: Risc-V ACLINT Supervisor-level Software Interrupt Device

maintainers:
  - Inochi Amaoto <inochiama@outlook.com>

description:
  The SSWI device is a part of the Risc-V ACLINT device. It provides
  supervisor-level IPI functionality for a set of HARTs on a THEAD
  platform. It provides a register to set an IPI (SETSSIP) for each
  HART connected to the SSWI device. See specification
  https://github.com/riscvarchive/riscv-aclint

  T-HEAD C900 ACLINT is a variant of the ACLINT, using dedicated
  compatible string

properties:
  compatible:
    oneOf:
      - items:
          - enum:
              - sophgo,sg2044-aclint-sswi
          - const: thead,c900-aclint-sswi
      - items:
          - const: riscv,aclint-sswi

  reg:
    maxItems: 1

  "#interrupt-cells":
    const: 0

  interrupt-controller: true

  interrupts-extended:
    minItems: 1
    maxItems: 4095

  riscv,hart-indexes:
    $ref: /schemas/types.yaml#/definitions/uint32-array
    minItems: 1
    maxItems: 16384
    description:
      A list of hart indexes that APLIC should use to address each hart
      that is mentioned in the "interrupts-extended"

additionalProperties: false

required:
  - compatible
  - reg
  - "#interrupt-cells"
  - interrupt-controller
  - interrupts-extended

examples:
  - |
    //Example 1
    interrupt-controller@94000000 {
      compatible = "sophgo,sg2044-aclint-sswi", "thead,c900-aclint-sswi";
      reg = <0x94000000 0x00004000>;
      #interrupt-cells = <0>;
      interrupt-controller;
      interrupts-extended = <&cpu1intc 1>,
                            <&cpu2intc 1>,
                            <&cpu3intc 1>,
                            <&cpu4intc 1>;
    };

  - |
    //Example 2
    interrupt-controller@94000000 {
      compatible = "riscv,aclint-sswi";
      reg = <0x94000000 0x00004000>;
      #interrupt-cells = <0>;
      interrupt-controller;
      interrupts-extended = <&cpu1intc 1>,
                            <&cpu2intc 1>,
                            <&cpu3intc 1>,
                            <&cpu4intc 1>;
      riscv,hart-indexes = <0 1 0x10 0x11>;
    };

...
```

## Documentation/devicetree/bindings/interrupt-controller/sophgo,sg2042-msi.yaml
```yaml
# SPDX-License-Identifier: (GPL-2.0 OR BSD-2-Clause)
%YAML 1.2
---
$id: http://devicetree.org/schemas/interrupt-controller/sophgo,sg2042-msi.yaml#
$schema: http://devicetree.org/meta-schemas/core.yaml#

title: Sophgo SG2042 MSI Controller

maintainers:
  - Chen Wang <unicorn_wang@outlook.com>

description:
  This interrupt controller is in Sophgo SG2042 for transforming interrupts from
  PCIe MSI to PLIC interrupts.

allOf:
  - $ref: /schemas/interrupts.yaml#
  - $ref: /schemas/interrupt-controller/msi-controller.yaml#

properties:
  compatible:
    const: sophgo,sg2042-msi

  reg:
    items:
      - description: msi doorbell address
      - description: clear register

  reg-names:
    items:
      - const: doorbell
      - const: clr

  msi-controller: true

  msi-ranges:
    maxItems: 1

required:
  - compatible
  - reg
  - reg-names
  - msi-controller
  - msi-ranges

unevaluatedProperties: false

examples:
  - |
    #include <dt-bindings/interrupt-controller/irq.h>
    msi-controller@30000000 {
      compatible = "sophgo,sg2042-msi";
      reg = <0x30000000 0x4>, <0x30000008 0x4>;
      reg-names = "doorbell", "clr";
      msi-controller;
      msi-ranges = <&plic 64 IRQ_TYPE_LEVEL_HIGH 32>;
      interrupt-parent = <&plic>;
    };
```

## Documentation/devicetree/bindings/interrupt-controller/thead,c900-aclint-mswi.yaml
```yaml
# SPDX-License-Identifier: (GPL-2.0-only OR BSD-2-Clause)
%YAML 1.2
---
$id: http://devicetree.org/schemas/interrupt-controller/thead,c900-aclint-mswi.yaml#
$schema: http://devicetree.org/meta-schemas/core.yaml#

title: ACLINT Machine-level Software Interrupt Device

maintainers:
  - Inochi Amaoto <inochiama@outlook.com>

properties:
  compatible:
    oneOf:
      - items:
          - enum:
              - sophgo,sg2042-aclint-mswi
              - sophgo,sg2044-aclint-mswi
          - const: thead,c900-aclint-mswi
      - items:
          - const: gf,mips-p8700-aclint-mswi
      - items:
          - enum:
              - anlogic,dr1v90-aclint-mswi
          - const: nuclei,ux900-aclint-mswi

  reg:
    maxItems: 1

  interrupts-extended:
    minItems: 1
    maxItems: 4095

  riscv,hart-indexes:
    $ref: /schemas/types.yaml#/definitions/uint32-array
    minItems: 1
    maxItems: 4095
    description:
      A list of hart indexes that the MSWI device uses to address each hart
      that is mentioned in the "interrupts-extended"

additionalProperties: false

required:
  - compatible
  - reg
  - interrupts-extended

allOf:
  - if:
      properties:
        compatible:
          contains:
            const: gf,mips-p8700-aclint-mswi
    then:
      required:
        - riscv,hart-indexes
    else:
      properties:
        riscv,hart-indexes: false

examples:
  - |
    interrupt-controller@94000000 {
      compatible = "sophgo,sg2042-aclint-mswi", "thead,c900-aclint-mswi";
      interrupts-extended = <&cpu1intc 3>,
                            <&cpu2intc 3>,
                            <&cpu3intc 3>,
                            <&cpu4intc 3>;
      reg = <0x94000000 0x00010000>;
    };

  - |
    mswi@16150000 {
      compatible = "gf,mips-p8700-aclint-mswi";
      reg = <0x16150000 0x4000>;
      interrupts-extended = <&cpu1intc 3>,
                            <&cpu2intc 3>,
                            <&cpu3intc 3>,
                            <&cpu4intc 3>;
      riscv,hart-indexes = <0x0 0x1 0x10 0x11>;
    };
...
```

## Documentation/devicetree/bindings/interrupt-controller/toshiba,tc9564-msigen.yaml
```yaml
# SPDX-License-Identifier: (GPL-2.0-only OR BSD-2-Clause)
%YAML 1.2
---
$id: http://devicetree.org/schemas/interrupt-controller/toshiba,tc9564-msigen.yaml#
$schema: http://devicetree.org/meta-schemas/core.yaml#

title: Toshiba TC9564 MSIGEN Interrupt Controller

maintainers:
  - Daniel Thompson <daniel@riscstar.com>
  - Alex Elder <elder@riscstar.com>

description: |
  The Toshiba TC9564 is an SoC accessed by a host system through the
  upstream PCIe port on the PCIe switch it implements.  The switch
  includes an embedded PCIe endpoint that provides access to various
  SoC peripherals (including an interrupt controller) via its BARs.

  The TC9564 MSIGEN (MSI Generator) provides an interrupt controller
  with 25 hardware interrupt lines.  It aggregates internal interrupts
  and generates a single PCIe MSI to the host.  Each PCIe function
  implements an MSIGEN instance.

  Each MSIGEN uses a gated clock and reset line.  These are provided
  by the clock and reset controllers internal to the TC9564.

allOf:
  - $ref: /schemas/interrupt-controller.yaml#

properties:
  compatible:
    const: toshiba,tc9564-msigen

  reg:
    maxItems: 1

  interrupt-controller: true

  '#interrupt-cells':
    const: 1

  clocks:
    maxItems: 1
    description: Gate clock from the TC9564 clock controller

  resets:
    maxItems: 1
    description: Reset signal from the TC9564 reset controller

required:
  - compatible
  - reg
  - interrupt-controller
  - '#interrupt-cells'

additionalProperties: false

examples:
  - |
    #include <dt-bindings/clock/toshiba,tc9564.h>
    #include <dt-bindings/reset/toshiba,tc9564.h>

    interrupt-controller@f000 {
        compatible = "toshiba,tc9564-msigen";
        reg = <0xf000 0x100>;
        interrupt-controller;
        #interrupt-cells = <1>;
        clocks = <&tc9564_clock0 CLOCK_MSIGEN>;
        resets = <&tc9564_reset0 RESET_MSIGEN>;
    };
```

## Documentation/devicetree/bindings/iommu/brcm,bcm2712-iommu.yaml
```yaml
# SPDX-License-Identifier: (GPL-2.0-only OR BSD-2-Clause)
%YAML 1.2
---
$id: http://devicetree.org/schemas/iommu/brcm,bcm2712-iommu.yaml#
$schema: http://devicetree.org/meta-schemas/core.yaml#

title: Broadcom BCM2712 IOMMU

maintainers:
  - Daniel Drake <dan@reactivated.net>

description:
  The BCM2712 IOMMU provides address translation for various hardware blocks
  on the BCM2712 SoC, such as the VC6 display pipeline.

properties:
  compatible:
    const: brcm,bcm2712-iommu

  reg:
    maxItems: 1

  '#iommu-cells':
    const: 0

  brcm,iommu-cache:
    $ref: /schemas/types.yaml#/definitions/phandle
    description:
      Phandle to the shared IOMMU cache. The IOMMUC is a shared hardware block
      that provides centralized Translation Lookaside Buffer (TLB) caching and
      invalidation.

required:
  - compatible
  - reg
  - '#iommu-cells'
  - brcm,iommu-cache

additionalProperties: false

examples:
  - |
    iommu@5200 {
        compatible = "brcm,bcm2712-iommu";
        reg = <0x5200 0x80>;
        brcm,iommu-cache = <&iommuc>;
        #iommu-cells = <0>;
    };
```

## Documentation/devicetree/bindings/iommu/brcm,bcm2712-iommuc.yaml
```yaml
# SPDX-License-Identifier: (GPL-2.0-only OR BSD-2-Clause)
%YAML 1.2
---
$id: http://devicetree.org/schemas/iommu/brcm,bcm2712-iommuc.yaml#
$schema: http://devicetree.org/meta-schemas/core.yaml#

title: Broadcom BCM2712 Shared IOMMU Cache (IOMMUC)

maintainers:
  - Daniel Drake <dan@reactivated.net>

description: |
  The BCM2712 IOMMU Cache (IOMMUC) provides a shared Translation Lookaside
  Buffer (TLB) cache used by the primary BCM2712 IOMMUs to speed up address
  translations.

properties:
  compatible:
    const: brcm,bcm2712-iommuc

  reg:
    maxItems: 1

required:
  - compatible
  - reg

additionalProperties: false

examples:
  - |
    iommuc: iommu-cache@1001000 {
        compatible = "brcm,bcm2712-iommuc";
        reg = <0x1001000 0x100>;
    };
```

## Documentation/devicetree/bindings/iommu/nvidia,tegra264-cmdqv.yaml
```yaml
# SPDX-License-Identifier: (GPL-2.0-only OR BSD-2-Clause)
%YAML 1.2
---
$schema: http://devicetree.org/meta-schemas/core.yaml#

title: NVIDIA Tegra264 CMDQV
description: |
  The CMDQ-Virtualization hardware block is part of the SMMUv3 implementation
  on Tegra264 SoCs. It assists in virtualizing the command queue for the SMMU.

maintainers:
  - NVIDIA Corporation <linux-tegra@nvidia.com>

properties:
  compatible:
    const: nvidia,tegra264-cmdqv

  reg:
    maxItems: 1

  interrupts:
    maxItems: 1

  interrupt-names:
    items:
      - const: cmdqv

required:
  - compatible
  - reg
  - interrupts
  - interrupt-names

additionalProperties: false

examples:
  - |
    #include <dt-bindings/interrupt-controller/arm-gic.h>
    #include <dt-bindings/interrupt-controller/irq.h>

    cmdqv: cmdqv@8105200000 {
        compatible = "nvidia,tegra264-cmdqv";
        reg = <0x81 0x05200000 0x0 0x00830000>;
        interrupts = <GIC_SPI 19 IRQ_TYPE_LEVEL_HIGH>;
        interrupt-names = "cmdqv";
    };
```

## Documentation/devicetree/bindings/iommu/qcom,apq8064-iommu.yaml
```yaml
# SPDX-License-Identifier: (GPL-2.0-only OR BSD-2-Clause)
%YAML 1.2
---

$id: http://devicetree.org/schemas/iommu/qcom,apq8064-iommu.yaml#
$schema: http://devicetree.org/meta-schemas/core.yaml#

title: Qualcomm APQ8064 IOMMU

maintainers:
  - Will Deacon <will@kernel.org>

description: >
  The MSM IOMMU is an implementation compatible with the ARM VMSA short
  descriptor page tables. It provides address translation for bus masters
  outside of the CPU, each connected to the IOMMU through a port called micro-TLB.

properties:
  compatible:
    const: qcom,apq8064-iommu

  clocks:
    items:
      - description: interface clock for register accesses
      - description: functional clock for bus accesses

  clock-names:
    items:
      - const: smmu_pclk
      - const: iommu_clk

  reg:
    maxItems: 1

  interrupts:
    description: Specifiers for the MMU fault interrupts.
    minItems: 1
    items:
      - description: non-secure mode interrupt
      - description: secure mode interrupt (for instances which supports it)

  "#iommu-cells":
    const: 1
    description: |
      The first cell is a phandle to the IOMMU and
      the second cell is the stream id.
      A single master device can be connected to more than one iommu
      and multiple contexts in each of the iommu.
      So multiple entries are required to list all the iommus and
      the stream ids that the master is connected to.

  qcom,ncb:
    $ref: /schemas/types.yaml#/definitions/uint32
    description: The total number of context banks in the IOMMU.

required:
  - clocks
  - clock-names
  - reg
  - interrupts
  - qcom,ncb

additionalProperties: false

examples:
  - |
    #include <dt-bindings/clock/qcom,mmcc-msm8960.h>

    iommu@7500000 {
            compatible = "qcom,apq8064-iommu";
            #iommu-cells = <1>;
            clock-names =
                "smmu_pclk",
                "iommu_clk";
            clocks =
                <&clk SMMU_AHB_CLK>,
                <&clk MDP_AXI_CLK>;
            reg = <0x07500000 0x100000>;
            interrupts =
                <0 63 0>,
                <0 64 0>;
            qcom,ncb = <2>;
    };
```
