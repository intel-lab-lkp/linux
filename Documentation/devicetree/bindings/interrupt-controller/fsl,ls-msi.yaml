## Documentation/devicetree/bindings/interrupt-controller/renesas,rzv2h-icu.yaml
```yaml
# SPDX-License-Identifier: (GPL-2.0-only OR BSD-2-Clause)
%YAML 1.2
---
$id: http://devicetree.org/schemas/interrupt-controller/renesas,rzv2h-icu.yaml#
$schema: http://devicetree.org/meta-schemas/core.yaml#

title: Renesas RZ/V2H(P) Interrupt Control Unit

maintainers:
  - Fabrizio Castro <fabrizio.castro.jz@renesas.com>
  - Geert Uytterhoeven <geert+renesas@glider.be>

allOf:
  - $ref: /schemas/interrupt-controller.yaml#

description: |
  The Interrupt Control Unit (ICU) handles external interrupts (NMI, IRQ, and
  TINT), error interrupts, DMAC requests, GPT interrupts, and internal
  interrupts.
  It notifies GIC of the relevant interrupts.

properties:
  compatible:
    const: renesas,r9a09g057-icu          # RZ/V2H(P)

  '#interrupt-cells':
    description: The first cell should contain a macro RZV2H_{NMI,IRQn} from
                 file include/dt-bindings/interrupt-controller/icu-rzv2h.h,
                 and the second cell is used to specify the flag. Helper macros
                 for the second cell can also be found in the same header file.
    const: 2

  '#address-cells':
    const: 0

  interrupt-controller: true

  reg:
    maxItems: 1

  interrupts:
    minItems: 58
    items:
      - description: NMI interrupt
      - description: IRQ0 interrupt
      - description: IRQ1 interrupt
      - description: IRQ2 interrupt
      - description: IRQ3 interrupt
      - description: IRQ4 interrupt
      - description: IRQ5 interrupt
      - description: IRQ6 interrupt
      - description: IRQ7 interrupt
      - description: IRQ8 interrupt
      - description: IRQ9 interrupt
      - description: IRQ10 interrupt
      - description: IRQ11 interrupt
      - description: IRQ12 interrupt
      - description: IRQ13 interrupt
      - description: IRQ14 interrupt
      - description: IRQ15 interrupt
      - description: GPIO interrupt, TINT0
      - description: GPIO interrupt, TINT1
      - description: GPIO interrupt, TINT2
      - description: GPIO interrupt, TINT3
      - description: GPIO interrupt, TINT4
      - description: GPIO interrupt, TINT5
      - description: GPIO interrupt, TINT6
      - description: GPIO interrupt, TINT7
      - description: GPIO interrupt, TINT8
      - description: GPIO interrupt, TINT9
      - description: GPIO interrupt, TINT10
      - description: GPIO interrupt, TINT11
      - description: GPIO interrupt, TINT12
      - description: GPIO interrupt, TINT13
      - description: GPIO interrupt, TINT14
      - description: GPIO interrupt, TINT15
      - description: GPIO interrupt, TINT16
      - description: GPIO interrupt, TINT17
      - description: GPIO interrupt, TINT18
      - description: GPIO interrupt, TINT19
      - description: GPIO interrupt, TINT20
      - description: GPIO interrupt, TINT21
      - description: GPIO interrupt, TINT22
      - description: GPIO interrupt, TINT23
      - description: GPIO interrupt, TINT24
      - description: GPIO interrupt, TINT25
      - description: GPIO interrupt, TINT26
      - description: GPIO interrupt, TINT27
      - description: GPIO interrupt, TINT28
      - description: GPIO interrupt, TINT29
      - description: GPIO interrupt, TINT30
      - description: GPIO interrupt, TINT31
      - description: Software interrupt, INTA55_0
      - description: Software interrupt, INTA55_1
      - description: Software interrupt, INTA55_2
      - description: Software interrupt, INTA55_3
      - description: Error interrupt to CA55
      - description: GTCCRA compare match/input capture (U0)
      - description: GTCCRB compare match/input capture (U0)
      - description: GTCCRA compare match/input capture (U1)
      - description: GTCCRB compare match/input capture (U1)

  interrupt-names:
    minItems: 58
    items:
      - const: nmi
      - const: irq0
      - const: irq1
      - const: irq2
      - const: irq3
      - const: irq4
      - const: irq5
      - const: irq6
      - const: irq7
      - const: irq8
      - const: irq9
      - const: irq10
      - const: irq11
      - const: irq12
      - const: irq13
      - const: irq14
      - const: irq15
      - const: tint0
      - const: tint1
      - const: tint2
      - const: tint3
      - const: tint4
      - const: tint5
      - const: tint6
      - const: tint7
      - const: tint8
      - const: tint9
      - const: tint10
      - const: tint11
      - const: tint12
      - const: tint13
      - const: tint14
      - const: tint15
      - const: tint16
      - const: tint17
      - const: tint18
      - const: tint19
      - const: tint20
      - const: tint21
      - const: tint22
      - const: tint23
      - const: tint24
      - const: tint25
      - const: tint26
      - const: tint27
      - const: tint28
      - const: tint29
      - const: tint30
      - const: tint31
      - const: int-ca55-0
      - const: int-ca55-1
      - const: int-ca55-2
      - const: int-ca55-3
      - const: icu-error-ca55
      - const: gpt-u0-gtciada
      - const: gpt-u0-gtciadb
      - const: gpt-u1-gtciada
      - const: gpt-u1-gtciadb

  clocks:
    maxItems: 1

  power-domains:
    maxItems: 1

  resets:
    maxItems: 1

required:
  - compatible
  - reg
  - '#interrupt-cells'
  - '#address-cells'
  - interrupt-controller
  - interrupts
  - interrupt-names
  - clocks
  - power-domains
  - resets

unevaluatedProperties: false

examples:
  - |
    #include <dt-bindings/interrupt-controller/arm-gic.h>
    #include <dt-bindings/clock/renesas-cpg-mssr.h>

    icu: interrupt-controller@10400000 {
        compatible = "renesas,r9a09g057-icu";
        reg = <0x10400000 0x10000>;
        #interrupt-cells = <2>;
        #address-cells = <0>;
        interrupt-controller;
        interrupts = <GIC_SPI 0 IRQ_TYPE_LEVEL_HIGH>,
                     <GIC_SPI 1 IRQ_TYPE_LEVEL_HIGH>,
                     <GIC_SPI 2 IRQ_TYPE_LEVEL_HIGH>,
                     <GIC_SPI 3 IRQ_TYPE_LEVEL_HIGH>,
                     <GIC_SPI 4 IRQ_TYPE_LEVEL_HIGH>,
                     <GIC_SPI 5 IRQ_TYPE_LEVEL_HIGH>,
                     <GIC_SPI 6 IRQ_TYPE_LEVEL_HIGH>,
                     <GIC_SPI 7 IRQ_TYPE_LEVEL_HIGH>,
                     <GIC_SPI 8 IRQ_TYPE_LEVEL_HIGH>,
                     <GIC_SPI 9 IRQ_TYPE_LEVEL_HIGH>,
                     <GIC_SPI 10 IRQ_TYPE_LEVEL_HIGH>,
                     <GIC_SPI 11 IRQ_TYPE_LEVEL_HIGH>,
                     <GIC_SPI 12 IRQ_TYPE_LEVEL_HIGH>,
                     <GIC_SPI 13 IRQ_TYPE_LEVEL_HIGH>,
                     <GIC_SPI 14 IRQ_TYPE_LEVEL_HIGH>,
                     <GIC_SPI 15 IRQ_TYPE_LEVEL_HIGH>,
                     <GIC_SPI 16 IRQ_TYPE_LEVEL_HIGH>,
                     <GIC_SPI 419 IRQ_TYPE_LEVEL_HIGH>,
                     <GIC_SPI 420 IRQ_TYPE_LEVEL_HIGH>,
                     <GIC_SPI 421 IRQ_TYPE_LEVEL_HIGH>,
                     <GIC_SPI 422 IRQ_TYPE_LEVEL_HIGH>,
                     <GIC_SPI 423 IRQ_TYPE_LEVEL_HIGH>,
                     <GIC_SPI 424 IRQ_TYPE_LEVEL_HIGH>,
                     <GIC_SPI 425 IRQ_TYPE_LEVEL_HIGH>,
                     <GIC_SPI 426 IRQ_TYPE_LEVEL_HIGH>,
                     <GIC_SPI 427 IRQ_TYPE_LEVEL_HIGH>,
                     <GIC_SPI 428 IRQ_TYPE_LEVEL_HIGH>,
                     <GIC_SPI 429 IRQ_TYPE_LEVEL_HIGH>,
                     <GIC_SPI 430 IRQ_TYPE_LEVEL_HIGH>,
                     <GIC_SPI 431 IRQ_TYPE_LEVEL_HIGH>,
                     <GIC_SPI 432 IRQ_TYPE_LEVEL_HIGH>,
                     <GIC_SPI 433 IRQ_TYPE_LEVEL_HIGH>,
                     <GIC_SPI 434 IRQ_TYPE_LEVEL_HIGH>,
                     <GIC_SPI 435 IRQ_TYPE_LEVEL_HIGH>,
                     <GIC_SPI 436 IRQ_TYPE_LEVEL_HIGH>,
                     <GIC_SPI 437 IRQ_TYPE_LEVEL_HIGH>,
                     <GIC_SPI 438 IRQ_TYPE_LEVEL_HIGH>,
                     <GIC_SPI 439 IRQ_TYPE_LEVEL_HIGH>,
                     <GIC_SPI 440 IRQ_TYPE_LEVEL_HIGH>,
                     <GIC_SPI 441 IRQ_TYPE_LEVEL_HIGH>,
                     <GIC_SPI 442 IRQ_TYPE_LEVEL_HIGH>,
                     <GIC_SPI 443 IRQ_TYPE_LEVEL_HIGH>,
                     <GIC_SPI 444 IRQ_TYPE_LEVEL_HIGH>,
                     <GIC_SPI 445 IRQ_TYPE_LEVEL_HIGH>,
                     <GIC_SPI 446 IRQ_TYPE_LEVEL_HIGH>,
                     <GIC_SPI 447 IRQ_TYPE_LEVEL_HIGH>,
                     <GIC_SPI 448 IRQ_TYPE_LEVEL_HIGH>,
                     <GIC_SPI 449 IRQ_TYPE_LEVEL_HIGH>,
                     <GIC_SPI 450 IRQ_TYPE_LEVEL_HIGH>,
                     <GIC_SPI 262 IRQ_TYPE_EDGE_RISING>,
                     <GIC_SPI 263 IRQ_TYPE_EDGE_RISING>,
                     <GIC_SPI 264 IRQ_TYPE_EDGE_RISING>,
                     <GIC_SPI 265 IRQ_TYPE_EDGE_RISING>,
                     <GIC_SPI 266 IRQ_TYPE_LEVEL_HIGH>,
                     <GIC_SPI 451 IRQ_TYPE_LEVEL_HIGH>,
                     <GIC_SPI 452 IRQ_TYPE_LEVEL_HIGH>,
                     <GIC_SPI 453 IRQ_TYPE_LEVEL_HIGH>,
                     <GIC_SPI 454 IRQ_TYPE_LEVEL_HIGH>;
        interrupt-names = "nmi",
                          "irq0", "irq1", "irq2", "irq3",
                          "irq4", "irq5", "irq6", "irq7",
                          "irq8", "irq9", "irq10", "irq11",
                          "irq12", "irq13", "irq14", "irq15",
                          "tint0", "tint1", "tint2", "tint3",
                          "tint4", "tint5", "tint6", "tint7",
                          "tint8", "tint9", "tint10", "tint11",
                          "tint12", "tint13", "tint14", "tint15",
                          "tint16", "tint17", "tint18", "tint19",
                          "tint20", "tint21", "tint22", "tint23",
                          "tint24", "tint25", "tint26", "tint27",
                          "tint28", "tint29", "tint30", "tint31",
                          "int-ca55-0", "int-ca55-1",
                          "int-ca55-2", "int-ca55-3",
                          "icu-error-ca55",
                          "gpt-u0-gtciada", "gpt-u0-gtciadb",
                          "gpt-u1-gtciada", "gpt-u1-gtciadb";
        clocks = <&cpg CPG_MOD 0x5>;
        power-domains = <&cpg>;
        resets = <&cpg 0x36>;
    };
```

## Documentation/devicetree/bindings/interrupt-controller/renesas,sh7751-intc.yaml
```yaml
# SPDX-License-Identifier: GPL-2.0-only OR BSD-2-Clause
%YAML 1.2
---
$id: http://devicetree.org/schemas/interrupt-controller/renesas,sh7751-intc.yaml#
$schema: http://devicetree.org/meta-schemas/core.yaml#

title: Renesas SH7751 Interrupt Controller

maintainers:
  - Yoshinori Sato <ysato@users.sourceforge.jp>

properties:
  compatible:
    items:
      - const: renesas,sh7751-intc

  '#interrupt-cells':
    # an interrupt index and flags, as defined in interrupts.txt in
    # this directory
    const: 2

  interrupt-controller: true

  reg:
    maxItems: 2

  reg-names:
    items:
      - const: ICR
      - const: INTPRI00

  renesas,icr-irlm:
    type: boolean
    description: Use ICR.IRLM=1

  renesas,ipr-map:
    $ref: /schemas/types.yaml#/definitions/uint32-array
    description: |
      IRQ to IPR mapping definition.

required:
  - compatible
  - '#interrupt-cells'
  - interrupt-controller
  - reg
  - reg-names
  - renesas,ipr-map

additionalProperties: false

examples:
  - |
        shintc: interrupt-controller@ffd00000 {
                compatible = "renesas,sh7751-intc";
                #interrupt-cells = <2>;
                interrupt-controller;
                reg = <0xffd00000 14>, <0xfe080000 128>;
                renesas,ipr-map = IPRDEF(0x240, IPRD, IPR_B12), /* IRL0 */
                                  IPRDEF(0x2a0, IPRD, IPR_B8),  /* IRL1 */
                                  IPRDEF(0x300, IPRD, IPR_B4),  /* IRL2 */
                                  IPRDEF(0x360, IPRD, IPR_B0),  /* IRL3 */
                                  IPRDEF(0x400, IPRA, IPR_B12), /* TMU0 */
                                  IPRDEF(0x420, IPRA, IPR_B8),  /* TMU1 */
                                  IPRDEF(0x440, IPRA, IPR_B4),  /* TMU2 TNUI */
                                  IPRDEF(0x460, IPRA, IPR_B4),  /* TMU2 TICPI */
                                  IPRDEF(0x480, IPRA, IPR_B0),  /* RTC ATI */
                                  IPRDEF(0x4a0, IPRA, IPR_B0),  /* RTC PRI */
                                  IPRDEF(0x4c0, IPRA, IPR_B0),  /* RTC CUI */
                                  IPRDEF(0x4e0, IPRB, IPR_B4),  /* SCI ERI */
                                  IPRDEF(0x500, IPRB, IPR_B4),  /* SCI RXI */
                                  IPRDEF(0x520, IPRB, IPR_B4),  /* SCI TXI */
                                  IPRDEF(0x540, IPRB, IPR_B4),  /* SCI TEI */
                                  IPRDEF(0x560, IPRB, IPR_B12), /* WDT */
                                  IPRDEF(0x580, IPRB, IPR_B8),  /* REF RCMI */
                                  IPRDEF(0x5a0, IPRB, IPR_B4),  /* REF ROVI */
                                  IPRDEF(0x600, IPRC, IPR_B0),  /* H-UDI */
                                  IPRDEF(0x620, IPRC, IPR_B12), /* GPIO */
                                  IPRDEF(0x640, IPRC, IPR_B8),  /* DMAC DMTE0 */
                                  IPRDEF(0x660, IPRC, IPR_B8),  /* DMAC DMTE1 */
                                  IPRDEF(0x680, IPRC, IPR_B8),  /* DMAC DMTE2 */
                                  IPRDEF(0x6a0, IPRC, IPR_B8),  /* DMAC DMTE3 */
                                  IPRDEF(0x6c0, IPRC, IPR_B8),  /* DMAC DMAE */
                                  IPRDEF(0x700, IPRC, IPR_B4),  /* SCIF ERI */
                                  IPRDEF(0x720, IPRC, IPR_B4),  /* SCIF RXI */
                                  IPRDEF(0x740, IPRC, IPR_B4),  /* SCIF BRI */
                                  IPRDEF(0x760, IPRC, IPR_B4),  /* SCIF TXI */
                                  IPRDEF(0x780, IPRC, IPR_B8),  /* DMAC DMTE4 */
                                  IPRDEF(0x7a0, IPRC, IPR_B8),  /* DMAC DMTE5 */
                                  IPRDEF(0x7c0, IPRC, IPR_B8),  /* DMAC DMTE6 */
                                  IPRDEF(0x7e0, IPRC, IPR_B8),  /* DMAC DMTE7 */
                                  IPRDEF(0xa00, INTPRI00, IPR_B0),      /* PCIC PCISERR */
                                  IPRDEF(0xa20, INTPRI00, IPR_B4),      /* PCIC CIDMA3 */
                                  IPRDEF(0xa40, INTPRI00, IPR_B4),      /* PCIC CIDMA2 */
                                  IPRDEF(0xa60, INTPRI00, IPR_B4),      /* PCIC PCIDMA1 */
                                  IPRDEF(0xa80, INTPRI00, IPR_B4),      /* PCIC PCIDMA0 */
                                  IPRDEF(0xaa0, INTPRI00, IPR_B4),      /* PCIC PCIPWON */
                                  IPRDEF(0xac0, INTPRI00, IPR_B4),      /* PCIC PCIPWDWN */
                                  IPRDEF(0xae0, INTPRI00, IPR_B4),      /* PCIC PCIERR */
                                  IPRDEF(0xb00, INTPRI00, IPR_B8),      /* TMU3 */
                                  IPRDEF(0xb80, INTPRI00, IPR_B12);     /* TMU4 */
        };
...
```
