## Documentation/devicetree/bindings/interrupt-controller/fsl,ls-msi.yaml
```yaml
# SPDX-License-Identifier: (GPL-2.0-only OR BSD-2-Clause)
%YAML 1.2
---
$id: http://devicetree.org/schemas/interrupt-controller/fsl,ls-msi.yaml#
$schema: http://devicetree.org/meta-schemas/core.yaml#

title: Freescale Layerscape SCFG PCIe MSI controller

description: |
  This interrupt controller hardware is a second level interrupt controller that
  is hooked to a parent interrupt controller: e.g: ARM GIC for ARM-based
  platforms. If interrupt-parent is not provided, the default parent interrupt
  controller will be used.

  Each PCIe node needs to have property msi-parent that points to
  MSI controller node

maintainers:
  - Frank Li <Frank.Li@nxp.com>

properties:
  compatible:
    enum:
      - fsl,ls1021a-msi
      - fsl,ls1043a-msi
      - fsl,ls1046a-msi
      - fsl,ls1043a-v1.1-msi
      - fsl,ls1012a-msi

  reg:
    maxItems: 1

  msi-controller: true

  interrupts:
    minItems: 1
    maxItems: 4

required:
  - compatible
  - reg
  - msi-controller
  - interrupts

additionalProperties: false

allOf:
  - if:
      properties:
        compatible:
          contains:
            enum:
              - fsl,ls1046a-msi
    then:
      properties:
        interrupts:
          minItems: 4
    else:
      properties:
        interrupts:
          maxItems: 1

examples:
  - |
    #include <dt-bindings/interrupt-controller/arm-gic.h>

    interrupt-controller@1571000 {
        compatible = "fsl,ls1043a-msi";
        reg = <0x1571000 0x8>;
        msi-controller;
        interrupts = <GIC_SPI 116 IRQ_TYPE_LEVEL_HIGH>;
    };
```

## Documentation/devicetree/bindings/interrupt-controller/intel,soc-msi.yaml
```yaml
# SPDX-License-Identifier: (GPL-2.0 OR BSD-2-Clause)
# Copyright 2025 TDT AG.
%YAML 1.2
---
$id: http://devicetree.org/schemas/interrupt-controller/intel,soc-msi.yaml#
$schema: http://devicetree.org/meta-schemas/core.yaml#

title: Intel LGM Interrupt Controller

maintainers:
  - Florian Eckert <fe@dev.tdt.de>

description: |
  This interrupt controller is found in the Intel LGM.

properties:
  compatible:
    items:
      - enum:
          - intel,soc-msi.yaml

  reg:
    maxItems: 1

  interrupt-controller: true

  '#interrupt-cells':
    const: 2

required:
  - compatible
  - reg
  - interrupt-controller
  - '#interrupt-cells'

additionalProperties: false

examples:
  - |
    soc_msi: soc_msi@e00e0000 {
        compatible = "intel,soc-msi";
        reg = <0xe00e0000 0x800>;
        interrupt-controller;
        #interrupt-cells = <1>;
    };
```

## Documentation/devicetree/bindings/interrupt-controller/lsi,zevio-intc.yaml
```yaml
# SPDX-License-Identifier: (GPL-2.0-only OR BSD-2-Clause)
%YAML 1.2
---
$id: http://devicetree.org/schemas/interrupt-controller/lsi,zevio-intc.yaml#
$schema: http://devicetree.org/meta-schemas/core.yaml#

title: TI NSPIRE interrupt controller

maintainers:
  - Andrew Davis <afd@ti.com>

allOf:
  - $ref: /schemas/interrupt-controller.yaml#

properties:
  compatible:
    const: lsi,zevio-intc

  reg:
    maxItems: 1

  interrupt-controller: true

  "#interrupt-cells":
    const: 1

required:
  - compatible
  - reg
  - "#interrupt-cells"
  - interrupt-controller

additionalProperties: false

examples:
  - |
    interrupt-controller@dc000000 {
        compatible = "lsi,zevio-intc";
        reg = <0xdc000000 0x1000>;
        interrupt-controller;
        #interrupt-cells = <1>;
    };
```

## Documentation/devicetree/bindings/interrupt-controller/nxp,lpc3220-mic.yaml
```yaml
# SPDX-License-Identifier: (GPL-2.0-only OR BSD-2-Clause)
%YAML 1.2
---
$id: http://devicetree.org/schemas/interrupt-controller/nxp,lpc3220-mic.yaml#
$schema: http://devicetree.org/meta-schemas/core.yaml#

title: NXP LPC32xx MIC, SIC1 and SIC2 Interrupt Controllers

maintainers:
  - Vladimir Zapolskiy <vz@mleia.com>

properties:
  compatible:
    enum:
      - nxp,lpc3220-mic
      - nxp,lpc3220-sic

  reg:
    maxItems: 1

  interrupt-controller: true

  '#interrupt-cells':
    const: 2

  interrupts:
    items:
      - description:
          IRQ number.
      - description: |
          IRQ type. Can be one of:

              IRQ_TYPE_EDGE_RISING = Low-to-high edge triggered,
              IRQ_TYPE_EDGE_FALLING = High-to-low edge triggered,
              IRQ_TYPE_LEVEL_HIGH = Active high level-sensitive,
              IRQ_TYPE_LEVEL_LOW = Active low level-sensitive.

          Reset value is IRQ_TYPE_LEVEL_LOW.

required:
  - compatible
  - reg
  - interrupt-controller
  - '#interrupt-cells'

allOf:
  - if:
      properties:
        compatible:
          contains:
            const: nxp,lpc3220-sic
    then:
      required:
        - interrupts
    else:
      properties:
        interrupts: false

additionalProperties: false

examples:
  - |
    #include <dt-bindings/interrupt-controller/irq.h>

    mic: interrupt-controller@40008000 {
      compatible = "nxp,lpc3220-mic";
      reg = <0x40008000 0x4000>;
      interrupt-controller;
      #interrupt-cells = <2>;
    };

    sic1: interrupt-controller@4000c000 {
      compatible = "nxp,lpc3220-sic";
      reg = <0x4000c000 0x4000>;
      interrupt-controller;
      #interrupt-cells = <2>;
      interrupt-parent = <&mic>;
      interrupts = <0 IRQ_TYPE_LEVEL_LOW>,
                  <30 IRQ_TYPE_LEVEL_LOW>;
    };
```

## Documentation/devicetree/bindings/interrupt-controller/qcom,msm-vic.yaml
```yaml
# SPDX-License-Identifier: GPL-2.0
# qualcomm,msm-vic.yaml - Device Tree binding for Qualcomm MSM VIC interrupt controller

description: >
  Qualcomm MSM VIC (Vector Interrupt Controller). This interrupt controller
  handles normal and wakeup interrupts and supports mapping to the
  Qualcomm SMSM system.

compatible: ["qcom,msm-vic"]

properties:
  interrupt-controller:
    description: "Identifies this node as an interrupt controller"
    required: true
    type: boolean

  #interrupt-cells:
    description: "Specifies the number of cells needed to encode an interrupt"
    required: true
    type: integer
    default: 1

  reg:
    description: "Base address and size of the VIC registers"
    required: true
    type: reg

  num-irqs:
    description: "Total number of interrupts supported by this VIC"
    required: true
    type: integer

  num-gpio-irqs:
    description: "Number of GPIO interrupts routed through this VIC"
    required: true
    type: integer

  vic-num-regs:
    description: "Number of VIC register banks"
    required: true
    type: integer

  irq-mapping:
    description:
      Mapping of VIC IRQ numbers to SMSM wakeup channels. Each mapping
      consists of two integers: <VIC IRQ> <SMSM channel>.  
      "SMSM_FAKE_IRQ" can be used for virtual/fake wakeup interrupts.
    required: true
    type: list
    items:
      - vic-irq: integer
        smsm-channel: integer

examples:
  - |
    #include <dt-bindings/interrupt-controller/qcom-vic.h>
    intc: interrupt-controller@ac000000 {
        compatible = "qcom,msm-vic";
        interrupt-controller;
        #interrupt-cells = <1>;
        reg = <0xac000000 0x1000>;
        num-irqs = <64>;
        num-gpio-irqs = <165>;
        vic-num-regs = <2>;
        irq-mapping = <
            17 1   /* INT_MDDI_EXT -> SMSM 1 */
            16 2   /* INT_MDDI_PRI -> SMSM 2 */
            18 3   /* INT_MDDI_CLIENT -> SMSM 3 */
            15 4   /* INT_USB_OTG -> SMSM 4 */
            0 SMSM_FAKE_IRQ   /* INT_A9_M2A_0 -> SMSM_FAKE_IRQ */
        >;
    }
```

## Documentation/devicetree/bindings/interrupt-controller/qcom,msm8660-mpm.yaml
```yaml
# SPDX-License-Identifier: (GPL-2.0-only OR BSD-2-Clause)
%YAML 1.2
---
$id: http://devicetree.org/schemas/interrupt-controller/qcom,msm8660-mpm.yaml#
$schema: http://devicetree.org/meta-schemas/core.yaml#

title: Qualcomm MSM8x60 MPM wakeup interrupt controller

maintainers:
  - Herman van Hazendonk <github.com@herrie.org>

description: |
  The MSM Power Manager (MPM) on the MSM8x60 family (MSM8260/MSM8660/
  APQ8060) is an always-on hardware block that keeps a set of wake
  interrupts alive while the application processor is powered down.

  The vMPM (virtual MPM) registers live INSIDE the RPM control block:
  the request window (ENABLE, DETECT_CTL, POLARITY, CLEAR) starts at
  RPM_BASE + 0x9d8 and the status window starts 0x420 above the
  request window. The reg property points at this vMPM sub-region;
  the qcom,rpm-msm8660 driver maps the surrounding RPM control area
  for its own use, so the two mappings overlap but neither claims
  exclusive ownership of the other's range.

  Notification of new wake-source configuration is delivered via the
  qcom-apcs-ipc mailbox (writing GCC + 0x008 bit 1).

  This binding is MSM8x60-specific. Newer Qualcomm SoCs (sm6375, etc.)
  use the qcom,mpm binding which assumes a dedicated MPM SRAM region
  and an IPCC mailbox - neither holds on MSM8x60. The driver lives at
  drivers/irqchip/irq-msm8660-mpm.c.

allOf:
  - $ref: /schemas/interrupt-controller.yaml#

properties:
  compatible:
    const: qcom,msm8660-mpm

  reg:
    maxItems: 1
    description: |
      vMPM register window inside the RPM control block. Must cover
      the request registers at offset 0 of the window and the status
      registers at offset 0x420 of the window. A length of 0x440 is
      sufficient for the four-word request banks and the status bank.

  interrupts:
    maxItems: 1
    description:
      IPC IRQ raised by MPM when one of the enabled wake sources fires.
      On MSM8x60 this is wired to GIC SPI 2.

  mboxes:
    maxItems: 1
    description:
      Mailbox channel used to notify MPM that the vMPM request
      registers have been updated. On MSM8x60 this is the
      qcom-apcs-ipc mailbox channel 1 (writes GCC + 0x008 bit 1).

  interrupt-controller: true

  '#interrupt-cells':
    const: 2
    description:
      First cell is the MPM pin number / parent GIC SPI; second cell
      is the trigger type.

  qcom,mpm-pin-count:
    $ref: /schemas/types.yaml#/definitions/uint32
    description: Total number of MPM pins exposed.

  qcom,mpm-pin-map:
    $ref: /schemas/types.yaml#/definitions/uint32-matrix
    items:
      items:
        - description: MPM pin number
        - description: GIC SPI number this pin maps to
    description: |
      List of (MPM-pin, GIC-SPI) tuples for wake sources that have a
      corresponding GIC IRQ. Consumers route their interrupts through
      the MPM hierarchical irqdomain to take advantage of these
      mappings.

      Raw wake pins like SDC3/4 DATx (pins 21-24) are NOT listed
      here - they have no GIC SPI mapping and are accessed through
      the msm8660_mpm_set_pin_wake() / msm8660_mpm_enable_pin() C API
      by consumer drivers.

required:
  - compatible
  - reg
  - interrupts
  - mboxes
  - interrupt-controller
  - '#interrupt-cells'
  - qcom,mpm-pin-count

additionalProperties: false

examples:
  - |
    #include <dt-bindings/interrupt-controller/arm-gic.h>

    soc {
        #address-cells = <1>;
        #size-cells = <1>;

        msm8660_mpm: interrupt-controller@1049d8 {
            compatible = "qcom,msm8660-mpm";
            reg = <0x001049d8 0x440>;
            interrupts = <GIC_SPI 2 IRQ_TYPE_EDGE_RISING>;
            mboxes = <&gcc_ipc 1>;
            interrupt-controller;
            #interrupt-cells = <2>;
            interrupt-parent = <&intc>;
            qcom,mpm-pin-count = <64>;
            qcom,mpm-pin-map = <25 100>,
                               <26 50>,
                               <27 79>;
        };
    };
```

## Documentation/devicetree/bindings/interrupt-controller/realtek,intc.yaml
```yaml
# SPDX-License-Identifier: (GPL-2.0-only OR BSD-2-Clause)
%YAML 1.2
---
$id: http://devicetree.org/schemas/interrupt-controller/realtek,intc.yaml#
$schema: http://devicetree.org/meta-schemas/core.yaml#

title: Realtek DHC SoCs Interrupt Controller

maintainers:
  - James Tai <james.tai@realtek.com>

description:
  This interrupt controller is a component of Realtek DHC (Digital Home Center)
  SoCs and is designed to receive interrupts from peripheral devices.

  Each DHC SoC has two sets of interrupt controllers, each capable of
  handling up to 32 interrupts.

allOf:
  - $ref: /schemas/interrupt-controller.yaml#

properties:
  compatible:
    enum:
      - realtek,rtd1319-intc-iso
      - realtek,rtd1319-intc-misc
      - realtek,rtd1319d-intc-iso
      - realtek,rtd1319d-intc-misc
      - realtek,rtd1325-intc-iso
      - realtek,rtd1325-intc-misc
      - realtek,rtd1619b-intc-iso
      - realtek,rtd1619b-intc-misc

  reg:
    maxItems: 1

  interrupt-controller: true

  '#interrupt-cells':
    const: 1

  '#address-cells':
    const: 0

  interrupts:
    description: |
      Contains the GIC SPI IRQs mapped to the external interrupt lines.
    minItems: 2
    maxItems: 4

required:
  - compatible
  - reg
  - interrupt-controller
  - '#interrupt-cells'
  - '#address-cells'
  - interrupts

additionalProperties: false

examples:
  - |
    #include <dt-bindings/interrupt-controller/irq.h>
    #include <dt-bindings/interrupt-controller/arm-gic.h>

    realtek_iso_intc: interrupt-controller@40 {
      compatible = "realtek,rtd1319-intc-iso";
      reg = <0x00 0x40>;
      interrupt-parent = <&gic>;
      interrupts = <GIC_SPI 41 IRQ_TYPE_LEVEL_HIGH>,
                   <GIC_SPI 0 IRQ_TYPE_LEVEL_HIGH>;
      interrupt-controller;
      #address-cells = <0>;
      #interrupt-cells = <1>;
    };
...
```

## Documentation/devicetree/bindings/interrupt-controller/realtek,rtd1319d-intc.yaml
```yaml
# SPDX-License-Identifier: (GPL-2.0-only OR BSD-2-Clause)
%YAML 1.2
---
$id: http://devicetree.org/schemas/interrupt-controller/realtek,rtd1319d-intc.yaml#
$schema: http://devicetree.org/meta-schemas/core.yaml#

title: Realtek DHC RTD1319D Interrupt Controller Device Tree Bindings

description:
  This interrupt controller is a component of Realtek DHC RTD1319D and
  is designed to receive interrupts from peripheral devices.

  Each DHC SoC has two sets of interrupt controllers, each capable of
  handling up to 32 interrupts.

maintainers:
  - James Tai <james.tai@realtek.com>

allOf:
  - $ref: /schemas/interrupt-controller.yaml#

properties:
  "#interrupt-cells":
    const: 1

  compatible:
    enum:
      - realtek,rtd1319d-intc-iso
      - realtek,rtd1319d-intc-misc

  "#address-cells":
    const: 0

  interrupt-controller: true

  interrupts-extended:
    minItems: 1
    maxItems: 4

  reg:
    maxItems: 1

required:
  - "#interrupt-cells"
  - "#address-cells"
  - compatible
  - interrupt-controller
  - interrupts-extended
  - reg

additionalProperties: false

examples:
  - |
    #include <dt-bindings/interrupt-controller/irq.h>
    #include <dt-bindings/interrupt-controller/arm-gic.h>

    rtd1319d_iso_irq: interrupt-controller@40 {
      compatible = "realtek,rtd1319d-intc-iso";
      reg = <0x00 0x40>;
      interrupts-extended = <&gic GIC_SPI 41 IRQ_TYPE_LEVEL_HIGH>,
                            <&gic GIC_SPI 0 IRQ_TYPE_LEVEL_HIGH>;
      interrupt-controller;
      #address-cells = <0>;
      #interrupt-cells = <1>;
    };

    rtd1319d_misc_irq: interrupt-controller@80 {
      compatible = "realtek,rtd1319d-intc-misc";
      reg = <0x00 0x80>;
      interrupts-extended = <&gic GIC_SPI 40 IRQ_TYPE_LEVEL_HIGH>,
                            <&gic GIC_SPI 89 IRQ_TYPE_LEVEL_HIGH>,
                            <&gic GIC_SPI 90 IRQ_TYPE_LEVEL_HIGH>,
                            <&gic GIC_SPI 39 IRQ_TYPE_LEVEL_HIGH>;
      interrupt-controller;
      #address-cells = <0>;
      #interrupt-cells = <1>;
    };
...
```
