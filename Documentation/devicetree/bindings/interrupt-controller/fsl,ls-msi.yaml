## Documentation/devicetree/bindings/iommu/qcom,qsmmuv500-tbu.yaml
```yaml
# SPDX-License-Identifier: (GPL-2.0-only OR BSD-2-Clause)
%YAML 1.2
---
$id: http://devicetree.org/schemas/iommu/qcom,qsmmuv500-tbu.yaml#
$schema: http://devicetree.org/meta-schemas/core.yaml#

title: Qualcomm TBU (Translation Buffer Unit)

maintainers:
  - Georgi Djakov <quic_c_gdjako@quicinc.com>

description:
  TBU nodes represent Translation Buffer Units in an ARM SMMU. Each TBU node
  should be a child node of the SMMU in the device tree.

properties:
  compatible:
    enum:
      - qcom,qsmmuv500-tbu

  reg:
    items:
      - description: Address and size of the TBU's register space.

  reg-names:
    items:
      - const: base

  clocks:
    maxItems: 1

  interconnects:
    maxItems: 1

  power-domains:
    maxItems: 1

  qcom,stream-id-range:
    $ref: /schemas/types.yaml#/definitions/uint32-array
    description: Stream ID range (address and size) that is assigned by the TBU

required:
  - compatible
  - reg
  - interconnects
  - qcom,stream-id-range

additionalProperties: false

examples:
  - |
    #include <dt-bindings/clock/qcom,gcc-sdm845.h>
    #include <dt-bindings/interconnect/qcom,sdm845.h>
    #include <dt-bindings/power/qcom-rpmpd.h>


    tbu@150e1000 {
        compatible = "qcom,qsmmuv500-tbu";
        reg = <0x150e1000 0x1000>;
        reg-names = "base";
        clocks = <&gcc GCC_AGGRE_NOC_PCIE_TBU_CLK>;
        power-domains = <&gcc HLOS1_VOTE_AGGRE_NOC_MMU_PCIE_TBU_GDSC>;
        interconnects = <&system_noc MASTER_GNOC_SNOC 0 &config_noc SLAVE_IMEM_CFG 0>;
        qcom,stream-id-range = <0x1c00 0x400>;
    };

...
```

## Documentation/devicetree/bindings/ipmi/aspeed,ast2400-ibt-bmc.yaml
```yaml
# SPDX-License-Identifier: (GPL-2.0-only OR BSD-2-Clause)
%YAML 1.2
---
$id: http://devicetree.org/schemas/ipmi/aspeed,ast2400-ibt-bmc.yaml#
$schema: http://devicetree.org/meta-schemas/core.yaml#

title: Aspeed Block Transfer (BT) IPMI interface

maintainers:
  - Joel Stanley <joel@jms.id.au>

properties:
  compatible:
    enum:
      - aspeed,ast2400-ibt-bmc
      - aspeed,ast2500-ibt-bmc
      - aspeed,ast2600-ibt-bmc

  reg:
    maxItems: 1

  clocks:
    maxItems: 1

  interrupts:
    maxItems: 1

  aspeed,lpc-io-reg:
    $ref: /schemas/types.yaml#/definitions/uint32-array
    maxItems: 1
    description: |
      The host CPU LPC IO address for the BT device.

  aspeed,lpc-interrupts:
    $ref: /schemas/types.yaml#/definitions/uint32-array
    minItems: 2
    maxItems: 2
    description: |
      A 2-cell property expressing the LPC SerIRQ number and the interrupt
      level/sense encoding (specified in the standard fashion).

      Note that the generated interrupt is issued from the BMC to the host, and
      thus the target interrupt controller is not captured by the BMC's
      devicetree.

required:
  - compatible
  - reg
  - clocks

additionalProperties: false

examples:
  - |
    #include <dt-bindings/clock/aspeed-clock.h>
    #include <dt-bindings/interrupt-controller/irq.h>

    bt@1e789140 {
        compatible = "aspeed,ast2400-ibt-bmc";
        reg = <0x1e789140 0x18>;
        interrupts = <8>;
        clocks = <&syscon ASPEED_CLK_GATE_LCLK>;
        aspeed,lpc-io-reg = <0xe4>;
        aspeed,lpc-interrupts = <10 IRQ_TYPE_LEVEL_LOW>;
    };
```

## Documentation/devicetree/bindings/ipmi/ipmb-dev.yaml
```yaml
# SPDX-License-Identifier: (GPL-2.0-only OR BSD-2-Clause)
%YAML 1.2
---
$id: http://devicetree.org/schemas/ipmi/ipmb-dev.yaml#
$schema: http://devicetree.org/meta-schemas/core.yaml#

title: The Intelligent Platform Management Bus(IPMB) Device

description: |
  The IPMB is an I2C bus which provides interconnection between Baseboard
  Management Controller(BMC) and chassis electronics. The BMC sends IPMI
  requests to intelligent controllers like Satellite Management Controller(MC)
  device via IPMB and the device sends a response back to the BMC.
  This device binds backend Satelite MC which is a I2C slave device with the BMC
  for management purpose. A miscalleneous device provices a user space program
  to communicate with kernel and backend device. Some IPMB devices only support
  I2C protocol instead of SMB protocol.

  IPMB communications protocol Specification V1.0
  https://www.intel.com/content/dam/www/public/us/en/documents/product-briefs/ipmp-spec-v1.0.pdf

maintainers:
  - Ninad Palsule <ninad@linux.ibm.com>

properties:
  compatible:
    enum:
      - ipmb-dev

  reg:
    maxItems: 1

  i2c-protocol:
    description:
      Use I2C block transfer instead of SMBUS block transfer.
    type: boolean

required:
  - compatible
  - reg

additionalProperties: false

examples:
  - |
    i2c {
        #address-cells = <1>;
        #size-cells = <0>;

        ipmb-dev@10 {
            compatible = "ipmb-dev";
            reg = <0x10>;
            i2c-protocol;
        };
    };
```

## Documentation/devicetree/bindings/ipmi/ssif-bmc.yaml
```yaml
# SPDX-License-Identifier: (GPL-2.0-only OR BSD-2-Clause)
%YAML 1.2
---
$id: http://devicetree.org/schemas/ipmi/ssif-bmc.yaml#
$schema: http://devicetree.org/meta-schemas/core.yaml#

title: SSIF IPMI BMC interface

description: SSIF IPMI BMC device bindings

maintainers:
  - Quan Nguyen <quan@os.amperecomputing.com>

properties:
  compatible:
    enum:
      - ssif-bmc

  reg:
    maxItems: 1

  timeout-ms:
    minimum: 0
    maximum: 4294967295
    default: 500
    description: Response timeout in millisecond.

required:
  - compatible
  - reg

additionalProperties: false

examples:
  - |
    i2c {
        #address-cells = <1>;
        #size-cells = <0>;

        ssif-bmc@10 {
            compatible = "ssif-bmc";
            reg = <0x10>;
        };
    };
```

## Documentation/devicetree/bindings/leds/adi,ltc3220.yaml
```yaml
# SPDX-License-Identifier: (GPL-2.0-only OR BSD-2-Clause)
%YAML 1.2
---
$id: http://devicetree.org/schemas/leds/adi,ltc3220.yaml#
$schema: http://devicetree.org/meta-schemas/core.yaml#

title: Analog Devices LTC3220 LED Driver

maintainers:
  - Edelweise Escala <edelweise.escala@analog.com>

description:
  The LTC3220 is a multi-display LED driver, which contains a high-efficiency,
  low-noise charge pump to provide power to up to 18 LED current sources.
  The LEDs are individually configurable to 64-step linear brightness control,
  blinking and gradation control via 2-wire I2C interface.

  For more product information please see the link below
    https://www.analog.com/en/products/ltc3220.html

properties:
  compatible:
    const: adi,ltc3220

  reg:
    maxItems: 1

  '#address-cells':
    const: 1

  '#size-cells':
    const: 0

  reset-gpios:
    maxItems: 1

patternProperties:
  '^led@([1-9]|1[0-8])$':
    type: object
    $ref: /schemas/leds/common.yaml#
    unevaluatedProperties: false
    properties:
      reg:
        description:
          Output channel for the LED (1-18 maps to LED outputs D1-D18).
          For aggregated LED control, define only one LED node with reg = <1>
          and use led-sources to list all controlled outputs. Only reg 1 should
          be present when using led-sources.
        minimum: 1
        maximum: 18

    required:
      - reg

required:
  - compatible
  - reg

additionalProperties: false

examples:
  - |
    // Independent LEDs
    #include <dt-bindings/gpio/gpio.h>
    #include <dt-bindings/leds/common.h>

    i2c {
        #address-cells = <1>;
        #size-cells = <0>;

        led-controller@1c {
            compatible = "adi,ltc3220";
            reg = <0x1c>;
            #address-cells = <1>;
            #size-cells = <0>;
            reset-gpios = <&gpio 17 GPIO_ACTIVE_LOW>;

            led@1 {
                reg = <1>;
                function = LED_FUNCTION_INDICATOR;
                function-enumerator = <1>;
            };

            led@2 {
                reg = <2>;
                function = LED_FUNCTION_INDICATOR;
                function-enumerator = <2>;
            };

            led@3 {
                reg = <3>;
                function = LED_FUNCTION_INDICATOR;
                function-enumerator = <3>;
            };
        };
    };

  - |
    // Aggregated LED
    #include <dt-bindings/leds/common.h>

    i2c {
        #address-cells = <1>;
        #size-cells = <0>;

        led-controller@1c {
            compatible = "adi,ltc3220";
            reg = <0x1c>;
            #address-cells = <1>;
            #size-cells = <0>;

            led@1 {
                reg = <1>;
                led-sources = <1 2 3 4 5 6 7 8 9 10 11 12 13 14 15 16 17 18>;
                function = LED_FUNCTION_BACKLIGHT;
            };
        };
    };

...
```

## Documentation/devicetree/bindings/leds/ams,as3645a.yaml
```yaml
# SPDX-License-Identifier: (GPL-2.0-only OR BSD-2-Clause)
%YAML 1.2
---
$id: http://devicetree.org/schemas/leds/ams,as3645a.yaml#
$schema: http://devicetree.org/meta-schemas/core.yaml#

title: Analog Devices AS3645A LED Controller

maintainers:
  - Sakari Ailus <sakari.ailus@iki.fi>

description: |
  The AS3645A flash LED controller can drive two LEDs, one high current
  flash LED and one indicator LED. The high current flash LED can be
  used in torch mode as well.

properties:
  compatible:
    const: ams,as3645a

  "#address-cells":
    const: 1

  "#size-cells":
    const: 0

  reg:
    maxItems: 1

  led@0:
    type: object
    $ref: common.yaml#
    unevaluatedProperties: false

    properties:
      reg:
        const: 0

      flash-timeout-us:
        minimum: 100000
        maximum: 850000
        description: |
          Flash timeout in microseconds. Must be divisible by 50000

      flash-max-microamp:
        minimum: 200000
        maximum: 500000
        description: |
          Maximum flash current in microamperes. Must be divisible by 20000

      led-max-microamp:
        minimum: 20000
        maximum: 160000
        description: |
          Maximum torch (assist) current in microamperes Must be divisible by 20000

      ams,input-max-microamp:
        minimum: 1250000
        maximum: 2000000
        description: |
          Maximum flash controller input current. Must be divisible by 50000

    required:
      - reg
      - flash-timeout-us
      - flash-max-microamp
      - led-max-microamp
      - ams,input-max-microamp

  led@1:
    type: object
    $ref: common.yaml#
    unevaluatedProperties: false

    properties:
      reg:
        const: 1

      led-max-microamp:
        enum:
          - 2500
          - 5000
          - 7500
          - 10000
        description: |
          Maximum indicator current. The allowed values are 2500, 5000, 7500 and 10000.

    required:
      - reg
      - led-max-microamp

required:
  - compatible
  - reg
  - "#size-cells"
  - "#address-cells"

additionalProperties: false

examples:
  - |
    #include <dt-bindings/leds/common.h>

    i2c{
        #address-cells = <1>;
        #size-cells = <0>;

        as3645a@30 {
            compatible = "ams,as3645a";
            #address-cells = <1>;
            #size-cells = <0>;
            reg = <0x30>;

            led@0 {
                reg = <0>;
                flash-timeout-us = <150000>;
                flash-max-microamp = <320000>;
                led-max-microamp = <60000>;
                ams,input-max-microamp = <1750000>;
                function = LED_FUNCTION_FLASH;
            };

            led@1 {
                reg = <1>;
                led-max-microamp = <10000>;
                function = LED_FUNCTION_INDICATOR;
            };
        };
    };
...
```
