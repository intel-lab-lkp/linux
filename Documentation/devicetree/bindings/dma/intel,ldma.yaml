## Documentation/devicetree/bindings/dvfs/riscv,rpmi-performance.yaml
```yaml
# SPDX-License-Identifier: (GPL-2.0-only OR BSD-2-Clause)
%YAML 1.2
---
$id: http://devicetree.org/schemas/dvfs/riscv,rpmi-performance.yaml#
$schema: http://devicetree.org/meta-schemas/core.yaml#

title: RISC-V RPMI performance service group

maintainers:
  - Joshua Yeong <joshua.yeong@starfivetech.com>

description: |
  The RISC-V Platform Management Interface (RPMI) [1] defines a modular and
  extensible messaging protocol for platform management functions. The supervisor
  software can send and receive RPMI messages via SBI MPXY extension [2]
  or via a dedicated supervisor-mode RPMI transport.

  The RPMI specification [1] defines performance service group (performance
  domain) for accessing and controlling platform-managed performance-related
  resources, as implemented by a platform microcontroller. Supervisor software
  can interact with the RPMI performance service group through an SBI MPXY
  channel or through a dedicated supervisor-mode RPMI transport.

  The node is a performance domain provider. A CPU references its domain
  through the generic "performance-domains" property described in
  dvfs/performance-domain.yaml.

  The node can also be a power domain provider, with one power domain for each
  performance domain. Any other device that runs in one of the domains
  references it through "power-domains", and each level the domain advertises
  is a performance state of that power domain.

  For example, with the provider labelled "performance", a CPU that runs in
  domain 0 and a device that runs in domain 1 reference their domains as:

    cpu@0 {
        ...
        performance-domains = <&performance 0>;
    };

    gpu@40000000 {
        ...
        power-domains = <&performance 1>;
    };

  ===========================================
  References
  ===========================================

  [1] RISC-V Platform Management Interface (RPMI) v1.0 (or higher)
      https://github.com/riscv-non-isa/riscv-rpmi/releases

  [2] RISC-V Supervisor Binary Interface (SBI) v3.0 (or higher)
      https://github.com/riscv-non-isa/riscv-sbi-doc/releases

properties:
  compatible:
    description:
      Intended for use by the supervisor software.
    const: riscv,rpmi-performance

  mboxes:
    maxItems: 1
    description:
      Mailbox channel of the underlying RPMI transport or SBI message proxy channel.

  "#performance-domain-cells":
    const: 1

  "#power-domain-cells":
    const: 1

required:
  - compatible
  - mboxes
  - "#performance-domain-cells"

additionalProperties: false

examples:
  - |
    rpmi-performance {
        compatible = "riscv,rpmi-performance";
        mboxes = <&mpxy_mbox 0x1003 0x0>;
        #performance-domain-cells = <0x01>;
        #power-domain-cells = <0x01>;
    };
...
```

## Documentation/devicetree/bindings/edac/aspeed,ast2400-sdram-edac.yaml
```yaml
# SPDX-License-Identifier: (GPL-2.0-only OR BSD-2-Clause)
%YAML 1.2
---
$id: http://devicetree.org/schemas/edac/aspeed,ast2400-sdram-edac.yaml#
$schema: http://devicetree.org/meta-schemas/core.yaml#

title: Aspeed BMC SoC SDRAM EDAC controller

maintainers:
  - Stefan Schaeckeler <sschaeck@cisco.com>

description: >
  The Aspeed BMC SoCs support DDR memory with and without ECC (error
  correction check): DDR3 and DDR4 on the AST2400, AST2500 and AST2600,
  and DDR4 and DDR5 on the AST2700.

  The memory controller supports SECDED (single bit error correction, double bit
  error detection) and single bit error auto scrubbing by reserving 8 bits for
  every 64 bit word (effectively reducing available memory to 8/9).

  Note, the bootloader must configure ECC mode in the memory controller.

properties:
  compatible:
    enum:
      - aspeed,ast2400-sdram-edac
      - aspeed,ast2500-sdram-edac
      - aspeed,ast2600-sdram-edac
      - aspeed,ast2700-sdram-edac

  reg:
    maxItems: 1

  interrupts:
    maxItems: 1

required:
  - compatible
  - reg
  - interrupts

additionalProperties: false

examples:
  - |
    sdram@1e6e0000 {
        compatible = "aspeed,ast2500-sdram-edac";
        reg = <0x1e6e0000 0x174>;
        interrupts = <0>;
    };
```

## Documentation/devicetree/bindings/edac/loongson,ls-mc-edac.yaml
```yaml
# SPDX-License-Identifier: GPL-2.0-only OR BSD-2-Clause
%YAML 1.2
---
$id: http://devicetree.org/schemas/edac/loongson,ls-mc-edac.yaml#
$schema: http://devicetree.org/meta-schemas/core.yaml#

title: Loongson Memory Controller EDAC

maintainers:
  - Zhao Qunqin <zhaoqunqin@loongson.cn>

description: |
  EDAC node is defined to describe on-chip error detection and correction for
  Loongson Memory Controller.

properties:

  compatible:
    const: loongson,ls-mc-edac

  reg:
    maxItems: 1

required:
  - compatible
  - reg

additionalProperties: false

examples:
  - |
    edac: mc0@1fe00600 {
        compatible = "loongson,ls-mc-edac";
        reg = <0x0 0x1fe00600 0x0 0x50>;
    };
```

## Documentation/devicetree/bindings/eeprom/st,m24lr.yaml
```yaml
# SPDX-License-Identifier: (GPL-2.0-only OR BSD-2-Clause)
%YAML 1.2
---
$id: http://devicetree.org/schemas/eeprom/st,m24lr.yaml#
$schema: http://devicetree.org/meta-schemas/core.yaml#

title: STMicroelectronics M24LR Series NFC/RFID EEPROM Control Interface

maintainers:
  - Abd-Alrhman Masalkhi <abd.masalkhi@gmail.com>

description: |
  STMicroelectronics M24LR series are dual-interface (RF + I2C)
  EEPROM chips. These devices support I2C-based access to both
  memory and a system area that controls authentication and configuration.
  They expose two I2C addresses: one for EEPROM memory and one for the
  system control area (e.g., UID, password management).

allOf:
  - $ref: ../i2c/i2c-mux.yaml#

properties:
  compatible:
    enum:
      - st,m24lr04e-r
      - st,m24lr16e-r
      - st,m24lr64e-r

  reg:
    maxItems: 1

  pagesize:
    enum: [1, 4, 8, 16, 32, 64, 128, 256]
    default: 1
    $ref: /schemas/types.yaml#/definitions/uint32
    description: >
      Maximum number of bytes that can be written in one I2C transaction.
      the default is 1.

required:
  - compatible
  - reg

unevaluatedProperties: false

examples:
  - |
    i2c {
      #address-cells = <1>;
      #size-cells = <0>;

      i2cmux@57 {
        compatible = "st,m24lr04e-r";
        reg = <0x57>;
        #address-cells = <1>;
        #size-cells = <0>;

        i2c@0 {
          reg = <0x0>;
          #address-cells = <1>;
          #size-cells = <0>;

          eeprom@53 {
            compatible = "atmel,24c04";
            reg = <0x53>;
            address-width = <16>;
            pagesize = <4>;
          };
        };
      };
    };
...
```
