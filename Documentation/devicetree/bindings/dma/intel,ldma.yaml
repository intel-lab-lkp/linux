## Documentation/devicetree/bindings/dma/intel,ldma.yaml
```yaml
# SPDX-License-Identifier: (GPL-2.0-only OR BSD-2-Clause)
%YAML 1.2
---
$id: http://devicetree.org/schemas/dma/intel,ldma.yaml#
$schema: http://devicetree.org/meta-schemas/core.yaml#

title: Lightning Mountain centralized DMA controllers.

maintainers:
  - yzhu@maxlinear.com

allOf:
  - $ref: dma-controller.yaml#

properties:
  compatible:
    enum:
      - intel,lgm-ldma

  reg:
    maxItems: 1

  "#dma-cells":
    const: 3
    description:
      The first cell is the peripheral's DMA request line.
      The second cell is the peripheral's (port) number corresponding to the channel.
      The third cell is the burst length of the channel.

  dma-channels:
    minimum: 1
    maximum: 16

  dma-channel-mask:
    maxItems: 1

  clocks:
    maxItems: 1

  resets:
    maxItems: 1

  reset-names:
    items:
      - const: ctrl

  interrupts:
    maxItems: 1

  intel,dma-poll-cnt:
    $ref: /schemas/types.yaml#/definitions/uint32
    description:
      DMA descriptor polling counter is used to control the poling mechanism
      for the descriptor fetching for all channels.

  intel,dma-byte-en:
    type: boolean
    description:
      DMA byte enable is only valid for DMA write(RX).
      Byte enable(1) means DMA write will be based on the number of dwords
      instead of the whole burst.

  intel,dma-drb:
    type: boolean
    description:
      DMA descriptor read back to make sure data and desc synchronization.

  intel,dma-dburst-wr:
    type: boolean
    description:
      Enable RX dynamic burst write. When it is enabled, the DMA does RX dynamic burst;
      if it is disabled, the DMA RX will still support programmable fixed burst size of 2,4,8,16.
      It only applies to RX DMA and memcopy DMA.

  intel,dma-flowctrl:
    type: boolean
    description:
      DMA per-channel flow control.

  intel,dma-fod:
    type: boolean
    description:
      DMA fetch-on-demand.
      It should only be enabled when DMA connected to a component that can
      provide fetch-on-demand signal to DMA.

  intel,dma-desc-in-sram:
    type: boolean
    description:
      DMA descriptor in sram.
      It only affects legacy DMA(V22)
      DMA version V31 onwards, it is always enabled and setting ignored by
      DMA HW.

  intel,dma-desc-fack:
    type: boolean
    description:
      DMA descriptor fetch acknowledgement.
      This feature only takes effects if DMA fetch-on-demand is enabled.

  intel,dma-orrc:
    $ref: /schemas/types.yaml#/definitions/uint32
    description:
      DMA outstanding descriptor read.
      The maximum orrc count is 16.

  intel,dma-type:
    $ref: /schemas/types.yaml#/definitions/uint32
    description:
      DMA type. Only valid for DMAV31 onwards.
      DMA type TX is 0.
      DMA type RX is 1.
      DMA type MCPY is 2.

  intel,dma-name:
    $ref: /schemas/types.yaml#/definitions/string
    description:
      Name of the DMA.

required:
  - compatible
  - reg
  - intel,dma-name

additionalProperties: false

examples:
  - |
    dma0: dma-controller@e0e00000 {
      compatible = "intel,lgm-ldma";
      reg = <0xe0e00000 0x1000>;
      #dma-cells = <3>;
      dma-channels = <16>;
      dma-channel-mask = <0xFFFF>;
      interrupt-parent = <&ioapic1>;
      interrupts = <82 1>;
      resets = <&rcu0 0x30 0>;
      reset-names = "ctrl";
      clocks = <&cgu0 80>;
      intel,dma-poll-cnt = <4>;
      intel,dma-byte-en;
      intel,dma-drb;
      intel,dma-name = "dma0";
    };
  - |
    dma3: dma-controller@ec800000 {
      compatible = "intel,lgm-ldma";
      reg = <0xec800000 0x1000>;
      clocks = <&cgu0 71>;
      resets = <&rcu0 0x10 9>;
      #dma-cells = <3>;
      intel,dma-poll-cnt = <16>;
      intel,dma-byte-en;
      intel,dma-dburst-wr;
      intel,dma-type = <2>;
      intel,dma-desc-in-sram;
      intel,dma-name = "dma3";
      intel,dma-orrc = <16>;
    };
```

## Documentation/devicetree/bindings/dma/loongson,ls1x-dma.yaml
```yaml
# SPDX-License-Identifier: (GPL-2.0-only OR BSD-2-Clause)
%YAML 1.2
---
$id: http://devicetree.org/schemas/dma/loongson,ls1x-dma.yaml#
$schema: http://devicetree.org/meta-schemas/core.yaml#

title: Loongson-1 DMA Controller

maintainers:
  - Keguang Zhang <keguang.zhang@gmail.com>

description: |
  Loongson-1 DMA controller provides 3 independent channels for
  peripherals such as NAND and AC97.

properties:
  compatible:
    enum:
      - loongson,ls1b-dma
      - loongson,ls1c-dma

  reg:
    maxItems: 1

  interrupts:
    description: Each channel has a dedicated interrupt line.
    minItems: 1
    maxItems: 3

  interrupt-names:
    minItems: 1
    items:
      - pattern: ch0
      - pattern: ch1
      - pattern: ch2

  '#dma-cells':
    description: The single cell represents the channel index.
    const: 1

required:
  - compatible
  - reg
  - interrupts
  - interrupt-names
  - '#dma-cells'

additionalProperties: false

examples:
  - |
    #include <dt-bindings/interrupt-controller/irq.h>
    dma: dma-controller@1fd01160 {
        compatible = "loongson,ls1b-dma";
        reg = <0x1fd01160 0x18>;

        interrupt-parent = <&intc0>;
        interrupts = <13 IRQ_TYPE_EDGE_RISING>,
        	     <14 IRQ_TYPE_EDGE_RISING>,
        	     <15 IRQ_TYPE_EDGE_RISING>;
        interrupt-names = "ch0", "ch1", "ch2";

        #dma-cells = <1>;
    };
```

## Documentation/devicetree/bindings/dma/loongson,ls2k0300-dmamux.yaml
```yaml
# SPDX-License-Identifier: (GPL-2.0-only OR BSD-2-Clause)
%YAML 1.2
---
$id: http://devicetree.org/schemas/dma/loongson,ls2k0300-dmamux.yaml#
$schema: http://devicetree.org/meta-schemas/core.yaml#

title: Loongson-2 APB DMA MUX (DMA request router)

maintainers:
  - Binbin Zhou <zhoubinbin@loongson.cn>

allOf:
  - $ref: /schemas/dma/dma-router.yaml#

properties:
  compatible:
    const: loongson,ls2k0300-dmamux

  reg:
    maxItems: 1

  '#dma-cells':
    const: 3
    description: |
      Each cell represents the following:
      1. Peripheral request ID: This describes the corresponding bit field
         for that peripheral in the configuration register; see (
         include/dt-bindings/dma/loongson,ls2k-dmamux.h) for details.
      2. Physical DMA channel (0-7): This not only represents the DMA
         channel used by the peripheral but is also converted into a value for
         the corresponding bit field in the configuration register, indicating
         the legitimacy of that peripheral using that channel.
         Specifically:
         - I2S/SPI/UART/I2C: Require adjacent channels in pairs; valid
            values are 0/1, 2/3, 4/5, 6/7;
         - SM3/SM4/DES/AES: Single channel; valid values are limited to 0/1;
         - CAN/ADC: Single channel; valid values range from 0 to 7.
      3. DMA Channel Configuration: A 32-bit mask used to specify
         device-specific DMA channel configurations.
         - Bit 6: Peripheral Address Increment Mode
            0x0: Disabled
            0x1: Enabled
         - Bit 7: Memory Address Increment Mode
            0x0: Disabled
            0x1: Enabled
         - Bits 12-13: Priority
            0x0: Low
            0x1: Medium
            0x2: High
            0x3: Very High

  dma-requests:
    const: 22

required:
  - compatible
  - reg
  - dma-requests

unevaluatedProperties: false

examples:
  - |
    #include <dt-bindings/dma/loongson,ls2k-dmamux.h>
    dma-router@16000134 {
        compatible = "loongson,ls2k0300-dmamux";
        reg = <0x16000134 0xc>;
        #dma-cells = <3>;
        dma-masters = <&dma>;
        dma-requests = <22>;
    };
...
```

## Documentation/devicetree/bindings/dma/marvell,xor-v2.yaml
```yaml
# SPDX-License-Identifier: GPL-2.0
%YAML 1.2
---
$id: http://devicetree.org/schemas/dma/marvell,xor-v2.yaml#
$schema: http://devicetree.org/meta-schemas/core.yaml#

title: Marvell XOR v2 engines

maintainers:
  - Vinod Koul <vkoul@kernel.org>

properties:
  compatible:
    contains:
      enum:
        - marvell,armada-7k-xor
        - marvell,xor-v2

  reg:
    items:
      - description: DMA registers location and length
      - description: global registers location and length

  clocks:
    minItems: 1
    maxItems: 2

  clock-names:
    items:
      - const: core
      - const: reg

  msi-parent:
    description:
      Phandle to the MSI-capable interrupt controller used for
      interrupts.
    maxItems: 1

  dma-coherent: true

required:
  - compatible
  - reg
  - msi-parent
  - dma-coherent

if:
  required:
    - clocks
  properties:
    clocks:
      minItems: 2
      maxItems: 2
then:
  required:
    - clock-names

additionalProperties: false

examples:
  - |
    xor0@6a0000 {
        compatible = "marvell,armada-7k-xor", "marvell,xor-v2";
        reg = <0x6a0000 0x1000>, <0x6b0000 0x1000>;
        clocks = <&ap_clk 0>, <&ap_clk 1>;
        clock-names = "core", "reg";
        msi-parent = <&gic_v2m0>;
        dma-coherent;
    };
```

## Documentation/devicetree/bindings/dma/mediatek,exdma.yaml
```yaml
# SPDX-License-Identifier: (GPL-2.0-only OR BSD-2-Clause)
%YAML 1.2
---
$id: http://devicetree.org/schemas/dma/mediatek,exdma.yaml#
$schema: http://devicetree.org/meta-schemas/core.yaml#

title: MediaTek display overlap extended DMA engine

maintainers:
  - Chun-Kuang Hu <chunkuang.hu@kernel.org>
  - Philipp Zabel <p.zabel@pengutronix.de>

description:
  The MediaTek display overlap extended DMA engine, namely OVL_EXDMA or EXDMA,
  primarily functions as a DMA engine for reading data from DRAM with various
  DRAM footprints and data formats. For input sources in certain color formats
  and color domains, OVL_EXDMA also includes a color transfer function
  to process pixels into a consistent color domain.

properties:
  compatible:
    const: mediatek,mt8196-exdma

  reg:
    maxItems: 1

  clocks:
    maxItems: 1

  power-domains:
    maxItems: 1

  mediatek,larb:
    $ref: /schemas/types.yaml#/definitions/phandle
    description: |
      A phandle to the local arbiters node in the current SoCs.
      Refer to bindings/memory-controllers/mediatek,smi-larb.yaml.

  iommus:
    maxItems: 1

  '#dma-cells':
    const: 1

required:
  - compatible
  - reg
  - clocks
  - power-domains
  - mediatek,larb

additionalProperties: false

examples:
  - |
    soc {
        #address-cells = <2>;
        #size-cells = <2>;

        exdma: dma-controller@32850000 {
            compatible = "mediatek,mt8196-exdma";
            reg = <0 0x32850000 0 0x1000>;
            clocks = <&ovlsys_config_clk 13>;
            power-domains = <&hfrpsys 12>;
            iommus = <&mm_smmu 144>;
            #dma-cells = <1>;
        };
    };
```

## Documentation/devicetree/bindings/dma/nvidia,tegra20-apbdma.yaml
```yaml
# SPDX-License-Identifier: (GPL-2.0-only OR BSD-2-Clause)
%YAML 1.2
---
$id: http://devicetree.org/schemas/dma/nvidia,tegra20-apbdma.yaml#
$schema: http://devicetree.org/meta-schemas/core.yaml#

title: NVIDIA Tegra APB DMA Controller

description: |
  The NVIDIA Tegra APB DMA controller is a hardware component that
  enables direct memory access (DMA) on Tegra systems. It facilitates
  data transfer between I/O devices and main memory without constant
  CPU intervention.

maintainers:
  - Jonathan Hunter <jonathanh@nvidia.com>

properties:
  compatible:
    oneOf:
      - const: nvidia,tegra20-apbdma
      - items:
          - const: nvidia,tegra30-apbdma
          - const: nvidia,tegra20-apbdma

  "#dma-cells":
    description:
      Must be <1>. This dictates the length of DMA specifiers
      in client node's dmas properties.
    const: 1

  clocks:
    maxItems: 1

  reg:
    maxItems: 1

  interrupts:
    description:
      Should contain all of the per-channel DMA interrupts in
      ascending order with respect to the DMA channel index.
    minItems: 1
    maxItems: 32

  resets:
    maxItems: 1

  reset-names:
    const: dma

required:
  - compatible
  - reg
  - interrupts
  - clocks
  - resets
  - reset-names
  - "#dma-cells"

additionalProperties: false

examples:
  - |
    #include <dt-bindings/interrupt-controller/arm-gic.h>
    #include <dt-bindings/reset/tegra186-reset.h>
    dma@6000a000 {
        compatible = "nvidia,tegra30-apbdma", "nvidia,tegra20-apbdma";
        reg = <0x6000a000 0x1200>;
        interrupts = <0 136 0x04>,
                     <0 137 0x04>,
                     <0 138 0x04>,
                     <0 139 0x04>,
                     <0 140 0x04>,
                     <0 141 0x04>,
                     <0 142 0x04>,
                     <0 143 0x04>,
                     <0 144 0x04>,
                     <0 145 0x04>,
                     <0 146 0x04>,
                     <0 147 0x04>,
                     <0 148 0x04>,
                     <0 149 0x04>,
                     <0 150 0x04>,
                     <0 151 0x04>;
        clocks = <&tegra_car 34>;
        resets = <&tegra_car 34>;
        reset-names = "dma";
        #dma-cells = <1>;
    };
...
```

## Documentation/devicetree/bindings/dma/rda,ifc.yaml
```yaml
# SPDX-License-Identifier: (GPL-2.0-only OR BSD-2-Clause)
%YAML 1.2
---
$id: http://devicetree.org/schemas/dma/rda,ifc.yaml#
$schema: http://devicetree.org/meta-schemas/core.yaml#

title: RDA Intelligent Flow Controller (IFC)

maintainers:
  - Dang Huynh <dang.huynh@mainlining.org>

description: |
  RDA IFC is a DMA controller, it only supports scatter/gather lists.

allOf:
  - $ref: dma-controller.yaml#

properties:
  compatible:
    const: rda,8810pl-ifc

  reg:
    maxItems: 1

  "#dma-cells":
    const: 1
    description:
      The cell corresponding to DMA request ID

required:
  - compatible
  - reg

additionalProperties: false

examples:
  - |
    ifc: dma-controller@f0000 {
      compatible = "rda,8810pl-ifc";
      reg = <0xf0000 0x1000>;
      #dma-cells = <1>;
    };
```

## Documentation/devicetree/bindings/dma/sophgo,cv1800-dmamux.yaml
```yaml
# SPDX-License-Identifier: (GPL-2.0-only OR BSD-2-Clause)
%YAML 1.2
---
$id: http://devicetree.org/schemas/dma/sophgo,cv1800-dmamux.yaml#
$schema: http://devicetree.org/meta-schemas/core.yaml#

title: Sophgo CV1800/SG200 Series DMA mux

maintainers:
  - Inochi Amaoto <inochiama@outlook.com>

allOf:
  - $ref: dma-router.yaml#

properties:
  compatible:
    const: sophgo,cv1800-dmamux

  reg:
    items:
      - description: DMA channal remapping register
      - description: DMA channel interrupt mapping register

  '#dma-cells':
    const: 2
    description:
      The first cells is device id. The second one is the cpu id.

  dma-masters:
    maxItems: 1

  dma-requests:
    const: 8

required:
  - '#dma-cells'
  - dma-masters

additionalProperties: false

examples:
  - |
    dma-router {
      compatible = "sophgo,cv1800-dmamux";
      #dma-cells = <2>;
      dma-masters = <&dmac>;
      dma-requests = <8>;
    };
```
