## Documentation/devicetree/bindings/dpll/microchip,zl3073x-i2c.yaml
```yaml
# SPDX-License-Identifier: (GPL-2.0 OR BSD-2-Clause)
%YAML 1.2
---
$id: http://devicetree.org/schemas/dpll/microchip,zl3073x-i2c.yaml#
$schema: http://devicetree.org/meta-schemas/core.yaml#

title: I2C-attached Microchip Azurite DPLL device

maintainers:
  - Ivan Vecera <ivecera@redhat.com>

description:
  Microchip Azurite DPLL (ZL3073x) is a family of DPLL devices that
  provides 2 independent DPLL channels, up to 10 differential or
  single-ended inputs and up to 20 differential or 20 single-ended outputs.
  It can be connected via multiple busses, one of them being I2C.

properties:
  compatible:
    enum:
      - microchip,zl3073x-i2c

  reg:
    maxItems: 1

required:
  - compatible
  - reg

allOf:
  - $ref: /schemas/dpll/dpll-device.yaml#

unevaluatedProperties: false

examples:
  - |
    i2c {
      #address-cells = <1>;
      #size-cells = <0>;

      dpll@70 {
        compatible = "microchip,zl3073x-i2c";
        reg = <0x70>;
        #address-cells = <0>;
        #size-cells = <0>;
        dpll-types = "pps", "eec";

        input-pins {
          #address-cells = <1>;
          #size-cells = <0>;

          pin@0 { /* REF0P */
            reg = <0>;
            label = "Input 0";
            supported-frequencies = /bits/ 64 <1 1000>;
            type = "ext";
          };
        };

        output-pins {
          #address-cells = <1>;
          #size-cells = <0>;

          pin@3 { /* OUT1N */
            reg = <3>;
            esync-control;
            label = "Output 1";
            supported-frequencies = /bits/ 64 <1 10000>;
            type = "gnss";
          };
        };
      };
    };
...
```

## Documentation/devicetree/bindings/dpll/microchip,zl3073x-spi.yaml
```yaml
# SPDX-License-Identifier: (GPL-2.0 OR BSD-2-Clause)
%YAML 1.2
---
$id: http://devicetree.org/schemas/dpll/microchip,zl3073x-spi.yaml#
$schema: http://devicetree.org/meta-schemas/core.yaml#

title: SPI-attached Microchip Azurite DPLL device

maintainers:
  - Ivan Vecera <ivecera@redhat.com>

description:
  Microchip Azurite DPLL (ZL3073x) is a family of DPLL devices that
  provides 2 independent DPLL channels, up to 10 differential or
  single-ended inputs and up to 20 differential or 20 single-ended outputs.
  It can be connected via multiple busses, one of them being I2C.

properties:
  compatible:
    enum:
      - microchip,zl3073x-spi

  reg:
    maxItems: 1

required:
  - compatible
  - reg

allOf:
  - $ref: /schemas/dpll/dpll-device.yaml#
  - $ref: /schemas/spi/spi-peripheral-props.yaml#

unevaluatedProperties: false

examples:
  - |
    spi {
      #address-cells = <1>;
      #size-cells = <0>;

      dpll@70 {
        compatible = "microchip,zl3073x-spi";
        reg = <0x70>;
        #address-cells = <0>;
        #size-cells = <0>;
        spi-max-frequency = <12500000>;

        dpll-types = "pps", "eec";

        input-pins {
          #address-cells = <1>;
          #size-cells = <0>;

          pin@0 { /* REF0P */
            reg = <0>;
            label = "Input 0";
            supported-frequencies = /bits/ 64 <1 1000>;
            type = "ext";
          };
        };

        output-pins {
          #address-cells = <1>;
          #size-cells = <0>;

          pin@3 { /* OUT1N */
            reg = <3>;
            esync-control;
            label = "Output 1";
            supported-frequencies = /bits/ 64 <1 10000>;
            type = "gnss";
          };
        };
      };
    };
...
```

## Documentation/devicetree/bindings/dpll/microchip,zl3073x.yaml
```yaml
# SPDX-License-Identifier: (GPL-2.0 OR BSD-2-Clause)
%YAML 1.2
---
$id: http://devicetree.org/schemas/dpll/microchip,zl3073x.yaml#
$schema: http://devicetree.org/meta-schemas/core.yaml#

title: Microchip Azurite DPLL device

maintainers:
  - Ivan Vecera <ivecera@redhat.com>

properties:
  compatible:
    enum:
      - microchip,zl3073x-i2c
      - microchip,zl3073x-spi

  reg:
    maxItems: 1

required:
  - compatible
  - reg

allOf:
  - $ref: /schemas/dpll/dpll-device.yaml

unevaluatedProperties: false

examples:
  - |
    i2c {
      #address-cells = <1>;
      #size-cells = <0>;

      dpll@70 {
        compatible = "microchip,zl3073x-i2c";
        #address-cells = <0>;
        #size-cells = <0>;
        reg = <0x70>;
        status = "okay";

        num-dplls = <2>;
        dpll-types = "pps", "eec";

        input-pins {
          #address-cells = <1>;
          #size-cells = <0>;

          pin@0 { /* REF0P */
            reg = <0>;

            label = "Input 0";
            type = "ext";
            supported-frequencies = /bits/ 64 <1 1000>;
          };
        };

        output-pins {
          #address-cells = <1>;
          #size-cells = <0>;

          pin@3 { /* OUT1N */
            reg = <3>;

            label = "Output 1";
            type = "gnss";
            esync-control;
            supported-frequencies = /bits/ 64 <1 10000>;
          };
        };
      };
    };
...
```

## Documentation/devicetree/bindings/dpll/sitime,sit9531x.yaml
```yaml
# SPDX-License-Identifier: (GPL-2.0-only OR BSD-2-Clause)
%YAML 1.2
---
$id: http://devicetree.org/schemas/dpll/sitime,sit9531x.yaml#
$schema: http://devicetree.org/meta-schemas/core.yaml#

title: SiTime SiT9531x DPLL Clock Generator

maintainers:
  - Ali Rouhi <arouhi@sitime.com>

description: |
  SiTime SiT95316 and SiT95317 are I2C-controlled programmable clock
  generators with integrated DPLL for synchronization applications.  Both
  variants contain four PLLs with automatic/manual reference selection,
  DCO frequency adjustment, and phase offset measurement via an on-chip
  TDC (Time-to-Digital Converter).

  SiT95317 provides 4 inputs and 8 outputs; SiT95316 provides
  4 inputs and 12 outputs.

properties:
  compatible:
    enum:
      - sitime,sit95316
      - sitime,sit95317

  reg:
    maxItems: 1

  clocks:
    maxItems: 1
    description:
      External crystal/oscillator feeding the chip's XIN/XO_CLK input.
      The chip's PLL Fvco is computed relative to this reference, so the
      driver requires a non-zero rate at probe time.

  clock-names:
    items:
      - const: xtal

  reset-gpios:
    maxItems: 1
    description:
      GPIO connected to the chip's active-low reset pin (RESETB).

  interrupts:
    maxItems: 1
    description:
      Interrupt from the chip's active-low INTRB output.  Asserted when
      the device detects a status change such as lock acquisition or loss.

required:
  - compatible
  - reg
  - clocks
  - clock-names

allOf:
  - $ref: /schemas/dpll/dpll-device.yaml#

unevaluatedProperties: false

examples:
  - |
    xo: xo {
        compatible = "fixed-clock";
        #clock-cells = <0>;
        clock-frequency = <48000000>;
    };

    i2c {
        #address-cells = <1>;
        #size-cells = <0>;

        dpll@68 {
            compatible = "sitime,sit95317";
            reg = <0x68>;
            clocks = <&xo>;
            clock-names = "xtal";
        };
    };

  - |
    #include <dt-bindings/gpio/gpio.h>
    #include <dt-bindings/interrupt-controller/irq.h>

    xo2: xo2 {
        compatible = "fixed-clock";
        #clock-cells = <0>;
        clock-frequency = <48000000>;
    };

    i2c {
        #address-cells = <1>;
        #size-cells = <0>;

        dpll@68 {
            compatible = "sitime,sit95316";
            reg = <0x68>;
            clocks = <&xo2>;
            clock-names = "xtal";
            reset-gpios = <&gpio 78 GPIO_ACTIVE_LOW>;
            interrupts = <12 IRQ_TYPE_LEVEL_LOW>;
            dpll-types = "eec", "eec", "eec", "eec";

            input-pins {
                #address-cells = <1>;
                #size-cells = <0>;

                pin@0 {
                    reg = <0>;
                    label = "clkin0";
                    connection-type = "ext";
                    supported-frequencies-hz = /bits/ 64 <10000000>;
                };

                pin@1 {
                    reg = <1>;
                    label = "clkin1";
                    connection-type = "synce";
                    supported-frequencies-hz = /bits/ 64 <156250000>;
                };
            };

            output-pins {
                #address-cells = <1>;
                #size-cells = <0>;

                pin@0 {
                    reg = <0>;
                    label = "clkout0";
                    esync-control;
                    supported-frequencies-hz = /bits/ 64 <156250000>;
                };

                pin@1 {
                    reg = <1>;
                    label = "clkout1";
                    supported-frequencies-hz = /bits/ 64 <25000000>;
                };
            };
        };
    };
...
```

## Documentation/devicetree/bindings/dsp/fsl,dsp.yaml
```yaml
# SPDX-License-Identifier: (GPL-2.0 OR BSD-2-Clause)
%YAML 1.2
---
$id: http://devicetree.org/schemas/dsp/fsl,dsp.yaml#
$schema: http://devicetree.org/meta-schemas/core.yaml#

title: NXP i.MX8 DSP core

maintainers:
  - Daniel Baluta <daniel.baluta@nxp.com>
  - Shengjiu Wang <shengjiu.wang@nxp.com>

description: |
  Some boards from i.MX8 family contain a DSP core used for
  advanced pre- and post- audio processing.

properties:
  compatible:
    enum:
      - fsl,imx8qxp-hifi4
      - fsl,imx8qm-hifi4
      - fsl,imx8mp-hifi4
      - fsl,imx8ulp-hifi4

  reg:
    maxItems: 1

  clocks:
    items:
      - description: ipg clock
      - description: ocram clock
      - description: core clock
      - description: debug interface clock
      - description: message unit clock
    minItems: 3

  clock-names:
    items:
      - const: ipg
      - const: ocram
      - const: core
      - const: debug
      - const: mu
    minItems: 3

  power-domains:
    description:
      List of phandle and PM domain specifier as documented in
      Documentation/devicetree/bindings/power/power_domain.txt
    minItems: 1
    maxItems: 4

  mboxes:
    description:
      List of <&phandle type channel> - 2 channels for TXDB, 2 channels for RXDB
      or - 1 channel for TX, 1 channel for RX, 1 channel for RXDB
      (see mailbox/fsl,mu.txt)
    maxItems: 3

  mbox-names:
    items:
      - const: tx
      - const: rx
      - const: rxdb

  memory-region:
    description:
      phandle to a node describing reserved memory (System RAM memory)
      used by DSP (see bindings/reserved-memory/reserved-memory.txt)
    maxItems: 4

  firmware-name:
    description: |
      Default name of the firmware to load to the remote processor.

  fsl,dsp-ctrl:
    $ref: /schemas/types.yaml#/definitions/phandle
    description:
      Phandle to syscon block which provide access for processor enablement

  resets:
    minItems: 1

  reset-names:
    minItems: 1
    items:
      - const: runstall
      - const: softreset

  access-controllers:
    maxItems: 1

required:
  - compatible
  - reg
  - clocks
  - clock-names
  - power-domains
  - mboxes
  - mbox-names
  - memory-region

allOf:
  - if:
      properties:
        compatible:
          contains:
            enum:
              - fsl,imx8qxp-hifi4
    then:
      properties:
        power-domains:
          minItems: 2
          maxItems: 2

  - if:
      properties:
        compatible:
          contains:
            enum:
              - fsl,imx8qm-hifi4
    then:
      properties:
        power-domains:
          minItems: 4

  - if:
      properties:
        compatible:
          contains:
            enum:
              - fsl,imx8mp-hifi4
              - fsl,imx8ulp-hifi4
    then:
      properties:
        power-domains:
          maxItems: 1

  - if:
      properties:
        compatible:
          contains:
            enum:
              - fsl,imx8mp-hifi4
    then:
      required:
        - resets
        - reset-names

additionalProperties: false

examples:
  - |
    #include <dt-bindings/clock/imx8mp-clock.h>
    #include <dt-bindings/reset/imx8mp-reset-audiomix.h>

    dsp: dsp@3b6e8000 {
      compatible = "fsl,imx8mp-hifi4";
      reg = <0x3b6e8000 0x88000>;
      clocks = <&audio_blk_ctrl IMX8MP_CLK_AUDIOMIX_DSP_ROOT>,
               <&audio_blk_ctrl IMX8MP_CLK_AUDIOMIX_OCRAMA_IPG>,
               <&audio_blk_ctrl IMX8MP_CLK_AUDIOMIX_DSP_ROOT>,
               <&audio_blk_ctrl IMX8MP_CLK_AUDIOMIX_DSPDBG_ROOT>;
      clock-names = "ipg", "ocram", "core", "debug";
      firmware-name = "imx/dsp/hifi4.bin";
      power-domains = <&audiomix_pd>;
      mbox-names = "tx", "rx", "rxdb";
      mboxes = <&mu2 0 0>,
               <&mu2 1 0>,
               <&mu2 3 0>;
      memory-region = <&dsp_vdev0buffer>, <&dsp_vdev0vring0>,
                      <&dsp_vdev0vring1>, <&dsp_reserved>;
      resets = <&audio_blk_ctrl IMX8MP_AUDIOMIX_DSP_RUNSTALL>;
      reset-names = "runstall";
    };
```

## Documentation/devicetree/bindings/dvfs/riscv,rpmi-mpxy-performance.yaml
```yaml
# SPDX-License-Identifier: (GPL-2.0-only OR BSD-2-Clause)
%YAML 1.2
---
$id: http://devicetree.org/schemas/dvfs/riscv,rpmi-mpxy-performance.yaml#
$schema: http://devicetree.org/meta-schemas/core.yaml#

title: RISC-V RPMI performance service group based message proxy

maintainers:
  - Joshua Yeong <joshua.yeong@starfivetech.com>

description: |
  The RISC-V Platform Management Interface (RPMI) [1] defines a modular and
  extensible messaging protocol for platform management functions. The supervisor
  software can send and receive RPMI messages via SBI MPXY extension [2]
  or via a dedicated supervisor-mode RPMI transport.

  The RPMI specification [1] defines performance service group (performance
  domain) for accessing and controlling platform-managed performance-related
  resources implemented by a platform microcontroller. The SBI implementation
  (machine mode firmware or hypervisor) can implement an SBI MPXY channel
  to allow supervisor software to access the RPMI performance service group.

  ===========================================
  References
  ===========================================

  [1] RISC-V Platform Management Interface (RPMI) v1.0 (or higher)
      https://github.com/riscv-non-isa/riscv-rpmi/releases

  [2] RISC-V Supervisor Binary Interface (SBI) v3.0 (or higher)
      https://github.com/riscv-non-isa/riscv-sbi-doc/releases

properties:
  compatible:
    description:
      Intended for use by the SBI implementation.
    const: riscv,rpmi-mpxy-performance

  mboxes:
    maxItems: 1
    description:
      Mailbox channel of the underlying RPMI transport.

  riscv,sbi-mpxy-channel-id:
    $ref: /schemas/types.yaml#/definitions/uint32
    description:
      The SBI MPXY channel id to be used for providing RPMI access to
      the supervisor software.

required:
  - compatible
  - mboxes
  - riscv,sbi-mpxy-channel-id

additionalProperties: false

examples:
  - |
    performance {
        compatible = "riscv,rpmi-mpxy-performance";
        mboxes = <&rpmi_shmem_mbox 0x0a>;
        riscv,sbi-mpxy-channel-id = <0x1003>;
    };
...
```
