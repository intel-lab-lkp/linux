## Documentation/devicetree/bindings/dma/ti,dra7-dma-crossbar.yaml
```yaml
# SPDX-License-Identifier: (GPL-2.0-only OR BSD-2-Clause)
%YAML 1.2
---
$id: http://devicetree.org/schemas/dma/ti,dra7-dma-crossbar.yaml#
$schema: http://devicetree.org/meta-schemas/core.yaml#

title: Texas Instruments DMA Crossbar (DMA request router)

maintainers:
  - Bhargav Joshi <j.bhargav.u@gmail.com>
  - Peter Ujfalusi <peter.ujfalusi@gmail.com>

properties:
  compatible:
    enum:
      - ti,dra7-dma-crossbar
      - ti,am335x-edma-crossbar

  reg:
    maxItems: 1

  "#dma-cells":
    minimum: 1
    maximum: 3

  dma-requests:
    minimum: 1
    maximum: 256

  dma-masters:
    maxItems: 1

  ti,dma-safe-map:
    $ref: /schemas/types.yaml#/definitions/uint32
    description: Safe routing value for unused request lines

  ti,reserved-dma-request-ranges:
    $ref: /schemas/types.yaml#/definitions/uint32-matrix
    description:
      DMA request ranges which should not be used when mapping xbar input to
      DMA request, they are either allocated to be used by for example the DSP
      or they are used as memcpy channels in eDMA.

required:
  - compatible
  - reg
  - "#dma-cells"
  - dma-requests
  - dma-masters

allOf:
  - $ref: dma-router.yaml#

  - if:
      properties:
        compatible:
          contains:
            const: ti,am335x-edma-crossbar
    then:
      properties:
        "#dma-cells":
          const: 3

unevaluatedProperties: false

examples:
  - |
    #include <dt-bindings/interrupt-controller/arm-gic.h>

    /* DMA controller */
    sdma: dma-controller@4a056000 {
        compatible = "ti,omap4430-sdma";
        reg = <0x4a056000 0x1000>;
        interrupts =  <GIC_SPI 7 IRQ_TYPE_LEVEL_HIGH>,
                      <GIC_SPI 8 IRQ_TYPE_LEVEL_HIGH>,
                      <GIC_SPI 9 IRQ_TYPE_LEVEL_HIGH>,
                      <GIC_SPI 10 IRQ_TYPE_LEVEL_HIGH>;
        #dma-cells = <1>;
        dma-channels = <32>;
        dma-requests = <127>;
    };

    /* DMA crossbar */
    sdma_xbar: dma-router@4a002b78 {
        compatible = "ti,dra7-dma-crossbar";
        reg = <0x4a002b78 0xfc>;
        #dma-cells = <1>;
        dma-requests = <205>;
        ti,dma-safe-map = <0>;
        /* Protect the sDMA request ranges: 10-14 and 100-126 */
        ti,reserved-dma-request-ranges = <10 5>, <100 27>;
        dma-masters = <&sdma>;
    };

    /* DMA client */
    serial@4806a000 {
        compatible = "ti,omap4-uart";
        reg = <0x4806a000 0x100>;
        interrupts-extended = <&gic GIC_SPI 67 IRQ_TYPE_LEVEL_HIGH>;
        ti,hwmods = "uart1";
        clock-frequency = <48000000>;
        /* Requesting crossbar input 49 and 50 */
        dmas = <&sdma_xbar 49>, <&sdma_xbar 50>;
        dma-names = "tx", "rx";
    };
```

## Documentation/devicetree/bindings/dma/ti/ti,edma3-tpcc.yaml
```yaml
# SPDX-License-Identifier: (GPL-2.0-only OR BSD-2-Clause)
%YAML 1.2
---
$id: http://devicetree.org/schemas/dma/ti/ti,edma3-tpcc.yaml#
$schema: http://devicetree.org/meta-schemas/core.yaml#

title: Texas Instruments eDMA3 Channel Controller

description: |
  The eDMA3 consists of two components, Channel controller (CC) and Transfer
  Controller(s) (TC). The CC is the main entry for DMA users since it is
  responsible for the DMA channel handling, while the TCs are responsible to
  execute the actual DMA tansfer. This documents the Channel Controller.

maintainers:
  - Andrew Davis <afd@ti.com>

allOf:
  - $ref: /schemas/dma/dma-controller.yaml#

properties:
  compatible:
    oneOf:
      - const: ti,edma3-tpcc # OMAP, AM33xx, and AM43xx
      - items:
          - const: ti,k2g-edma3-tpcc # 66AK2G
          - const: ti,edma3-tpcc

  reg:
    maxItems: 1

  reg-names:
    const: edma3_cc

  interrupts:
    items:
      - description: CCINT Interrupt
      - description: MPERR Interrupt
      - description: CCERRINT Interrupt

  interrupt-names:
    items:
      - const: edma3_ccint
      - const: edma3_mperr
      - const: edma3_ccerrint

  "#dma-cells":
    const: 2
    description: |
      The first cell is the DMA request number.
      The second cell is the TC the channel is serviced on.

  ti,tptcs:
    $ref: /schemas/types.yaml#/definitions/phandle-array
    description: |
      List of TPTCs associated with the eDMA in the following form,
      <&tptc_phandle TC_priority_number>. The highest priority is 0.

  power-domains:
    maxItems: 1

  ti,edma-memcpy-channels:
    $ref: /schemas/types.yaml#/definitions/uint32-array
    description: |
      List of channels allocated to be used for memcpy, iow
      these channels will be SW triggered channels.

  ti,edma-reserved-slot-ranges:
    $ref: /schemas/types.yaml#/definitions/uint32-array
    description: |
      PaRAM slot ranges which should not be used by the driver,
      they are allocated to be used by for example the DSP.

  dma-channel-mask:
    description: |
      Mask of usable channels. Single uint32 for EDMA with 32 channels,
      array of two uint32 for EDMA with 64 channels.

required:
  - compatible
  - reg
  - reg-names
  - interrupts
  - interrupt-names
  - "#dma-cells"
  - ti,tptcs

if:
  properties:
    compatible:
      contains:
        enum:
          - ti,k2g-edma3-tptc
then:
  required:
    - power-domains

additionalProperties: false

examples:
  - |
    dma-controller@49000000 {
        compatible = "ti,edma3-tpcc";
        reg = <0x49000000 0x10000>;
        reg-names = "edma3_cc";
        interrupts = <12 13 14>;
        interrupt-names = "edma3_ccint", "edma3_mperr", "edma3_ccerrint";
        dma-requests = <64>;
        #dma-cells = <2>;

        ti,tptcs = <&edma_tptc0 7>, <&edma_tptc1 7>, <&edma_tptc2 0>;

        /* Channel 20 and 21 is allocated for memcpy */
        ti,edma-memcpy-channels = <20 21>;
        /* The following PaRAM slots are reserved: 35-44 and 100-109 */
        ti,edma-reserved-slot-ranges = <35 10>, <100 10>;
        /* The following channels are reserved: 35-44 */
        dma-channel-mask = <0xffffffff /* Channel 0-31 */
                            0xffffe007>; /* Channel 32-63 */
    };

    sham@53100000 {
        compatible = "ti,omap4-sham";
        reg = <0x53100000 0x200>;
        interrupts = <109>;
        /* DMA channel 36 executed on eDMA TC0 - low priority queue */
        dmas = <&edma 36 0>;
        dma-names = "rx";
    };

    mcasp@48038000 {
        compatible = "ti,am33xx-mcasp-audio";
        reg = <0x48038000 0x2000>,
              <0x46000000 0x400000>;
        reg-names = "mpu", "dat";
        interrupts = <80>, <81>;
        interrupt-names = "tx", "rx";
        /* DMA channels 8 and 9 executed on eDMA TC2 - high priority queue */
        dmas = <&edma 8 2>,
               <&edma 9 2>;
        dma-names = "tx", "rx";
    };
```

## Documentation/devicetree/bindings/dma/ti/ti,edma3-tptc.yaml
```yaml
# SPDX-License-Identifier: (GPL-2.0-only OR BSD-2-Clause)
%YAML 1.2
---
$id: http://devicetree.org/schemas/dma/ti/ti,edma3-tptc.yaml#
$schema: http://devicetree.org/meta-schemas/core.yaml#

title: Texas Instruments eDMA3 Transfer Controller

description: |
  The eDMA3 consists of two components, Channel controller (CC) and Transfer
  Controller(s) (TC). The CC is the main entry for DMA users since it is
  responsible for the DMA channel handling, while the TCs are responsible to
  execute the actual DMA tansfer. This documents the Transfer Controller.

maintainers:
  - Andrew Davis <afd@ti.com>

properties:
  compatible:
    oneOf:
      - const: ti,edma3-tptc # OMAP, AM33xx, and AM43xx
      - items:
          - const: ti,k2g-edma3-tptc # 66AK2G
          - const: ti,edma3-tptc

  reg:
    maxItems: 1

  interrupts:
    description: Interrupt number for TCerrint
    maxItems: 1

  interrupt-names:
    const: edma3_tcerrint

  power-domains:
    maxItems: 1

required:
  - compatible
  - reg

if:
  properties:
    compatible:
      contains:
        enum:
          - ti,k2g-edma3-tptc
then:
  required:
    - power-domains

additionalProperties: false

examples:
  - |
    tptc@49800000 {
        compatible = "ti,k2g-edma3-tptc", "ti,edma3-tptc";
        reg = <0x49800000 0x100000>;
        interrupts = <112>;
        interrupt-names = "edm3_tcerrint";
        power-domains = <&k2g_pds 0xb>;
    };
```

## Documentation/devicetree/bindings/dma/ti/ti,k3-pktdma-v2.yaml
```yaml
# SPDX-License-Identifier: (GPL-2.0-only OR BSD-2-Clause)
# Copyright (C) 2024-2025 Texas Instruments Incorporated
%YAML 1.2
---
$id: http://devicetree.org/schemas/dma/ti/ti,k3-pktdma-v2.yaml#
$schema: http://devicetree.org/meta-schemas/core.yaml#

title: Texas Instruments K3 DMSS PKTDMA V2

maintainers:
  - Sai Sree Kartheek Adivi <s-adivi@ti.com>

description: |
  The PKTDMA V2 is intended to perform similar functions as the packet mode
  channels of K3 UDMA-P. PKTDMA V2 only includes Split channels to service
  PSI-L based peripherals.

  The peripherals can be PSI-L native or legacy, non PSI-L native peripherals
  with PDMAs. PDMA is tasked to act as a bridge between the PSI-L fabric and the
  legacy peripheral.

allOf:
  - $ref: /schemas/dma/dma-controller.yaml#

properties:
  compatible:
    const: ti,am62l-dmss-pktdma

  reg:
    items:
      - description: Packet DMA Control /Status
      - description: Channel Realtime
      - description: Ring Realtime

  reg-names:
    items:
      - const: gcfg
      - const: chanrt
      - const: ringrt

  "#dma-cells":
    const: 2
    description: |
      cell 1: Channel identification for the peripheral
        PSI-L thread ID of the remote (to BCDMA) end.
        Valid ranges for thread ID depends on the data movement direction:
        for source thread IDs (rx): 0 - 0x7fff
        for destination thread IDs (tx): 0x8000 - 0xffff

        Please refer to the device documentation for the PSI-L thread map and
        also the PSI-L peripheral chapter for the correct thread ID.

      cell 2: ASEL value for the channel

required:
  - compatible
  - reg
  - reg-names
  - "#dma-cells"

unevaluatedProperties: false

examples:
  - |
    main {
        #address-cells = <2>;
        #size-cells = <2>;

        main_pktdma: dma-controller@485c0000 {
            compatible = "ti,am62l-dmss-pktdma";
            reg = <0x00 0x485c0000 0x00 0x4000>,
                  <0x00 0x48900000 0x00 0x80000>,
                  <0x00 0x47200000 0x00 0x100000>;
            reg-names = "gcfg", "chanrt", "ringrt";
            #dma-cells = <2>;
        };

        serial@2800000 {
            compatible = "ti,am64-uart", "ti,am654-uart";
            reg = <0x00 0x02800000 0x00 0x100>;
            power-domains = <&scmi_pds 89>;
            clocks = <&scmi_clk 358>;
            clock-names = "fclk";
            dmas = <&main_pktdma 0xc400 0>,
                   /* tx: PSI-L thread ID, ASEL value */
                   <&main_pktdma 0x4400 0>;
                   /* rx: PSI-L thread ID, ASEL value */
            dma-names = "tx", "rx";
        };
    };
```

## Documentation/devicetree/bindings/dpll/dpll-device.yaml
```yaml
# SPDX-License-Identifier: (GPL-2.0 OR BSD-2-Clause)
%YAML 1.2
---
$id: http://devicetree.org/schemas/dpll/dpll-device.yaml#
$schema: http://devicetree.org/meta-schemas/core.yaml#

title: Digital Phase-Locked Loop (DPLL) Device

maintainers:
  - Ivan Vecera <ivecera@redhat.com>

description:
  Digital Phase-Locked Loop (DPLL) device is used for precise clock
  synchronization in networking and telecom hardware. The device can
  have one or more channels (DPLLs) and one or more physical input and
  output pins. Each DPLL channel can either produce pulse-per-clock signal
  or drive ethernet equipment clock. The type of each channel can be
  indicated by dpll-types property.

properties:
  $nodename:
    pattern: "^dpll(@.*)?$"

  "#address-cells":
    const: 0

  "#size-cells":
    const: 0

  channels:
    type: object
    description: DPLL channels
    unevaluatedProperties: false

    properties:
      "#address-cells":
        const: 1
      "#size-cells":
        const: 0

    patternProperties:
      "^channel@[0-9a-f]+$":
        type: object
        description: DPLL channel
        unevaluatedProperties: false

        properties:
          reg:
            description: Hardware index of the DPLL channel
            maxItems: 1

          dpll-type:
            description: DPLL channel type
            $ref: /schemas/types.yaml#/definitions/string
            enum: [pps, eec]

          ethernet-handle:
            description:
              Specifies a reference to a node representing an Ethernet device
              that uses this channel to synchronize its hardware clock.
            $ref: /schemas/types.yaml#/definitions/phandle

        required:
          - reg

  input-pins:
    type: object
    description: DPLL input pins
    unevaluatedProperties: false

    properties:
      "#address-cells":
        const: 1
      "#size-cells":
        const: 0

    patternProperties:
      "^pin@[0-9a-f]+$":
        $ref: /schemas/dpll/dpll-pin.yaml
        unevaluatedProperties: false

    required:
      - "#address-cells"
      - "#size-cells"

  output-pins:
    type: object
    description: DPLL output pins
    unevaluatedProperties: false

    properties:
      "#address-cells":
        const: 1
      "#size-cells":
        const: 0

    patternProperties:
      "^pin@[0-9]+$":
        $ref: /schemas/dpll/dpll-pin.yaml
        unevaluatedProperties: false

    required:
      - "#address-cells"
      - "#size-cells"

additionalProperties: true
```

## Documentation/devicetree/bindings/dpll/dpll-pin-consumer.yaml
```yaml
# SPDX-License-Identifier: (GPL-2.0-only OR BSD-2-Clause)
%YAML 1.2
---
$id: http://devicetree.org/schemas/dpll/dpll-pin-consumer.yaml#
$schema: http://devicetree.org/meta-schemas/core.yaml#

title: DPLL Pin Consumer

maintainers:
  - Ivan Vecera <ivecera@redhat.com>

description: |
  Common properties for devices that require connection to DPLL (Digital Phase
  Locked Loop) pins for frequency synchronization (e.g. SyncE).

properties:
  dpll-pins:
    $ref: /schemas/types.yaml#/definitions/phandle-array
    description:
      List of phandles to the DPLL pin nodes connected to this device.

  dpll-pin-names:
    $ref: /schemas/types.yaml#/definitions/string-array
    description:
      Names for the DPLL pins defined in 'dpll-pins', in the same order.

dependencies:
  dpll-pin-names: [ dpll-pins ]

additionalProperties: true
```

## Documentation/devicetree/bindings/dpll/dpll-pin.yaml
```yaml
# SPDX-License-Identifier: (GPL-2.0 OR BSD-2-Clause)
%YAML 1.2
---
$id: http://devicetree.org/schemas/dpll/dpll-pin.yaml#
$schema: http://devicetree.org/meta-schemas/core.yaml#

title: DPLL Pin

maintainers:
  - Ivan Vecera <ivecera@redhat.com>

description: |
  Schema for defining input and output pins of a Digital Phase-Locked Loop (DPLL).
  Each pin can have a set of supported frequencies, label, type and may support
  embedded sync.

properties:
  reg:
    description: Hardware index of the pin.
    $ref: /schemas/types.yaml#/definitions/uint32

  esync-control:
    description: Indicates whether the pin supports embedded sync functionality.
    type: boolean

  label:
    description: String exposed as the pin board label
    $ref: /schemas/types.yaml#/definitions/string

  supported-frequencies:
    description: List of supported frequencies for this pin, expressed in Hz.
    $ref: /schemas/types.yaml#/definitions/uint64-array

  type:
    description: Type of the pin
    $ref: /schemas/types.yaml#/definitions/string
    enum: [ext, gnss, int, mux, synce]


required:
  - reg

additionalProperties: false
```
