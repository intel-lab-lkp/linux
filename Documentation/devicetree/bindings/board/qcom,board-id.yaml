## Documentation/devicetree/bindings/bus/fsl,imx8mp-aipstz.yaml
```yaml
# SPDX-License-Identifier: (GPL-2.0-only OR BSD-2-Clause)
%YAML 1.2
---
$id: http://devicetree.org/schemas/bus/fsl,imx8mp-aipstz.yaml#
$schema: http://devicetree.org/meta-schemas/core.yaml#

title: Secure AHB to IP Slave bus (AIPSTZ) bridge

description:
  The secure AIPS bridge (AIPSTZ) acts as a bridge for AHB masters
  issuing transactions to IP Slave peripherals. Additionally, this module
  offers access control configurations meant to restrict which peripherals
  a master can access.

maintainers:
  - Laurentiu Mihalcea <laurentiu.mihalcea@nxp.com>

properties:
  compatible:
    const: fsl,imx8mp-aipstz

  reg:
    maxItems: 1

  power-domains:
    maxItems: 1

  "#address-cells":
    enum: [1, 2]

  "#size-cells":
    enum: [1, 2]

  "#access-controller-cells":
    const: 0

  ranges: true

# borrowed from simple-bus.yaml, no additional requirements for children
patternProperties:
  "@(0|[1-9a-f][0-9a-f]*)$":
    type: object
    additionalProperties: true
    properties:
      reg:
        items:
          minItems: 2
          maxItems: 4
        minItems: 1
        maxItems: 1024
      ranges:
        oneOf:
          - items:
              minItems: 3
              maxItems: 7
            minItems: 1
            maxItems: 1024
          - $ref: /schemas/types.yaml#/definitions/flag
    anyOf:
      - required:
          - reg
      - required:
          - ranges

required:
  - compatible
  - reg
  - power-domains
  - "#address-cells"
  - "#size-cells"
  - "#access-controller-cells"
  - ranges

additionalProperties: false

examples:
  - |
    bus@30df0000 {
      compatible = "fsl,imx8mp-aipstz";
      reg = <0x30df0000 0x10000>;
      power-domains = <&pgc_audio>;
      #address-cells = <1>;
      #size-cells = <1>;
      #access-controller-cells = <0>;
      ranges;
    };
```

## Documentation/devicetree/bindings/bus/microsoft,vmbus.yaml
```yaml
# SPDX-License-Identifier: (GPL-2.0-only OR BSD-2-Clause)
%YAML 1.2
---
$id: http://devicetree.org/schemas/bus/microsoft,vmbus.yaml#
$schema: http://devicetree.org/meta-schemas/core.yaml#

title: Microsoft Hyper-V VMBus

maintainers:
  - Saurabh Sengar <ssengar@linux.microsoft.com>

description:
  VMBus is a software bus that implements the protocols for communication
  between the root or host OS and guest OS'es (virtual machines).

properties:
  compatible:
    const: microsoft,vmbus

  microsoft,message-connection-id:
    description: |
      VMBus message connection ID to be used for communication between host and
      guest. If not specified, defaults to VMBUS_MESSAGE_CONNECTION_ID_4 (4) for
      protocol version VERSION_WIN10_V5 and above, or VMBUS_MESSAGE_CONNECTION_ID
      (1) for older versions.
    $ref: /schemas/types.yaml#/definitions/uint32

  ranges: true

  '#address-cells':
    const: 2

  '#size-cells':
    const: 1

  dma-coherent: true

  interrupts:
    maxItems: 1
    description: Interrupt is used to report a message from the host.

required:
  - compatible
  - ranges
  - interrupts
  - '#address-cells'
  - '#size-cells'

additionalProperties: false

examples:
  - |
    #include <dt-bindings/interrupt-controller/irq.h>
    #include <dt-bindings/interrupt-controller/arm-gic.h>
    soc {
        #address-cells = <2>;
        #size-cells = <1>;
        bus {
            compatible = "simple-bus";
            #address-cells = <2>;
            #size-cells = <1>;
            ranges;

            vmbus@ff0000000 {
                compatible = "microsoft,vmbus";
                microsoft,message-connection-id = <4>;
                #address-cells = <2>;
                #size-cells = <1>;
                ranges = <0x0f 0xf0000000 0x0f 0xf0000000 0x10000000>;
                dma-coherent;
                interrupt-parent = <&gic>;
                interrupts = <GIC_PPI 2 IRQ_TYPE_EDGE_RISING>;
            };
        };
    };
```

## Documentation/devicetree/bindings/bus/simple-platform-bus.yaml
```yaml
# SPDX-License-Identifier: (GPL-2.0-only OR BSD-2-Clause)
%YAML 1.2
---
$id: http://devicetree.org/schemas/bus/simple-platform-bus.yaml#
$schema: http://devicetree.org/meta-schemas/core.yaml#

title: Simple Platform Bus

maintainers:
  - Herve Codina <herve.codina@bootlin.com>

description: |
  A Simple Platform Bus is a transparent bus that doesn't need a specific
  driver to perform operations at bus level.

  Similar to simple-bus, a Simple Platform Bus allows to automatically
  instantiate devices connected to this bus. Those devices are instantiated
  only by the Simple Platform Bus probe function itself.

properties:
  $nodename:
    pattern: "^bus(@[0-9a-f]+)?$"

  compatible:
    const: simple-platform-bus

  '#address-cells':
    enum: [ 1, 2 ]

  '#size-cells':
    enum: [ 1, 2 ]

  ranges: true

required:
  - compatible
  - '#address-cells'
  - '#size-cells'

additionalProperties: false

examples:
  - |

    bus {
        compatible = "simple-platform-bus";
        #address-cells = <1>;
        #size-cells = <1>;
        ranges;
    };
```

## Documentation/devicetree/bindings/bus/ti,da850-mstpri.yaml
```yaml
# SPDX-License-Identifier: (GPL-2.0-only OR BSD-2-Clause)
%YAML 1.2
---
$id: http://devicetree.org/schemas/bus/ti,da850-mstpri.yaml#
$schema: http://devicetree.org/meta-schemas/core.yaml#
title: Texas Instruments DA850 Master Peripheral Priority
maintainers:
  - Bartosz Golaszewski <bartosz.golaszewski@oss.qualcomm.com>
description: |
  DA8XX SoCs feature a set of registers allowing to change the priority of all
  peripherals classified as masters.
properties:
  compatible:
    const: ti,da850-mstpri
  reg:
    maxItems: 1
required:
  - compatible
  - reg

additionalProperties: false

examples:
  - |
    mstpri@14110 {
        compatible = "ti,da850-mstpri";
        reg = <0x14110 0x0c>;
    };
```

## Documentation/devicetree/bindings/cache/andestech,andes-llcache.yaml
```yaml
# SPDX-License-Identifier: (GPL-2.0 OR BSD-2-Clause)
# Copyright (C) 2023 Renesas Electronics Corp.
%YAML 1.2
---
$id: http://devicetree.org/schemas/cache/andestech,llcache.yaml#
$schema: http://devicetree.org/meta-schemas/core.yaml#

title: Andestech Last Level Cache Controller

maintainers:
  - Lad Prabhakar <prabhakar.mahadev-lad.rj@bp.renesas.com>

description:
  A last level cache (LLC) is used to improve the system performance by providing
  a large amount of cache line entries and reasonable access delays. The LLC
  is shared between cores, and a non-inclusive non-exclusive policy is used.

select:
  properties:
    compatible:
      contains:
        enum:
          - andestech,llcache

  required:
    - compatible

properties:
  compatible:
    items:
      - enum:
          - andestech,qilai-llcache
          - renesas,r9a07g043f-llcache
      - const: andestech,llcache
      - const: cache

  reg:
    maxItems: 1

  interrupts:
    maxItems: 1

  cache-line-size:
    const: 64

  cache-level:
    const: 2

  cache-sets:
    enum: [1024, 2048]

  cache-size:
    enum: [131072, 262144, 524288, 1048576, 2097152]

  cache-unified: true

  next-level-cache: true

additionalProperties: false

required:
  - compatible
  - reg
  - interrupts
  - cache-line-size
  - cache-level
  - cache-sets
  - cache-size
  - cache-unified

allOf:
  - if:
      properties:
        compatible:
          contains:
            const: andestech,qilai-llcache

    then:
      properties:
        cache-sets:
          const: 2048
        cache-size:
          const: 2097152
    else:
      properties:
        cache-sets:
          const: 1024

examples:
  - |
    #include <dt-bindings/interrupt-controller/irq.h>

    cache-controller@13400000 {
        compatible = "renesas,r9a07g043f-llcache", "andestech,llcache",
                     "cache";
        reg = <0x13400000 0x100000>;
        interrupts = <508 IRQ_TYPE_LEVEL_HIGH>;
        cache-line-size = <64>;
        cache-level = <2>;
        cache-sets = <1024>;
        cache-size = <262144>;
        cache-unified;
    };
```

## Documentation/devicetree/bindings/chrome/google,cros-charge-state.yaml
```yaml
# SPDX-License-Identifier: (GPL-2.0-only OR BSD-2-Clause)
%YAML 1.2
---
$id: http://devicetree.org/schemas/chrome/google,cros-charge-state.yaml#
$schema: http://devicetree.org/meta-schemas/core.yaml#

title: Google Chrome OS EC(Embedded Controller) charge state driver.

maintainers:
  - Sung-Chi, Li <lschyi@chromium.org>

description:
  Chrome OS devices have an Embedded Controller(EC) which has access to
  battery charger IC. This node is intended to allow the host to read and
  control the charger current. The node for this device should be under a
  cros-ec node like google,cros-ec-spi.

properties:
  compatible:
    const: google,cros-ec-charge-state

  min-milliamp:
    description: min current in milliamp.
    $ref: /schemas/types.yaml#/definitions/uint32

  max-milliamp:
    description: max current in milliamp.
    $ref: /schemas/types.yaml#/definitions/uint32

  type:
    description: current limit type.
    enum:
      - charge
      - input

required:
  - compatible
  - min-milliamp
  - man-milliamp
  - type

additionalProperties: false

examples:
  - |+
    spi {
      #address-cells = <1>;
      #size-cells = <0>;

      cros_ec: ec@0 {
        compatible = "google,cros-ec-spi";
        reg = <0>;
        interrupts = <35 0>;

        charge_chip_battery_current: charge-chip-battery {
          compatible = "google,cros-ec-charge";
          type = "charge";
          min-milliamp = <150>;
          max-milliamp = <5000>;
        };
      };
    };
```

## Documentation/devicetree/bindings/chrome/google,cros-ec-ucsi.yaml
```yaml
# SPDX-License-Identifier: (GPL-2.0-only OR BSD-2-Clause)
%YAML 1.2
---
$id: http://devicetree.org/schemas/chrome/google,cros-ec-ucsi.yaml#
$schema: http://devicetree.org/meta-schemas/core.yaml#

title: Google Chrome OS EC(Embedded Controller) UCSI driver.

maintainers:
  - Abhishek Pandit-Subedi <abhishekpandit@chromium.org>
  - Andrei Kuchynski <akuchynski@chromium.org>
  - Benson Leung <bleung@chromium.org>
  - Jameson Thies <jthies@google.com>
  - Łukasz Bartosik <ukaszb@chromium.org>

description:
  Chrome OS devices with PDC-based USB-C ports expose a UCSI interface
  from the Embedded Controller (EC) which allows the host to request
  port state and control limited port behavior (DR/PR swap). This node
  allows the host UCSI driver to send and receive UCSI commands to a
  Chrome OS EC. The node for this device should be under a cros-ec node
  like google,cros-ec-spi.

properties:
  compatible:
    const: google,cros-ec-ucsi

  '#address-cells':
    const: 1

  '#size-cells':
    const: 0

patternProperties:
  '^connector@[0-9a-f]+$':
    $ref: /schemas/connector/usb-connector.yaml#
    required:
      - reg

required:
  - compatible

additionalProperties: false

examples:
  - |+
    spi {
      #address-cells = <1>;
      #size-cells = <0>;

      cros_ec: ec@0 {
        compatible = "google,cros-ec-spi";
        reg = <0>;
        interrupts = <35 0>;

        typec {
          compatible = "google,cros-ec-ucsi";

          #address-cells = <1>;
          #size-cells = <0>;

          connector@0 {
            compatible = "usb-c-connector";
            reg = <0>;
            power-role = "dual";
            data-role = "dual";
            try-power-role = "source";
          };
        };
      };
    };
```

## Documentation/devicetree/bindings/clock/actions,owl-cmu.yaml
```yaml
# SPDX-License-Identifier: (GPL-2.0-only OR BSD-2-Clause)
%YAML 1.2
---
$id: http://devicetree.org/schemas/clock/actions,owl-cmu.yaml#
$schema: http://devicetree.org/meta-schemas/core.yaml#

title: Actions Semi Owl Clock Management Unit (CMU)

maintainers:
  - Manivannan Sadhasivam <manivannan.sadhasivam@linaro.org>

description: |
  The Actions Semi Owl Clock Management Unit generates and supplies clock
  to various controllers within the SoC.

  All available clocks are defined as preprocessor macros in
  include/dt-bindings/clock/ headers.

properties:
  compatible:
    enum:
      - actions,s500-cmu
      - actions,s700-cmu
      - actions,s900-cmu

  clocks:
    items:
      - description: Host oscillator source
      - description: Internal low frequency oscillator source

  "#clock-cells":
    const: 1

  reg:
    maxItems: 1

  "#reset-cells":
    const: 1

required:
  - compatible
  - reg
  - "#clock-cells"
  - "#reset-cells"

additionalProperties: false

examples:
  - |
    soc {
        #address-cells = <2>;
        #size-cells = <2>;
        cmu: clock-controller@e0160000 {
          compatible = "actions,s900-cmu";
          reg = <0x0 0xe0160000 0x0 0x1000>;
          clocks = <&hosc>, <&losc>;
          #clock-cells = <1>;
          #reset-cells = <1>;
        };
    };
...
```

## Documentation/devicetree/bindings/clock/allwinner,sun8i-b288-ccu.yaml
```yaml
# SPDX-License-Identifier: (GPL-2.0-only OR BSD-2-Clause)
%YAML 1.2
---
$id: http://devicetree.org/schemas/clock/allwinner,sun8i-b288-ccu.yaml#
$schema: http://devicetree.org/meta-schemas/core.yaml#

title: Allwinner B288 Clock Control Unit

maintainers:
  - Chen-Yu Tsai <wens@csie.org>
  - Maxime Ripard <mripard@kernel.org>

properties:
  "#clock-cells":
    const: 1

  "#reset-cells":
    const: 1

  compatible:
    const: allwinner,sun8i-b288-ccu

  reg:
    maxItems: 1

  clocks:
    items:
      - description: High Frequency Oscillator
      - description: Low Frequency Oscillator

  clock-names:
    items:
      - const: hosc
      - const: losc

required:
  - "#clock-cells"
  - "#reset-cells"
  - compatible
  - reg
  - clocks
  - clock-names

additionalProperties: false

examples:
  - |
    ccu: clock-controller@1c20000 {
        compatible = "allwinner,sun8i-b288-ccu";
        reg = <0x01c20000 0x400>;
        clocks = <&osc24M>, <&osc32k>;
        clock-names = "hosc", "losc";
        #clock-cells = <1>;
        #reset-cells = <1>;
    };
```
