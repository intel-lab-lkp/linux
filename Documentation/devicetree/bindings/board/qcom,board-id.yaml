## Documentation/devicetree/bindings/clock/altr,socfpga-a10.yaml
```yaml
# SPDX-License-Identifier: (GPL-2.0-only OR BSD-2-Clause)
%YAML 1.2
---
$id: http://devicetree.org/schemas/clock/altr,socfpga-a10.yaml#
$schema: http://devicetree.org/meta-schemas/core.yaml#

title: Device Tree Clock bindings for Altera's SoCFPGA platform

maintainers:
  - TODO

description:
  This binding uses the common clock binding[1].

  [1] Documentation/devicetree/bindings/clock/clock-bindings.txt

properties:
  compatible:
    description: |
      shall be one of the following
        - "altr,socfpga-a10-pll-clock" - for a PLL clock
        - "altr,socfpga-a10-perip-clk" - The peripheral clock divided from the
            PLL clock.
        - "altr,socfpga-a10-gate-clk" - Clocks that directly feed peripherals
            and can get gated.
    enum:
      - altr,socfpga-a10-pll-clock
      - altr,socfpga-a10-perip-clk
      - altr,socfpga-a10-gate-clk

  reg:
    description: |
      shall be the control register offset from CLOCK_MANAGER's base for the
      clock.
    maxItems: 1

  clocks:
    description: |
      shall be the input parent clock phandle for the clock. This is either an
      oscillator or a pll output.
    minItems: 1
    maxItems: 5

  '#clock-cells':
    description: from common clock binding, shall be set to 0.
    maxItems: 1

  fixed-divider:
    description: if clocks have a fixed divider value, use this property.
    minimum: 1
    maximum: 16

  clk-gate:
    description: |
      for "socfpga-a10-gate-clk", clk-gate contains the gating register and the
      bit index.
    minItems: 2

  div-reg:
    description: |
      for "socfpga-a10-gate-clk" and "socfpga-a10-periph-clk", div-reg contains
      the divider register, bit shift, and width.
    minItems: 3
    maxItems: 3

  clk-phase:
    description: |
      for the sdmmc_clk, contains the value of the clock phase that controls
      the SDMMC CIU clock. The first value is the clk_sample(smpsel), and the
      second value is the cclk_in_drv(drvsel). The clk-phase is used to enable
      the correct hold/delay times that is needed for the SD/MMC CIU clock. The
      values of both can be 0-315 degrees, in 45 degree increments.
    minItems: 1

required:
  - compatible
  - clocks
  - '#clock-cells'

oneOf:
  - items:
      - required:
          - reg
      - required:
          - div-reg

additionalProperties: false

examples:
  - |
    main_pll: main_pll@40 {
      #address-cells = <1>;
      #size-cells = <0>;
      #clock-cells = <0>;
      compatible = "altr,socfpga-a10-pll-clock";
      clocks = <&osc1>, <&cb_intosc_ls_clk>,
           <&f2s_free_clk>;
      reg = <0x40>;

      main_noc_base_clk: main_noc_base_clk {
        compatible = "altr,socfpga-a10-perip-clk";
        div-reg = <0x140 16 11>;
        clocks = <&periph_pll>;
        #clock-cells = <0>;
      };
    };
...
```

## Documentation/devicetree/bindings/clock/ambarella,cv75-rct.yaml
```yaml
# SPDX-License-Identifier: GPL-2.0-only OR BSD-2-Clause
%YAML 1.2
---
$id: http://devicetree.org/schemas/clock/ambarella,cv75-rct.yaml#
$schema: http://devicetree.org/meta-schemas/core.yaml#

title: Ambarella CV75 RCT Clock Controller

maintainers:
  - Long Zhao <longzhao@ambarella.com>

description: |
  The RCT (Reset and Clock Tree) block on the Ambarella CV75 SoC provides
  PLLs, clock muxes and dividers for on-chip peripherals.

  The same register region is also exposed as a syscon for other SoC
  blocks (e.g. pin drive-strength), hence the "syscon" compatible.

  Clock indices are defined in
  include/dt-bindings/clock/ambarella,cv75-clock.h:

  - CV75_GCLK_UART0: UART0 mux/div clock
  - CV75_GCLK_CORE: Core PLL (gclk_core)
  - CV75_GCLK_AHB: AHB bus clock (core / 2)
  - CV75_GCLK_APB: APB bus clock (core / 4)

properties:
  $nodename:
    pattern: "^clock-controller@"

  compatible:
    items:
      - const: ambarella,cv75-rct
      - const: syscon

  reg:
    maxItems: 1

  clocks:
    description: Reference crystal oscillator (typically 24 MHz)
    maxItems: 1

  clock-names:
    const: osc

  "#clock-cells":
    const: 1

required:
  - compatible
  - reg
  - clocks
  - clock-names
  - "#clock-cells"

additionalProperties: false

examples:
  - |
    clock-controller@ed080000 {
        compatible = "ambarella,cv75-rct", "syscon";
        reg = <0xed080000 0x1000>;
        clocks = <&osc>;
        clock-names = "osc";
        #clock-cells = <1>;
    };
```

## Documentation/devicetree/bindings/clock/amlogic,a1-audio-clkc.yaml
```yaml
# SPDX-License-Identifier: GPL-2.0-only OR BSD-2-Clause
%YAML 1.2
---
$id: http://devicetree.org/schemas/clock/amlogic,a1-audio-clkc.yaml#
$schema: http://devicetree.org/meta-schemas/core.yaml#

title: Amlogic A1 Audio Clock Control Unit and Reset Controller

maintainers:
  - Neil Armstrong <neil.armstrong@linaro.org>
  - Jerome Brunet <jbrunet@baylibre.com>
  - Jan Dakinevich <jan.dakinevich@salutedevices.com>

properties:
  compatible:
    const: amlogic,a1-audio-clkc

  '#clock-cells':
    const: 1

  '#reset-cells':
    const: 1

  reg:
    minItems: 2
    maxItems: 2

  clocks:
    items:
      - description: input main peripheral bus clock
      - description: input dds_in
      - description: input fixed pll div2
      - description: input fixed pll div3
      - description: input hifi_pll
      - description: input oscillator (usually at 24MHz)

  clock-names:
    items:
      - const: pclk
      - const: dds_in
      - const: fclk_div2
      - const: fclk_div3
      - const: hifi_pll
      - const: xtal

required:
  - compatible
  - '#clock-cells'
  - '#reset-cells'
  - reg
  - clocks
  - clock-names

additionalProperties: false

examples:
  - |
    #include <dt-bindings/clock/amlogic,a1-pll-clkc.h>
    #include <dt-bindings/clock/amlogic,a1-peripherals-clkc.h>
    audio {
        #address-cells = <2>;
        #size-cells = <2>;

        clkc_audio: audio-clock-controller@0 {
                compatible = "amlogic,a1-audio-clkc";
                reg = <0x0 0xfe050000 0x0 0xb0>,
                      <0x0 0xfe054800 0x0 0x20>;
                #clock-cells = <1>;
                #reset-cells = <1>;
                clocks = <&clkc_periphs CLKID_AUDIO>,
                         <&clkc_periphs CLKID_DDS_IN>,
                         <&clkc_pll CLKID_FCLK_DIV2>,
                         <&clkc_pll CLKID_FCLK_DIV3>,
                         <&clkc_pll CLKID_HIFI_PLL>,
                         <&xtal>;
                clock-names = "pclk",
                              "dds_in",
                              "fclk_div2",
                              "fclk_div3",
                              "hifi_pll",
                              "xtal";
        };
    };
```

## Documentation/devicetree/bindings/clock/amlogic,a4-pll-clkc.yaml
```yaml
# SPDX-License-Identifier: (GPL-2.0-only OR BSD-2-Clause)
# Copyright (C) 2025 Amlogic, Inc. All rights reserved
%YAML 1.2
---
$id: http://devicetree.org/schemas/clock/amlogic,a4-pll-clkc.yaml#
$schema: http://devicetree.org/meta-schemas/core.yaml#

title: Amlogic A4 series PLL Clock Controller

maintainers:
  - Neil Armstrong <neil.armstrong@linaro.org>
  - Jerome Brunet <jbrunet@baylibre.com>
  - Chuan Liu <chuan.liu@amlogic.com>
  - Xianwei Zhao <xianwei.zhao@amlogic.com>

properties:
  compatible:
    const: amlogic,a4-pll-clkc

  reg:
    maxItems: 1

  clocks:
    items:
      - description: input oscillator
      - description: input fix pll

  clock-names:
    items:
      - const: xtal
      - const: fix

  "#clock-cells":
    const: 1

required:
  - compatible
  - reg
  - clocks
  - clock-names
  - "#clock-cells"

additionalProperties: false

examples:
  - |
    #include <dt-bindings/clock/amlogic,a4-scmi-clkc.h>
    apb {
        #address-cells = <2>;
        #size-cells = <2>;

        clock-controller@8000 {
            compatible = "amlogic,a4-pll-clkc";
            reg = <0x0 0x8000 0x0 0x110>;
            clocks = <&xtal>,
                     <&scmi_clk CLKID_FIXED_PLL>;
            clock-names = "xtal",
                          "fix";
            #clock-cells = <1>;
        };
    };
```

## Documentation/devicetree/bindings/clock/amlogic,a5-peripherals-clkc.yaml
```yaml
# SPDX-License-Identifier: (GPL-2.0-only OR BSD-2-Clause)
# Copyright (C) 2024 Amlogic, Inc. All rights reserved
%YAML 1.2
---
$id: http://devicetree.org/schemas/clock/amlogic,a5-peripherals-clkc.yaml#
$schema: http://devicetree.org/meta-schemas/core.yaml#

title: Amlogic A5 series Peripheral Clock Controller

maintainers:
  - Xianwei Zhao <xianwei.zhao@amlogic.com>
  - Chuan Liu <chuan.liu@amlogic.com>

properties:
  compatible:
    const: amlogic,a5-peripherals-clkc

  reg:
    maxItems: 1

  clocks:
    minItems: 18
    items:
      - description: input oscillator
      - description: input oscillators multiplexer
      - description: input fix pll
      - description: input fclk div 2
      - description: input fclk div 2p5
      - description: input fclk div 3
      - description: input fclk div 4
      - description: input fclk div 5
      - description: input fclk div 7
      - description: input mpll2
      - description: input mpll3
      - description: input gp0 pll
      - description: input gp1 pll
      - description: input hifi pll
      - description: input sys clk
      - description: input axi clk
      - description: input sys pll div 16
      - description: input cpu clk div 16
      - description: input pad clock for rtc clk (optional)
      - description: input ddr pll (optional)
      - description: input source from clk-measure (optional)
      - description: input rtc pll (optional)

  clock-names:
    minItems: 18
    items:
      - const: xtal
      - const: oscin
      - const: fix
      - const: fdiv2
      - const: fdiv2p5
      - const: fdiv3
      - const: fdiv4
      - const: fdiv5
      - const: fdiv7
      - const: mpll2
      - const: mpll3
      - const: gp0
      - const: gp1
      - const: hifi
      - const: sysclk
      - const: axiclk
      - const: sysplldiv16
      - const: cpudiv16
      - const: pad_osc
      - const: ddr
      - const: clkmsr
      - const: rtc

  "#clock-cells":
    const: 1

required:
  - compatible
  - reg
  - clocks
  - clock-names
  - "#clock-cells"

additionalProperties: false

examples:
  - |
    #include <dt-bindings/clock/amlogic,a5-scmi-clkc.h>
    #include <dt-bindings/clock/amlogic,a5-pll-clkc.h>
    apb {
        #address-cells = <2>;
        #size-cells = <2>;

        clock-controller@0 {
            compatible = "amlogic,a5-peripherals-clkc";
            reg = <0x0 0x0 0x0 0x224>;
            #clock-cells = <1>;
            clocks = <&xtal>,
                     <&scmi_clk CLKID_OSC>,
                     <&scmi_clk CLKID_FIXED_PLL>,
                     <&scmi_clk CLKID_FCLK_DIV2>,
                     <&scmi_clk CLKID_FCLK_DIV2P5>,
                     <&scmi_clk CLKID_FCLK_DIV3>,
                     <&scmi_clk CLKID_FCLK_DIV4>,
                     <&scmi_clk CLKID_FCLK_DIV5>,
                     <&scmi_clk CLKID_FCLK_DIV7>,
                     <&clkc_pll CLKID_MPLL2>,
                     <&clkc_pll CLKID_MPLL3>,
                     <&clkc_pll CLKID_GP0_PLL>,
                     <&scmi_clk CLKID_GP1_PLL>,
                     <&clkc_pll CLKID_HIFI_PLL>,
                     <&scmi_clk CLKID_SYS_CLK>,
                     <&scmi_clk CLKID_AXI_CLK>,
                     <&scmi_clk CLKID_SYS_PLL_DIV16>,
                     <&scmi_clk CLKID_CPU_CLK_DIV16>;
            clock-names = "xtal",
                          "oscin",
                          "fix",
                          "fdiv2",
                          "fdiv2p5",
                          "fdiv3",
                          "fdiv4",
                          "fdiv5",
                          "fdiv7",
                          "mpll2",
                          "mpll3",
                          "gp0",
                          "gp1",
                          "hifi",
                          "sysclk",
                          "axiclk",
                          "sysplldiv16",
                          "cpudiv16";
        };
    };
```

## Documentation/devicetree/bindings/clock/amlogic,a5-pll-clkc.yaml
```yaml
# SPDX-License-Identifier: (GPL-2.0-only OR BSD-2-Clause)
# Copyright (C) 2024 Amlogic, Inc. All rights reserved
%YAML 1.2
---
$id: http://devicetree.org/schemas/clock/amlogic,a5-pll-clkc.yaml#
$schema: http://devicetree.org/meta-schemas/core.yaml#

title: Amlogic A5 series PLL Clock Controller

maintainers:
  - Chuan Liu <chuan.liu@amlogic.com>
  - Xianwei Zhao <xianwei.zhao@amlogic.com>

properties:
  compatible:
    const: amlogic,a5-pll-clkc

  reg:
    maxItems: 1

  clocks:
    items:
      - description: input oscillator
      - description: input fix pll dco
      - description: input fix pll

  clock-names:
    items:
      - const: xtal
      - const: fix_dco
      - const: fix

  "#clock-cells":
    const: 1

required:
  - compatible
  - reg
  - clocks
  - clock-names
  - "#clock-cells"

additionalProperties: false

examples:
  - |
    #include <dt-bindings/clock/amlogic,a5-scmi-clkc.h>
    apb {
        #address-cells = <2>;
        #size-cells = <2>;

        clock-controller@8000 {
            compatible = "amlogic,a5-pll-clkc";
            reg = <0x0 0x8000 0x0 0x1a4>;
            clocks = <&xtal>,
                     <&scmi_clk CLKID_FIXED_PLL_DCO>,
                     <&scmi_clk CLKID_FIXED_PLL>;
            clock-names = "xtal",
                          "fix_dco",
                          "fix";
            #clock-cells = <1>;
        };
    };
```
