## Documentation/devicetree/bindings/board/qcom,board-id.yaml
```yaml
# SPDX-License-Identifier: BSD-2-Clause
%YAML 1.2
---
$id: http://devicetree.org/schemas/board/qcom,board-id.yaml
$schema: http://devicetree.org/meta-schemas/core.yaml

title: Board identifiers for devices from Qualcomm Technologies, Inc.
description: Board identifiers for devices from Qualcomm Technologies, Inc.

maintainers:
  - Elliot Berman <quic_eberman@quicinc.com>

properties:
  $nodename:
    const: 'board-id'

  qcom,soc:
    description:
      List of Qualcomm SoCs this devicetree is applicable to.

  qcom,soc-version:
    items:
      items:
        - description: Qualcomm SoC identifier
        - description: SoC version

  qcom,platform:
    description:
      List of Qualcomm platforms this devicetree is applicable to.

  qcom,platform-type:
    items:
      items:
        - description: Qualcomm platform type identifier
        - description: Qualcomm platform subtype

  qcom,platform-version:
    items:
      items:
        - description: Qualcomm platform type identifier
        - description: Qualcomm platform subtype
        - description: Qualcomm platform major and minor version.

  qcom,boot-device:
    description:
      Boot device type

  qcom,pmic:
    description:
      List of Qualcomm PMIC attaches

  qcom,pmic-id:
    items:
      items:
        - description: Qualcomm PMIC identifier
        - description: Qualcomm PMIC revision

allOf:
  # either describe soc or soc-version; it's confusing to have both
  - if:
      properties:
        qcom,soc: true
    then:
      properties:
        qcom,soc-version: false
  - if:
      properties:
        qcom,soc-version: true
    then:
      properties:
        qcom,soc: false

  # describe one of platform, platform-type, or platform-version; it's confusing to have multiple
  - if:
    properties:
      qcom,platform: true
    then:
      properties:
        qcom,platform-type: false
        qcom,platform-version: false
  - if:
    properties:
      qcom,platform-type: true
    then:
      properties:
        qcom,platform: false
        qcom,platform-version: false
  - if:
    properties:
      qcom,platform: true
    then:
      properties:
        qcom,platform: false
        qcom,platform-type: false

  # either describe pmic or pmic-id; it's confusing to have both
  - if:
    properties:
      qcom,pmic: true
    then:
      properties:
        qcom,pmic-id: false
  - if:
    properties:
      qcom,pmic-id: true
    then:
      properties:
        qcom,pmic: false

additionalProperties: true

examples:
  - |
    #include <dt-bindings/arm/qcom,ids.h>
    / {
      compatible = "qcom,sm8650";
      board-id {
        qcom,soc = <QCOM_ID_SM8650>;
        qcom,platform = <QCOM_BOARD_ID_MTP>;
      };
    };

  - |
    #include <dt-bindings/arm/qcom,ids.h>
    / {
      compatible = "qcom,sm8650";
      board-id {
        qcom,soc-version = <QCOM_ID_SM8650 QCOM_SOC_REVISION(1)>,
                           <QCOM_ID_SM8650 QCOM_SOC_REVISION(2)>;
        qcom,platform-type = <QCOM_BOARD_ID_MTP 0>, <QCOM_BOARD_ID_MTP 1>;
      };
    };

  - |
    #include <dt-bindings/arm/qcom,ids.h>
    / {
      compatible = "qcom,sm8650";
      board-id {
        qcom,soc = <QCOM_ID_SM8650>;
        qcom,platform-version = <QCOM_BOARD_ID(MTP, 0, 1, 0)>,
                                <QCOM_BOARD_ID(MTP, 0, 1, 1)>;
        qcom,boot-device = <QCOM_BOARD_BOOT_UFS>;
      };
    };
```

## Documentation/devicetree/bindings/bootcache/linux,bootcache-backend-memory.yaml
```yaml
# SPDX-License-Identifier: (GPL-2.0-only OR BSD-2-Clause)
%YAML 1.2
---
$id: http://devicetree.org/schemas/bootcache/linux,bootcache-backend-memory.yaml#
$schema: http://devicetree.org/meta-schemas/core.yaml#

title: Bootcache Framework reserved memory backend

maintainers:
  - Marc Kelly <mkelly@thegoodpenguin.co.uk>
  - Andrea Campenella <acampenella@thegoodpenguin.co.uk>

description:
  This bootcache backend adds support for using reserved memory
  for the storage location for bootcache data. On initialization this
  memory is read and any bootcache entries found are added to the
  bootcache framework.
  Data is inserted into these memory locations via the bootloader
  or other means before the kernel boots.

properties:
  compatible:
    enum:
      - linux,backend-backend-memory

  reg:
    maxItems: 2

  memory-region:
    maxItems: 1
    description:
      Contains the bootcache reserved memory.
      Data format is a binary block of packed cache data consisting
      of a selection of key and value pairs, along with size indicators.
      The format should be considered private to the driver and should
      not be interpreted outside of the drivers context.

required:
  - compatible
  - reg
  - memory-region

unevaluatedProperties: false

examples:
  - |
    /*
     * The bootcache-backend is placed in the in the main domain
     * of the SOC, with the reserved memory location defined as
     * follows.
     * This defines 64kBytes in the upper 2GBytes.
     *
     * The size
     * reserved-memory {
     *     bootcache_reserved: bootcache-reserved@BFFF0000 {
     *         no-map;
     *         reg = <0x00 0xBFFF0000 0x00 0x10000>;
     *         label = "bootcache_backend_memory";
     *     };
     * }
     */

    bootcache-backend@BFFF0000 {
        compatible = "linux,backend-backend-memory";
        reg = <0x00 0xBFFF0000 0x00 0x10000>;
        memory-region = <&bootcache_reserved>;
    };
```

## Documentation/devicetree/bindings/bus/altera-timeout-bridge.yaml
```yaml
# SPDX-License-Identifier: GPL-2.0-only OR BSD-2-Clause
%YAML 1.2
---
$id: http://devicetree.org/schemas/bus/altera-timeout-bridge.yaml#
$schema: http://devicetree.org/meta-schemas/core.yaml#

title: Altera Timeout Bridge

maintainers:
  - Vyacheslav Yurkov <V.Yurkov.EXT@bruker.com>

description: |
  Altera timeout bridge bus.

properties:
  compatible:
    items:
      - const: altera-timeout-bridge
      - const: simple-bus
  reg:
    maxItems: 1

  interrupts:
    maxItems: 1

  ranges: true

  "#address-cells":
    const: 1

  "#size-cells":
    const: 1

required:
  - compatible
  - reg
  - interrupts
  - interrupt-parent
  - ranges
  - "#address-cells"
  - "#size-cells"

patternProperties:
  "^[a-zA-Z][a-zA-Z0-9,+._-]*@[0-9a-f]+$":
    type: object
    description: |
      Device connected to the timeout bridge.

    required:
      - compatible
      - reg

    additionalProperties: true

additionalProperties: false

examples:
  - |
    #include <dt-bindings/interrupt-controller/irq.h>

    intc: interrupt-controller {
        interrupt-controller;
        #interrupt-cells = <3>;
    };

    timeout_bridge_hps@10000 {
        compatible = "altera-timeout-bridge", "simple-bus";
        #address-cells = <1>;
        #size-cells = <1>;

        reg = <0x10000 0xF>;

        interrupts = <0 12 IRQ_TYPE_LEVEL_HIGH>;
        interrupt-parent = <&intc>;

        ranges = <0x0 0x10010 0x1000>;

        timeout-device@100 {
            compatible = "timeout-device";
            reg = <0x100 0x10>;
        };
    };
```

## Documentation/devicetree/bindings/bus/brcm,bcm6362-wlan-bus-axi.yaml
```yaml
# SPDX-License-Identifier: (GPL-2.0-only OR BSD-2-Clause)
%YAML 1.2
---
$id: http://devicetree.org/schemas/bus/brcm,bcm6362-wlan-bus-axi.yaml#
$schema: http://devicetree.org/meta-schemas/core.yaml#

title: Broadcom BCM6362 integrated WLAN AXI backplane

maintainers:
  - Alessio Ferri <alessio.ferri@mythread.it>

description: |
  The BCM6362 integrates a WLAN macro on a dedicated AXI backplane
  (bcma), whose cores are discovered at runtime from the backplane
  EROM.

  The cores have no DMP wrappers: clock gating and reset of the
  ChipCommon and 802.11 cores are controlled through a separate WLAN
  control register block. The backplane registers are big-endian.

  Interrupts of the cores are described with an interrupt-map, keyed
  by the core base address and the core interrupt index, as for
  brcm,bus-axi.

properties:
  compatible:
    const: brcm,bcm6362-wlan-bus-axi

  reg:
    items:
      - description: ChipCommon core registers
      - description: WLAN control registers

  reg-names:
    items:
      - const: chipcommon
      - const: wlan-ctrl

  clocks:
    maxItems: 1

  resets:
    items:
      - description: WLAN macro reset
      - description: WLAN UBUS interface reset

  reset-names:
    items:
      - const: wlan
      - const: wlan-ubus

  power-domains:
    maxItems: 1

  "#address-cells":
    const: 1

  "#interrupt-cells":
    const: 1

  interrupt-map-mask: true

  interrupt-map: true

required:
  - compatible
  - reg
  - reg-names
  - clocks
  - resets
  - reset-names
  - power-domains
  - "#address-cells"
  - "#interrupt-cells"
  - interrupt-map-mask
  - interrupt-map

additionalProperties: false

examples:
  - |
    #include <dt-bindings/clock/bcm6362-clock.h>
    #include <dt-bindings/reset/bcm6362-reset.h>
    #include <dt-bindings/soc/bcm6362-pm.h>

    bus@10004000 {
        compatible = "brcm,bcm6362-wlan-bus-axi";
        reg = <0x10004000 0x1000>, <0x10007000 0x100>;
        reg-names = "chipcommon", "wlan-ctrl";

        #address-cells = <1>;
        clocks = <&periph_clk BCM6362_CLK_WLAN_OCP>;
        #interrupt-cells = <1>;
        interrupt-map = <0x00005000 0 &periph_intc 7>;
        interrupt-map-mask = <0x000fffff 0xffff>;
        power-domains = <&periph_pwr BCM6362_POWER_DOMAIN_WLAN_PADS>;
        resets = <&periph_rst BCM6362_RST_WLAN_SHIM>,
                 <&periph_rst BCM6362_RST_WLAN_UBUS>;
        reset-names = "wlan", "wlan-ubus";
    };
```

## Documentation/devicetree/bindings/bus/brcm,bcm6362-wlan.yaml
```yaml
# SPDX-License-Identifier: (GPL-2.0-only OR BSD-2-Clause)
%YAML 1.2
---
$id: http://devicetree.org/schemas/bus/brcm,bcm6362-wlan.yaml#
$schema: http://devicetree.org/meta-schemas/core.yaml#

title: Broadcom BCM6362 on-chip WLAN SHIM bridge

maintainers:
  - Alessio Ferri <alessio.ferri@mythread.it>

description: |
  The BCM6362 SoC integrates a 2.4 GHz Broadcom WLAN block whose
  register backplane uses the Broadcom AMBA (bcma) architecture. The
  backplane is gated by a small SHIM bridge that holds the WLAN macro
  in reset and disables its clocks until released by software. CFE
  does not release this block, so software bring-up is required
  before bcma can enumerate the backplane.

  This binding describes the SHIM bridge node. The SHIM driver brings
  the macro up and then populates the brcm,bus-axi child node, which
  describes the bcma backplane behind the SHIM and is bound by the
  bcma-host-soc driver. The SoC-specific configuration (big-endian
  accessors, SHIM-attached topology, SHIM Control register peephole
  pointer) is delivered to bcma via platform_data injected at
  populate time, so the brcm,bus-axi child stays SoC-agnostic.

properties:
  compatible:
    const: brcm,bcm6362-wlan

  reg:
    maxItems: 1
    description: SHIM peephole registers.

  reg-names:
    items:
      - const: shim

  clocks:
    maxItems: 1

  resets:
    items:
      - description: SHIM macro reset
      - description: SHIM ubus reset

  reset-names:
    items:
      - const: shim
      - const: shim-ubus

  '#address-cells':
    const: 1

  '#size-cells':
    const: 1

  ranges: true

patternProperties:
  "^axi@[0-9a-f]+$":
    type: object
    description: The bcma AXI backplane behind the SHIM.
    $ref: /schemas/types.yaml#

required:
  - compatible
  - reg
  - reg-names
  - clocks
  - resets
  - reset-names
  - '#address-cells'
  - '#size-cells'
  - ranges

additionalProperties: false

examples:
  - |
    wlan@10007000 {
        compatible = "brcm,bcm6362-wlan";
        reg = <0x10007000 0x100>;
        reg-names = "shim";
        clocks = <&periph_clk 11>;
        resets = <&periph_rst 7>, <&periph_rst 17>;
        reset-names = "shim", "shim-ubus";

        #address-cells = <1>;
        #size-cells = <1>;
        ranges;

        axi@10004000 {
            compatible = "brcm,bus-axi";
            reg = <0x10004000 0x1000>;
            ranges = <0x00000000 0x10004000 0x00002000>;

            #address-cells = <1>;
            #size-cells = <1>;
            #interrupt-cells = <1>;

            interrupt-map-mask = <0x000fffff 0xffff>;
            interrupt-map = <0x00005000 0 &periph_intc 0 12>;
        };
    };
```

## Documentation/devicetree/bindings/bus/brcm,bus-axi.yaml
```yaml
# SPDX-License-Identifier: (GPL-2.0-only OR BSD-2-Clause)
%YAML 1.2
---
$id: http://devicetree.org/schemas/bus/brcm,bus-axi.yaml#
$schema: http://devicetree.org/meta-schemas/core.yaml#

title: Broadcom AXI Bus with bcma driver

maintainers:
  - Hauke Mehrtens <hauke@hauke-mehrtens.de>
  - Rafał Miłecki <rafal@milecki.pl>

description: |
  Driver for ARM AXI Bus with Broadcom Plugins (bcma).

  The cores on the AXI bus are automatically detected by bcma with the
  memory ranges they are using and they get registered afterwards.
  Automatic detection of the IRQ number is not working on
  BCM47xx/BCM53xx ARM SoCs. To assign IRQ numbers to the cores, provide
  them manually through device tree. Use an interrupt-map to specify the
  IRQ used by the devices on the bus. The first address is just an index,
  because we do not have any special register.

properties:
  compatible:
    const: brcm,bus-axi

  reg:
    description: IOMEM address range of chipcommon core.
    maxItems: 1

  ranges: true

  "#address-cells":
    const: 1

  "#size-cells":
    const: 1

  "#interrupt-cells":
    const: 1

  interrupt-map-mask: true
  interrupt-map: true

patternProperties:
  "@[0-9a-f]+$":
    type: object

required:
  - compatible
  - reg

additionalProperties: false

examples:
  - |
    axi@18000000 {
        compatible = "brcm,bus-axi";
        reg = <0x18000000 0x1000>;
        ranges = <0x00000000 0x18000000 0x00100000>;
        #address-cells = <1>;
        #size-cells = <1>;
        #interrupt-cells = <1>;
        interrupt-map-mask = <0x000fffff 0xffff>;
        interrupt-map =
            /* Ethernet Controller 0 */
            <0x00024000 0 &gic GIC_SPI 147 IRQ_TYPE_LEVEL_HIGH>,
            /* Ethernet Controller 1 */
            <0x00025000 0 &gic GIC_SPI 148 IRQ_TYPE_LEVEL_HIGH>;

        chipcommon {
            reg = <0x00000000 0x1000>;
            gpio-controller;
            #gpio-cells = <2>;
        };
    };
```
