## Documentation/devicetree/bindings/power/supply/sgmicro,sgm41542.yaml
```yaml
# SPDX-License-Identifier: (GPL-2.0-only OR BSD-2-Clause)
%YAML 1.2
---
$id: http://devicetree.org/schemas/power/supply/sgmicro,sgm41542-charger.yaml#
$schema: http://devicetree.org/meta-schemas/core.yaml#

title: SGM41542 Battery Charger

description:
  The SGMicro SGM41542 is a single cell battery charger/boost controller.

maintainers:
  - Chris Morgan <macromorgan@hotmail.com>
  - Xu Shengfei <xsf@rock-chips.com>

properties:
  compatible:
    const: sgmicro,sgm41542

  input-current-limit-microamp:
    description:
      Optional value to clamp the maximum input current limit to for
      the device. If omitted, the default value for the hardware will
      be used (2400000).
    minimum: 100000
    maximum: 3800000

  input-voltage-limit-microvolt:
    description:
      Optional value to clamp the maximum input voltage limit to for
      the device. If omitted, the default value for the hardware will
      be used (4500000).
    minimum: 3900000
    maximum: 12000000

  interrupts:
    maxItems: 1

  monitored-battery:
    description: |
        A phandle to a monitored battery node. Values for the following
        are used by the driver and if not present will result in default
        values being applied:
        constant-charge-current-max-microamp
        constant-charge-voltage-max-microvolt
        charge-term-current-microamp
        precharge-current-microamp

  reg:
    maxItems: 1

  regulators:
    type: object
    properties:
      otg-vbus:
        type: object
        description: OTG boost regulator
        $ref: /schemas/regulator/regulator.yaml
        unevaluatedProperties: false
    additionalProperties: false

required:
  - compatible
  - reg

additionalProperties: false

examples:
  - |
    battery: battery {
      compatible = "simple-battery";
      constant-charge-current-max-microamp = <10000000>;
      constant-charge-voltage-max-microvolt = <4350000>;
      precharge-current-microamp = <180000>;
      charge-term-current-microamp = <300000>;
    };
    #include <dt-bindings/gpio/gpio.h>
    #include <dt-bindings/interrupt-controller/irq.h>
    i2c {
      #address-cells = <1>;
      #size-cells = <0>;

      charger@3b {
        compatible = "sgmicro,sgm41542";
        reg = <0x3b>;
        input-current-limit-microamp = <3000000>;
        input-voltage-limit-microvolt = <4500000>;
        interrupt-parent = <&gpio0>;
        interrupts = <26 IRQ_TYPE_EDGE_FALLING>;
        monitored-battery = <&battery>;

        regulators {
          otg-vbus {
            regulator-max-microvolt = <5000000>;
            regulator-min-microvolt = <5000000>;
          };
        };
      };
    };
```

## Documentation/devicetree/bindings/power/supply/silergy,sy6974b.yaml
```yaml
# SPDX-License-Identifier: (GPL-2.0-only OR BSD-2-Clause)
# Copyright (C) 2025 Silergy Semiconductor Technology Co., Ltd.
%YAML 1.2
---
$id: http://devicetree.org/schemas/power/supply/silergy,sy6974b.yaml#
$schema: http://devicetree.org/meta-schemas/core.yaml#

title: Silergy SY6974B 3A Single Cell Switching Battery charger

maintainers:
  - Tian Ge <tian.ge@silergymicro.com>

allOf:
  - $ref: power-supply.yaml#

properties:
  compatible:
    const: silergy,sy6974b

  reg:
    maxItems: 1

  interrupts:
    maxItems: 1

  sy,charge-current:
    $ref: /schemas/types.yaml#/definitions/uint32
    description: |
      maximum charging current (in mA).
      Range: 0 ~ 3000 mA, step: 60 mA

  sy,precharge-current:
    $ref: /schemas/types.yaml#/definitions/uint32
    description: |
      maximum charge current during precharge phase (in mA).
      Range: 60 ~ 780 mA, step: 60 mA

  sy,termination-current:
    $ref: /schemas/types.yaml#/definitions/uint32
    description: |
      charge will be terminated when current in constant-voltage phase
      drops below this value (in mA).
      Range: 60 ~ 960 mA, step: 60 mA

  sy,regulation-voltage:
    $ref: /schemas/types.yaml#/definitions/uint32
    description: |
      maximum charging voltage (in mV).
      Range: 3856 ~ 4624 mV, step: 32 mV

  sy,minimum-sys-voltage:
    $ref: /schemas/types.yaml#/definitions/uint32
    description: |
      when battery is charging and it is below minimum system voltage,
      the system will be regulated above minimum-sys-voltage setting (in mV).
      Allowed values: 2600, 2800, 3000, 3200, 3400, 3500, 3600, 3700 mV

required:
  - compatible
  - reg
  - interrupts
  - sy,charge-current
  - sy,precharge-current
  - sy,termination-current
  - sy,regulation-voltage
  - sy,minimum-sys-voltage

unevaluatedProperties: false

examples:
  - |
    #include <dt-bindings/interrupt-controller/irq.h>
    i2c {
      #address-cells = <1>;
      #size-cells = <0>;

      charger@6b {
        compatible = "silergy,sy6974b";
        reg = <0x6b>;

        interrupt-parent = <&tlmm>;
        interrupts = <64 IRQ_TYPE_EDGE_FALLING>;

        sy,charge-current = <3000>;		/* 3000 mA */
        sy,precharge-current = <500>;		/* 500 mA */
        sy,termination-current = <300>;		/* 300 mA */
        sy,regulation-voltage = <4480>;		/* 4480 mV */
        sy,minimum-sys-voltage = <3500>;	/* 3500 mV */
      };
    };
```

## Documentation/devicetree/bindings/power/supply/stc3117-fg.yaml
```yaml
# SPDX-License-Identifier: GPL-2.0-only
%YAML 1.2
---
$id: http://devicetree.org/schemas/power/supply/stc3117-fg.yaml#
$schema: http://devicetree.org/meta-schemas/core.yaml#

title: STMicroelectronics STC3117 Fuel Gauge Unit Power Supply

maintainers:
  - Bhavin Sharma <bhavin.sharma@siliconsignals.io>
  - Hardevsinh Palaniya <hardevsinh.palaniya@siliconsignals.io>

allOf:
  - $ref: power-supply.yaml#

properties:
  compatible:
    enum:
      - st,stc3117-fgu

  reg:
    maxItems: 1

required:
  - compatible
  - reg

additionalProperties: false

examples:
  - |
    &i2c6 {
      #address-cells = <1>;
      #size-cells = <0>;

      st3117: stc3117@70 {
        compatible = "st,stc3117-fgu";
        reg = <0x70>;
        status = "okay";
      };
    };
```

## Documentation/devicetree/bindings/power/ti,omap3-smartreflex-core.yaml
```yaml
# SPDX-License-Identifier: (GPL-2.0-only OR BSD-2-Clause)
%YAML 1.2
---
$id: http://devicetree.org/schemas/power/ti,omap3-smartreflex-core.yaml#
$schema: http://devicetree.org/meta-schemas/core.yaml#

title: Texas Instruments SmartReflex module

maintainers:
  - Tony Lindgren <tony@atomide.com>

description:
  Texas Instruments SmartReflex is an on-chip adaptive power management
  technology integrated into TI's OMAP and other SoCs. It dynamically
  adjusts voltage and frequency for different chip domains in real time
  to compensate for process, voltage, and temperature (PVT) variations.
  Dedicated hardware sensors and control logic continuously monitor
  conditions and apply the lowest safe voltage for the required performance
  level.

properties:
  compatible:
    enum:
      - ti,omap3-smartreflex-core
      - ti,omap3-smartreflex-mpu-iva
      - ti,omap4-smartreflex-core
      - ti,omap4-smartreflex-mpu
      - ti,omap4-smartreflex-iva

  reg:
    maxItems: 1

  interrupts:
    maxItems: 1

  ti,hwmods:
    $ref: /schemas/types.yaml#/definitions/string
    deprecated: true
    description:
      It was required by the OMAP interconnect/PRCM code to automatically
      initialize hardware modules using TI's internal database.

required:
  - compatible
  - reg
  - interrupts

unevaluatedProperties: false

examples:
  - |
    #include <dt-bindings/interrupt-controller/arm-gic.h>
    smartreflex@4a0db000 {
        compatible = "ti,omap4-smartreflex-iva";
        reg = <0x4a0db000 0x80>;
        interrupts = <GIC_SPI 102 IRQ_TYPE_LEVEL_HIGH>;
    };
...
```
