## Documentation/devicetree/bindings/power/supply/glinet,gl-e750-mcu.yaml
```yaml
# SPDX-License-Identifier: (GPL-2.0-only OR BSD-2-Clause)
%YAML 1.2
---
$id: http://devicetree.org/schemas/power/supply/glinet,gl-e750-mcu.yaml#
$schema: http://devicetree.org/meta-schemas/core.yaml#

title: GL.iNet GL-E750 status MCU

maintainers:
  - Serv Pol <servpol@tuta.io>

description:
  The GL.iNet GL-E750 (Mudi) travel router has a microcontroller connected
  to the SoC UART. It drives the OLED status screen, monitors the battery
  and reports when the power switch is turned off, a few seconds before it
  cuts the power.

allOf:
  - $ref: power-supply.yaml#
  - $ref: /schemas/serial/serial-peripheral-props.yaml#

properties:
  compatible:
    const: glinet,gl-e750-mcu

required:
  - compatible

unevaluatedProperties: false

examples:
  - |
    serial {
        mcu {
            compatible = "glinet,gl-e750-mcu";
        };
    };
```

## Documentation/devicetree/bindings/power/supply/maxim,max17042.yaml
```yaml
# SPDX-License-Identifier: GPL-2.0
%YAML 1.2
---
$id: http://devicetree.org/schemas/power/supply/maxim,max17042.yaml#
$schema: http://devicetree.org/meta-schemas/core.yaml#

title: Maxim 17042 fuel gauge series

maintainers:
  - Sebastian Reichel <sre@kernel.org>

allOf:
  - $ref: maxim,max17042-base.yaml#

properties:
  reg:
    maxItems: 1

required:
  - reg

additionalProperties: false

examples:
  - |
    i2c {
      #address-cells = <1>;
      #size-cells = <0>;

      battery@36 {
        compatible = "maxim,max17042";
        reg = <0x36>;
        maxim,rsns-microohm = <10000>;
        maxim,over-heat-temp = <600>;
        maxim,over-volt = <4300>;
      };
    };
```

## Documentation/devicetree/bindings/power/supply/maxim,max17201.yaml
```yaml
# SPDX-License-Identifier: GPL-2.0-only OR BSD-2-Clause
%YAML 1.2
---
$id: http://devicetree.org/schemas/power/supply/maxim,max17201.yaml#
$schema: http://devicetree.org/meta-schemas/core.yaml#

title: Maxim MAX17201 fuel gauge

maintainers:
  - Dimitri Fedrau <dima.fedrau@gmail.com>

properties:
  compatible:
    oneOf:
      - const: maxim,max17201
      - const: maxim,max77759-fg
      - items:
          - enum:
              - maxim,max17205
          - const: maxim,max17201

  reg:
    items:
      - description: ModelGauge m5 registers
      - description: Nonvolatile registers
    minItems: 1
    maxItems: 2

  reg-names:
    items:
      - const: m5
      - const: nvmem
    minItems: 1
    maxItems: 2

  shunt-resistor-micro-ohms:
    description: The value of current sense resistor in microohms.

  interrupts:
    maxItems: 1

required:
  - compatible
  - reg
  - reg-names

allOf:
  - $ref: power-supply.yaml#

  - if:
      properties:
        compatible:
          contains:
            enum:
              - maxim,max17201
    then:
      properties:
        reg:
          minItems: 2
        reg-names:
          minItems: 2

  - if:
      properties:
        compatible:
          contains:
            enum:
              - maxim,max77759-fg
    then:
      properties:
        reg:
          maxItems: 1
        reg-names:
          maxItems: 1
      required:
        - shunt-resistor-micro-ohms

unevaluatedProperties: false

examples:
  - |
    #include <dt-bindings/interrupt-controller/irq.h>
    i2c {
      #address-cells = <1>;
      #size-cells = <0>;

      fuel-gauge@36 {
        compatible = "maxim,max17201";
        reg = <0x36>, <0xb>;
        reg-names = "m5", "nvmem";
        interrupt-parent = <&gpio0>;
        interrupts = <31 IRQ_TYPE_LEVEL_LOW>;
      };
    };
```

## Documentation/devicetree/bindings/power/supply/maxim,max77705-fg.yaml
```yaml
# SPDX-License-Identifier: GPL-2.0-only OR BSD-2-Clause
%YAML 1.2
---
$id: http://devicetree.org/schemas/power/supply/maxim,max77705-fg.yaml#
$schema: http://devicetree.org/meta-schemas/core.yaml#

title: Maxim MAX77705 Companion Power Management IC fuelgauge

maintainers:
  - Dzmitry Sankouski <dsankouski@gmail.com>

description: |
  This is a part of device tree bindings for Maxim MAX77705 multi functional device.

  MAX77705 fuelgauge with ModelGauge m5 EZ algorithm support.

  See also Documentation/devicetree/bindings/mfd/maxim,max77705.yaml for
  additional information and example.

allOf:
  - $ref: power-supply.yaml#

properties:
  compatible:
    const: maxim,max77705-fg

  rsense:
    $ref: /schemas/types.yaml#/definitions/uint32
    description: |
      Sense resistor value in mOhm

required:
  - compatible

additionalProperties: false
```

## Documentation/devicetree/bindings/power/supply/maxim,max77759-charger.yaml
```yaml
# SPDX-License-Identifier: GPL-2.0-only OR BSD-2-Clause
%YAML 1.2
---
$id: http://devicetree.org/schemas/power/supply/maxim,max77759-charger.yaml#
$schema: http://devicetree.org/meta-schemas/core.yaml#

title: Maxim Integrated MAX77759 Battery charger

maintainers:
  - Amit Sunil Dhamne <amitsd@google.com>

description: |
  This module is part of the MAX77759 PMIC. For additional information, see
  Documentation/devicetree/bindings/mfd/maxim,max77759.yaml.

  The Maxim MAX77759 is a dual input switch mode battery charger for portable
  applications. It supports wired and wireless charging and can operate in buck
  and boost mode.

allOf:
  - $ref: power-supply.yaml#

properties:
  compatible:
    const: maxim,max77759-charger

  usb-otg-vbus-regulator:
    type: object
    description: Provides Boost for sourcing VBUS.
    $ref: /schemas/regulator/regulator.yaml#
    unevaluatedProperties: false

required:
  - compatible

unevaluatedProperties: false
```

## Documentation/devicetree/bindings/power/supply/maxim,max77759.yaml
```yaml
# SPDX-License-Identifier: GPL-2.0-only OR BSD-2-Clause
%YAML 1.2
---
$id: http://devicetree.org/schemas/power/supply/maxim,max77759.yaml#
$schema: http://devicetree.org/meta-schemas/core.yaml#

title: Maxim Integrated MAX77759 fuel gauge

maintainers:
  - Thomas Antoine <t.antoine@uclouvain.be>

allOf:
  - $ref: power-supply.yaml#

properties:
  compatible:
    const: maxim,max77759-fg

  reg:
    maxItems: 1

  interrupts:
    maxItems: 1

  shunt-resistor-micro-ohms:
    description: The value of the current sense resistor in microohms.

  monitored-battery:
    description: |
      The fuel gauge needs the following battery properties:
      - charge-full-design-microamp-hours
      - charge-term-current-microamp

  nvmem-cells:
    maxItems: 1
    description: |
      Saved fuel gauge state. This state will be used during the initialization
      and saved on exit. It must be initialized beforehand.
      Its layout must be composed of
        - RCOMP0 (characterization of the open-circuit voltage)
        - TCOMPO (temperature compensation information)
        - FULLCAPREP (reported full capacity)
        - QRTABLE00, QRTABLE10, QRTABLE20, QRTABLE30 (cell capacity information)
        - cv_mixcap (remaining capacity of the cell without empty compensation)
        - cv_halftime (time-to-full characterization time constant)
      They must all be aligned on 2 bytes. A valid CRC8 checksum must
      also be found at the end (polynomial x^8 + x^2 + x + 1).

  nvmem-cell-names:
    const: fg_state

required:
  - compatible
  - reg
  - shunt-resistor-micro-ohms
  - monitored-battery
  - nvmem-cells
  - nvmem-cell-names

unevaluatedProperties: false

examples:
  - |
    #include <dt-bindings/interrupt-controller/irq.h>
    i2c {
      #address-cells = <1>;
      #size-cells = <0>;

      fuel-gauge@36 {
        compatible = "maxim,max77759-fg";
        reg = <0x36>;
        interrupts-extended = <&gpa9 3 IRQ_TYPE_LEVEL_LOW>;
        shunt-resistor-micro-ohms = <5000>;
        monitored-battery = <&battery>;
        nvmem-cells = <&fg_state>;
        nvmem-cell-names = "fg_state";
      };
    };
```

## Documentation/devicetree/bindings/power/supply/maxim,max8971.yaml
```yaml
# SPDX-License-Identifier: (GPL-2.0-only OR BSD-2-Clause)
%YAML 1.2
---
$id: http://devicetree.org/schemas/power/supply/maxim,max8971.yaml#
$schema: http://devicetree.org/meta-schemas/core.yaml#

title: Maxim MAX8971 IC charger

maintainers:
  - Svyatoslav Ryhel <clamor95@gmail.com>

description:
  The MAX8971 is a compact, high-frequency, high-efficiency switch-mode charger
  for a one-cell lithium-ion (Li+) battery.

allOf:
  - $ref: power-supply.yaml#

properties:
  compatible:
    const: maxim,max8971

  reg:
    maxItems: 1

  interrupts:
    maxItems: 1

  monitored-battery: true

  maxim,usb-connector:
    description:
      Phandle to a USB connector according to usb-connector.yaml. The connector
      should be a child of the extcon device.
    $ref: /schemas/types.yaml#/definitions/phandle

required:
  - compatible
  - reg
  - interrupts

unevaluatedProperties: false

examples:
  - |
    #include <dt-bindings/gpio/gpio.h>
    #include <dt-bindings/interrupt-controller/irq.h>

    i2c {
        #address-cells = <1>;
        #size-cells = <0>;

        charger@35 {
            compatible = "maxim,max8971";
            reg = <0x35>;

            interrupt-parent = <&gpio>;
            interrupts = <74 IRQ_TYPE_LEVEL_LOW>;

            monitored-battery = <&battery>;
            maxim,usb-connector = <&usb_con>;
        };
    };
...
```

## Documentation/devicetree/bindings/power/supply/pf1550_charger.yaml
```yaml
# SPDX-License-Identifier: GPL-2.0
%YAML 1.2
---
$id: http://devicetree.org/schemas/power/supply/pf1550_charger.yaml#
$schema: http://devicetree.org/meta-schemas/core.yaml#

title: Battery charger driver for PF1550 PMIC from NXP.

maintainers:
  - Samuel Kayode <samuel.kayode@savoirfairelinux.com>

description: |
  This module is part of the PF1550 MFD device. For more details
  see Documentation/devicetree/bindings/mfd/pf1550.yaml.

  The charger is represented as a sub-node of the PMIC node on the device tree.

properties:
  compatible:
    const: fsl,pf1550-charger

  fsl,constant-microvolt:
    description:
      Constant charge voltage (in microvolts).
    minimum: 3500000
    maximum: 4400000

  fsl,min-system-microvolt:
    description:
      Minimum charge voltage (in microvolts).
    enum: [ 3500000, 3700000, 4300000 ]

  fsl,thermal-regulation:
    $ref: /schemas/types.yaml#/definitions/uint32
    description:
      Temperature (in degrees Celsius) threshold past which the charging
      current is reduced.
    enum: [ 60, 75, 90, 105 ]

required:
  - compatible
additionalProperties: false

...
```

## Documentation/devicetree/bindings/power/supply/qcom,pmi8998-fg.yaml
```yaml
# SPDX-License-Identifier: (GPL-2.0-only or BSD-3-Clause)
%YAML 1.2
---
$id: http://devicetree.org/schemas/power/supply/qcom,pmi8998-fg.yaml#
$schema: http://devicetree.org/meta-schemas/core.yaml#

title: Qualcomm PMI8998 PMIC Fuel Gauge

maintainers:
  - Casey Connolly <casey@connolly.tech>
  - Joel Selvaraj <foss@joelselvaraj.com>
  - Yassine Oudjana <y.oudjana@protonmail.com>

allOf:
  - $ref: /schemas/power/supply/power-supply.yaml#

properties:
  compatible:
    const: qcom,pmi8998-fg

  reg:
    maxItems: 1

  monitored-battery:
    description: |
       phandle of battery characteristics node.
       The fuel gauge uses the following battery properties:
       - charge-full-design-microamp-hours
       - voltage-min-design-microvolt
       - voltage-max-design-microvolt
       See Documentation/devicetree/bindings/power/supply/battery.yaml

  interrupts:
    items:
      - description: State of charge change interrupt

  interrupt-names:
    items:
      - const: soc-delta

  power-supplies: true

required:
  - compatible
  - reg
  - monitored-battery
  - interrupts
  - interrupt-names

additionalProperties: false

examples:
  - |
    #include <dt-bindings/interrupt-controller/irq.h>

    battery: battery {
      compatible = "simple-battery";

      charge-full-design-microamp-hours = <4070000>;
      voltage-min-design-microvolt = <3400000>;
      voltage-max-design-microvolt = <4400000>;
    };

    pmic {
      #address-cells = <1>;
      #size-cells = <0>;

      fuel-gauge@4000 {
        compatible = "qcom,pmi8998-fg";
        reg = <0x4000>;

        interrupts = <0x2 0x40 0x4 IRQ_TYPE_EDGE_RISING>;
        interrupt-names = "soc-delta";

        monitored-battery = <&battery>;
      };
    };
```

## Documentation/devicetree/bindings/power/supply/samsung,s2mu005-charger.yaml
```yaml
# SPDX-License-Identifier: (GPL-2.0-only OR BSD-2-Clause)
%YAML 1.2
---
$id: http://devicetree.org/schemas/power/supply/samsung,s2mu005-charger.yaml#
$schema: http://devicetree.org/meta-schemas/core.yaml#

title: Battery Charger for Samsung S2M series PMICs

maintainers:
  - Kaustabh Chakraborty <kauschluss@disroot.org>

description: |
  The Samsung S2M series PMIC battery charger manages power interfacing
  of the USB port. It may supply power, as done in USB OTG operation
  mode, or it may accept power and redirect it to the battery fuelgauge
  for charging.

  This is a part of device tree bindings for S2M and S5M family of Power
  Management IC (PMIC).

  See also Documentation/devicetree/bindings/mfd/samsung,s2mps11.yaml for
  additional information and example.

allOf:
  - $ref: power-supply.yaml#

properties:
  compatible:
    enum:
      - samsung,s2mu005-charger

required:
  - compatible

unevaluatedProperties: false
```
