## Documentation/devicetree/bindings/power/reset/google,gs101-reboot.yaml
```yaml
# SPDX-License-Identifier: GPL-2.0-only OR BSD-2-Clause
%YAML 1.2
---
$id: http://devicetree.org/schemas/power/reset/google,gs101-reboot.yaml#
$schema: http://devicetree.org/meta-schemas/core.yaml#

title: Google GS101 syscon-mapped reset

maintainers:
  - André Draszik <andre.draszik@linaro.org>

description:
  GS101 supports a couple different reset types via certain registers in the
  SYSCON register map. This map is retrieved from the parental dt-node. So the
  gs101-reboot node should be represented as a sub-node of such a node.

properties:
  compatible:
    oneOf:
      - items:
          - const: google,gs101-reboot

  priority:
    default: 192

required:
  - compatible

additionalProperties: false

allOf:
  - $ref: restart-handler.yaml#
```

## Documentation/devicetree/bindings/power/reset/pscr-nvmem.yaml
```yaml
# SPDX-License-Identifier: (GPL-2.0-only OR BSD-2-Clause)
%YAML 1.2
---
$id: http://devicetree.org/schemas/power/state-change/pscr-nvmem.yaml#
$schema: http://devicetree.org/meta-schemas/core.yaml#

title: Generic NVMEM Power State Change Reason storage

maintainers:
  - Oleksij Rempel <o.rempel@pengutronix.de>

description: This binding describes the Non-Volatile Memory (NVMEM) hardware
  that stores Power State Change Reasons (PSCR).

allOf:
  - $ref: pse-controller.yaml#

properties:
  compatible:
    const: pscr-nvmem

  nvmem-cells:
    description: |
      A phandle pointing to the nvmem-cells node where the power state change
      reasons are stored.
    maxItems: 1

  nvmem-cell-names:
    items:
      - const: pscr

  pscr-unknown:
  pscr-under-voltage:
  pscr-over-current:
  pscr-over-temperature:

required:
  - compatible
  - nvmem-cells
  - nvmem-cell-names

additionalProperties: false

examples:
  - |
    power-state-change-reason {
      compatible = "pscr-nvmem";
      nvmem-cells = <&pscr_cell>;
      nvmem-cell-names = "pscr";
      pscr-unknown = <1>;
      pscr-under-voltage = <2>;
      pscr-over-temperature = <3>;
    };
...
```

## Documentation/devicetree/bindings/power/reset/pscr.yaml
```yaml
# SPDX-License-Identifier: (GPL-2.0-only OR BSD-2-Clause)
%YAML 1.2
---
$id: http://devicetree.org/schemas/power/state-change/pscr.yaml#
$schema: http://devicetree.org/meta-schemas/core.yaml#

title: Power State Change Reason (PSCR)

maintainers:
  - Oleksij Rempel <o.rempel@pengutronix.de>

description: Binding for devices responsable to store reasons for power state
  changes such as reboot and power-off. Reasons like unknown, under voltage,
  and over temperature are captured for diagnostic or automatic recovery
  purposes.

properties:
  $nodename:
    pattern: "^pscr(@.*|-([0-9]|[1-9][0-9]+))?$"

  pscr-unknown:
    $ref: /schemas/types.yaml#/definitions/uint32
    description: Value to indicate an unknown reason for the power state change.

  pscr-under-voltage:
    $ref: /schemas/types.yaml#/definitions/uint32
    description: |
      Value to indicate an under-voltage condition of a system critical
      regulator as the reason for the power state change.

  pscr-over-current:
    $ref: /schemas/types.yaml#/definitions/uint32
    description: |
      Value to indicate an over-current condition of a system ctitical regulator
      as the reason for the power state change.

  pscr-regulator-failure:
    $ref: /schemas/types.yaml#/definitions/uint32
    description: |
      Value to indicate an unknow, system ctitical regulator related failure
      as the reason for the power state change.

  pscr-over-temperature:
    $ref: /schemas/types.yaml#/definitions/uint32
    description: |
      Value to indicate a system critical over-temperature condition as the
      reason for the power state change.

additionalProperties: true

...
```

## Documentation/devicetree/bindings/power/reset/pscrr-nvmem.yaml
```yaml
# SPDX-License-Identifier: (GPL-2.0-only OR BSD-2-Clause)
%YAML 1.2
---
$id: http://devicetree.org/schemas/power/reset/pscrr-nvmem.yaml#
$schema: http://devicetree.org/meta-schemas/core.yaml#

title: Generic NVMEM Power State Change Reason Recorder

maintainers:
  - Oleksij Rempel <o.rempel@pengutronix.de>

description: This binding describes the Non-Volatile Memory (NVMEM) hardware
  that stores Power State Change Reasons (PSCR).

allOf:
  - $ref: pscrr.yaml#

properties:
  compatible:
    const: pscrr-nvmem

  nvmem-cells:
    description: |
      A phandle pointing to the nvmem-cells node where the power state change
      reasons are stored.
    maxItems: 1

  nvmem-cell-names:
    items:
      - const: pscr

  pscr-under-voltage: true
  pscr-over-current: true
  pscr-regulator-failure: true
  pscr-over-temperature: true

required:
  - compatible
  - nvmem-cells
  - nvmem-cell-names

additionalProperties: false

examples:
  - |
    power-state-change-reason {
      compatible = "pscrr-nvmem";
      nvmem-cells = <&pscr_cell>;
      nvmem-cell-names = "pscr";
      pscr-under-voltage = <1>;
      pscr-over-temperature = <2>;
    };
...
```

## Documentation/devicetree/bindings/power/reset/rda,md-reset.yaml
```yaml
# SPDX-License-Identifier: GPL-2.0-only OR BSD-2-Clause
%YAML 1.2
---
$id: http://devicetree.org/schemas/power/reset/rda,md-reset.yaml#
$schema: http://devicetree.org/meta-schemas/core.yaml#

title: RDA Micro Modem Reset

maintainers:
  - Dang Huynh <dang.huynh@mainlining.org>

description:
  The modem has a reset register that can be used to fully reset the board.

  To do that, a magic value needs to be written to unprotect the register,
  then the soft reset register can be used.

properties:
  compatible:
    const: rda,md-reset

  reg:
    maxItems: 1

required:
  - compatible
  - reg

additionalProperties: false

examples:
  - |
    reset-controller@1a00000 {
      compatible = "rda,md-reset";
      reg = <0x1a00000 0x4>;
    };
```

## Documentation/devicetree/bindings/power/reset/sprd,sc2731-poweroff.yaml
```yaml
# SPDX-License-Identifier: GPL-2.0-only OR BSD-2-Clause
%YAML 1.2
---
$id: http://devicetree.org/schemas/power/reset/sprd,sc2731-poweroff.yaml#
$schema: http://devicetree.org/meta-schemas/core.yaml#

title: Unisoc SC27xx series PMIC power off

maintainers:
  - Otto Pflüger <otto.pflueger@abscue.de>

properties:
  compatible:
    enum:
      - sprd,sc2730-poweroff
      - sprd,sc2731-poweroff

required:
  - compatible

additionalProperties: false
...
```

## Documentation/devicetree/bindings/power/reset/st,stih407-restart.yaml
```yaml
# SPDX-License-Identifier: (GPL-2.0-only OR BSD-2-Clause)
%YAML 1.2
---
$id: http://devicetree.org/schemas/power/reset/st,stih407-restart.yaml#
$schema: http://devicetree.org/meta-schemas/core.yaml#

title: ST SW reset controller

maintainers:
  - Lee Jones <lee@kernel.org>

properties:
  compatible:
    const: st,stih407-restart

  st,syscfg:
    description: phandle of the syscfg node
    $ref: /schemas/types.yaml#/definitions/phandle

required:
  - compatible
  - st,syscfg

additionalProperties: false

examples:
  - |
    reset {
      compatible = "st,stih407-restart";
      st,syscfg = <&syscfg_sbc_reg>;
    };
```

## Documentation/devicetree/bindings/power/reset/syscon-reboot.yaml
```yaml
# SPDX-License-Identifier: GPL-2.0
%YAML 1.2
---
$id: http://devicetree.org/schemas/power/reset/syscon-reboot.yaml#
$schema: http://devicetree.org/meta-schemas/core.yaml#

title: Generic SYSCON mapped register reset driver

maintainers:
  - Sebastian Reichel <sre@kernel.org>

description: |+
  This is a generic reset driver using syscon to map the reset register.
  The reset is generally performed with a write to the reset register
  defined by the SYSCON register map base plus the offset with the value and
  mask defined in the reboot node. Default will be little endian mode, 32 bit
  access only. The SYSCON registers map is normally retrieved from the
  parental dt-node. So the SYSCON reboot node should be represented as a
  sub-node of a "syscon", "simple-mfd" node. Though the regmap property
  pointing to the system controller node is also supported.
  This also supports specification of separate sets of register/mask/value
  pairs for different types of reset: cold, hard, soft and warm, using
  the respective properties with the respective reset type prefix. If prefixed
  properties are not specified for a reset type, the non-prefixed properties
  will be used for that reset type.

properties:
  compatible:
    const: syscon-reboot

  mask:
    $ref: /schemas/types.yaml#/definitions/uint32
    description: Update only the register bits defined by the mask (32 bit).

  offset:
    $ref: /schemas/types.yaml#/definitions/uint32
    description: Offset in the register map for the reboot register (in bytes).

  reg:
    maxItems: 1
    description: Base address and size for the reboot register.

  regmap:
    $ref: /schemas/types.yaml#/definitions/phandle
    deprecated: true
    description: |
      Phandle to the register map node. This property is deprecated in favor of
      the syscon-reboot node been a child of a system controller node.

  value:
    $ref: /schemas/types.yaml#/definitions/uint32
    description: The reset value written to the reboot register (32 bit access).

  priority:
    default: 192

patternProperties:
  "^(cold|hard|soft|warm)-(mask|offset|value)$":
    $ref: /schemas/types.yaml#/definitions/uint32
    description:
      Optional alternative offset / mask / value combinations for specific
      reboot modes. The mask is optional.

  "^(cold|hard|soft|warm)-reg$":
    description:
      Optional alternative base address and size for the reboot register for
      specific reboot modes.

oneOf:
  - required:
      - offset
  - required:
      - reg

dependencies:
  cold-mask: [ cold-value ]
  cold-offset: [ cold-value ]
  cold-reg: [ cold-value ]

  hard-mask: [ hard-value ]
  hard-offset: [ hard-value ]
  hard-reg: [ hard-value ]

  soft-mask: [ soft-value ]
  soft-offset: [ soft-value ]
  soft-reg: [ soft-value ]

  warm-mask: [ warm-value ]
  warm-offset: [ warm-value ]
  warm-reg: [ warm-value ]

required:
  - compatible

additionalProperties: false

allOf:
  - $ref: restart-handler.yaml#
  - if:
      not:
        required:
          - mask
    then:
      required:
        - value

  - if:
      required:
        - cold-value
    then:
      oneOf:
        - required:
            - cold-offset
        - required:
            - cold-reg

  - if:
      required:
        - hard-value
    then:
      oneOf:
        - required:
            - hard-offset
        - required:
            - hard-reg

  - if:
      required:
        - soft-value
    then:
      oneOf:
        - required:
            - soft-offset
        - required:
            - soft-reg

  - if:
      required:
        - warm-value
    then:
      oneOf:
        - required:
            - warm-offset
        - required:
            - warm-reg

examples:
  - |
    reboot {
        compatible = "syscon-reboot";
        regmap = <&regmapnode>;
        offset = <0x0>;
        mask = <0x1>;
    };
```

## Documentation/devicetree/bindings/power/reset/ti,sci-reboot.yaml
```yaml
# SPDX-License-Identifier: (GPL-2.0-only OR BSD-2-Clause)
%YAML 1.2
---
$id: http://devicetree.org/schemas/power/reset/ti,sci-reboot.yaml#
$schema: http://devicetree.org/meta-schemas/core.yaml#

title: TI-SCI reboot controller

maintainers:
  - Andrew Davis <afd@ti.com>

description: |
  Some TI SoCs contain a system controller (like the Power Management Micro
  Controller (PMMC) on Keystone 66AK2G SoC) that are responsible for controlling
  the state of the various hardware modules present on the SoC. Communication
  between the host processor running an OS and the system controller happens
  through a protocol called TI System Control Interface (TI-SCI protocol).

  This reboot controller node uses the TI SCI protocol to perform a device reboot.

  Must be a child node of the associated TI-SCI system controller node.

properties:
  compatible:
    const: ti,sci-reboot

additionalProperties: false

examples:
  - |
    k3_reboot: reboot-controller {
        compatible = "ti,sci-reboot";
    };
```

## Documentation/devicetree/bindings/power/sifive,tmc.yaml
```yaml
# SPDX-License-Identifier: (GPL-2.0-only OR BSD-2-Clause)
%YAML 1.2
---
$id: http://devicetree.org/schemas/power/sifive,tmc.yaml#
$schema: http://devicetree.org/meta-schemas/core.yaml#

title: SiFive Domain Management Controller

maintainers:
  - Cyan Yang <cyan.yang@sifive.com>
  - Nick Hu <nick.hu@sifive.com>
  - Samuel Holland <samuel.holland@sifive.com>

description: |
  SiFive Domain Management Controllers includes the following components
    - Tile Management Controller (TMC)
    - Cluster Management Controller (CMC)
    - Subsystem Management Controller (SMC)
  These controllers manage both the clock and power domains of the
  associated components. They support the SiFive Quiet Interface Protocol
  (SQIP) starting from Version 1. The control method differs from Version
  0, making them incompatible.

allOf:
  - $ref: power-domain.yaml#

properties:
  compatible:
    oneOf:
      - items:
          - {} # Leave a empty for future SoC specific compatible string
          - const: sifive,cmc3
          - const: sifive,cmc2
      - items:
          - {} # Leave a empty for future SoC specific compatible string
          - const: sifive,cmc2
      - items:
          - {} # Leave a empty for future SoC specific compatible string
          - const: sifive,smc0
      - items:
          - {} # Leave a empty for future SoC specific compatible string
          - const: sifive,smc1
      - items:
          - {} # Leave a empty for future SoC specific compatible string
          - const: sifive,smc3
          - const: sifive,smc1
      - items:
          - {} # Leave a empty for future SoC specific compatible string
          - const: sifive,tmc0
      - items:
          - {} # Leave a empty for future SoC specific compatible string
          - const: sifive,tmc1
      - items:
          - {} # Leave a empty for future SoC specific compatible string
          - const: sifive,tmc3
          - const: sifive,tmc1

  reg:
    maxItems: 1

  "#power-domain-cells":
    const: 0

required:
  - compatible
  - reg

additionalProperties: false

# The example will be added once the SoC specific compatible string is available
```

## Documentation/devicetree/bindings/power/supply/bq25630.yaml
```yaml
# SPDX-License-Identifier: (GPL-2.0-only OR BSD-2-Clause)
%YAML 1.2
---
$id: http://devicetree.org/schemas/power/supply/bq25630.yaml#
$schema: http://devicetree.org/meta-schemas/core.yaml#

title: TI BQ25630 battery charger

maintainers:
  - Waqar Hameed <waqar.hameed@axis.com>

description: |
  I2C controlled single cell Li-ion and Li-polymer 5A buck charger.
  Datasheet: https://www.ti.com/lit/gpn/bq25630

allOf:
  - $ref: power-supply.yaml#

properties:
  compatible:
    const: ti,bq25630

  reg:
    const: 0x6b
    description:
      Device I2C address.

  interrupts:
    maxItems: 1
    description: |
      Device sends active low 256 µs pulse. Type should therefore be
      IRQ_TYPE_EDGE_FALLING.

  monitored-battery: true

required:
  - compatible
  - reg
  - interrupts
  - monitored-battery

additionalProperties: false

examples:
  - |
    #include <dt-bindings/interrupt-controller/irq.h>

    bat: battery {
        compatible = "simple-battery";
        voltage-min-design-microvolt = <1800000>;
        constant-charge-current-max-microamp = <1344000>;
        constant-charge-voltage-max-microvolt = <3700000>;
        charge-term-current-microamp = <128000>;
        precharge-current-microamp = <1000000>;
    };

    i2c {
        #address-cells = <1>;
        #size-cells = <0>;

        charger@6b {
            compatible = "ti,bq25630";
            reg = <0x6b>;
            interrupts = <13 IRQ_TYPE_EDGE_FALLING>;
            monitored-battery = <&bat>;
        };
    };
...
```
