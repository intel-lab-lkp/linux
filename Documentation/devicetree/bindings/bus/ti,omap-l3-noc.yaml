## Documentation/devicetree/bindings/bus/ti,omap-l3-noc.yaml
```yaml
# SPDX-License-Identifier: (GPL-2.0-only OR BSD-2-Clause)
%YAML 1.2
---
$id: http://devicetree.org/schemas/bus/ti,omap-l3-noc.yaml#
$schema: http://devicetree.org/meta-schemas/core.yaml#

title: TI OMAP L3 Network On Chip (NoC) Interconnect

maintainers:
  - Santosh Shilimkar <santosh.shilimkar@ti.com>
  - Sricharan R <r.sricharan@ti.com>

description:
  The L3 interconnect is an implementation of the generic NoC IP provided by
  Arteris.

properties:
  compatible:
    enum:
      - ti,omap4-l3-noc
      - ti,omap5-l3-noc
      - ti,dra7-l3-noc
      - ti,am4372-l3-noc

  reg:
    minItems: 2
    items:
      - description: L3_MAIN_1 / L3F
      - description: L3_MAIN_2 / L3S
      - description: L3_MAIN_3

  interrupts:
    items:
      - description: l3-dbg-irq
      - description: l3-app-irq

required:
  - compatible
  - reg
  - interrupts

allOf:
  - if:
      properties:
        compatible:
          contains:
            enum:
              - ti,omap4-l3-noc
              - ti,omap5-l3-noc
    then:
      properties:
        reg:
          minItems: 3
    else:
      properties:
        reg:
          maxItems: 2

additionalProperties: false

examples:
  - |
    #include <dt-bindings/interrupt-controller/arm-gic.h>
    l3-noc@44000000 {
        compatible = "ti,omap4-l3-noc";
        reg = <0x44000000 0x1000>,
              <0x44800000 0x2000>,
              <0x45000000 0x1000>;
        interrupts = <GIC_SPI 9 IRQ_TYPE_LEVEL_HIGH>,
                     <GIC_SPI 10 IRQ_TYPE_LEVEL_HIGH>;
    };
```

## Documentation/devicetree/bindings/bus/ti,omap3-l3-smx.yaml
```yaml
# SPDX-License-Identifier: (GPL-2.0-only OR BSD-2-Clause)
%YAML 1.2
---
$id: http://devicetree.org/schemas/bus/ti,omap3-l3-smx.yaml#
$schema: http://devicetree.org/meta-schemas/core.yaml#

title: TI OMAP3 L3 (SMX) Interconnect

maintainers:
  - Santosh Shilimkar <santosh.shilimkar@ti.com>
  - Sricharan R <r.sricharan@ti.com>

description:
  The L3 interconnect for OMAP3 is based on the SonicsMX (SMX) architecture.

properties:
  compatible:
    items:
      - const: ti,omap3-l3-smx
      - const: simple-bus

  reg:
    maxItems: 1

  interrupts:
    items:
      - description: l3-dbg-irq
      - description: l3-app-irq

  ti,hwmods:
    description: hwmod names for each domain.
    $ref: /schemas/types.yaml#/definitions/string
    const: l3_main
    deprecated: true

  "#address-cells":
    const: 1

  "#size-cells":
    const: 1

  ranges: true

patternProperties:
  "^.*@[0-9a-f]+$":
    type: object

required:
  - compatible
  - reg
  - interrupts
  - "#address-cells"
  - "#size-cells"
  - ranges

additionalProperties: false

examples:
  - |
    l3-noc@68000000 {
        compatible = "ti,omap3-l3-smx", "simple-bus";
        reg = <0x68000000 0x10000>;
        #address-cells = <1>;
        #size-cells = <1>;
        ranges;
        interrupts = <9>, <10>;
        ti,hwmods = "l3_main";
    };
```

## Documentation/devicetree/bindings/clock/amlogic,s7-pll-clkc.yaml
```yaml
# SPDX-License-Identifier: (GPL-2.0-only OR BSD-2-Clause)
# Copyright (c) 2026 BayLibre, SAS.
%YAML 1.2
---
$id: http://devicetree.org/schemas/clock/amlogic,s7-pll-clkc.yaml#
$schema: http://devicetree.org/meta-schemas/core.yaml#

title: Amlogic S7 Series PLL Clock Controller

maintainers:
  - Neil Armstrong <neil.armstrong@linaro.org>
  - Jerome Brunet <jbrunet@baylibre.com>
  - Carlo Caione <ccaione@baylibre.com>

properties:
  compatible:
    const: amlogic,s7-pll-clkc

  reg:
    maxItems: 1

  '#clock-cells':
    const: 1

  clocks:
    items:
      - description: input fixed pll
      - description: input gp0 pll
      - description: input hifi pll
      - description: input hifi1 pll
      - description: input hdmi pll

  clock-names:
    items:
      - const: fix
      - const: gp0
      - const: hifi
      - const: hifi1
      - const: hdmi

required:
  - compatible
  - reg
  - '#clock-cells'
  - clocks
  - clock-names

additionalProperties: false

examples:
  - |
    #include <dt-bindings/clock/amlogic,s7-scmi-clkc.h>

    soc {
        #address-cells = <2>;
        #size-cells = <2>;

        clock-controller@8000 {
            compatible = "amlogic,s7-pll-clkc";
            reg = <0x0 0x8000 0x0 0x1e8>;
            #clock-cells = <1>;
            clocks = <&scmi_clk CLKID_TOP_PLL_OSC>,
                     <&scmi_clk CLKID_TOP_PLL_OSC>,
                     <&scmi_clk CLKID_TOP_PLL_OSC>,
                     <&scmi_clk CLKID_TOP_PLL_OSC>,
                     <&scmi_clk CLKID_HDMI_PLL_OSC>;
            clock-names = "fix",
                          "gp0",
                          "hifi",
                          "hifi1",
                          "hdmi";
        };
    };
```

## Documentation/devicetree/bindings/clock/rockchip,rk3572-cru.yaml
```yaml
# SPDX-License-Identifier: GPL-2.0-only OR BSD-2-Clause
%YAML 1.2
---
$id: http://devicetree.org/schemas/clock/rockchip,rk3572-cru.yaml#
$schema: http://devicetree.org/meta-schemas/core.yaml#

title: Rockchip RK3572 Family Clock and Reset Control Module

maintainers:
  - Elaine Zhang <zhangqing@rock-chips.com>
  - Heiko Stuebner <heiko@sntech.de>

description:
  The RK3572 CRU supplies peripheral clocks and resets.

properties:
  compatible:
    const: rockchip,rk3572-cru

  reg:
    maxItems: 1

  "#clock-cells":
    const: 1

  "#reset-cells":
    const: 1

  clocks:
    maxItems: 1

  clock-names:
    items:
      - const: xin24m

  rockchip,grf:
    $ref: /schemas/types.yaml#/definitions/phandle
    description: PMU0 GRF register block.

required:
  - compatible
  - reg
  - "#clock-cells"
  - "#reset-cells"
  - rockchip,grf

additionalProperties: false

examples:
  - |
    clock-controller@26090000 {
        compatible = "rockchip,rk3572-cru";
        reg = <0x26090000 0x60000>;
        #clock-cells = <1>;
        #reset-cells = <1>;
        rockchip,grf = <&pmu0_grf>;
    };
```

## Documentation/devicetree/bindings/clock/toshiba,tc9564-clock.yaml
```yaml
# SPDX-License-Identifier: (GPL-2.0-only OR BSD-2-Clause)
%YAML 1.2
---
$id: http://devicetree.org/schemas/clock/toshiba,tc9564-clock.yaml#
$schema: http://devicetree.org/meta-schemas/core.yaml#

title: Toshiba TC9564 Clock and Reset Controller

maintainers:
  - Lorenzo Bianconi <lorenzo.bianconi@oss.qualcomm.com>
  - Alex Elder <elder@kernel.org>
  - Daniel Thompson <danielt@kernel.org>

description:
  The Toshiba TC9564 is an SoC accessed by a host system through the
  upstream PCIe port on the PCIe switch it implements.  The chip includes
  an embedded PCIe endpoint that provides access to various peripherals
  within the SoC via its BARs.  These peripherals include a simple
  controller to gate internal clocks, and a reset controller.

  The TC9564 chip has a single input clock.  Internally that clock is
  multiplied by a PLL, and the PLL signal is divided internally into
  a set of fixed rate, always-on clocks.

  The clock controller exposes a set of simple gated clocks, which are
  controlled by two registers.  Each is derived from one of the internal
  fixed-rate clocks.  A total of 21 gated clocks are implemented within
  the chip, but support for enabling and disabling only a subset of them
  is provided at this time.  Two clocks (I2C and PCIE) are marked critical
  to make it clear that they should never be disabled.

  The reset controller uses two other registers to control a set of 13
  resets that can be asserted or deasserted.  Here too, only a subset
  of the resets can currently be managed, and the I2C and PCIE resets
  are treated as critical.

  Clock and reset IDs are defined <dt-bindings/clock/toshiba,tc9564.h>.

properties:
  compatible:
    items:
      - const: toshiba,tc9564-clock

  reg:
    maxItems: 1

  clocks:
    maxItems: 1

  "#clock-cells":
    const: 1

  "#reset-cells":
    const: 1

required:
  - compatible
  - reg
  - clocks
  - "#clock-cells"
  - "#reset-cells"

additionalProperties: false

examples:
  - |
    clock-controller@1004 {
        compatible = "toshiba,tc9564-clock";
        reg = <0x1004 0x10>;
        clocks = <&tc9564_xo_board>;
        #clock-cells = <1>;
        #reset-cells = <1>;
    };
```

## Documentation/devicetree/bindings/connector/fsl,aud-io-slot.yaml
```yaml
# SPDX-License-Identifier: (GPL-2.0-only OR BSD-2-Clause)
%YAML 1.2
---
$id: http://devicetree.org/schemas/connector/fsl,aud-io-slot.yaml#
$schema: http://devicetree.org/meta-schemas/base.yaml#

title: NXP AUD-IO Slot

maintainers:
  - Frank Li <Frank.Li@nxp.com>
  - Chancel Liu <chancel.liu@nxp.com>

description:
  The NXP AUD-IO slot represents a physically present I/O connector on
  the base board. It acts as a nexus that exposes a constrained set of
  I/O resources, such as GPIOs, clocks and interrupts, through fixed
  electrical wiring. All actual hardware providers reside on the base
  board. The connector node only defines index-based mappings to those
  providers. This connector type is present on i.MX95 19x19 EVK and
  i.MX952 EVK, where it is used to attach the IMX-AUD-IO expansion card.

properties:
  compatible:
    oneOf:
      - items:
          - enum:
              - fsl,imx952-evk-aud-io
          - const: fsl,imx95-19x19-evk-aud-io
      - const: fsl,imx95-19x19-evk-aud-io

  '#gpio-cells':
    const: 2

  gpio-map:
    minItems: 1
    maxItems: 3

  gpio-map-mask:
    items:
      - const: 0xffffffff
      - const: 0x0

  gpio-map-pass-thru:
    items:
      - const: 0x0
      - const: 0xffffffff

  '#clock-cells':
    const: 1

  clock-map:
    minItems: 1
    maxItems: 2

  '#address-cells':
    const: 0

  '#interrupt-cells':
    const: 2

  interrupt-map:
    minItems: 1
    maxItems: 2

  interrupt-map-mask:
    items:
      - const: 0xffffffff
      - const: 0x0

required:
  - compatible
  - '#gpio-cells'
  - gpio-map
  - gpio-map-mask
  - gpio-map-pass-thru

additionalProperties: false

examples:
  - |
    #include <dt-bindings/gpio/gpio.h>
    #include <dt-bindings/interrupt-controller/irq.h>

    connector {
        compatible = "fsl,imx95-19x19-evk-aud-io";
        #gpio-cells = <2>;
        gpio-map = <0 0 &gpio1 8 GPIO_ACTIVE_LOW>;
        gpio-map-mask = <0xffffffff 0x0>;
        gpio-map-pass-thru = <0x0 0xffffffff>;
        #clock-cells = <1>;
        clock-map = <0 &clk 1>;
        #address-cells = <0>;
        #interrupt-cells = <2>;
        interrupt-map-mask = <0xffffffff 0x0>;
        interrupt-map = <0 0 &gpio2 27 IRQ_TYPE_LEVEL_LOW>;
    };
```

## Documentation/devicetree/bindings/display/panel/lg,sw43103.yaml
```yaml
# SPDX-License-Identifier: (GPL-2.0-only OR BSD-2-Clause)
%YAML 1.2
---
$id: http://devicetree.org/schemas/display/panel/lg,sw43103.yaml#
$schema: http://devicetree.org/meta-schemas/core.yaml#

title: LG / BOE SW43103 1080x2460 DSI cmd mode panel

maintainers:
  - Abdur Rofik <rofikcoga@gmail.com>

description: |
  The SW43103 is a 1080x2460 command-mode AMOLED panel used by LG V60 (timelm).
  It uses Display Stream Compression (DSC) over a 4-lane MIPI DSI interface.

allOf:
  - $ref: panel-common.yaml#

properties:
  compatible:
    enum:
      - lg,sw43103
      - boe,sw43103

  reg:
    maxItems: 1

  port: true
  vddi-supply: true
  vpnl-supply: true
  reset-gpios: true
  enable-gpios: true

required:
  - compatible
  - reg
  - vddi-supply
  - vpnl-supply
  - reset-gpios
  - port

additionalProperties: false

examples:
  - |
    #include <dt-bindings/gpio/gpio.h>

    dsi {
        #address-cells = <1>;
        #size-cells = <0>;

        panel@0 {
            compatible = "lg,sw43103";
            reg = <0>;

            vddi-supply = <&vreg_l14a_1p8>;
            vpnl-supply = <&vreg_l11c_3p0>;

            reset-gpios = <&tlmm 75 GPIO_ACTIVE_LOW>;
            enable-gpios = <&pm8150l_gpios 4 GPIO_ACTIVE_HIGH>;

            port {
                endpoint {
                    remote-endpoint = <&mdss_dsi0_out>;
                };
            };
        };
    };
...
```

## Documentation/devicetree/bindings/display/panel/novatek,nt36525.yaml
```yaml
# SPDX-License-Identifier: (GPL-2.0-only OR BSD-2-Clause)
%YAML 1.2
---
$id: http://devicetree.org/schemas/display/panel/novatek,nt36525.yaml#
$schema: http://devicetree.org/meta-schemas/core.yaml#

title: Novatek NT36525 MIPI-DSI panel

maintainers:
  - Adil Hüsrev Tepe <tadilhusrev@gmail.com>

description:
  A MIPI-DSI video-mode panel driven by a Novatek NT36525 controller,
  720x1480. The first compatible string names the specific panel as fitted
  in a device; the second is the NT36525 controller it is based on. The
  panel reset (RESX) is active low.

allOf:
  - $ref: panel-common.yaml#

properties:
  compatible:
    items:
      - enum:
          - novatek,nt36525-xcover5
      - const: novatek,nt36525

  reg:
    maxItems: 1
    description: DSI virtual channel

  reset-gpios:
    maxItems: 1

  vdd-supply:
    description: panel logic power supply (vdd_ldo28, 1.8V)

  vpos-supply:
    description: LCD positive bias supply

  vneg-supply:
    description: LCD negative bias supply

  backlight: true

  port: true

required:
  - compatible
  - reg
  - reset-gpios
  - vdd-supply
  - vpos-supply
  - vneg-supply
  - port

additionalProperties: false

examples:
  - |
    #include <dt-bindings/gpio/gpio.h>

    dsi {
        #address-cells = <1>;
        #size-cells = <0>;

        panel@0 {
            compatible = "novatek,nt36525-xcover5", "novatek,nt36525";
            reg = <0>;
            reset-gpios = <&gpa0 0 GPIO_ACTIVE_LOW>;
            vdd-supply = <&panel_vdd>;
            vpos-supply = <&panel_vpos>;
            vneg-supply = <&panel_vneg>;
            backlight = <&panel_backlight>;

            port {
                panel_in: endpoint {
                    remote-endpoint = <&dsi_out>;
                };
            };
        };
    };
...
```
