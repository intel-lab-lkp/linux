## Documentation/devicetree/bindings/iio/adc/nuvoton,ma35d1-eadc.yaml
```yaml
# SPDX-License-Identifier: (GPL-2.0-only OR BSD-2-Clause)
%YAML 1.2
---
$id: http://devicetree.org/schemas/iio/adc/nuvoton,ma35d1-eadc.yaml#
$schema: http://devicetree.org/meta-schemas/core.yaml#

title: Nuvoton MA35D1 Enhanced Analog-to-Digital Converter

maintainers:
  - Chi-Wen Weng <cwweng@nuvoton.com>

description: |
  The Nuvoton MA35D1 Enhanced Analog-to-Digital Converter (EADC) is a
  12-bit successive approximation converter with eight external analog
  inputs and one internally connected VBAT input.

  The external inputs can be used as eight single-ended channels or as
  four fixed differential pairs: 0-4, 1-5, 2-6 and 3-7. The internally
  connected VBAT input is not described by a channel child node.

  The controller provides four interrupt outputs, ADINT0 through ADINT3.

properties:
  compatible:
    const: nuvoton,ma35d1-eadc

  reg:
    maxItems: 1

  interrupts:
    items:
      - description: ADINT0
      - description: ADINT1
      - description: ADINT2
      - description: ADINT3

  clocks:
    maxItems: 1

  resets:
    maxItems: 1

  vref-supply:
    description:
      Optional external reference voltage connected to the VREF pin. If this
      supply is absent, the controller uses its internal 1.6 V reference.

  dmas:
    maxItems: 1

  dma-names:
    const: rx

  '#io-channel-cells':
    const: 1
    description:
      The cell selects the logical EADC channel identified by the reg value
      of the corresponding channel child node.

  '#address-cells':
    const: 1

  '#size-cells':
    const: 0

patternProperties:
  '^channel@[0-7]$':
    type: object
    $ref: /schemas/iio/adc/adc.yaml#
    description: |
      External EADC channel description. The reg property identifies the
      logical IIO channel index.

      A single-ended channel may use single-channel to select an external
      analog input independently of reg. If single-channel and diff-channels
      are both absent, the external analog input is selected by reg.

      A differential channel uses diff-channels to select one of the fixed
      hardware input pairs: 0-4, 1-5, 2-6 or 3-7. Each single-ended input
      and each differential input pair may be described at most once.

    properties:
      reg:
        maximum: 7

      single-channel:
        maximum: 7

      diff-channels:
        oneOf:
          - items:
              - const: 0
              - const: 4
          - items:
              - const: 1
              - const: 5
          - items:
              - const: 2
              - const: 6
          - items:
              - const: 3
              - const: 7

    allOf:
      - not:
          required:
            - single-channel
            - diff-channels

    required:
      - reg

    additionalProperties: false

required:
  - compatible
  - reg
  - interrupts
  - clocks
  - '#io-channel-cells'
  - '#address-cells'
  - '#size-cells'

additionalProperties: false

examples:
  - |
    #include <dt-bindings/clock/nuvoton,ma35d1-clk.h>
    #include <dt-bindings/interrupt-controller/arm-gic.h>
    #include <dt-bindings/interrupt-controller/irq.h>
    #include <dt-bindings/reset/nuvoton,ma35d1-reset.h>

    soc {
        #address-cells = <2>;
        #size-cells = <2>;

        adc@40430000 {
            compatible = "nuvoton,ma35d1-eadc";
            reg = <0x0 0x40430000 0x0 0x10000>;
            interrupts = <GIC_SPI 65 IRQ_TYPE_LEVEL_HIGH>,
                         <GIC_SPI 66 IRQ_TYPE_LEVEL_HIGH>,
                         <GIC_SPI 67 IRQ_TYPE_LEVEL_HIGH>,
                         <GIC_SPI 68 IRQ_TYPE_LEVEL_HIGH>;
            clocks = <&clk EADC_GATE>;
            resets = <&sys MA35D1_RESET_EADC0>;

            #io-channel-cells = <1>;
            #address-cells = <1>;
            #size-cells = <0>;

            channel@0 {
                reg = <0>;
                single-channel = <2>;
            };

            channel@1 {
                reg = <1>;
                diff-channels = <0 4>;
            };
        };
    };

...
```

## Documentation/devicetree/bindings/iio/chemical/aosong,acd10.yaml
```yaml
# SPDX-License-Identifier: (GPL-2.0 OR BSD-2-Clause)
%YAML 1.2
---
$id: http://devicetree.org/schemas/iio/chemical/aosong,acd10.yaml#
$schema: http://devicetree.org/meta-schemas/core.yaml#

title: aosong acd10 carbon dioxide sensor

maintainers:
  - Akhilesh Patil <akhilesh.patil@linux.dev>

description:
  aosong acd10 is NDIR CO2 sensor with measurement range of 400 to 5000 ppm.
  It provides serial interface over UART communication with fixed baud rate of 1200.

properties:
  compatible:
    const: aosong,acd10

  vcc-supply: true

required:
  - compatible

additionalProperties: false

examples:
  - |
    serial {
        co2-sensor {
            compatible = "aosong,acd10";
        };
    };
...
```

## Documentation/devicetree/bindings/iio/chemical/sensirion,sgp41.yaml
```yaml
# SPDX-License-Identifier: (GPL-2.0 OR BSD-2-Clause)
%YAML 1.2
---
$id: http://devicetree.org/schemas/iio/chemical/sensirion,sgp41.yaml#
$schema: http://devicetree.org/meta-schemas/core.yaml#

title: Sensirion SGP41 VOC and NOx gas sensor

maintainers:
  - Akshat Chandra <notmissinge@gmail.com>

description: |
  Sensirion SGP41 indoor air quality sensor measuring raw VOC and NOx
  signals over I2C.

properties:
  compatible:
    const: sensirion,sgp41

  reg:
    const: 0x59

  vdd-supply: true

required:
  - compatible
  - reg
  - vdd-supply
additionalProperties: false

examples:
  - |
    i2c {
      #address-cells = <1>;
      #size-cells = <0>;

      gas-sensor@59 {
        compatible = "sensirion,sgp41";
        reg = <0x59>;
        vdd-supply = <&vdd>;
      };
    };
...
```

## Documentation/devicetree/bindings/iio/proximity/imagis,isg5320a.yaml
```yaml
# SPDX-License-Identifier: (GPL-2.0-only OR BSD-2-Clause)
%YAML 1.2
---
$id: http://devicetree.org/schemas/iio/proximity/imagis,isg5320a.yaml#
$schema: http://devicetree.org/meta-schemas/core.yaml#

title: Imagis ISG5320A SAR proximity (grip) sensor

maintainers:
  - Adil Hüsrev Tepe <tadilhusrev@gmail.com>

description:
  Imagis ISG5320A capacitive SAR/grip proximity sensor, connected over I2C.
  As fitted on the Samsung Galaxy XCover5.

properties:
  compatible:
    const: imagis,isg5320a

  reg:
    maxItems: 1

  interrupts:
    maxItems: 1
    description: active-low data-ready / proximity interrupt

  vdd-supply: true

  wakeup-source: true

required:
  - compatible
  - reg
  - interrupts

additionalProperties: false

examples:
  - |
    #include <dt-bindings/interrupt-controller/irq.h>

    i2c {
        #address-cells = <1>;
        #size-cells = <0>;

        proximity@28 {
            compatible = "imagis,isg5320a";
            reg = <0x28>;
            interrupt-parent = <&gpa2>;
            interrupts = <0 IRQ_TYPE_LEVEL_LOW>;
            vdd-supply = <&grip_vdd>;
            wakeup-source;
        };
    };
...
```

## Documentation/devicetree/bindings/input/oneplus,pogo-keyboard.yaml
```yaml
# SPDX-License-Identifier: (GPL-2.0-only OR BSD-2-Clause)
# Copyright (c) 2026 Yibo Wang <wyibo6109@gmail.com>
%YAML 1.2
---
$id: http://devicetree.org/schemas/input/oneplus,pogo-keyboard.yaml#
$schema: http://devicetree.org/meta-schemas/core.yaml#

title: OnePlus / OPPO Pad pogo-pin smart keyboard

maintainers:
  - Yibo Wang <wyibo6109@gmail.com>

description: |
  The Tinno keyboard MCU used by the OnePlus Pad 3 Pro / Pad 4 and OPPO
  Pad 5 Pro smart keyboards.  It is attached to a tablet UART and speaks
  a framed half-duplex protocol over a shared single wire; host
  transmission is gated onto the wire by a PMIC GPIO for the duration of
  a frame.  The device provides a keyboard matrix, a touchpad and a
  keyboard backlight.

allOf:
  - $ref: /schemas/serial/serial-peripheral-props.yaml#
  - $ref: /schemas/input/touchscreen/touchscreen.yaml#

properties:
  compatible:
    const: oneplus,pogo-keyboard

  power-gpios:
    description: GPIO enabling the keyboard supply, held high while attached.
    maxItems: 1

  tx-enable-gpios:
    description: GPIO gating host TX onto the shared one-wire bus.
    maxItems: 1

  wake-gpios:
    description: GPIO signalling attach/detach, also used as the wake line.
    maxItems: 1

  touchscreen-size-x: true
  touchscreen-size-y: true
  touchscreen-x-mm: true
  touchscreen-y-mm: true

required:
  - compatible
  - power-gpios
  - tx-enable-gpios
  - wake-gpios

unevaluatedProperties: false

examples:
  - |
    #include <dt-bindings/gpio/gpio.h>

    keyboard {
        compatible = "oneplus,pogo-keyboard";
        power-gpios = <&pmic_gpios 12 GPIO_ACTIVE_HIGH>;
        tx-enable-gpios = <&pmic2_gpios 6 GPIO_ACTIVE_HIGH>;
        wake-gpios = <&tlmm 151 GPIO_ACTIVE_LOW>;
        touchscreen-size-x = <2561>;
        touchscreen-size-y = <1441>;
    };
...
```

## Documentation/devicetree/bindings/input/touchscreen/lg,sw42902.yaml
```yaml
# SPDX-License-Identifier: (GPL-2.0-only OR BSD-2-Clause)
%YAML 1.2
---
$id: http://devicetree.org/schemas/input/touchscreen/lg,sw42902.yaml#
$schema: http://devicetree.org/meta-schemas/core.yaml#

title: Silicon Works SW42902 Touchscreen Controller

maintainers:
  - Abdur Rofik <rofikcoga@gmail.com>

description: |
  The SW42902 is an I2C capacitive touchscreen controller used on the
  LG V60 (timelm).

allOf:
  - $ref: touchscreen.yaml#

properties:
  compatible:
    const: lg,sw42902

  reg:
    maxItems: 1

  interrupts:
    maxItems: 1

  reset-gpios:
    maxItems: 1
    description: Active-low hardware reset

  vcl-supply:
    description: 3.3 V power supply

  vdd-supply:
    description: 1.8 V power supply

required:
  - compatible
  - reg
  - interrupts
  - reset-gpios
  - vcl-supply
  - vdd-supply

unevaluatedProperties: false

examples:
  - |
    #include <dt-bindings/gpio/gpio.h>
    #include <dt-bindings/interrupt-controller/irq.h>

    i2c {
        #address-cells = <1>;
        #size-cells = <0>;

        touchscreen@48 {
            compatible = "lg,sw42902";
            reg = <0x48>;

            interrupts-extended = <&tlmm 39 IRQ_TYPE_LEVEL_LOW>;

            reset-gpios = <&tlmm 38 GPIO_ACTIVE_LOW>;
            vcl-supply = <&reg_ts_vcl>;
            vdd-supply = <&reg_ts_vdd>;

            touchscreen-size-x = <1080>;
            touchscreen-size-y = <2460>;
        };
    };
...
```

## Documentation/devicetree/bindings/input/touchscreen/novatek,nt36672a-spi.yaml
```yaml
# SPDX-License-Identifier: (GPL-2.0-only OR BSD-2-Clause)
%YAML 1.2
---
$id: http://devicetree.org/schemas/input/touchscreen/novatek,nt36672a-spi.yaml#
$schema: http://devicetree.org/meta-schemas/core.yaml#

title: Novatek NT36672A SPI Touchscreen Controller

maintainers:
  - Dmitry Torokhov <dmitry.torokhov@gmail.com>

description:
  The Novatek NT36672A TDDI controller is connected over SPI for touchscreen
  interaction, with host-downloaded firmware into controller SRAM. It integrates
  with the display panel lifecycle using the DRM panel follower API.

allOf:
  - $ref: touchscreen.yaml#
  - $ref: /schemas/spi/spi-peripheral-props.yaml#

properties:
  compatible:
    enum:
      - novatek,nt36672a-spi
      - novatek,nt36672a-ts

  reg:
    maxItems: 1

  interrupts:
    maxItems: 1

  spi-max-frequency: true

  panel:
    description: phandle of the display panel that this touchscreen follows.
    $ref: /schemas/types.yaml#/definitions/phandle

  firmware-name:
    description: Name of the firmware file to load into controller SRAM.

required:
  - compatible
  - reg
  - interrupts

unevaluatedProperties: false

examples:
  - |
    #include <dt-bindings/interrupt-controller/irq.h>
    spi {
        #address-cells = <1>;
        #size-cells = <0>;

        touchscreen@0 {
            compatible = "novatek,nt36672a-spi";
            reg = <0>;
            spi-max-frequency = <4000000>;
            interrupts = <88 IRQ_TYPE_EDGE_RISING>;
            panel = <&panel>;
            touchscreen-size-x = <1080>;
            touchscreen-size-y = <2340>;
        };
    };
...
```

## Documentation/devicetree/bindings/leds/backlight/kinetic,ktd3136.yaml
```yaml
# SPDX-License-Identifier: (GPL-2.0 OR BSD-2-Clause)
%YAML 1.2
---
$id: http://devicetree.org/schemas/leds/backlight/kinetic,ktd3136.yaml#
$schema: http://devicetree.org/meta-schemas/core.yaml#

title: Kinetic Technologies KTD3136 3-Channel LED Backlight Driver

maintainers:
  - Lee Jones <lee@kernel.org>

description: |
  The Kinetic Technologies KTD3136 is a high efficiency, 3-channel LED
  backlight driver with 11-bit exponential or linear dimming control
  via I2C interface.

allOf:
  - $ref: common.yaml#

properties:
  compatible:
    const: kinetic,ktd3136

  reg:
    maxItems: 1

  enable-gpios:
    description: GPIO connected to the HWEN (Chip Enable) pin.
    maxItems: 1

  vin-supply:
    description: Regulator providing power to the VIN pin.

  default-brightness:
    minimum: 0
    maximum: 2047
    default: 2047

  max-brightness:
    minimum: 0
    maximum: 2047
    default: 2047

required:
  - compatible
  - reg

additionalProperties: false

examples:
  - |
    #include <dt-bindings/gpio/gpio.h>

    i2c {
        #address-cells = <1>;
        #size-cells = <0>;

        backlight@36 {
            compatible = "kinetic,ktd3136";
            reg = <0x36>;
            enable-gpios = <&gpio 6 GPIO_ACTIVE_HIGH>;
            default-brightness = <2047>;
            max-brightness = <2047>;
        };
    };
```

## Documentation/devicetree/bindings/leds/lltc,lt3593.yaml
```yaml
# SPDX-License-Identifier: (GPL-2.0-only OR BSD-2-Clause)
%YAML 1.2
---
$id: http://devicetree.org/schemas/leds/lltc,lt3593.yaml#
$schema: http://devicetree.org/meta-schemas/core.yaml#

title: Linear Technology LT3593 LED controller

maintainers:
  - Daniel Mack <daniel@zonque.org>

description: |
  The LT3593 is a step-up DC/DC converter designed to drive a single LED
  string. Its output current is programmed by the number of pulses applied to
  the CTRL pin, which also acts as the enable input.

  The hardware supports only one LED. The properties of this LED are
  configured in a sub-node in the device node. If multiple chips of this type
  are found in a design, each one needs to be handled by its own device node.

properties:
  compatible:
    const: lltc,lt3593

  lltc,ctrl-gpios:
    maxItems: 1
    description:
      A handle to the GPIO that is connected to the 'CTRL' pin of the chip.

  led:
    type: object
    $ref: common.yaml#
    unevaluatedProperties: false
    description:
      Properties of the LED driven by the controller.

required:
  - compatible
  - lltc,ctrl-gpios
  - led

additionalProperties: false

examples:
  - |
    #include <dt-bindings/gpio/gpio.h>
    #include <dt-bindings/leds/common.h>

    led-controller {
        compatible = "lltc,lt3593";
        pinctrl-names = "default";
        pinctrl-0 = <&lt3593_pins>;
        lltc,ctrl-gpios = <&gpio 17 GPIO_ACTIVE_HIGH>;

        led {
            function = LED_FUNCTION_BACKLIGHT;
            color = <LED_COLOR_ID_WHITE>;
            default-state = "on";
        };
    };

...
```
