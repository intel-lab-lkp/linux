## Documentation/devicetree/bindings/dma/brcm,bcm2835-dma.yaml
```yaml
# SPDX-License-Identifier: (GPL-2.0-only OR BSD-2-Clause)
%YAML 1.2
---
$id: http://devicetree.org/schemas/dma/brcm,bcm2835-dma.yaml#
$schema: http://devicetree.org/meta-schemas/core.yaml#

title: BCM2835 DMA controller

maintainers:
  - Nicolas Saenz Julienne <nsaenz@kernel.org>

description: |
  The BCM2835 DMA controller has 16 channels in total. Only the lower
  13 channels have an associated IRQ. Some arbitrary channels are used by the
  VideoCore firmware (1,3,6,7 in the current firmware version). The channels
  0, 2 and 3 have special functionality and should not be used by the driver.

  On BCM2711 the channels 11 to 14 of the same DMA block have a different
  programming model, which allows them to address 40 bits, and are described
  by a separate node.

  The channel numbers used in the channel mask and in the interrupt names
  always refer to the whole DMA block, also when a node only describes some
  of its channels.

allOf:
  - $ref: dma-controller.yaml#
  - if:
      properties:
        compatible:
          contains:
            const: brcm,bcm2711-dma
    then:
      properties:
        interrupts:
          maxItems: 4
        interrupt-names:
          maxItems: 4
      required:
        - interrupt-names

properties:
  compatible:
    enum:
      - brcm,bcm2711-dma
      - brcm,bcm2835-dma

  reg:
    maxItems: 1

  interrupts:
    description:
      Should contain the DMA interrupts associated to the DMA channels in
      ascending order.
    minItems: 1
    maxItems: 16

  interrupt-names:
    minItems: 1
    maxItems: 16
    items:
      pattern: "^dma([0-9]|1[0-4]|-shared-all)$"

  '#dma-cells':
    description: |
      The single cell contains the DREQ number in bits 0-4, optionally
      combined with the following per-channel flags:
        bits 16-19: AXI priority
        bits 20-23: AXI panic priority
        bit 24: use wide (128-bit) source reads
        bit 25: use wide (128-bit) destination writes
        bit 27: do not wait for AXI write responses
        bit 28: wait for outstanding writes before signalling completion
        bit 29: do not pause the channel when the debug signal is asserted
        bit 30: use multi-beat bursts
    const: 1

  dma-channel-mask:
    maxItems: 1

  brcm,dma-channel-mask:
    $ref: /schemas/types.yaml#/definitions/uint32
    deprecated: true
    description:
      Bitmask of available DMA channels in ascending order that are
      not reserved by firmware and are available to the
      kernel. i.e. first channel corresponds to LSB.
      Use the generic dma-channel-mask property instead.

unevaluatedProperties: false

required:
  - compatible
  - reg
  - interrupts
  - "#dma-cells"

anyOf:
  - required:
      - dma-channel-mask
  - required:
      - brcm,dma-channel-mask

examples:
  - |
    dma-controller@7e007000 {
      compatible = "brcm,bcm2835-dma";
      reg = <0x7e007000 0xf00>;
      interrupts = <1 16>,
                   <1 17>,
                   <1 18>,
                   <1 19>,
                   <1 20>,
                   <1 21>,
                   <1 22>,
                   <1 23>,
                   <1 24>,
                   <1 25>,
                   <1 26>,
                   /* dma channel 11-14 share one irq */
                   <1 27>,
                   <1 27>,
                   <1 27>,
                   <1 27>,
                   /* unused shared irq for all channels */
                   <1 28>;
      interrupt-names = "dma0",
                        "dma1",
                        "dma2",
                        "dma3",
                        "dma4",
                        "dma5",
                        "dma6",
                        "dma7",
                        "dma8",
                        "dma9",
                        "dma10",
                        "dma11",
                        "dma12",
                        "dma13",
                        "dma14",
                        "dma-shared-all";
        #dma-cells = <1>;
        dma-channel-mask = <0x7f35>;
    };

  - |
    #include <dt-bindings/interrupt-controller/arm-gic.h>

    dma-controller@7e007b00 {
      compatible = "brcm,bcm2711-dma";
      reg = <0x7e007b00 0x400>;
      interrupts = <GIC_SPI 89 IRQ_TYPE_LEVEL_HIGH>,
                   <GIC_SPI 90 IRQ_TYPE_LEVEL_HIGH>,
                   <GIC_SPI 91 IRQ_TYPE_LEVEL_HIGH>,
                   <GIC_SPI 92 IRQ_TYPE_LEVEL_HIGH>;
      interrupt-names = "dma11",
                        "dma12",
                        "dma13",
                        "dma14";
      #dma-cells = <1>;
      dma-channel-mask = <0x7000>;
    };

...
```

## Documentation/devicetree/bindings/gpio/andestech,ae350-gpio.yaml
```yaml
# SPDX-License-Identifier: (GPL-2.0-only OR BSD-2-Clause)
%YAML 1.2
---
$id: http://devicetree.org/schemas/gpio/andestech,ae350-gpio.yaml#
$schema: http://devicetree.org/meta-schemas/core.yaml#

title: Andes ATCGPIO100 GPIO controller on AE350 platform

maintainers:
  - CL Wang <cl634@andestech.com>

properties:
  compatible:
    oneOf:
      - items:
          - enum:
              - andestech,qilai-gpio
          - const: andestech,ae350-gpio
      - const: andestech,ae350-gpio

  reg:
    maxItems: 1

  interrupts:
    maxItems: 1

  interrupt-controller: true

  "#interrupt-cells":
    const: 2

  gpio-controller: true

  "#gpio-cells":
    const: 2

  ngpios:
    minimum: 1
    maximum: 32

  gpio-line-names:
    minItems: 1
    maxItems: 32

  clocks:
    minItems: 1
    items:
      - description: APB bus clock
      - description: External clock for debounce

  clock-names:
    minItems: 1
    items:
      - const: pclk
      - const: extclk

patternProperties:
  "^.+-hog(-[0-9]+)?$":
    type: object
    required:
      - gpio-hog

required:
  - compatible
  - reg
  - gpio-controller
  - "#gpio-cells"
  - clocks
  - clock-names

additionalProperties: false

dependencies:
  interrupt-controller: [ interrupts, "#interrupt-cells" ]

examples:
  - |
    #include <dt-bindings/interrupt-controller/irq.h>

    gpio@f0700000 {
        compatible = "andestech,ae350-gpio";
        reg = <0xf0700000 0x100>;
        interrupts = <7 IRQ_TYPE_LEVEL_HIGH>;
        interrupt-parent = <&plic>;
        interrupt-controller;
        #interrupt-cells = <2>;
        gpio-controller;
        #gpio-cells = <2>;
        ngpios = <32>;
        clocks = <&pclk>, <&extclk>;
        clock-names = "pclk", "extclk";
    };
```

## Documentation/devicetree/bindings/hwmon/amd,sbrmi.yaml
```yaml
# SPDX-License-Identifier: (GPL-2.0-only OR BSD-2-Clause)
%YAML 1.2
---
$id: http://devicetree.org/schemas/hwmon/amd,sbrmi.yaml#
$schema: http://devicetree.org/meta-schemas/core.yaml#

title: AMD SoC SB-RMI power and DIMM thermal sensor

maintainers:
  - Akshay Gupta <Akshay.Gupta@amd.com>

description: |
  SB Remote Management Interface (SB-RMI) is an SMBus compatible
  interface that reports AMD SoC's Power (normalized Power) using,
  Mailbox Service Request and resembles a typical 8-pin remote power
  sensor's I2C interface to BMC. The power attributes in hwmon
  reports power in microwatts. The same mailbox also reports the
  temperature of the TS0/TS1 thermal sensors on each populated DIMM.

properties:
  compatible:
    enum:
      - amd,sbrmi

  reg:
    maxItems: 1
    description: |
      I2C bus address of the device as specified in Section SBI SMBus Address
      of the SoC register reference. The SB-RMI address is normally 78h for
      socket 0 and 70h for socket 1, but it could vary based on hardware
      address select pins.
      \[open source SoC register reference\]
        https://www.amd.com/en/support/tech-docs?keyword=55898

  amd,dpc:
    $ref: /schemas/types.yaml#/definitions/uint8
    enum: [1, 2]
    default: 1
    description:
      DIMMs per channel (dimms-per-channel), the number of DIMM slots per
      memory channel.

  amd,dimm-ids:
    $ref: /schemas/types.yaml#/definitions/uint8-array
    minItems: 1
    maxItems: 32
    uniqueItems: true
    description: |
      Mode 1 SB-RMI DIMM_ADDRESS of each DIMM thermal sensor to report.
      Encoding: bit[7]=1 (Mode 1), bit[6] sensor (0=TS0, 1=TS1), bit[5]
      reserved, bit[4] DIMM slot, bit[3:0] memory channel ID. With one DIMM
      per channel bit[4] is 0; with two, the memory channel ID is 0-7.
      When absent, the TS0 and TS1 sensors of all 16 DIMMs are reported.

required:
  - compatible
  - reg

allOf:
  - if:
      required:
        - amd,dpc
      properties:
        amd,dpc:
          const: 2
    then:
      properties:
        amd,dimm-ids:
          items:
            anyOf:
              - minimum: 0x80
                maximum: 0x87
              - minimum: 0x90
                maximum: 0x97
              - minimum: 0xc0
                maximum: 0xc7
              - minimum: 0xd0
                maximum: 0xd7
    else:
      properties:
        amd,dimm-ids:
          items:
            anyOf:
              - minimum: 0x80
                maximum: 0x8f
              - minimum: 0xc0
                maximum: 0xcf

additionalProperties: false

examples:
  - |
    i2c {
        #address-cells = <1>;
        #size-cells = <0>;

        sbrmi@3c {
            compatible = "amd,sbrmi";
            reg = <0x3c>;
            /* TS0 sensors of the DIMMs on memory channels 0-7 */
            amd,dimm-ids = /bits/ 8 <0x80 0x81 0x82 0x83 0x84 0x85 0x86 0x87>;
        };
    };
...
```

## Documentation/devicetree/bindings/hwmon/raspberrypi,rp1-fan.yaml
```yaml
# SPDX-License-Identifier: (GPL-2.0-only OR BSD-2-Clause)
%YAML 1.2
---
$id: http://devicetree.org/schemas/hwmon/raspberrypi,rp1-fan.yaml#
$schema: http://devicetree.org/meta-schemas/core.yaml#

title: Raspberry Pi RP1 fan tachometer

maintainers:
  - Andrea della Porta <andrea.porta@suse.com>

description: |
  Hardware monitoring driver for the fan connected to the Raspberry Pi RP1
  southbridge. The RP1 PWM controller hardware contains a built-in tachometer
  logic that calculates the fan RPM. This binding links the fan to the PWM
  controller to read the tachometer values.

properties:
  compatible:
    const: raspberrypi,rp1-fan

  raspberrypi,pwm-tachometer:
    $ref: /schemas/types.yaml#/definitions/phandle
    description:
      Phandle to the RP1 PWM controller node that contains the tachometer
      registers for this fan.

required:
  - compatible
  - raspberrypi,pwm-tachometer

additionalProperties: false

examples:
  - |
    fan {
        compatible = "raspberrypi,rp1-fan";
        raspberrypi,pwm-tachometer = <&rp1_pwm1>;
    };
```

## Documentation/devicetree/bindings/i2c/amlogic,a9-i2c.yaml
```yaml
# SPDX-License-Identifier: (GPL-2.0 OR BSD-2-Clause)
%YAML 1.2
---
$id: http://devicetree.org/schemas/i2c/amlogic,a9-i2c.yaml#
$schema: http://devicetree.org/meta-schemas/core.yaml#

title: Amlogic A9 I2C Controller

maintainers:
  - Xianwei Zhao <xianwei.zhaol@amlogic.com>
  - Junyi Zhao <junyi.zhaol@amlogic.com>

allOf:
  - $ref: /schemas/i2c/i2c-controller.yaml#

properties:
  compatible:
    const: amlogic,a9-i2c

  reg:
    maxItems: 1

  interrupts:
    maxItems: 1

  clocks:
    maxItems: 1

  dmas:
    items:
      - description: DMA controller phandle and request line for RX
      - description: DMA controller phandle and request line for TX

  dma-names:
    items:
      - const: rx
      - const: tx

required:
  - compatible
  - reg
  - interrupts
  - clocks

unevaluatedProperties: false

examples:
  - |
    i2c@3a4400 {
        compatible = "amlogic,a9-i2c";
        reg = <0x3a4400 0x3c>;
        interrupts = <1 164 1>;
        clocks = <&clkc_periphs 11>;
        #address-cells = <1>;
        #size-cells = <0>;

        eeprom@52 {
            compatible = "atmel,24c32";
            reg = <0x52>;
        };
    };
```

## Documentation/devicetree/bindings/i2c/slave-eeprom.yaml
```yaml
# SPDX-License-Identifier: (GPL-2.0-only OR BSD-2-Clause)
%YAML 1.2
---
$id: http://devicetree.org/schemas/i2c/slave-eeprom.yaml#
$schema: http://devicetree.org/meta-schemas/core.yaml#

title: I2C target EEPROM backend

maintainers:
  - Arun Iyengar <aiyengar1990@gmail.com>

description:
  The I2C controller answers on its own address as a target and behaves
  like a 24Cxx EEPROM towards the other controllers on the bus. The
  compatible selects the EEPROM type that is simulated. The "ro" variants
  ignore writes from the bus.

properties:
  compatible:
    enum:
      - slave-24c02
      - slave-24c02ro
      - slave-24c32
      - slave-24c32ro
      - slave-24c64
      - slave-24c64ro
      - slave-24c512
      - slave-24c512ro

  reg:
    maxItems: 1
    description:
      Own address of the controller on the bus. The I2C_OWN_SLAVE_ADDRESS
      flag must be set.

  firmware-name:
    maxItems: 1
    description:
      File with the initial content. Without it all bytes start as 0xff.

required:
  - compatible
  - reg

additionalProperties: false

examples:
  - |
    #include <dt-bindings/i2c/i2c.h>

    i2c {
        #address-cells = <1>;
        #size-cells = <0>;

        eeprom@64 {
            compatible = "slave-24c02";
            reg = <(0x64 | I2C_OWN_SLAVE_ADDRESS)>;
        };
    };
```

## Documentation/devicetree/bindings/i2c/snps,dwc-adv-i2c.yaml
```yaml
# SPDX-License-Identifier: GPL-2.0-only OR BSD-2-Clause
%YAML 1.2
---
$id: http://devicetree.org/schemas/i2c/snps,dwc-adv-i2c.yaml#
$schema: http://devicetree.org/meta-schemas/core.yaml#

title: Synopsys DesignWare Advanced I2C (DWC_i2c) Controller

maintainers:
  - Aniket Limaye <a-limaye@ti.com>

allOf:
  - $ref: /schemas/i2c/i2c-controller.yaml#

properties:
  compatible:
    enum:
      - ti,tda54-i2c

  reg:
    maxItems: 1

  interrupts:
    maxItems: 1

  clocks:
    items:
      - description: I2C functional clock (ic_clk)
      - description: Register interface clock (pclk)

  clock-names:
    items:
      - const: ref
      - const: pclk

  resets:
    maxItems: 1

  clock-frequency:
    enum: [100000, 400000, 1000000, 3400000]
    default: 400000

  i2c-sda-hold-time-ns: true

  i2c-scl-falling-time-ns:
    default: 300

  i2c-sda-falling-time-ns:
    default: 300

required:
  - compatible
  - reg
  - interrupts
  - clocks
  - clock-names

unevaluatedProperties: false

examples:
  - |
    #include <dt-bindings/interrupt-controller/arm-gic.h>

    i2c@53b00000 {
        compatible = "ti,tda54-i2c";
        reg = <0x53b00000 0x1000>;
        interrupts = <GIC_SPI 166 IRQ_TYPE_LEVEL_HIGH>;
        clocks = <&sysclk>, <&pclk>;
        clock-names = "ref", "pclk";
        clock-frequency = <400000>;
        i2c-sda-hold-time-ns = <300>;
        #address-cells = <1>;
        #size-cells = <0>;
    };
...
```
