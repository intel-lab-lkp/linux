## Documentation/devicetree/bindings/pci/sophgo,sg2042-pcie-host.yaml
```yaml
# SPDX-License-Identifier: (GPL-2.0 OR BSD-2-Clause)
%YAML 1.2
---
$id: http://devicetree.org/schemas/pci/sophgo,sg2042-pcie-host.yaml#
$schema: http://devicetree.org/meta-schemas/core.yaml#

title: Sophgo SG2042 PCIe Host (Cadence PCIe Wrapper)

description: |+
  Sophgo SG2042 PCIe host controller is based on the Cadence PCIe core.
  It shares common features with the PCIe core and inherits common properties
  defined in Documentation/devicetree/bindings/pci/cdns-pcie-host.yaml.

maintainers:
  - Chen Wang <unicorn_wang@outlook.com>

properties:
  compatible:
    const: sophgo,sg2042-pcie-host

  reg:
    maxItems: 2

  reg-names:
    items:
      - const: reg
      - const: cfg

  sophgo,syscon-pcie-ctrl:
    $ref: /schemas/types.yaml#/definitions/phandle
    description: Phandle to the SYSCON entry

  sophgo,link-id:
    $ref: /schemas/types.yaml#/definitions/uint32
    description: Cadence IP link ID.

  sophgo,internal-msi:
    $ref: /schemas/types.yaml#/definitions/flag
    description: Identifies whether the PCIE node uses internal MSI controller.

  vendor-id:
    const: 0x1f1c

  device-id:
    const: 0x2042

  interrupts:
    maxItems: 1

  interrupt-names:
    const: msi

allOf:
  - $ref: cdns-pcie-host.yaml#

required:
  - compatible
  - reg
  - reg-names
  - sophgo,syscon-pcie-ctrl
  - sophgo,link-id
  - vendor-id
  - device-id
  - ranges

additionalProperties: true

examples:
  - |
    pcie@62000000 {
      compatible = "sophgo,sg2042-pcie-host";
      device_type = "pci";
      reg = <0x62000000  0x00800000>,
            <0x48000000  0x00001000>;
      reg-names = "reg", "cfg";
      #address-cells = <3>;
      #size-cells = <2>;
      ranges = <0x81000000 0 0x00000000 0xde000000 0 0x00010000>,
               <0x82000000 0 0xd0400000 0xd0400000 0 0x0d000000>;
      bus-range = <0x80 0xbf>;
      vendor-id = <0x1f1c>;
      device-id = <0x2042>;
      cdns,no-bar-match-nbits = <48>;
      sophgo,link-id = <0>;
      sophgo,syscon-pcie-ctrl = <&cdns_pcie1_ctrl>;
      sophgo,internal-msi;
      interrupt-parent = <&intc>;
    };
```

## Documentation/devicetree/bindings/phy/fsl,lynx-28g.yaml
```yaml
# SPDX-License-Identifier: (GPL-2.0-only OR BSD-2-Clause)
%YAML 1.2
---
$id: http://devicetree.org/schemas/phy/fsl,lynx-28g.yaml#
$schema: http://devicetree.org/meta-schemas/core.yaml#

title: Freescale Lynx 28G SerDes PHY

maintainers:
  - Ioana Ciornei <ioana.ciornei@nxp.com>

description:
  The Lynx 28G is a multi-lane, multi-protocol SerDes (PCIe, SATA, Ethernet)
  present in multiple instances on NXP LX2160A and LX2162A SoCs. All instances
  share a common register map and programming model, however they differ in
  supported protocols per lane in a way that is not detectable by said
  programming model without prior knowledge. The distinction is made through
  the compatible string.

properties:
  compatible:
    oneOf:
      - const: fsl,lynx-28g
        deprecated: true
        description:
          Legacy compatibility string for Lynx 28G SerDes. Any assumption
          regarding whether a certain lane supports a certain protocol may
          be incorrect. Deprecated except when used as a fallback. Use
          device-specific strings instead.
      - items:
          - const: fsl,lx2160a-serdes1
          - const: fsl,lynx-28g
      - items:
          - const: fsl,lx2160a-serdes2
          - const: fsl,lynx-28g
      - items:
          - const: fsl,lx2162a-serdes1
          - const: fsl,lynx-28g
      - items:
          - const: fsl,lx2162a-serdes2
          - const: fsl,lynx-28g
      - const: fsl,lx2160a-serdes3

  reg:
    maxItems: 1

  "#address-cells": true

  "#size-cells": true

  "#phy-cells": true

patternProperties:
  "^phy@[0-9a-f]+$":
    type: object
    description: Individual SerDes lane acting as PHY provider

    properties:
      reg:
        description: Lane index as seen in register map
        maxItems: 1

      "#phy-cells":
        const: 0

    required:
      - reg
      - "#phy-cells"

    additionalProperties: false

required:
  - compatible
  - reg

allOf:
  - if:
      properties:
        compatible:
          contains:
            const: fsl,lynx-28g
    then:
      # Legacy case: parent is the PHY provider, cell encodes lane index
      properties:
        "#phy-cells":
          const: 1
      required:
        - "#phy-cells"

  - if:
      properties:
        compatible:
          contains:
            enum:
              - fsl,lx2160a-serdes1
              - fsl,lx2160a-serdes2
              - fsl,lx2160a-serdes3
              - fsl,lx2162a-serdes1
              - fsl,lx2162a-serdes2
    then:
      # Modern binding: lanes must have their own nodes
      properties:
        "#address-cells":
          const: 1
        "#size-cells":
          const: 0
      required:
        - "#address-cells"
        - "#size-cells"

  # LX2162A SerDes 1 has fewer lanes than the others
  - if:
      properties:
        compatible:
          contains:
            const: fsl,lx2162a-serdes1
    then:
      patternProperties:
        "^phy@[0-9a-f]+$":
          properties:
            reg:
              enum: [4, 5, 6, 7]
    else:
      patternProperties:
        "^phy@[0-9a-f]+$":
          properties:
            reg:
              enum: [0, 1, 2, 3, 4, 5, 6, 7]

additionalProperties: false

examples:
  - |
    soc {
      #address-cells = <2>;
      #size-cells = <2>;

      serdes_1: serdes@1ea0000 {
        compatible = "fsl,lx2160a-serdes1", "fsl,lynx-28g";
        reg = <0x0 0x1ea0000 0x0 0x1e30>;
        #address-cells = <1>;
        #size-cells = <0>;
        #phy-cells = <1>;

        phy@0 {
          reg = <0>;
          #phy-cells = <0>;
        };

        phy@1 {
          reg = <1>;
          #phy-cells = <0>;
        };

        phy@2 {
          reg = <2>;
          #phy-cells = <0>;
        };

        phy@3 {
          reg = <3>;
          #phy-cells = <0>;
        };

        phy@4 {
          reg = <4>;
          #phy-cells = <0>;
        };

        phy@5 {
          reg = <5>;
          #phy-cells = <0>;
        };

        phy@6 {
          reg = <6>;
          #phy-cells = <0>;
        };

        phy@7 {
          reg = <7>;
          #phy-cells = <0>;
        };
      };
    };
```

## Documentation/devicetree/bindings/phy/marvell,pxa1928-usb-phy.yaml
```yaml
# SPDX-License-Identifier: (GPL-2.0-only OR BSD-2-Clause)
%YAML 1.2
---
$id: http://devicetree.org/schemas/phy/marvell,pxa1928-usb-phy.yaml#
$schema: http://devicetree.org/meta-schemas/core.yaml#

title: Marvell PXA1928 USB/HSIC PHY

maintainers:
  - Duje Mihanović <duje.mihanovic@skole.hr>

properties:
  $nodename:
    pattern: '^phy@[a-f0-9]+$'

  compatible:
    oneOf:
      - items:
          const: marvell,pxa1928-usb-phy
      - items:
          const: marvell,pxa1928-hsic-phy

  reg:
    maxItems: 1

  clocks:
    maxItems: 1

  '#phy-cells':
    const: 0

  resets:
    maxItems: 1

required:
  - compatible
  - reg
  - clocks
  - '#phy-cells'

additionalProperties: false
```

## Documentation/devicetree/bindings/phy/qcom,qcs615-qmp-dp-phy.yaml
```yaml
# SPDX-License-Identifier: (GPL-2.0 OR BSD-2-Clause)
%YAML 1.2
---
$id: http://devicetree.org/schemas/phy/qcom,qcs615-qmp-dp-phy.yaml#
$schema: http://devicetree.org/meta-schemas/core.yaml#

title: Qualcomm QMP PHY controller (DP, QCS615)

maintainers:
  - Vinod Koul <vkoul@kernel.org>

description:
  The QMP DP PHY controller supports DisplayPort physical layer functionality
  on Qualcomm QCS615 SoCs. This PHY is independent from USB3 PHY and does not
  support combo mode.

properties:
  compatible:
    enum:
      - qcom,qcs615-qmp-dp-phy

  reg:
    maxItems: 4

  clocks:
    maxItems: 2

  clock-names:
    items:
      - const: cfg_ahb
      - const: ref

  clock-output-names:
    maxItems: 2
    description:
      Names of the clocks provided by the PHY.

  qcom,tcsr-reg:
    $ref: /schemas/types.yaml#/definitions/phandle-array
    items:
      - items:
          - description: phandle to TCSR hardware block
          - description: offset of the DP PHY moode register
    description:
      DP PHY moode register present in the TCSR

  resets:
    maxItems: 1

  reset-names:
    items:
      - const: phy

  vdda-phy-supply: true

  vdda-pll-supply: true

  "#clock-cells":
    const: 1
    description:
      See include/dt-bindings/phy/phy-qcom-qmp.h

  "#phy-cells":
    const: 1
    description:
      See include/dt-bindings/phy/phy-qcom-qmp.h

required:
  - compatible
  - reg
  - clocks
  - clock-names
  - clock-output-names
  - qcom,tcsr-reg
  - resets
  - reset-names
  - vdda-phy-supply
  - vdda-pll-supply
  - "#clock-cells"
  - "#phy-cells"

additionalProperties: false

examples:
  - |
    #include <dt-bindings/clock/qcom,qcs615-gcc.h>
    #include <dt-bindings/clock/qcom,rpmh.h>

    phy@88e9000 {
      compatible = "qcom,qcs615-qmp-dp-phy";
      reg = <0x088e9000 0x200>,
            <0x088e9400 0x10c>,
            <0x088e9800 0x10c>,
            <0x088e9c00 0x200>;

      clocks = <&gcc GCC_AHB2PHY_WEST_CLK>,
               <&gcc GCC_USB3_SEC_CLKREF_CLK>;
      clock-names = "cfg_ahb", "ref";
      clock-output-names = "dp_phy_link_clk", "dp_phy_vco_div_clk";

      qcom,tcsr-reg = <&tcsr 0xb24c>;

      resets = <&gcc GCC_USB3_DP_PHY_SEC_BCR>;
      reset-names = "phy";

      vdda-phy-supply = <&vreg_l11a>;
      vdda-pll-supply = <&vreg_l5a>;

      #clock-cells = <1>;
      #phy-cells = <1>;
    };
```

## Documentation/devicetree/bindings/phy/spacemit,k1-combphy.yaml
```yaml
# SPDX-License-Identifier: (GPL-2.0-only OR BSD-2-Clause)
%YAML 1.2
---
$id: http://devicetree.org/schemas/phy/spacemit,k1-combphy.yaml#
$schema: http://devicetree.org/meta-schemas/core.yaml#

title: SpacemiT K1 PCIe/USB3 Combo PHY

maintainers:
  - Ze Huang <huangze9015@gmail.com>

description:
  Combo PHY on SpacemiT K1 SoC. PCIe port A and USB3 controller share this
  phy, only one of PCIe port A and USB3 port can work at any given application
  scenario.

properties:
  compatible:
    const: spacemit,k1-combphy

  reg:
    items:
      - description: PHY control registers
      - description: PCIe/USB3 mode selection register

  reg-names:
    items:
      - const: ctrl
      - const: sel

  resets:
    maxItems: 1

  "#phy-cells":
    const: 1
    description:
      Indicates the PHY mode to select. The value determines whether the PHY
      operates in PCIe or USB3 mode.

  spacemit,lfps-threshold:
    description:
      Controls the LFPS signal detection threshold, affects polling.LFPS
      handshake. Lower the threshold when core voltage rises.
    $ref: /schemas/types.yaml#/definitions/uint32
    minimum: 0
    maximum: 0xff

  spacemit,rx-always-on:
    description:
      Affects RX.detect, enhance compatibility of some DFPs in device mode but
      increase power consumption.
    type: boolean

required:
  - compatible
  - reg
  - reg-names
  - resets
  - "#phy-cells"

additionalProperties: false

examples:
  - |
    phy@c0b10000 {
        compatible = "spacemit,k1-combphy";
        reg = <0xc0b10000 0x800>,
              <0xd4282910 0x400>;
        reg-names = "ctrl", "sel";
        resets = <&syscon_apmu 19>;
        #phy-cells = <1>;
    };
```

## Documentation/devicetree/bindings/phy/spacemit,k1-pcie-phy.yaml
```yaml
# SPDX-License-Identifier: (GPL-2.0-only OR BSD-2-Clause)
%YAML 1.2
---
$id: http://devicetree.org/schemas/phy/spacemit,k1-pcie-phy.yaml#
$schema: http://devicetree.org/meta-schemas/core.yaml#

title: SpacemiT K1 PCIe PHY

maintainers:
  - Alex Elder <elder@riscstar.com>

description: >
  There are two PHYs on the SpacemiT K1 SoC used for PCIe (only).
  These PHYs must be configured using calibration values that are
  determined by a third "combo PHY".  The combo PHY determines
  these calibration values during probe so they can be used for
  the two PCIe-only PHYs.

  The PHY uses an external oscillator as a reference clock.  During
  normal operation, the PCIe host driver is responsible for ensuring
  all other clocks needed by a PHY are enabled, and all resets
  affecting the PHY are deasserted.

properties:
  compatible:
    const: spacemit,k1-pcie-phy

  reg:
    items:
      - description: PHY control registers

  clocks:
    items:
      - description: External oscillator used by the PHY PLL

  clock-names:
    const: refclk

  "#phy-cells":
    const: 0

required:
  - compatible
  - reg
  - clocks
  - clock-names
  - "#phy-cells"

additionalProperties: false

examples:
  - |
    phy@c0c10000 {
        compatible = "spacemit,k1-pcie-phy";
        reg = <0xc0c10000 0x1000>;
        clocks = <&vctcxo_24m>;
        clock-names = "refclk";
        #phy-cells = <0>;
    };
```
