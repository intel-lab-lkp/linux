## Documentation/devicetree/bindings/pinctrl/mediatek,mt7621-pinctrl.yaml
```yaml
# SPDX-License-Identifier: GPL-2.0-only OR BSD-2-Clause
%YAML 1.2
---
$id: http://devicetree.org/schemas/pinctrl/mediatek,mt7621-pinctrl.yaml#
$schema: http://devicetree.org/meta-schemas/core.yaml#

title: MediaTek MT7621 Pin Controller

maintainers:
  - Arınç ÜNAL <arinc.unal@arinc9.com>
  - Sergio Paracuellos <sergio.paracuellos@gmail.com>

description: |
  MediaTek MT7621 pin controller for MT7621 SoC.
  The pin controller can only set the muxing of pin groups. Muxing individual
  pins is not supported. There is no pinconf support.

properties:
  compatible:
    oneOf:
      - const: ralink,mt7621-pinctrl
      - const: ralink,rt2880-pinmux
        deprecated: true

patternProperties:
  '-pins$':
    type: object
    additionalProperties: false

    patternProperties:
      '^(.*-)?pinmux$':
        type: object
        description: node for pinctrl.
        $ref: pinmux-node.yaml#
        additionalProperties: false

        properties:
          function:
            description:
              A string containing the name of the function to mux to the group.
            enum: [gpio, i2c, i2s, jtag, mdio, nand1, nand2, pcie refclk,
                   pcie rst, pcm, rgmii1, rgmii2, sdhci, spdif2, spdif3, spi,
                   uart1, uart2, uart3, wdt refclk, wdt rst]

          groups:
            description: |
              An array of strings. Each string contains the name of a group.

              group             pins
              ------------------------------------------------------------------
              "uart1"           1, 2
              "i2c"             3, 4
              "uart3"           5, 6, 7, 8
              "uart2"           9, 10, 11, 12
              "jtag"            13, 14, 15, 16, 17
              "wdt"             18
              "pcie"            19
              "mdio"            20, 21
              "rgmii2"          22, 23, 24, 25, 26, 27, 28, 29, 30, 31, 32, 33
              "spi"             34, 35, 36, 37, 38, 39, 40
              "sdhci"           41, 42, 43, 44, 45, 46, 47, 48
              "rgmii1"          49, 50, 51, 52, 53, 54, 55, 56, 57, 58, 59, 60

            maxItems: 1

        required:
          - groups
          - function

        allOf:
          - if:
              properties:
                function:
                  const: gpio
            then:
              properties:
                groups:
                  enum: [i2c, jtag, mdio, pcie, rgmii1, rgmii2, sdhci, spi,
                         uart1, uart2, uart3, wdt]

          - if:
              properties:
                function:
                  const: i2c
            then:
              properties:
                groups:
                  enum: [i2c]

          - if:
              properties:
                function:
                  const: i2s
            then:
              properties:
                groups:
                  enum: [uart3]

          - if:
              properties:
                function:
                  const: jtag
            then:
              properties:
                groups:
                  enum: [jtag]

          - if:
              properties:
                function:
                  const: mdio
            then:
              properties:
                groups:
                  enum: [mdio]

          - if:
              properties:
                function:
                  const: nand1
            then:
              properties:
                groups:
                  enum: [spi]

          - if:
              properties:
                function:
                  const: nand2
            then:
              properties:
                groups:
                  enum: [sdhci]

          - if:
              properties:
                function:
                  const: pcie refclk
            then:
              properties:
                groups:
                  enum: [pcie]

          - if:
              properties:
                function:
                  const: pcie rst
            then:
              properties:
                groups:
                  enum: [pcie]

          - if:
              properties:
                function:
                  const: pcm
            then:
              properties:
                groups:
                  enum: [uart2]

          - if:
              properties:
                function:
                  const: rgmii1
            then:
              properties:
                groups:
                  enum: [rgmii1]

          - if:
              properties:
                function:
                  const: rgmii2
            then:
              properties:
                groups:
                  enum: [rgmii2]

          - if:
              properties:
                function:
                  const: sdhci
            then:
              properties:
                groups:
                  enum: [sdhci]

          - if:
              properties:
                function:
                  const: spdif2
            then:
              properties:
                groups:
                  enum: [uart2]

          - if:
              properties:
                function:
                  const: spdif3
            then:
              properties:
                groups:
                  enum: [uart3]

          - if:
              properties:
                function:
                  const: spi
            then:
              properties:
                groups:
                  enum: [spi]

          - if:
              properties:
                function:
                  const: uart1
            then:
              properties:
                groups:
                  enum: [uart1]

          - if:
              properties:
                function:
                  const: uart2
            then:
              properties:
                groups:
                  enum: [uart2]

          - if:
              properties:
                function:
                  const: uart3
            then:
              properties:
                groups:
                  enum: [uart3]

          - if:
              properties:
                function:
                  const: wdt refclk
            then:
              properties:
                groups:
                  enum: [wdt]

          - if:
              properties:
                function:
                  const: wdt rst
            then:
              properties:
                groups:
                  enum: [wdt]

allOf:
  - $ref: pinctrl.yaml#

required:
  - compatible

additionalProperties: false

examples:
  - |
    pinctrl {
      compatible = "ralink,mt7621-pinctrl";

      i2c_pins: i2c0-pins {
        pinmux {
          groups = "i2c";
          function = "i2c";
        };
      };
    };
```

## Documentation/devicetree/bindings/pinctrl/ralink,rt2880-pinctrl.yaml
```yaml
# SPDX-License-Identifier: GPL-2.0-only OR BSD-2-Clause
%YAML 1.2
---
$id: http://devicetree.org/schemas/pinctrl/ralink,rt2880-pinctrl.yaml#
$schema: http://devicetree.org/meta-schemas/core.yaml#

title: Ralink RT2880 Pin Controller

maintainers:
  - Arınç ÜNAL <arinc.unal@arinc9.com>
  - Sergio Paracuellos <sergio.paracuellos@gmail.com>

description: |
  Ralink RT2880 pin controller for RT2880 SoC.
  The pin controller can only set the muxing of pin groups. Muxing individual
  pins is not supported. There is no pinconf support.

properties:
  compatible:
    oneOf:
      - const: ralink,rt2880-pinctrl
      - const: ralink,rt2880-pinmux
        deprecated: true

patternProperties:
  '-pins$':
    type: object
    additionalProperties: false

    patternProperties:
      '^(.*-)?pinmux$':
        type: object
        description: node for pinctrl.
        $ref: pinmux-node.yaml#
        additionalProperties: false

        properties:
          function:
            description:
              A string containing the name of the function to mux to the group.
            enum: [gpio, i2c, spi, uartlite, jtag, mdio, sdram, pci]

          groups:
            description: |
              An array of strings. Each string contains the name of a group.

              group             pins
              ------------------------------------------------------------------
              "i2c"             1, 2
              "spi"             3, 4, 5, 6
              "uartlite"        7, 8, 9, 10, 11, 12, 13, 14
              "jtag"            17, 18, 19, 20, 21
              "mdio"            22, 23
              "sdram"           24, 25, 26, 27, 28, 29, 30, 31, 32, 33, 34, 35,
                                36, 37, 38, 39

              "pci"             40, 41, 42, 43, 44, 45, 46, 47, 48, 49, 50, 51,
                                52, 53, 54, 55, 56, 57, 58, 59, 60, 61, 62, 63,
                                64, 65, 66, 67, 68, 69, 70, 71

            maxItems: 1

        required:
          - groups
          - function

        allOf:
          - if:
              properties:
                function:
                  const: gpio
            then:
              properties:
                groups:
                  enum: [i2c, spi, uartlite, jtag, mdio, sdram, pci]

          - if:
              properties:
                function:
                  const: i2c
            then:
              properties:
                groups:
                  enum: [i2c]

          - if:
              properties:
                function:
                  const: spi
            then:
              properties:
                groups:
                  enum: [spi]

          - if:
              properties:
                function:
                  const: uartlite
            then:
              properties:
                groups:
                  enum: [uartlite]

          - if:
              properties:
                function:
                  const: jtag
            then:
              properties:
                groups:
                  enum: [jtag]

          - if:
              properties:
                function:
                  const: mdio
            then:
              properties:
                groups:
                  enum: [mdio]

          - if:
              properties:
                function:
                  const: sdram
            then:
              properties:
                groups:
                  enum: [sdram]

          - if:
              properties:
                function:
                  const: pci
            then:
              properties:
                groups:
                  enum: [pci]

allOf:
  - $ref: pinctrl.yaml#

required:
  - compatible

additionalProperties: false

examples:
  - |
    pinctrl {
      compatible = "ralink,rt2880-pinctrl";

      i2c_pins: i2c0-pins {
        pinmux {
          groups = "i2c";
          function = "i2c";
        };
      };
    };
```
