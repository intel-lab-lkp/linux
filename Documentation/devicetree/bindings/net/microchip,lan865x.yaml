## Documentation/devicetree/bindings/net/microchip,lan865x.yaml
```yaml
# SPDX-License-Identifier: (GPL-2.0-only OR BSD-2-Clause)
%YAML 1.2
---
$id: http://devicetree.org/schemas/net/microchip,lan865x.yaml#
$schema: http://devicetree.org/meta-schemas/core.yaml#

title: Microchip LAN8650/1 10BASE-T1S MACPHY Ethernet Controllers

maintainers:
  - Parthiban Veerasooran <parthiban.veerasooran@microchip.com>

description:
  The LAN8650/1 combines a Media Access Controller (MAC) and an Ethernet
  PHY to enable 10BASE‑T1S networks. The Ethernet Media Access Controller
  (MAC) module implements a 10 Mbps half duplex Ethernet MAC, compatible
  with the IEEE 802.3 standard and a 10BASE-T1S physical layer transceiver
  integrated into the LAN8650/1. The communication between the Host and
  the MAC-PHY is specified in the OPEN Alliance 10BASE-T1x MACPHY Serial
  Interface (TC6).

  Specifications about the LAN8650/1 can be found at:
    https://www.microchip.com/en-us/product/lan8650

allOf:
  - $ref: ethernet-controller.yaml#

properties:
  compatible:
    const: microchip,lan865x

  reg:
    maxItems: 1

  interrupts:
    description:
      Interrupt from MAC-PHY asserted in the event of Receive Chunks
      Available, Transmit Chunk Credits Available and Extended Status
      Event.
    maxItems: 1

  local-mac-address:
    description:
      Specifies the MAC address assigned to the network device.
    $ref: /schemas/types.yaml#/definitions/uint8-array
    minItems: 6
    maxItems: 6

  spi-max-frequency:
    minimum: 15000000
    maximum: 25000000

  oa-tc6:
    $ref: oa-tc6.yaml#
    unevaluatedProperties: true

  "#address-cells":
    const: 1

  "#size-cells":
    const: 0

required:
  - compatible
  - reg
  - pinctrl-names
  - pinctrl-0
  - interrupts
  - interrupt-parent
  - local-mac-address
  - spi-max-frequency
  - oa-tc6

additionalProperties: false

examples:
  - |
    spi {
      #address-cells = <1>;
      #size-cells = <0>;

      ethernet@0 {
        compatible = "microchip,lan865x";
        reg = <0>;
        pinctrl-names = "default";
        pinctrl-0 = <&eth0_pins>;
        interrupt-parent = <&gpio>;
        interrupts = <6 IRQ_TYPE_EDGE_FALLING>;
        local-mac-address = [04 05 06 01 02 03];
        spi-max-frequency = <15000000>;
        status = "okay";
        oa-tc6 {
          #address-cells = <1>;
          #size-cells = <0>;
          oa-cps = <64>;
          oa-txcte;
	  oa_rxcte;
	  oa-prote;
	  oa-dprac;
        };
      };
    };
```

## Documentation/devicetree/bindings/net/oa-tc6.yaml
```yaml
# SPDX-License-Identifier: GPL-2.0-only OR BSD-2-Clause
%YAML 1.2
---
$id: http://devicetree.org/schemas/net/oa-tc6.yaml#
$schema: http://devicetree.org/meta-schemas/core.yaml#

title: OPEN Alliance 10BASE-T1x MAC-PHY Specification Common Properties

maintainers:
  - Parthiban Veerasooran <parthiban.veerasooran@microchip.com>

description:
  These are generic properties that can apply to any 10BASE-T1x MAC-PHY
  which uses OPEN Alliance TC6 specification.

  10BASE-T1x MAC-PHY Serial Interface Specification can be found at:
    https://opensig.org/about/specifications/

properties:
  $nodename:
    pattern: "^oa-tc6(@.*)?"

  "#address-cells":
    const: 1

  "#size-cells":
    const: 0

  oa-cps:
    maxItems: 1
    description:
      Chunk Payload Size. Configures the data chunk payload size to 2^N,
      where N is the value of this bitfield. The minimum possible data
      chunk payload size is 8 bytes or N = 3. The default data chunk
      payload size is 64 bytes, or N = 6. The minimum supported data chunk
      payload size for this MAC-PHY device is indicated in the CPSMIN
      field of the CAPABILITY register. Valid values for this parameter
      are 8, 16, 32 and 64. All other values are reserved.

  oa-txcte:
    maxItems: 1
    description:
      Transmit Cut-Through Enable. When supported by this MAC-PHY device,
      this bit enables the cut-through mode of frame transfer through the
      MAC-PHY device from the SPI host to the network.

  oa-rxcte:
    maxItems: 1
    description:
      Receive Cut-Through Enable. When supported by this MAC-PHY device,
      this bit enables the cut-through mode of frame transfer through the
      MAC-PHY device from the network to the SPI host.

  oa-prote:
    maxItems: 1
    description:
      Control data read/write Protection Enable. When set, all control
      data written to and read from the MAC-PHY will be transferred with
      its complement for detection of bit errors.

  oa-dprac:
    maxItems: 1
    description:
      Direct PHY Register Access Capability. Indicates if PHY registers
      are directly accessible within the SPI register memory space.

  oa-dprac:
    maxItems: 1
    description:
      Indirect PHY Register Access Capability. Indicates if PHY registers
      are indirectly accessible through the MDIO/MDC registers MDIOACCn.

additionalProperties: true

examples:
  - |
    oa-tc6 {
        #address-cells = <1>;
	#size-cells = <0>;
	oa-cps = <64>;
	oa-txcte;
	oa-rxcte;
	oa-prote;
	oa-dprac;
	oa-iprac;
    };
```

## Documentation/devicetree/bindings/net/qcom,ipq4019-ess.yaml
```yaml
# SPDX-License-Identifier: (GPL-2.0-only OR BSD-2-Clause)
%YAML 1.2
---
$id: http://devicetree.org/schemas/net/qcom,ipq4019-ess.yaml#
$schema: http://devicetree.org/meta-schemas/core.yaml#

title: Qualcomm IPQ4019 Ethernet switch subsystem driver

maintainers:
  - Romain Gantois <romain.gantois@bootlin.com>

$ref: ethernet-switch.yaml#

properties:
  compatible:
    const: qca,ipq4019-qca8337n

  reg:
    maxItems: 3
    description: Base ESS registers, PSGMII registers and EDMA registers

  reg-names:
    maxItems: 3

  resets:
    maxItems: 2
    description: Handles to the PSGMII and ESS reset lines

  reset-names:
    maxItems: 2

  clocks:
    maxItems: 1
    description: Handle to the GCC ESS clock

  clock-names:
    maxItems: 1

  psgmii-ethphy:
    maxItems: 1
    description: Handle to the MDIO bus node corresponding to the PSGMII

  mdio:
    maxItems: 1
    description: Handle to the IPQ4019 MDIO Controller

  interrupts:
    maxItems: 32
    description: One interrupt per tx and rx queue, the first 16 are rx queues
                 and the last 16 are the tx queues

required:
  - compatible
  - reg
  - reg-names
  - resets
  - reset-names
  - clocks
  - clock-names
  - mdio
  - interrupts

unevaluatedProperties: false

examples:
  - |
    #include <dt-bindings/clock/qcom,gcc-ipq4019.h>
    #include <dt-bindings/interrupt-controller/arm-gic.h>
    switch: switch@c000000 {
        compatible = "qca,ipq4019-qca8337n";
        reg = <0xc000000 0x80000>, <0x98000 0x800>, <0xc080000 0x80000>;
        reg-names = "base", "psgmii_phy", "edma";
        resets = <&gcc ESS_PSGMII_ARES>, <&gcc ESS_RESET>;
        reset-names = "psgmii_rst", "ess";
        clocks = <&gcc GCC_ESS_CLK>;
        clock-names = "ess";
        mdio = <&mdio>;
        interrupts = <GIC_SPI  65 IRQ_TYPE_EDGE_RISING>,
                     <GIC_SPI  66 IRQ_TYPE_EDGE_RISING>,
                     <GIC_SPI  67 IRQ_TYPE_EDGE_RISING>,
                     <GIC_SPI  68 IRQ_TYPE_EDGE_RISING>,
                     <GIC_SPI  69 IRQ_TYPE_EDGE_RISING>,
                     <GIC_SPI  70 IRQ_TYPE_EDGE_RISING>,
                     <GIC_SPI  71 IRQ_TYPE_EDGE_RISING>,
                     <GIC_SPI  72 IRQ_TYPE_EDGE_RISING>,
                     <GIC_SPI  73 IRQ_TYPE_EDGE_RISING>,
                     <GIC_SPI  74 IRQ_TYPE_EDGE_RISING>,
                     <GIC_SPI  75 IRQ_TYPE_EDGE_RISING>,
                     <GIC_SPI  76 IRQ_TYPE_EDGE_RISING>,
                     <GIC_SPI  77 IRQ_TYPE_EDGE_RISING>,
                     <GIC_SPI  78 IRQ_TYPE_EDGE_RISING>,
                     <GIC_SPI  79 IRQ_TYPE_EDGE_RISING>,
                     <GIC_SPI  80 IRQ_TYPE_EDGE_RISING>,
                     <GIC_SPI 240 IRQ_TYPE_EDGE_RISING>,
                     <GIC_SPI 241 IRQ_TYPE_EDGE_RISING>,
                     <GIC_SPI 242 IRQ_TYPE_EDGE_RISING>,
                     <GIC_SPI 243 IRQ_TYPE_EDGE_RISING>,
                     <GIC_SPI 244 IRQ_TYPE_EDGE_RISING>,
                     <GIC_SPI 245 IRQ_TYPE_EDGE_RISING>,
                     <GIC_SPI 246 IRQ_TYPE_EDGE_RISING>,
                     <GIC_SPI 247 IRQ_TYPE_EDGE_RISING>,
                     <GIC_SPI 248 IRQ_TYPE_EDGE_RISING>,
                     <GIC_SPI 249 IRQ_TYPE_EDGE_RISING>,
                     <GIC_SPI 250 IRQ_TYPE_EDGE_RISING>,
                     <GIC_SPI 251 IRQ_TYPE_EDGE_RISING>,
                     <GIC_SPI 252 IRQ_TYPE_EDGE_RISING>,
                     <GIC_SPI 253 IRQ_TYPE_EDGE_RISING>,
                     <GIC_SPI 254 IRQ_TYPE_EDGE_RISING>,
                     <GIC_SPI 255 IRQ_TYPE_EDGE_RISING>;

        ports {
            #address-cells = <1>;
            #size-cells = <0>;

            swport1: port@1 { /* MAC1 */
                 reg = <1>;
                 label = "lan1";
                 phy-handle = <&ethphy0>;
                 phy-mode = "psgmii";
            };

            swport2: port@2 { /* MAC2 */
                 reg = <2>;
                 label = "lan2";
                 phy-handle = <&ethphy1>;
                 phy-mode = "psgmii";
            };

            swport3: port@3 { /* MAC3 */
                 reg = <3>;
                 label = "lan3";
                 phy-handle = <&ethphy2>;
                 phy-mode = "psgmii";
            };

            swport4: port@4 { /* MAC4 */
                 reg = <4>;
                 label = "lan4";
                 phy-handle = <&ethphy3>;
                 phy-mode = "psgmii";
            };

            swport5: port@5 { /* MAC5 */
                 reg = <5>;
                 label = "wan";
                 phy-handle = <&ethphy4>;
                 phy-mode = "psgmii";
            };
        };
    };

...
```

## Documentation/devicetree/bindings/net/qcom,qca807x.yaml
```yaml
# SPDX-License-Identifier: (GPL-2.0-only OR BSD-2-Clause)
%YAML 1.2
---
$id: http://devicetree.org/schemas/net/qcom,qca807x.yaml#
$schema: http://devicetree.org/meta-schemas/core.yaml#

title: Qualcomm QCA807X Ethernet PHY

maintainers:
  - Christian Marangi <ansuelsmth@gmail.com>
  - Robert Marko <robert.marko@sartura.hr>

description: |
  Qualcomm QCA807X Ethernet PHY is PHY package of 2 or 5
  IEEE 802.3 clause 22 compliant 10BASE-Te, 100BASE-TX and
  1000BASE-T PHY-s.

  They feature 2 SerDes, one for PSGMII or QSGMII connection with
  MAC, while second one is SGMII for connection to MAC or fiber.

  Both models have a combo port that supports 1000BASE-X and
  100BASE-FX fiber.

  Each PHY inside of QCA807x series has 4 digitally controlled
  output only pins that natively drive LED-s for up to 2 attached
  LEDs. Some vendor also use these 4 output for GPIO usage without
  attaching LEDs.

  Note that output pins can be set to drive LEDs OR GPIO, mixed
  definition are not accepted.

  PHY package can be configured in 3 mode following this table:

                First Serdes mode       Second Serdes mode
  Option 1      PSGMII for copper       Disabled
                ports 0-4
  Option 2      PSGMII for copper       1000BASE-X / 100BASE-FX
                ports 0-4
  Option 3      QSGMII for copper       SGMII for
                ports 0-3               copper port 4

$ref: ethernet-phy-package.yaml#

properties:
  compatible:
    const: qcom,qca807x-package

  qcom,package-mode:
    enum:
      - qsgmii
      - psgmii

  qcom,tx-driver-strength:
    description: set the TX Amplifier value in mv.
      If not defined, 600mw is set by default.
    $ref: /schemas/types.yaml#/definitions/uint32
    enum: [140, 160, 180, 200, 220,
           240, 260, 280, 300, 320,
           400, 500, 600]

patternProperties:
  ^ethernet-phy(@[a-f0-9]+)?$:
    $ref: ethernet-phy.yaml#

    properties:
      gpio-controller:
        description: set the output lines as GPIO instead of LEDs
        type: boolean

      '#gpio-cells':
        description: number of GPIO cells for the PHY
        const: 2

    dependencies:
      gpio-controller: ['#gpio-cells']

    if:
      required:
        - gpio-controller
    then:
      properties:
        leds: false

    unevaluatedProperties: false

required:
  - compatible

unevaluatedProperties: false

examples:
  - |
    #include <dt-bindings/leds/common.h>

    mdio {
        #address-cells = <1>;
        #size-cells = <0>;

        ethernet-phy-package@0 {
            #address-cells = <1>;
            #size-cells = <0>;
            compatible = "qcom,qca807x-package";
            reg = <0>;

            qcom,package-mode = "qsgmii";

            ethernet-phy@0 {
                reg = <0>;

                leds {
                    #address-cells = <1>;
                    #size-cells = <0>;

                    led@0 {
                        reg = <0>;
                        color = <LED_COLOR_ID_GREEN>;
                        function = LED_FUNCTION_LAN;
                        default-state = "keep";
                    };
                };
            };

            ethernet-phy@1 {
                reg = <1>;
            };

            ethernet-phy@2 {
                reg = <2>;

                gpio-controller;
                #gpio-cells = <2>;
            };

            ethernet-phy@3 {
                reg = <3>;
            };

            ethernet-phy@4 {
                reg = <4>;
            };
        };
    };
```

## Documentation/devicetree/bindings/net/snps,dw-xpcs-mi.yaml
```yaml
# SPDX-License-Identifier: (GPL-2.0-only OR BSD-2-Clause)
%YAML 1.2
---
$id: http://devicetree.org/schemas/net/snps,dw-xpcs-mi.yaml#
$schema: http://devicetree.org/meta-schemas/core.yaml#

title: Synopsys DesignWare Ethernet PCS Management Interface

maintainers:
  - Serge Semin <fancer.lancer@gmail.com>

description:
  Synopsys DesignWare Ethernet PCS provides an interface between MAC and PMA
  through the Media Independent Interface. The PCS CSRs can be accessible over
  the Ethernet MDIO bus or directly by means of the APB3/MCI interfaces. In the
  later case the XPCS can be mapped right to the system IO memory space.

allOf:
  - $ref: mdio.yaml#

properties:
  compatible:
    const: snps,dw-xpcs-mi

  reg:
    items:
      - description:
          DW XPCS CSRs space can be either 'directly' or 'indirectly'
          accessible. In the former case all Clause 45 registers are
          contiguously mapped within the address space MMD '[20:16]',
          Reg '[15:0]'. In the later case the space is divided to the
          multiple 256 register sets. There is a special viewport CSR
          which is responsible for the set selection. The upper part of
          the CSR address is supposed to be written in there thus the
          corresponding subset would be mapped over the lowest 255 CSRs.

  reg-names:
    items:
      - enum: [ direct, indirect ]

  reg-io-width:
    description:
      The way the CSRs are mapped to the memory is platform depended. Since
      each Clause 45 CSR is of 16-bits wide the access instructions must be
      two bytes aligned at least.
    default: 2
    enum: [ 2, 4 ]

  clocks:
    items:
      - description: Peripheral MCI/APB3 bus clock source

  clock-names:
    items:
      - const: pclk

patternProperties:
  'ethernet-pcs@[0-9a-f]+$':
    type: object

    $ref: pcs/snps,dw-xpcs.yaml#

required:
  - compatible
  - reg
  - reg-names

unevaluatedProperties: false

examples:
  - |
    mdio@1f05d000 {
      compatible = "snps,dw-xpcs-mi";
      reg = <0x1f05d000 0x1000>;
      reg-names = "indirect";
      #address-cells = <1>;
      #size-cells = <0>;

      clocks = <&ccu_pclk>;
      clock-names = "pclk";

      reg-io-width = <4>;

      ethernet-pcs@0 {
        compatible = "snps,dw-xpcs";
        reg = <0>;
      };
    };
```
