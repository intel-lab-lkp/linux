## Documentation/devicetree/bindings/pinctrl/ralink,rt3883-pinctrl.yaml
```yaml
# SPDX-License-Identifier: GPL-2.0-only OR BSD-2-Clause
%YAML 1.2
---
$id: http://devicetree.org/schemas/pinctrl/ralink,rt3883-pinctrl.yaml#
$schema: http://devicetree.org/meta-schemas/core.yaml#

title: Ralink RT3883 Pin Controller

maintainers:
  - Arınç ÜNAL <arinc.unal@arinc9.com>
  - Sergio Paracuellos <sergio.paracuellos@gmail.com>

description: |
  Ralink RT3883 pin controller for RT3883 SoC.
  The pin controller can only set the muxing of pin groups. Muxing individual
  pins is not supported. There is no pinconf support.

properties:
  compatible:
    oneOf:
      - const: ralink,rt3883-pinctrl
      - const: ralink,rt2880-pinmux
        deprecated: true

patternProperties:
  '-pins$':
    type: object
    additionalProperties: false

    patternProperties:
      '^(.*-)?pinmux$':
        type: object
        description: node for pinctrl.
        $ref: pinmux-node.yaml#
        additionalProperties: false

        properties:
          function:
            description:
              A string containing the name of the function to mux to the group.
            enum: [ge1, ge2, gpio, gpio i2s, gpio uartf, i2c, i2s uartf, jtag,
                   lna a, lna g, mdio, pci-dev, pci-fnc, pci-host1, pci-host2,
                   pcm gpio, pcm i2s, pcm uartf, spi, uartf, uartlite]

          groups:
            description: |
              An array of strings. Each string contains the name of a group.

              group             pins
              ------------------------------------------------------------------
              "i2c"             1, 2
              "spi"             3, 4, 5, 6
              "uartf"           7, 8, 9, 10, 11, 12, 13, 14
              "uartlite"        15, 16
              "jtag"            17, 18, 19, 20, 21
              "mdio"            22, 23
              "lna a"           32, 33, 34
              "lna g"           35, 36, 37
              "ge1"             72, 73, 74, 75, 76, 77, 78, 79, 80, 81, 82, 83
              "ge2"             84, 85, 86, 87, 88, 89, 90, 91, 92, 93, 94, 95

            maxItems: 1

        required:
          - groups
          - function

        allOf:
          - if:
              properties:
                function:
                  const: ge1
            then:
              properties:
                groups:
                  enum: [ge1]

          - if:
              properties:
                function:
                  const: ge2
            then:
              properties:
                groups:
                  enum: [ge2]

          - if:
              properties:
                function:
                  const: gpio
            then:
              properties:
                groups:
                  enum: [ge1, ge2, i2c, jtag, lna a, lna g, mdio, pci, spi,
                         uartf, uartlite]

          - if:
              properties:
                function:
                  const: gpio i2s
            then:
              properties:
                groups:
                  enum: [uartf]

          - if:
              properties:
                function:
                  const: gpio uartf
            then:
              properties:
                groups:
                  enum: [uartf]

          - if:
              properties:
                function:
                  const: i2c
            then:
              properties:
                groups:
                  enum: [i2c]

          - if:
              properties:
                function:
                  const: i2s uartf
            then:
              properties:
                groups:
                  enum: [uartf]

          - if:
              properties:
                function:
                  const: jtag
            then:
              properties:
                groups:
                  enum: [jtag]

          - if:
              properties:
                function:
                  const: lna a
            then:
              properties:
                groups:
                  enum: [lna a]

          - if:
              properties:
                function:
                  const: lna g
            then:
              properties:
                groups:
                  enum: [lna g]

          - if:
              properties:
                function:
                  const: mdio
            then:
              properties:
                groups:
                  enum: [mdio]

          - if:
              properties:
                function:
                  const: pci-dev
            then:
              properties:
                groups:
                  enum: [pci]

          - if:
              properties:
                function:
                  const: pci-fnc
            then:
              properties:
                groups:
                  enum: [pci]

          - if:
              properties:
                function:
                  const: pci-host1
            then:
              properties:
                groups:
                  enum: [pci]

          - if:
              properties:
                function:
                  const: pci-host2
            then:
              properties:
                groups:
                  enum: [pci]

          - if:
              properties:
                function:
                  const: pcm gpio
            then:
              properties:
                groups:
                  enum: [uartf]

          - if:
              properties:
                function:
                  const: pcm i2s
            then:
              properties:
                groups:
                  enum: [uartf]

          - if:
              properties:
                function:
                  const: pcm uartf
            then:
              properties:
                groups:
                  enum: [uartf]

          - if:
              properties:
                function:
                  const: spi
            then:
              properties:
                groups:
                  enum: [spi]

          - if:
              properties:
                function:
                  const: uartf
            then:
              properties:
                groups:
                  enum: [uartf]

          - if:
              properties:
                function:
                  const: uartlite
            then:
              properties:
                groups:
                  enum: [uartlite]

allOf:
  - $ref: pinctrl.yaml#

required:
  - compatible

additionalProperties: false

examples:
  - |
    pinctrl {
      compatible = "ralink,rt3883-pinctrl";

      i2c_pins: i2c0-pins {
        pinmux {
          groups = "i2c";
          function = "i2c";
        };
      };
    };
```

## Documentation/devicetree/bindings/power/supply/maxim,max77705-charger.yaml
```yaml
# SPDX-License-Identifier: GPL-2.0-only OR BSD-2-Clause
%YAML 1.2
---
$id: http://devicetree.org/schemas/power/supply/maxim,max77705-charger.yaml#
$schema: http://devicetree.org/meta-schemas/core.yaml#

title: Maxim MAX77705 and Companion Power Management IC charger

maintainers:
  - Dzmitry Sankouski <dsankouski@gmail.com>

description: |
  This is a part of device tree bindings for Maxim MAX77705 multi functional device.

  See also Documentation/devicetree/bindings/mfd/maxim,max77705.yaml for
  additional information and example.

allOf:
  - $ref: power-supply.yaml#

properties:
  compatible:
    const: maxim,max77705-charger

required:
  - compatible

additionalProperties: false

...
```

## Documentation/devicetree/bindings/pwm/airoha,en7581-pwm.yaml
```yaml
# SPDX-License-Identifier: (GPL-2.0-only OR BSD-2-Clause)
%YAML 1.2
---
$id: http://devicetree.org/schemas/pwm/airoha,en7581-pwm.yaml#
$schema: http://devicetree.org/meta-schemas/core.yaml#

title: Airoha EN7581 PWM Controller

maintainers:
  - Lorenzo Bianconi <lorenzo@kernel.org>

allOf:
  - $ref: pwm.yaml#

properties:
  compatible:
    const: airoha,en7581-pwm

  "#pwm-cells":
    const: 3

  airoha,74hc595-mode:
    description: Set the PWM to handle attached shift register chip 74HC595.

      With this disabled, PWM assume a 74HC164 chip attached.

      The main difference between the 2 chip is the presence of a latch pin
      that needs to triggered to apply the configuration and PWM needs to
      account for that.
    type: boolean

  airoha,sipo-clock-divisor:
    description: Declare Shift Register chip clock divisor (clock source is
      from SoC APB Clock)
    $ref: /schemas/types.yaml#/definitions/uint32
    default: 32
    enum: [4, 8, 16, 32]

  airoha,sipo-clock-delay:
    description: Declare Serial GPIO Clock delay.
      This can be needed to permit the attached shift register to correctly
      setup and apply settings. Value must NOT be greater than
      "airoha,sipo-clock-divisor" / 2
    $ref: /schemas/types.yaml#/definitions/uint32
    default: 1
    minimum: 1
    maximum: 16

required:
  - compatible
  - "#pwm-cells"

additionalProperties: false

examples:
  - |
    pwm {
      compatible = "airoha,en7581-pwm";

      #pwm-cells = <3>;
    };
```

## Documentation/devicetree/bindings/regulator/samsung,s2dos05.yaml
```yaml
# SPDX-License-Identifier: (GPL-2.0 OR BSD-2-Clause)
%YAML 1.2
---
$id: http://devicetree.org/schemas/regulator/samsung,s2dos05.yaml#
$schema: http://devicetree.org/meta-schemas/core.yaml#

title: Samsung S2DOS05 Power Management IC Regulators

maintainers:
  - Dzmitry Sankouski <dsankouski@gmail.com>

description:
  This is a part of device tree bindings for S2M and S5M family of Power
  Management IC (PMIC).

  Has 4 LDO and 1 BUCK regulators, provides ELVDD, ELVSS, AVDD lines.

  See also Documentation/devicetree/bindings/mfd/samsung,s2dos05.yaml for
  additional information and example.

properties:
  compatible:
    const: samsung,s2dos05-regulator

patternProperties:
  "^buck1|ldo[1-4]$":
    type: object
    $ref: regulator.yaml#
    unevaluatedProperties: false

    required:
      - regulator-name

additionalProperties: false

...
```
