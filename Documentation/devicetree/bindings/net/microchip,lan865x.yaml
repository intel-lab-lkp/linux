## Documentation/devicetree/bindings/remoteproc/qcom,ipq8074-wcss-pil.yaml
```yaml
# SPDX-License-Identifier: (GPL-2.0 OR BSD-2-Clause)
%YAML 1.2
---
$id: http://devicetree.org/schemas/remoteproc/qcom,ipq8074-wcss-pil.yaml#
$schema: http://devicetree.org/meta-schemas/core.yaml#

title: Qualcomm IPQ WCSS Peripheral Image Loader

maintainers:
  - Bjorn Andersson <andersson@kernel.org>
  - Alexandru Gagniuc <mr.nuke.me@gmail.com>

description:
  The IPQ WCSS peripheral image loader is used to load firmware on the Qualcomm
  Q6 processor that exposes WiFi-6 devices to the OS via the AHB bus. It is
  generally used by ath11k to start up the wireless firmware.

properties:
  compatible:
    enum:
      - qcom,ipq8074-wcss-pil
      - qcom,ipq9574-wcss-pil
      - qcom,qcs404-wcss-pil

  reg:
    maxItems: 2

  reg-names:
    items:
      - const: qdsp6
      - const: rmb

  interrupts:
    maxItems: 5

  interrupt-names:
    items:
      - const: wdog
      - const: fatal
      - const: ready
      - const: handover
      - const: stop-ack

  resets:
    maxItems: 3

  reset-names:
    items:
      - const: wcss_aon_reset
      - const: wcss_reset
      - const: wcss_q6_reset

  clocks:
    minItems: 10
    maxItems: 13

  clock-names:
    minItems: 10
    maxItems: 13

  cx-supply:
    description:
      reference to the regulators used for the booting of the Hexagon core

  memory-region:
    maxItems: 1

  qcom,halt-regs:
    $ref: /schemas/types.yaml#/definitions/phandle-array
    description:
      A phandle reference to a syscon representing TCSR followed by the three
      offsets within syscon for q6, wcss and nc halt registers.
    items:
      - items:
          - description: phandle to TCSR_MUTEX registers
          - description: offset to the Q6 halt register
          - description: offset to the wcss halt register
          - description: offset to the nc halt register

  qcom,smem-states:
    $ref: /schemas/types.yaml#/definitions/phandle-array
    maxItems: 2
    description: States used by the AP to signal the remote processor

  qcom,smem-state-names:
    maxItems: 2
    description:
      Names of the states used by the AP to signal the remote processor

  glink-edge:
    $ref: /schemas/remoteproc/qcom,glink-edge.yaml#
    description:
      Qualcomm G-Link subnode which represents communication edge, channels
      and devices related to the Modem.

required:
  - compatible
  - reg
  - reg-names
  - interrupts-extended
  - interrupt-names
  - memory-region
  - qcom,halt-regs
  - qcom,smem-states
  - qcom,smem-state-names

allOf:
  - if:
      properties:
        compatible:
          contains:
            enum:
              - qcom,ipq8074-wcss-pil
    then:
      properties:
        qcom,smem-states:
          items:
            - description: Shutdown Q6
            - description: Stop Q6
        qcom,smem-state-names:
          items:
            - const: shutdown
            - const: stop
        clock-names: false
        clocks: false

  - if:
      properties:
        compatible:
          contains:
            enum:
              - qcom,ipq9574-wcss-pil
    then:
      properties:
        clocks:
          minItems: 13
        clock-names:
          items:
            - const: anoc_wcss_axi_m
            - const: q6_ahb
            - const: q6_ahb_s
            - const: q6_axim
            - const: q6ss_boot
            - const: mem_noc_q6_axi
            - const: sys_noc_wcss_ahb
            - const: wcss_acmt
            - const: wcss_ecahb
            - const: wcss_q6_tbu
            - const: q6_axim2
            - const: wcss_ahb_s
            - const: wcss_axi_m
        qcom,smem-states:
          items:
            - description: Shutdown Q6
            - description: Stop Q6
        qcom,smem-state-names:
          items:
            - const: shutdown
            - const: stop

      required:
        - clocks
        - clock-names

  - if:
      properties:
        compatible:
          contains:
            enum:
              - qcom,qcs404-wcss-pil
    then:
      properties:
        qcom,smem-states:
          maxItems: 1
        qcom,smem-state-names:
          items:
            - const: stop
        clocks:
          minItems: 10
          maxItems: 10
        clock-names:
          items:
            - const: xo
            - const: gcc_abhs_cbcr
            - const: gcc_axim_cbcr
            - const: lcc_ahbfabric_cbc
            - const: tcsr_lcc_cbc
            - const: lcc_abhs_cbc
            - const: lcc_tcm_slave_cbc
            - const: lcc_abhm_cbc
            - const: lcc_axim_cbc
            - const: lcc_bcr_sleep
      required:
        - clocks
        - clock-names
        - cx-supply

additionalProperties: false

examples:
  - |
    #include <dt-bindings/clock/qcom,ipq9574-gcc.h>
    #include <dt-bindings/interrupt-controller/arm-gic.h>
    #include <dt-bindings/reset/qcom,ipq9574-gcc.h>

    q6v5_wcss: remoteproc@cd00000 {
        compatible = "qcom,ipq9574-wcss-pil";
        reg = <0x0cd00000 0x4040>,
              <0x004ab000 0x20>;
        reg-names = "qdsp6", "rmb";

        interrupts-extended = <&intc GIC_SPI 325 IRQ_TYPE_EDGE_RISING>,
                              <&wcss_smp2p_in 0 IRQ_TYPE_NONE>,
                              <&wcss_smp2p_in 1 IRQ_TYPE_NONE>,
                              <&wcss_smp2p_in 2 IRQ_TYPE_NONE>,
                              <&wcss_smp2p_in 3 IRQ_TYPE_NONE>;
        interrupt-names = "wdog", "fatal", "ready",
                          "handover", "stop-ack";

        resets = <&gcc GCC_WCSSAON_RESET>,
                 <&gcc GCC_WCSS_BCR>,
                 <&gcc GCC_WCSS_Q6_BCR>;
        reset-names = "wcss_aon_reset",
                      "wcss_reset",
                      "wcss_q6_reset";

        clocks = <&gcc GCC_ANOC_WCSS_AXI_M_CLK>,
                 <&gcc GCC_Q6_AHB_CLK>,
                 <&gcc GCC_Q6_AHB_S_CLK>,
                 <&gcc GCC_Q6_AXIM_CLK>,
                 <&gcc GCC_Q6SS_BOOT_CLK>,
                 <&gcc GCC_MEM_NOC_Q6_AXI_CLK>,
                 <&gcc GCC_SYS_NOC_WCSS_AHB_CLK>,
                 <&gcc GCC_WCSS_ACMT_CLK>,
                 <&gcc GCC_WCSS_ECAHB_CLK>,
                 <&gcc GCC_WCSS_Q6_TBU_CLK>,
                 <&gcc GCC_WCSS_AHB_S_CLK>,
                 <&gcc GCC_Q6_AXIM2_CLK>,
                 <&gcc GCC_WCSS_AXI_M_CLK>;

        clock-names = "anoc_wcss_axi_m",
                      "q6_ahb",
                      "q6_ahb_s",
                      "q6_axim",
                      "q6ss_boot",
                      "mem_noc_q6_axi",
                      "sys_noc_wcss_ahb",
                      "wcss_acmt",
                      "wcss_ecahb",
                      "wcss_q6_tbu",
                      "q6_axim2",
                      "wcss_ahb_s",
                      "wcss_axi_m";

        qcom,halt-regs = <&tcsr 0x18000 0x1b000 0xe000>;

        qcom,smem-states = <&wcss_smp2p_out 0>,
                           <&wcss_smp2p_out 1>;
        qcom,smem-state-names = "shutdown",
                                "stop";
        memory-region = <&q6_region>;

        glink-edge {
            interrupts = <GIC_SPI 321 IRQ_TYPE_EDGE_RISING>;
            label = "rtr";
            qcom,remote-pid = <1>;
            mboxes = <&apcs_glb 8>;
        };
    };
```

## Documentation/devicetree/bindings/reset/reset-simple.yaml
```yaml
# SPDX-License-Identifier: (GPL-2.0 OR BSD-2-Clause)
%YAML 1.2
---
$id: http://devicetree.org/schemas/reset/reset-simple.yaml#
$schema: http://devicetree.org/meta-schemas/core.yaml#

title: Generic Bit Reset Controller

maintainers:
  - Inochi Amaoto <inochiama@gmail.com>

description: |
  This document defines device tree properties common to reset
  controller devices that perform assert/deassert by simply
  toggling bit.

  All devices in this binding should satisfy the following requirement:
  - There is a single, contiguous range of 32-bit registers.
  - All bits in each register directly control a reset line.
     - There are no self-deasserting resets.
     - There are no timing requirements.
     - The bits are exclusively resets, nothing else.
  - All bits behave the same, so all reset bits are either
    active-high or all are active-low.
  - The bits can be read back, but the read status may
    be active-low independently from the writes.

  If the device is not meet the requirement, it should use its
  own binding to describe the device.

properties:
  compatible:
    const: reset-simple

  reg:
    maxItems: 1

  "#reset-cells":
    const: 1

  active-low:
    type: boolean
    description:
      If true, bits are cleared to assert the reset. Otherwise,
      bits are set to assert the reset. This also applies to
      read back.

required:
  - compatible
  - reg
  - "#reset-cells"

additionalProperties: false

examples:
  - |
    reset-controller@1000000 {
        compatible = "reset-simple";
        reg = <0x1000000 0x1000>;
        #reset-cells = <1>;
    };
```

## Documentation/devicetree/bindings/serial/qcom,serial-geni-qcom.yaml
```yaml
# SPDX-License-Identifier: (GPL-2.0-only OR BSD-2-Clause)
%YAML 1.2
---
$id: http://devicetree.org/schemas/serial/qcom,serial-geni-qcom.yaml#
$schema: http://devicetree.org/meta-schemas/core.yaml#

title: Qualcomm Geni based QUP UART interface

maintainers:
  - Andy Gross <agross@kernel.org>
  - Bjorn Andersson <bjorn.andersson@linaro.org>

allOf:
  - $ref: /schemas/serial/serial.yaml#

properties:
  compatible:
    enum:
      - qcom,geni-uart
      - qcom,geni-debug-uart

  clocks:
    maxItems: 1

  clock-names:
    const: se

  interconnects:
    maxItems: 2

  interconnect-names:
    items:
      - const: qup-core
      - const: qup-config

  interrupts:
    minItems: 1
    items:
      - description: UART core irq
      - description: Wakeup irq (RX GPIO)

  operating-points-v2: true

  pinctrl-0: true
  pinctrl-1: true

  pinctrl-names:
    minItems: 1
    items:
      - const: default
      - const: sleep

  power-domains:
    maxItems: 1

  reg:
    maxItems: 1

  qcom,load-firmware:
    type: boolean
    description: Optional property to load SE (serial engine) Firmware from protocol driver.

  qcom,xfer-mode:
    description: Value 1,2 and 3 represents FIFO, CPU DMA and GSI DMA mode respectively.
    $ref: /schemas/types.yaml#/definitions/uint32
    enum: [1, 2, 3]


required:
  - compatible
  - clocks
  - clock-names
  - interrupts
  - reg

unevaluatedProperties: false

examples:
  - |
    #include <dt-bindings/interrupt-controller/arm-gic.h>
    #include <dt-bindings/clock/qcom,gcc-sc7180.h>
    #include <dt-bindings/interconnect/qcom,sc7180.h>

    serial@a88000 {
        compatible = "qcom,geni-uart";
        reg = <0xa88000 0x7000>;
        interrupts = <GIC_SPI 355 IRQ_TYPE_LEVEL_HIGH>;
        clock-names = "se";
        clocks = <&gcc GCC_QUPV3_WRAP0_S0_CLK>;
        pinctrl-0 = <&qup_uart0_default>;
        pinctrl-names = "default";
        interconnects = <&qup_virt MASTER_QUP_CORE_0 0 &qup_virt SLAVE_QUP_CORE_0 0>,
                        <&gem_noc MASTER_APPSS_PROC 0 &config_noc SLAVE_QUP_0 0>;
        interconnect-names = "qup-core", "qup-config";
        qcom,load-firmware;
        qcom,xfer-mode = <1>;
    };
...
```

## Documentation/devicetree/bindings/soc/airoha/airoha,an7581-scu-ssr.yaml
```yaml
# SPDX-License-Identifier: (GPL-2.0-only OR BSD-2-Clause)
%YAML 1.2
---
$id: http://devicetree.org/schemas/soc/airoha/airoha,an7581-scu-ssr.yaml#
$schema: http://devicetree.org/meta-schemas/core.yaml#

title: Airoha AN7581 SCU System Status Register

maintainers:
  - Christian Marangi <ansuelsmth@gmail.com>

description: >
  The Airoha AN7581 SoC have in the SCU register space particular
  address that control how some peripheral are configured.

  These are toggeled in the System Status Register and are used to
  toggle Serdes port for USB 3.0 mode or HSGMII, USB 3.0 mode or PCIe2
  or setup port for PCIe mode or Ethrnet mode (HSGMII/USXGMII).

  Modes are mutually exclusive and selecting one mode cause the
  other feature to not work (example a mode in USB 3.0 cause PCIe
  port 2 to not work) This depends also on what is physically
  connected to the Hardware and needs to correctly reflect the
  System Status Register bits.

  Special care is needed for PCIe port 0 in 2 line mode that
  requires both WiFi1 and WiFi2 Serdes port set to PCIe0 2 Line
  mode.

properties:
  compatible:
    const: airoha,an7581-scu-ssr

  airoha,serdes-wifi1:
    description: |
      Configure the Wifi1 Serdes port for:
      - 0: PCIe0 2 Line
      - 1: PCIe0 1 Line
      - 2: Ethernet modes (HSGMII/USXGMII)
    $ref: /schemas/types.yaml#/definitions/uint32
    enum: [0, 1, 2]
    default: 1

  airoha,serdes-wifi2:
    description: |
      Configure the Wifi2 Serdes port for:
      - 0: PCIe0 2 Line
      - 1: PCIe1 1 Line
      - 2: Ethernet modes (HSGMII/USXGMII)
    $ref: /schemas/types.yaml#/definitions/uint32
    enum: [0, 1, 2]
    default: 1

  airoha,serdes-usb1:
    description: |
      Configure the USB1 Serdes port for:
      - 0: USB 3.0
      - 1: Ethernet modes (HSGMII)
    $ref: /schemas/types.yaml#/definitions/uint32
    enum: [0, 1]
    default: 0

  airoha,serdes-usb2:
    description: |
      Configure the USB2 Serdes port for:
      - 0: USB 3.0
      - 1: PCIe2 1 Line
    $ref: /schemas/types.yaml#/definitions/uint32
    enum: [0, 1]
    default: 0

required:
  - compatible

allOf:
  - if:
      properties:
        airoha,serdes-wifi1:
          const: 0
    then:
      properties:
        airoha,serdes-wifi2:
          const: 0

  - if:
      properties:
        airoha,serdes-wifi2:
          const: 0
    then:
      properties:
        airoha,serdes-wifi1:
          const: 0

additionalProperties: false

examples:
  - |
    #include <dt-bindings/soc/airoha,scu-ssr.h>

    system-controller {
      compatible = "airoha,an7581-scu-ssr";

      airoha,serdes-wifi1 = <AIROHA_SCU_SSR_WIFI1_PCIE0_2LINE>;
      airoha,serdes-wifi2 = <AIROHA_SCU_SSR_WIFI2_PCIE0_2LINE>;
      airoha,serdes-usb2 = <AIROHA_SCU_SSR_USB2_PCIE2>;
    };
```

## Documentation/devicetree/bindings/soc/nuvoton/nuvoton,npcm-bpc.yaml
```yaml
# SPDX-License-Identifier: (GPL-2.0-only OR BSD-2-Clause)
%YAML 1.2
---
$id: http://devicetree.org/schemas/soc/nuvoton/nuvoton,npcm-bpc.yaml#
$schema: http://devicetree.org/meta-schemas/core.yaml#

title: Nuvoton BMC NPCM BIOS Post Code (BPC) controller

maintainers:
  - Tomer Maimon <tmaimon77@gmail.com>

description:
  Nuvoton BMC NPCM BIOS Post Code (BPC) monitoring two configurable I/O
  addresses written by the host on the bus, the capture data stored in
  128-word FIFO.

  NPCM BPC supports capture double words, when using capture
  double word only I/O address 1 is monitored.

properties:
  compatible:
    items:
      - enum:
          - nuvoton,npcm845-bpc
          - nuvoton,npcm750-bpc
      - const: nuvoton,npcm-bpc

  reg:
    maxItems: 1

  interrupts:
    maxItems: 1

  nuvoton,monitor-ports:
    $ref: /schemas/types.yaml#/definitions/uint32-array
    description:
      Contain monitor I/O addresses on the bus, at least one monitor I/O
      address required.

  nuvoton,bpc-en-dwcapture:
    description:
      Set DWCAPTURE bit in BPCFEN register that enable double words capture
      according to the first address setting.
    type: boolean

required:
  - compatible
  - reg
  - interrupts
  - nuvoton,monitor-ports

additionalProperties: false

examples:
  - |
    #include <dt-bindings/interrupt-controller/irq.h>
    #include <dt-bindings/interrupt-controller/arm-gic.h>

    bpc: bpc@f0007040 {
        compatible = "nuvoton,npcm750-bpc", "nuvoton,npcm-bpc";
        reg = <0xf0007040 0x20>;
        interrupts = <GIC_SPI 9 IRQ_TYPE_LEVEL_HIGH>;
        nuvoton,monitor-ports = <0x80>;
    };
...
```
