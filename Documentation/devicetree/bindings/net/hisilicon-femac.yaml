## Documentation/devicetree/bindings/net/hisilicon-femac.yaml
```yaml
# SPDX-License-Identifier: GPL-2.0-only OR BSD-2-Clause
%YAML 1.2
---
$id: http://devicetree.org/schemas/net/hisilicon-femac.yaml#
$schema: http://devicetree.org/meta-schemas/core.yaml#

title: Hisilicon Fast Ethernet MAC controller

maintainers:
  - Yang Xiwen <forbidden405@foxmail.com>

allOf:
  - $ref: ethernet-controller.yaml

properties:
  compatible:
    enum:
      - hisilicon,hi3798mv200-femac

  reg:
    minItems: 2
    maxItems: 2
    description: |
      The first region is the MAC core register base and size.
      The second region is the global MAC control register.

  ranges:
    maxItems: 1

  '#address-cells':
    const: 1

  '#size-cells':
    const: 1

  interrupts:
    maxItems: 1

  clocks:
    minItems: 3
    maxItems: 3

  clock-names:
    items:
      - const: mac
      - const: macif
      - const: phy

  resets:
    minItems: 2
    maxItems: 2

  reset-names:
    items:
      - const: mac
      - const: phy

  hisilicon,phy-reset-delays-us:
    minItems: 3
    maxItems: 3
    description: |
      The 1st cell is reset pre-delay in micro seconds.
      The 2nd cell is reset pulse in micro seconds.
      The 3rd cell is reset post-delay in micro seconds.

patternProperties:
  '^mdio@[0-9a-f]+$':
    type: object
    description: See ./hisi-femac-mdio.txt

required:
  - compatible
  - reg
  - interrupts
  - clocks
  - clock-names
  - resets
  - reset-names
  - phy-connection-type
  - phy-handle
  - hisilicon,phy-reset-delays-us

unevaluatedProperties: false

examples:
  - |
    #include <dt-bindings/interrupt-controller/arm-gic.h>
    #include <dt-bindings/clock/histb-clock.h>

    #ifndef HISTB_ETH0_PHY_CLK
    #define HISTB_ETH0_PHY_CLK 0
    #endif
    femac: ethernet@9c30000 {
        compatible = "hisilicon,hi3798mv200-femac";
        reg = <0x9c30000 0x1000>, <0x9c31300 0x200>;
        ranges = <0x0 0x9c30000 0x10000>;
        #address-cells = <1>;
        #size-cells = <1>;
        interrupts = <GIC_SPI 72 IRQ_TYPE_LEVEL_HIGH>;
        clocks = <&crg HISTB_ETH0_MAC_CLK>,
                 <&crg HISTB_ETH0_MACIF_CLK>,
                 <&crg HISTB_ETH0_PHY_CLK>;
        clock-names = "mac", "macif", "phy";
        resets = <&crg 0xd0 3>, <&crg 0x388 4>;
        reset-names = "mac", "phy";
        phy-handle = <&fephy>;
        phy-connection-type = "mii";
        // To be filled by bootloader
        mac-address = [00 00 00 00 00 00];
        hisilicon,phy-reset-delays-us = <10000 10000 500000>;
        status = "okay";

        mdio: mdio@1100 {
            compatible = "hisilicon,hisi-femac-mdio";
            reg = <0x1100 0x20>;
            #address-cells = <1>;
            #size-cells = <0>;
            status = "okay";

            fephy: ethernet-phy@1 {
                reg = <1>;
                #phy-cells = <0>;
            };
        };
    };
```

## Documentation/devicetree/bindings/net/infineon,xmm6260.yaml
```yaml
# SPDX-License-Identifier: (GPL-2.0 OR BSD-2-Clause)
%YAML 1.2
---
$id: http://devicetree.org/schemas/net/infineon,xmm6260.yaml#
$schema: http://devicetree.org/meta-schemas/core.yaml#

title: Infineon/Intel XMM6260 embedded USB modem

description:
  The Infineon/Intel XMM6260 is a 3G-focused, slim modem platform designed
  for smartphones, data cards, and Machine-to-Machine (M2M) applications.
  The modem is usually connected via the application processor's USB line
  in HSIC mode; however, to work properly, the modem must control this line

maintainers:
  - Svyatoslav Ryhel <clamor95@gmail.com>

properties:
  compatible:
    const: infineon,xmm6260

  interrupts:
    maxItems: 1

  enable-gpios:
    description: GPIO connected to the ON1 pin
    maxItems: 1

  reset-gpios:
    description: GPIO connected to the RESET_PWRDWN_N pin
    maxItems: 1

  ap-wake-gpios:
    description: GPIO connected to the EINT3 pin
    maxItems: 1

  cp-wake-gpios:
    description: GPIO connected to the EINT2 pin
    maxItems: 1

  phys:
    maxItems: 1

  vbat-supply:
    description: Supply connected to the VBAT lines.

required:
  - compatible
  - interrupts

additionalProperties: false

examples:
  - |
    #include <dt-bindings/gpio/gpio.h>
    #include <dt-bindings/interrupt-controller/irq.h>

    modem {
        compatible = "infineon,xmm6260";

        interrupt-parent = <&gpio>;
        interrupts = <168 IRQ_TYPE_EDGE_BOTH>;

        enable-gpios = <&gpio 112 GPIO_ACTIVE_HIGH>;
        reset-gpios = <&gpio 169 GPIO_ACTIVE_LOW>;

        cp-wake-gpios = <&gpio 151 GPIO_ACTIVE_HIGH>;
        ap-wake-gpios = <&gpio 168 GPIO_ACTIVE_HIGH>;

        phys = <&xmm6260_phy>;
        vbat-supply = <&vdd_3v3_vbat>;
    };
```

## Documentation/devicetree/bindings/net/intel,iccnet.yaml
```yaml
# SPDX-License-Identifier: (GPL-2.0-only OR BSD-2-Clause)
%YAML 1.2
---
$id: http://devicetree.org/schemas/net/intel,iccnet.yaml#
$schema: http://devicetree.org/meta-schemas/core.yaml#

title: Intel IPU ICCNET interface

maintainers:
  - Khalid Mughal <khalid.mughal@intel.com>

properties:
  compatible:
    items:
      - const: intel,iccnet

  reg:
    description:
      physical address and sizes of shared memory region
    maxItems: 1

  rxring-offset:
    description:
      offset of start of receive descriptor ring
    maxItems: 1

  txring-offset:
    description:
      offset of start of transmit descriptor ring
    maxItems: 1

  ipc-reg:
    description:
      interrupt/status register address
    maxItems: 1

  interrupts:
    description:
      interrupt specifier specific to interrupt controller
    maxItems: 1

required:
  - compatible
  - reg
  - rxring-offset
  - txring-offset
  - ipc-reg
  - interrupts


allOf:
  - $ref: ethernet-controller.yaml#

unevaluatedProperties: false

examples:
  - |
    #include <dt-bindings/interrupt-controller/arm-gic.h>
    soc {
        #address-cells = <2>;
        #size-cells = <2>;

        ethernet@4198000000 {
            compatible = "intel,iccnet";
            reg = <0x41 0x98000000 0x0 0x200000>;
            rxring-offset = <0x000000>;
            txring-offset = <0x100000>;
            ipc-reg = <0x20 0x53A10000>;
            interrupts = <GIC_SPI 121 IRQ_TYPE_LEVEL_HIGH>;
        };
    };
```

## Documentation/devicetree/bindings/net/jcore,emac.yaml
```yaml
# SPDX-License-Identifier: (GPL-2.0-only OR BSD-2-Clause)
%YAML 1.2
---
$id: http://devicetree.org/schemas/net/jcore,emac.yaml#
$schema: http://devicetree.org/meta-schemas/core.yaml#

title: J-Core Ethernet Media Access Controller

description: |
  This node provides properties for configuring the Ethernet MAC found
  in the J-Core family of SoCs.

maintainers:
  - Artur Rojek <contact@artur-rojek.eu>

properties:
  compatible:
    const: jcore,emac

  reg:
    maxItems: 1

  interrupts:
    maxItems: 1

required:
  - compatible
  - reg
  - interrupts

allOf:
  - $ref: ethernet-controller.yaml#

additionalProperties: false

examples:
  - |
    ethernet@10000 {
      compatible = "jcore,emac";
      reg = <0x10000 0x2000>;
      interrupts = <0x11>;
    };
```

## Documentation/devicetree/bindings/net/loongson,ls1x-dwmac.yaml
```yaml
# SPDX-License-Identifier: (GPL-2.0-only OR BSD-2-Clause)
%YAML 1.2
---
$id: http://devicetree.org/schemas/net/loongson,ls1x-dwmac.yaml#
$schema: http://devicetree.org/meta-schemas/core.yaml#

title: Loongson-1 DWMAC glue layer

maintainers:
  - Keguang Zhang <keguang.zhang@gmail.com>

select:
  properties:
    compatible:
      contains:
        enum:
          - loongson,ls1b-dwmac
          - loongson,ls1c-dwmac
  required:
    - compatible

properties:
  compatible:
    items:
      - enum:
          - loongson,ls1b-dwmac
          - loongson,ls1c-dwmac
      - const: snps,dwmac-3.50a

  reg:
    maxItems: 1

  clocks:
    maxItems: 1

  clock-names:
    const: stmmaceth

  interrupts:
    maxItems: 1

  interrupt-names:
    const: macirq

  syscon:
    $ref: /schemas/types.yaml#/definitions/phandle
    description:
      Phandle to the syscon containing some extra configurations
      including PHY interface mode.

required:
  - compatible
  - reg
  - clocks
  - clock-names
  - interrupts
  - interrupt-names
  - phy-handle
  - phy-mode
  - syscon

allOf:
  - $ref: snps,dwmac.yaml#

unevaluatedProperties: false

examples:
  - |
    #include <dt-bindings/clock/loongson,ls1x-clk.h>
    #include <dt-bindings/interrupt-controller/irq.h>

    gmac0: ethernet@1fe10000 {
        compatible = "loongson,ls1b-dwmac", "snps,dwmac-3.50a";
        reg = <0x1fe10000 0x10000>;

        clocks = <&clkc LS1X_CLKID_AHB>;
        clock-names = "stmmaceth";

        interrupt-parent = <&intc1>;
        interrupts = <2 IRQ_TYPE_LEVEL_HIGH>;
        interrupt-names = "macirq";

        phy-handle = <&phy0>;
        phy-mode = "mii";

        snps,pbl = <1>;
        syscon = <&syscon>;

        mdio {
            #address-cells = <1>;
            #size-cells = <0>;
            compatible = "snps,dwmac-mdio";

            phy0: ethernet-phy@0 {
                reg = <0x0>;
            };
        };
    };
```

## Documentation/devicetree/bindings/net/marvell,marvell10g.yaml
```yaml
# SPDX-License-Identifier: (GPL-2.0-only OR BSD-2-Clause)
%YAML 1.2
---
$id: http://devicetree.org/schemas/net/marvell,marvell10g.yaml#
$schema: http://devicetree.org/meta-schemas/core.yaml#

title: Marvell Alaska X 10G Ethernet PHY

maintainers:
  - Tobias Waldekranz <tobias@waldekranz.com>

description: |
  Bindings for Marvell Alaska X 10G Ethernet PHYs

allOf:
  - $ref: ethernet-phy.yaml#

properties:
  leds:
    type: object

    properties:
      '#address-cells':
        const: 1

      '#size-cells':
        const: 0

    patternProperties:
      '^led@[a-f0-9]+$':
        $ref: /schemas/leds/common.yaml#

        properties:
          marvell,polarity:
            description: |
              Electrical polarity and drive type for this LED. In the
              active state, hardware may drive the pin either low or
              high. In the inactive state, the pin can either be
              driven to the opposite logic level, or be tristated.
            $ref: /schemas/types.yaml#/definitions/string
            enum:
              - active-low
              - active-high
              - active-low-tristate
              - active-high-tristate

unevaluatedProperties: false

examples:
  - |
    mdio {
        #address-cells = <1>;
        #size-cells = <0>;

        ethernet-phy@0 {
            reg = <0>;

            marvell,polarity = "active-low-tristate";
        };
    };
```

## Documentation/devicetree/bindings/net/maxio,mae0621a.yaml
```yaml
# SPDX-License-Identifier: (GPL-2.0-only OR BSD-2-Clause)
%YAML 1.2
---
$id: http://devicetree.org/schemas/net/maxio,mae0621a.yaml#
$schema: http://devicetree.org/meta-schemas/core.yaml#

title: Maxio MAE0621A Ethernet PHY

maintainers:
  - Liu Changjie <liucj1228@outlook.com>

allOf:
  - $ref: ethernet-phy.yaml#

properties:
  compatible:
    const: ethernet-phy-id7b74.4412

  maxio,clk-out-frequency-hz:
    description:
      Selects a 125 MHz clock on the CLKOUT pin. If the property is absent,
      the hardware strap or bootloader configuration is preserved.
    const: 125000000

unevaluatedProperties: false

examples:
  - |
    mdio {
        #address-cells = <1>;
        #size-cells = <0>;

        ethernet-phy@1 {
            compatible = "ethernet-phy-id7b74.4412";
            reg = <1>;
            maxio,clk-out-frequency-hz = <125000000>;
        };
    };
```

## Documentation/devicetree/bindings/net/maxlinear,lgm-eth.yaml
```yaml
# SPDX-License-Identifier: (GPL-2.0 OR BSD-2-Clause)
%YAML 1.2
---
$id: http://devicetree.org/schemas/net/maxlinear,lgm-eth.yaml#
$schema: http://devicetree.org/meta-schemas/core.yaml#

title: MaxLinear LGM Ethernet Controller

maintainers:
  - Jack Ping Chng <jchng@maxlinear.com>

description:
  Binding for MaxLinear LGM Ethernet controller

properties:
  compatible:
    enum:
      - maxlinear,lgm-eth

  reg:
    maxItems: 2

  reg-names:
    items:
      - const: port
      - const: ctrl

  clocks:
    maxItems: 1

  clock-names:
    items:
      - const: ethif

  resets:
    maxItems: 1

  ethernet-ports:
    type: object
    additionalProperties: false

    properties:
      "#address-cells":
        const: 1

      "#size-cells":
        const: 0

    patternProperties:
      "^port@[0-3]$":
        type: object
        $ref: ethernet-controller.yaml#
        additionalProperties: false

        properties:
          reg:
            description: port id
            maxItems: 1

          phy-handle:
            maxItems: 1

        required:
          - reg
          - phy-handle

  mdio:
    $ref: mdio.yaml#
    unevaluatedProperties: false

additionalProperties: false

required:
  - compatible
  - reg
  - reg-names
  - clocks
  - clock-names
  - resets
  - mdio

examples:
  - |
    ethernet@e7140000 {
        compatible = "maxlinear,lgm-eth";
        reg = <0xe7140000 0x1200>,<0xe7150000 0x4000>;
        reg-names = "port", "ctrl";
        clocks = <&cgu0 32>;
        clock-names = "ethif";
        resets = <&rcu0 0x70 8>;

        ethernet-ports {
            #address-cells = <1>;
            #size-cells = <0>;

            port@0 {
                reg = <0>;
                phy-handle = <&eth_phy0>;
            };

            port@1 {
                reg = <1>;
                phy-handle = <&eth_phy1>;
            };
        };

        mdio {
            #address-cells = <1>;
            #size-cells = <0>;

            eth_phy0: ethernet-phy@0 {
                reg = <0>;
            };

            eth_phy1: ethernet-phy@1 {
                reg = <1>;
            };
        };
    };
```
