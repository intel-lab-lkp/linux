## Documentation/devicetree/bindings/net/nuvoton,npcm8xx-sgmii.yaml
```yaml
# SPDX-License-Identifier: (GPL-2.0-only OR BSD-2-Clause)
%YAML 1.2
---
$id: http://devicetree.org/schemas/net/nuvoton,npcm8xx-sgmii.yaml#
$schema: http://devicetree.org/meta-schemas/core.yaml#

title: Nuvoton NPCM DWMAC SGMII Ethernet controller

maintainers:
  - Tomer Maimon <tmaimon77@gmail.com>

select:
  properties:
    compatible:
      contains:
        enum:
          - nuvoton,npcm8xx-sgmii
  required:
    - compatible

allOf:
  - $ref: snps,dwmac.yaml#

properties:
  compatible:
    oneOf:
      - items:
          - enum:
              - nuvoton,npcm8xx-sgmii
          - const: snps,dwmac-3.50a
  reg:
    items:
      - description:
          The first range represent DWMAC controller registers.
      - description:
          The second range represent PCS configuration registers.

  clocks:
    items:
      - description: GMAC main clock

  clock-names:
    items:
      - const: stmmaceth

required:
  - compatible
  - reg
  - clocks
  - clock-names

unevaluatedProperties: false

examples:
  - |
    #include <dt-bindings/interrupt-controller/arm-gic.h>
    #include <dt-bindings/clock/nuvoton,npcm845-clk.h>

    ahb {
      #address-cells = <2>;
      #size-cells = <2>;

      gmac0: ethernet@f0802000 {
          compatible = "nuvoton,npcm8xx-sgmii","snps,dwmac-3.50a";
          reg = <0x0 0xf0802000 0x0 0x2000>, <0x0 0xf0780000 0x0 0x200>;
          interrupts = <GIC_SPI 14 IRQ_TYPE_LEVEL_HIGH>;
          interrupt-names = "macirq";
          clocks = <&clk NPCM8XX_CLK_AHB>;
          clock-names = "stmmaceth";
          phy-mode = "rgmii-id";
      };
    };
```

## Documentation/devicetree/bindings/net/pcs/altr,gmii-to-sgmii.yaml
```yaml
# SPDX-License-Identifier: (GPL-2.0-only OR BSD-2-Clause)
%YAML 1.2
---
$id: http://devicetree.org/schemas/pcs/altr,gmii-to-sgmii.yaml#
$schema: http://devicetree.org/meta-schemas/core.yaml#

title: Altera SOCFPGA Triple Speed Ethernet GMII-to-SGMII converter

maintainers:
  - Dinh Nguyen <dinguyen@altera.com>

description:
  The Altera Triple Speed Ethernet controller provides a SGMII PCS and some clocks
  to the ethernet subsystem to which it is attached.

properties:
  compatible:
    const: altr,gmii-to-sgmii-2.0

  reg:
    maxItems: 6

  reg-names:
    const: eth_tse_control_port

  clocks-names:
    items:
      - const: tse_pcs_ref_clk_clock_connection
      - const: tse_rx_cdr_refclk

required:
  - compatible
  - reg
  - reg-names

additionalProperties: false

examples:
  - |
    gmii_to_sgmii_converter: phy@100000240 {
          compatible = "altr,gmii-to-sgmii-2.0";
          reg = <0x00000001 0x00000240 0x00000008>,
                <0x00000001 0x00000200 0x00000040>;
          reg-names = "eth_tse_control_port";
          clocks = <&sgmii_1_clk_0 &emac1 1 &sgmii_clk_125 &sgmii_clk_125>;
          clock-names = "tse_pcs_ref_clk_clock_connection", "tse_rx_cdr_refclk";
    };
```

## Documentation/devicetree/bindings/net/pcs/rockchip-dwxpcs.yaml
```yaml
# SPDX-License-Identifier: (GPL-2.0-only OR BSD-2-Clause)
%YAML 1.2
---
$id: http://devicetree.org/schemas/net/pcs/rockchip-dwxpcs.yaml#
$schema: http://devicetree.org/meta-schemas/core.yaml#

title: Rockchip RK3568 Synopsys DesignWare Ethernet PCS

maintainers:
  - Coia Prant <coiaprant@gmail.com>

description: |
  Rockchip RK3568 SoC integrates a Synopsys DesignWare Ethernet Physical
  Coding Sublayer (XPCS).
  The PCS provides an interface between the Media Access Control (MAC)
  and the Physical Medium Attachment (PMA) sublayer through a Media
  Independent Interface (GMII).

  The XPCS is accessed over the APB3 bus and internally connected to a
  Naneng Combo SerDes PHY.
  It supports 1000BASE-X, SGMII and QSGMII modes.

  The block contains four MII ports (pcs-mii@0..3) that can be
  individually enabled and routed to one of the Ethernet GMAC controllers
  via the pcs-handle property in the MAC device tree node.

properties:
  compatible:
    const: rockchip,rk3568-xpcs

  '#address-cells':
    const: 1

  '#size-cells':
    const: 0

  reg:
    description: |
      Base address and size of the XPCS register space mapped over the
      APB3 bus.
    maxItems: 1

  clocks:
    description: |
      Clock sources for the XPCS:
      - csr: APB3 bus interface clock (clk_csr_i), required for register
        access.
      - eee: EEE clock (clk_eee_i), required for Energy Efficient
        Ethernet (EEE) operation.
    minItems: 2
    maxItems: 2

  clock-names:
    items:
      - const: csr
      - const: eee

  phys:
    description: |
      The phandle of SerDes PHY (Naneng Combo PHY) that provides
      the serial lanes for 1000BASE-X / SGMII / QSGMII.
      The SerDes must be powered on and initialised before any XPCS
      register access.
    maxItems: 1

  phy-names:
    const: serdes

  power-domains:
    description: |
      Power domain for the XPCS.
      On RK3568 this is typically the PD_PIPE power domain, which also
      supplies the SerDes PHY.
    maxItems: 1

patternProperties:
  "^pcs-mii@[0-3]$":
    type: object
    description: |
      One of the four MII ports of the XPCS.
      The port number is specified by the reg property (0..3).
      The port is linked to an Ethernet MAC controller via the
      pcs-handle property in the MAC's device tree node.

    properties:
      reg:
        minimum: 0
        maximum: 3
        description: |
          MII port number of PCS.

      status: true

    required:
      - reg

    additionalProperties: false

required:
  - compatible
  - reg
  - clocks
  - clock-names

additionalProperties: false

examples:
  - |
    #include <dt-bindings/clock/rk3568-cru.h>
    #include <dt-bindings/power/rk3568-power.h>

    pcs@fda00000 {
      compatible = "rockchip,rk3568-xpcs";
      #address-cells = <1>;
      #size-cells = <0>;
      reg = <0x0 0xfda00000 0x0 0x200000>;
      clocks = <&cru PCLK_XPCS>, <&cru CLK_XPCS_EEE>;
      clock-names = "csr", "eee";
      phys = <&combphy2 PHY_TYPE_SGMII>;
      phy-names = "serdes";
      power-domains = <&power RK3568_PD_PIPE>;

      pcs-mii@0 {
        reg = <0>;
      };
    };
```

## Documentation/devicetree/bindings/net/pcs/snps,dw-xpcs.yaml
```yaml
# SPDX-License-Identifier: (GPL-2.0-only OR BSD-2-Clause)
%YAML 1.2
---
$id: http://devicetree.org/schemas/net/pcs/snps,dw-xpcs.yaml#
$schema: http://devicetree.org/meta-schemas/core.yaml#

title: Synopsys DesignWare Ethernet PCS

maintainers:
  - Jose Abreu <Jose.Abreu@synopsys.com>

description:
  Synopsys DesignWare Ethernet Physical Coding Sublayer provides an interface
  between Media Access Control and Physical Medium Attachment Sublayer through
  the Media Independent Interface (XGMII, USXGMII, XLGMII, GMII, etc)
  controlled by means of the IEEE std. Clause 45 registers set. The PCS can be
  optionally synthesized with a vendor-specific interface connected to
  Synopsys PMA (also called DesignWare Consumer/Enterprise PHY) although in
  general it can be used to communicate with any compatible PHY.

properties:
  compatible:
    oneOf:
      - description: Synopsys DesignWare XPCS with none or unknown PMA
        const: snps,dw-xpcs
      - description: Synopsys DesignWare XPCS with Consumer Gen1 3G PMA
        const: snps,dw-xpcs-gen1-3g
      - description: Synopsys DesignWare XPCS with Consumer Gen2 3G PMA
        const: snps,dw-xpcs-gen2-3g
      - description: Synopsys DesignWare XPCS with Consumer Gen2 6G PMA
        const: snps,dw-xpcs-gen2-6g
      - description: Synopsys DesignWare XPCS with Consumer Gen4 3G PMA
        const: snps,dw-xpcs-gen4-3g
      - description: Synopsys DesignWare XPCS with Consumer Gen4 6G PMA
        const: snps,dw-xpcs-gen4-6g
      - description: Synopsys DesignWare XPCS with Consumer Gen5 10G PMA
        const: snps,dw-xpcs-gen5-10g
      - description: Synopsys DesignWare XPCS with Consumer Gen5 12G PMA
        const: snps,dw-xpcs-gen5-12g

  reg:
    maxItems: 1

  interrupts:
    description:
      System interface interrupt output (sbd_intr_o) indicating Clause 73/37
      auto-negotiation events like':' Page received, AN is completed or
      incompatible link partner.
    maxItems: 1

  clocks:
    description:
      PCS/PMA interface be can clocked either by internal reference clock
      source or by an externally connected (via a pad) clock generator.
    minItems: 1
    maxItems: 2

  clock-names:
    minItems: 1
    maxItems: 2
    items:
      enum: [ core, pad ]

required:
  - compatible
  - reg

additionalProperties: false

examples:
  - |
    #include <dt-bindings/interrupt-controller/irq.h>

    mdio-bus {
      #address-cells = <1>;
      #size-cells = <0>;

      xgmac_pcs: ethernet-pcs@0 {
        compatible = "snps,dw-xpcs";
        reg = <0>;

        interrupts = <79 IRQ_TYPE_LEVEL_HIGH>;

        clocks = <&ccu_core>, <&ccu_pad>;
        clock-names = "core", "pad";
      };
    };
...
```

## Documentation/devicetree/bindings/net/pse-pd/lltc,ltc4266.yaml
```yaml
# SPDX-License-Identifier: (GPL-2.0-only OR BSD-2-Clause)
%YAML 1.2
---
$id: http://devicetree.org/schemas/net/pse-pd/lltc,ltc4266.yaml#
$schema: http://devicetree.org/meta-schemas/core.yaml#

title: Linear Technology LTC4266 Power Sourcing Equipment controller

maintainers:
  - Kyle Swenson <kyle.swenson@est.tech>

allOf:
  - $ref: pse-controller.yaml#

properties:
  compatible:
    enum:
      - lltc,ltc4266

  reg:
    maxItems: 1

  interrupts:
    maxItems: 1

  reset-gpios:
    maxItems: 1

  channels:
    type: object
    additionalProperties: false
    description:
      Defines the 4 physical delivery channels on the controller that can be
      referenced by PSE PIs through their "pairsets" property. The actual port
      matrix mapping is created when PSE PIs reference these channels in their
      pairsets.

    properties:
      '#address-cells':
        const: 1

      '#size-cells':
        const: 0

    patternProperties:
      '^channel@[0-3]$':
        type: object
        additionalProperties: false

        properties:
          reg:
            maxItems: 1

          sense-resistor-micro-ohms:
            description: Sense resistor connected to the channel's MOSFET, used
              for current measurement for overcurrent detection.
            enum: [250000, 500000]

        required:
          - reg
          - sense-resistor-micro-ohms

    required:
      - '#address-cells'
      - '#size-cells'

  pse-pis:
    type: object
    additionalProperties: false

    properties:
      '#address-cells':
        const: 1

      '#size-cells':
        const: 0

    patternProperties:
      '^pse-pi@[0-3]$':
        type: object
        properties:
          pairsets:
            description: The LTC4266 delivers power to a PI over a single
              pairset, driven by one of the controller's four channels. There
              is no 4-pair mode spreading a PI over two channels, so exactly
              one channel phandle is expected.
            maxItems: 1
          pairset-names:
            maxItems: 1

required:
  - compatible
  - reg
  - interrupts
  - channels
  - pse-pis

unevaluatedProperties: false

examples:
  - |
    #include <dt-bindings/interrupt-controller/irq.h>

    i2c {
      #address-cells = <1>;
      #size-cells = <0>;

      ethernet-pse@2f {
        compatible = "lltc,ltc4266";
        reg = <0x2f>;
        interrupts = <8 IRQ_TYPE_LEVEL_LOW>;
        interrupt-parent = <&gpio>;

        channels {
          #address-cells = <1>;
          #size-cells = <0>;

          phys0: channel@0 {
            reg = <0>;
            sense-resistor-micro-ohms = <500000>;
          };

          phys1: channel@1 {
            reg = <1>;
            sense-resistor-micro-ohms = <500000>;
          };

          phys2: channel@2 {
            reg = <2>;
            sense-resistor-micro-ohms = <500000>;
          };

          phys3: channel@3 {
            reg = <3>;
            sense-resistor-micro-ohms = <500000>;
          };
        };

        pse-pis {
          #address-cells = <1>;
          #size-cells = <0>;

          pse_pi0: pse-pi@0 {
            reg = <0>;
            #pse-cells = <0>;
            pairset-names = "alternative-a";
            pairsets = <&phys0>;
            polarity-supported = "MDI";
            vpwr-supply = <&vreg_pse>;
          };

          pse_pi1: pse-pi@1 {
            reg = <1>;
            #pse-cells = <0>;
            pairset-names = "alternative-a";
            pairsets = <&phys1>;
            polarity-supported = "MDI";
            vpwr-supply = <&vreg_pse>;
          };

          pse_pi2: pse-pi@2 {
            reg = <2>;
            #pse-cells = <0>;
            pairset-names = "alternative-a";
            pairsets = <&phys2>;
            polarity-supported = "MDI";
            vpwr-supply = <&vreg_pse>;
          };

          pse_pi3: pse-pi@3 {
            reg = <3>;
            #pse-cells = <0>;
            pairset-names = "alternative-a";
            pairsets = <&phys3>;
            polarity-supported = "MDI";
            vpwr-supply = <&vreg_pse>;
          };
        };
      };
    };
```

## Documentation/devicetree/bindings/net/pse-pd/microchip,pd692x0.yaml
```yaml
# SPDX-License-Identifier: (GPL-2.0-only OR BSD-2-Clause)
%YAML 1.2
---
$id: http://devicetree.org/schemas/net/pse-pd/microchip,pd692x0.yaml#
$schema: http://devicetree.org/meta-schemas/core.yaml#

title: Microchip PD692x0 Power Sourcing Equipment controller

maintainers:
  - Kory Maincent <kory.maincent@bootlin.com>

allOf:
  - $ref: pse-controller.yaml#

properties:
  compatible:
    enum:
      - microchip,pd69200
      - microchip,pd69210
      - microchip,pd69220

  reg:
    maxItems: 1

  '#pse-cells':
    const: 1

  ports-matrix:
    description: each set of 48 logical ports can be assigned to one or two
      physical ports. Each physical port is wired to a PD69204/8 PoE
      manager. Using two different PoE managers for one RJ45 port
      (logical port) is interesting for temperature dissipation.
      This parameter describes the configuration of the port conversion
      matrix that establishes the relationship between the 48 logical ports
      and the available 96 physical ports. Unspecified logical ports will
      be deactivated.
    $ref: /schemas/types.yaml#/definitions/uint32-matrix
    minItems: 1
    maxItems: 48
    items:
      items:
        - description: Logical port number
          minimum: 0
          maximum: 47
        - description: Physical port number A (0xff for undefined)
          oneOf:
            - minimum: 0
              maximum: 95
            - const: 0xff
        - description: Physical port number B (0xff for undefined)
          oneOf:
            - minimum: 0
              maximum: 95
            - const: 0xff

unevaluatedProperties: false

required:
  - compatible
  - reg

examples:
  - |
    i2c {
        #address-cells = <1>;
        #size-cells = <0>;

        ethernet-pse@3c {
          compatible = "microchip,pd69200";
          reg = <0x3c>;
          #pse-cells = <1>;
          ports-matrix = <0 2 5
                          1 3 6
                          2 0 0xff
                          3 1 0xff>;
        };
    };
```
