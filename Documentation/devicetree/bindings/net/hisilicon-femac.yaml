## Documentation/devicetree/bindings/net/qca,ipq5018.yaml
```yaml
# SPDX-License-Identifier: (GPL-2.0-only OR BSD-2-Clause)
%YAML 1.2
---
$id: http://devicetree.org/schemas/net/qca,ipq5018.yaml#
$schema: http://devicetree.org/meta-schemas/core.yaml#

title: Qualcomm Atheros IPQ5018 Internal PHY

maintainers:
  - George Moussalem <george.moussalem@outlook.com>

description: |
  The IPQ5018 PHY is part of the IPQ5018 SoC and is always wired to GMAC0.
  The PHY supports 10/100/1000 mbps link modes, CDT, auto-negotiation and
  802.3az EEE.

properties:
  compatible:
    const: ethernet-phy-id004d.d0c0

  reg:
    const: 7  # This PHY is always at MDIO address 7 in the IPQ5018 SoC

  clocks:
    items:
      - description: RX clock
      - description: TX clock

  clock-names:
    items:
      - const: rx
      - const: tx

  resets:
    items:
      - description:
          GE PHY MISC reset which triggers a reset across MDC, DSP, RX, and TX lines.

  qcom,dac-preset-short-cable:
    description: |
      Set if this phy is connected to another phy to adjust the values for
      MDAC and EDAC to adjust amplitude, bias current settings, and error
      detection and correction algorithm to accommodate for short cable length.
      If not set, DAC values are not modified and it is assumed the MDI output pins
      of this PHY are directly connected to an RJ45 connector.
    type: boolean

required:
  - compatible
  - reg
  - clocks
  - clock-names
  - resets

additionalProperties: false

examples:
  - |
    #include <dt-bindings/clock/qcom,gcc-ipq5018.h>
    #include <dt-bindings/reset/qcom,gcc-ipq5018.h>

    mdio {
        #address-cells = <1>;
        #size-cells = <0>;

        ge_phy: ethernet-phy@7 {
            compatible = "ethernet-phy-id004d.d0c0";
            reg = <7>;

            clocks = <&gcc GCC_GEPHY_RX_CLK>,
                     <&gcc GCC_GEPHY_TX_CLK>;
            clock-names = "rx", "tx";
            resets = <&gcc GCC_GEPHY_MISC_ARES>;
        };
    };
```

## Documentation/devicetree/bindings/net/qca,qca808x.yaml
```yaml
# SPDX-License-Identifier: GPL-2.0-only OR BSD-2-Clause
%YAML 1.2
---
$id: http://devicetree.org/schemas/net/qca,qca808x.yaml#
$schema: http://devicetree.org/meta-schemas/core.yaml#

title: Qualcomm Atheros QCA808X PHY

maintainers:
  - Christian Marangi <ansuelsmth@gmail.com>

description:
  QCA808X PHYs can have up to 3 LEDs attached.
  All 3 LEDs are disabled by default.
  2 LEDs have dedicated pins with the 3rd LED having the
  double function of Interrupt LEDs/GPIO or additional LED.

  By default this special PIN is set to LED function.

allOf:
  - $ref: ethernet-phy.yaml#

properties:
  compatible:
    enum:
      - ethernet-phy-id004d.d101

  avdd18-supply:
    description: 1.8v analog power supply.

  vdd-supply:
    description: 1.05v power supply.

  vdd18-supply:
    description: 1.8v power supply.

  vdd125-supply:
    description: (1.25v to 1.98v) LDO regulator power supply.

unevaluatedProperties: false

examples:
  - |
    #include <dt-bindings/leds/common.h>

    mdio {
        #address-cells = <1>;
        #size-cells = <0>;

        ethernet-phy@0 {
            compatible = "ethernet-phy-id004d.d101";
            reg = <0>;

            vdd-supply = <&phy_vreg_1v8>;

            leds {
                #address-cells = <1>;
                #size-cells = <0>;

                led@0 {
                    reg = <0>;
                    color = <LED_COLOR_ID_GREEN>;
                    function = LED_FUNCTION_WAN;
                    default-state = "keep";
                };
            };
        };
    };
```

## Documentation/devicetree/bindings/net/qcom,ipq4019-mdio.yaml
```yaml
# SPDX-License-Identifier: GPL-2.0-only OR BSD-2-Clause
%YAML 1.2
---
$id: http://devicetree.org/schemas/net/qcom,ipq4019-mdio.yaml#
$schema: http://devicetree.org/meta-schemas/core.yaml#

title: Qualcomm IPQ40xx MDIO Controller

maintainers:
  - Robert Marko <robert.marko@sartura.hr>

properties:
  compatible:
    oneOf:
      - enum:
          - qcom,ipq4019-mdio
          - qcom,ipq5018-mdio

      - items:
          - enum:
              - qcom,ipq5332-mdio
              - qcom,ipq6018-mdio
              - qcom,ipq8074-mdio
              - qcom,ipq9574-mdio
          - const: qcom,ipq4019-mdio

  "#address-cells":
    const: 1

  "#size-cells":
    const: 0

  reg:
    minItems: 1
    maxItems: 5
    description: |
      The first address and length of the register set for the MDIO controller,
      the optional second address and length of the register is for CMN block,
      the optional third, fourth and fifth address and length of the register
      for Ethernet LDO, the optional Ethernet LDO address range is required by
      the platform IPQ50xx/IPQ5332.

  reg-names:
    minItems: 1
    items:
      - const: mdio
      - const: cmn_blk
      - const: eth_ldo1
      - const: eth_ldo2
      - const: eth_ldo3

  clocks:
    minItems: 1
    items:
      - description: MDIO clock source frequency fixed to 100MHZ
      - description: UNIPHY0 AHB clock source frequency fixed to 100MHZ
      - description: UNIPHY1 AHB clock source frequency fixed to 100MHZ
      - description: UNIPHY0 SYS clock source frequency fixed to 24MHZ
      - description: UNIPHY1 SYS clock source frequency fixed to 24MHZ

  clock-names:
    minItems: 1
    items:
      - const: gcc_mdio_ahb_clk
      - const: uniphy0_ahb
      - const: uniphy1_ahb
      - const: uniphy0_sys
      - const: uniphy1_sys

  qcom,cmn-ref-clock-frequency:
    $ref: /schemas/types.yaml#/definitions/uint32
    enum:
      - 25000000
      - 31250000
      - 40000000
      - 48000000
      - 50000000
      - 96000000
    default: 48000000
    description: |
      The reference clock source of CMN PLL block is selectable, the
      reference clock source can be from wifi module or the external
      xtal, the reference clock frequency 48MHZ can be from internal
      wifi or the external xtal, if absent, the internal 48MHZ is used,
      if the 48MHZ is specified, which means the external 48Mhz is used.

  clock-frequency:
    enum:
      - 390625
      - 781250
      - 1562500
      - 3125000
      - 6250000
      - 12500000
    default: 390625
    description: |
      The MDIO bus clock that must be output by the MDIO bus hardware,
      only the listed frequencies above can be supported, other frequency
      will cause malfunction. If absent, the default hardware value 0xff
      is used, which means the default MDIO clock frequency 390625HZ, The
      MDIO clock frequency is MDIO_SYS_CLK/(MDIO_CLK_DIV + 1), the SoC
      MDIO_SYS_CLK is fixed to 100MHZ, the MDIO_CLK_DIV is from MDIO control
      register, there is higher clock frequency requirement on the normal
      working case where the MDIO slave devices support high clock frequency.

required:
  - compatible
  - reg
  - "#address-cells"
  - "#size-cells"

allOf:
  - $ref: mdio.yaml#

  - if:
      properties:
        compatible:
          contains:
            enum:
              - qcom,ipq5018-mdio
              - qcom,ipq5332-mdio
              - qcom,ipq6018-mdio
              - qcom,ipq8074-mdio
              - qcom,ipq9574-mdio
    then:
      required:
        - clocks
        - clock-names
    else:
      properties:
        clocks: false
        clock-names: false

  - if:
      properties:
        compatible:
          contains:
            enum:
              - qcom,ipq5332-mdio
    then:
      properties:
        clocks:
          minItems: 5
          maxItems: 5
        reg-names:
          minItems: 4

unevaluatedProperties: false

examples:
  - |
    mdio@90000 {
      #address-cells = <1>;
      #size-cells = <0>;
      compatible = "qcom,ipq4019-mdio";
      reg = <0x90000 0x64>;

      ethphy0: ethernet-phy@0 {
        reg = <0>;
      };

      ethphy1: ethernet-phy@1 {
        reg = <1>;
      };

      ethphy2: ethernet-phy@2 {
        reg = <2>;
      };

      ethphy3: ethernet-phy@3 {
        reg = <3>;
      };

      ethphy4: ethernet-phy@4 {
        reg = <4>;
      };
    };

  - |
    #include <dt-bindings/clock/qcom,ipq5332-gcc.h>
    #include <dt-bindings/gpio/gpio.h>

    mdio@90000 {
      #address-cells = <1>;
      #size-cells = <0>;
      compatible = "qcom,ipq5332-mdio",
                   "qcom,ipq4019-mdio";

      reg = <0x90000 0x64>,
            <0x9b000 0x800>,
            <0x7a00610 0x4>,
            <0x7a10610 0x4>;

      reg-names = "mdio",
                  "cmn_blk",
                  "eth_ldo1",
                  "eth_ldo2";

      clocks = <&gcc GCC_MDIO_AHB_CLK>,
               <&gcc GCC_UNIPHY0_AHB_CLK>,
               <&gcc GCC_UNIPHY1_AHB_CLK>,
               <&gcc GCC_UNIPHY0_SYS_CLK>,
               <&gcc GCC_UNIPHY1_SYS_CLK>;

      clock-names = "gcc_mdio_ahb_clk",
                    "uniphy0_ahb",
                    "uniphy1_ahb",
                    "uniphy0_sys",
                    "uniphy1_sys";

      clock-frequency = <6250000>;
      reset-gpios = <&tlmm 51 GPIO_ACTIVE_LOW>;

      qca8kphy0: ethernet-phy@1 {
        compatible = "ethernet-phy-id004d.d180";
        reg = <1>;
      };

      qca8kphy1: ethernet-phy@2 {
        compatible = "ethernet-phy-id004d.d180";
        reg = <2>;
      };

      qca8kphy2: ethernet-phy@3 {
        compatible = "ethernet-phy-id004d.d180";
        reg = <3>;
      };

      qca8kphy3: ethernet-phy@4 {
        compatible = "ethernet-phy-id004d.d180";
        reg = <4>;
      };
    };
```
