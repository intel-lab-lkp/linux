## Documentation/devicetree/bindings/net/microchip,enc28j60.txt
```
* Microchip ENC28J60

This is a standalone 10 MBit ethernet controller with SPI interface.

For each device connected to a SPI bus, define a child node within
the SPI master node.

Required properties:
- compatible: Should be "microchip,enc28j60"
- reg: Specify the SPI chip select the ENC28J60 is wired to

Required interrupt properties with pin control subsystem:
- interrupts: Specify the interrupt index within the interrupt controller (referred
              to above in interrupt-parent) and interrupt type. The ENC28J60 natively
              generates falling edge interrupts, however, additional board logic
              might invert the signal.
- pinctrl-names: List of assigned state names, see pinctrl binding documentation.
- pinctrl-0: List of phandles to configure the GPIO pin used as interrupt line,
             see also generic and your platform specific pinctrl binding
             documentation.

Required interrupt properties with a single GPIO phandle:
- irq-gpios: Specify the GPIO pin used as the interrupt line. When this property is
             set, the kernel automatically requests the pin, configures it as an input,
             and converts it to an IRQ number. This simplifies the process by
             eliminating the need to manually define pinctrl and interrupt nodes.
             Additionally, it is necessary for platforms that do not support pin
             configuration and properties via the device tree.

Optional properties:
- spi-max-frequency: Maximum frequency of the SPI bus when accessing the ENC28J60.
  According to the ENC28J80 datasheet, the chip allows a maximum of 20 MHz, however,
  board designs may need to limit this value.

The MAC address will be determined using the optional properties
defined in ethernet.txt.

Example (for NXP i.MX28 with pin control stuff for GPIO irq):

        ssp2: ssp@80014000 {
                compatible = "fsl,imx28-spi";
                pinctrl-names = "default";
                pinctrl-0 = <&spi2_pins_b &spi2_sck_cfg>;

                enc28j60: ethernet@0 {
                        compatible = "microchip,enc28j60";
                        pinctrl-names = "default";
                        pinctrl-0 = <&enc28j60_pins>;
                        reg = <0>;
                        interrupt-parent = <&gpio3>;
                        interrupts = <3 IRQ_TYPE_EDGE_FALLING>;
                        spi-max-frequency = <12000000>;
                };
        };

        pinctrl@80018000 {
                enc28j60_pins: enc28j60_pins@0 {
                        reg = <0>;
                        fsl,pinmux-ids = <
                                MX28_PAD_AUART0_RTS__GPIO_3_3    /* Interrupt */
                        >;
                        fsl,drive-strength = <MXS_DRIVE_4mA>;
                        fsl,voltage = <MXS_VOLTAGE_HIGH>;
                        fsl,pull-up = <MXS_PULL_DISABLE>;
                };
        };

Example (if can not configure pin properties via the device tree):

        &spi2 {
                status = "okay";
                cs-gpios = <&porta 23 GPIO_ACTIVE_LOW>;

                enc28j60: ethernet@1 {
                        compatible = "microchip,enc28j60";
                        reg = <0>;
                        spi-max-frequency = <12000000>;
                        irq-gpios = <&porta 24 GPIO_ACTIVE_HIGH>;
                };
        };
```

## Documentation/devicetree/bindings/net/motorcomm,yt8824.yaml
```yaml
# SPDX-License-Identifier: (GPL-2.0-only OR BSD-2-Clause)
%YAML 1.2
---
$id: http://devicetree.org/schemas/net/motorcomm,yt8824.yaml#
$schema: http://devicetree.org/meta-schemas/core.yaml#

title: MotorComm YT8824 Ethernet PHY

maintainers:
  - Kyle Switch <kyle.switch@motor-comm.com>

description: |
  Motorcomm YT8824 Ethernet PHY is a PHY package of 4 PHYs.

$ref: ethernet-phy-package.yaml#

properties:
  compatible:
    enum:
      - ethernet-phy-id4f51.e8b8

  motorcomm,interface-mode:
    description: |
      PHY package interface mode.
    $ref: /schemas/types.yaml#/definitions/string
    enum:
      - internal
      - usxgmii
    default: internal

unevaluatedProperties: false

examples:
  - |
    mdio {
        #address-cells = <1>;
        #size-cells = <0>;

        ethernet-phy-package@0 {
            #address-cells = <1>;
            #size-cells = <0>;
            compatible = "ethernet-phy-id4f51.e8b8";
            reg = <9>;

            motorcomm,interface-mode = "usxgmii";

            ethernet-phy@4 {
                reg = <4>;
            };

            ethernet-phy@5 {
                reg = <5>;
            };

            ethernet-phy@6 {
                reg = <6>;
            };

            ethernet-phy@7 {
                reg = <7>;
            };
        };
    };
```

## Documentation/devicetree/bindings/net/mxl,lgm-eth.yaml
```yaml
# SPDX-License-Identifier: (GPL-2.0 OR BSD-2-Clause)
%YAML 1.2
---
$id: http://devicetree.org/schemas/net/mxl,lgm-eth.yaml#
$schema: http://devicetree.org/meta-schemas/core.yaml#

title: MaxLinear LGM Ethernet Controller

maintainers:
  - Jack Ping Chng <jchng@maxlinear.com>

description:
  Binding for MaxLinear LGM Ethernet controller

properties:
  compatible:
    enum:
      - mxl,lgm-eth

  clocks:
    maxItems: 1

  clock-names:
    items:
      - const: ethif

  resets:
    maxItems: 1

  '#address-cells':
    const: 1
  '#size-cells':
    const: 0

patternProperties:
  "^interface@[1-4]$":
    type: object
    properties:
      compatible:
        const: mxl,lgm-mac

      reg:
        minimum: 1
        maximum: 4

    required:
      - compatible
      - reg

required:
  - compatible
  - clocks
  - clock-names
  - '#address-cells'
  - '#size-cells'

additionalProperties: false

examples:
  - |
    eth {
      compatible = "mxl,lgm-eth";
      clocks = <&cgu0 32>;
      clock-names = "ethif";
      resets = <&rcu0 0x70 8>;
      #address-cells = <1>;
      #size-cells = <0>;

      mac: interface@1 {
        compatible = "mxl,eth-mac";
        reg = <1>;
      };
    };
```

## Documentation/devicetree/bindings/net/network-class.yaml
```yaml
# SPDX-License-Identifier: GPL-2.0-only OR BSD-2-Clause
%YAML 1.2
---
$id: http://devicetree.org/schemas/net/network-class.yaml#
$schema: http://devicetree.org/meta-schemas/core.yaml#

title: Network Class Common Properties

maintainers:
  - Devicetree Specification Mailing List <devicetree-spec-u79uwXL29TY76Z2rM5mHXA@public.gmane.org>

properties:
  address-bits:
    description:
      Specifies number of address bits required to address the device described
      by this node. This property specifies number of bits in MAC address.
    default: 48
    const: 48

  local-mac-address:
    description:
      Specifies MAC address that was assigned to the network device described by
      the node containing this property.
    $ref: /schemas/types.yaml#/definitions/uint8-array
    minItems: 6
    maxItems: 6

  mac-address:
    description:
      Specifies the MAC address that was last used by the boot program. This
      property should be used in cases where the MAC address assigned to the
      device by the boot program is different from the
      local-mac-address property. This property shall be used only if the value
      differs from local-mac-address property value.
    $ref: /schemas/types.yaml#/definitions/uint8-array
    minItems: 6
    maxItems: 6

  max-frame-size:
    $ref: /schemas/types.yaml#/definitions/uint32
    description:
      Maximum transfer unit (IEEE defined MTU).

additionalProperties: true
```

## Documentation/devicetree/bindings/net/nfc/st,st-nci.yaml
```yaml
# SPDX-License-Identifier: GPL-2.0-only OR BSD-2-Clause
%YAML 1.2
---
$id: http://devicetree.org/schemas/net/nfc/st,st-nci.yaml#
$schema: http://devicetree.org/meta-schemas/core.yaml#

title: STMicroelectronics ST NCI NFC controller

maintainers:
  - Krzysztof Kozlowski <krzk@kernel.org>

properties:
  compatible:
    description: |
      st,st21nfcb-* and st,st21nfcc-i2c use NDLC on the wire.
      st,st21nfcd is ST21NFCD with raw NCI (no NDLC PCB).
    enum:
      - st,st21nfcb-i2c
      - st,st21nfcb-spi
      - st,st21nfcc-i2c
      - st,st21nfcd

  reset-gpios:
    description: Output GPIO pin used for resetting the controller

  ese-present:
    type: boolean
    description: |
      Specifies that an ese is physically connected to the controller

  interrupts:
    maxItems: 1

  reg:
    maxItems: 1

  uicc-present:
    type: boolean
    description: |
      Specifies that the uicc swp signal can be physically connected to the
      controller

  clocks:
    maxItems: 1
    description:
      External reference clock connected to SYS_CLK.

  vdd-io-supply:
    description:
      Digital I/O supply (VPS_IO).

required:
  - compatible
  - interrupts
  - reg
  - reset-gpios

if:
  properties:
    compatible:
      contains:
        enum:
          - st,st21nfcb-i2c
          - st,st21nfcc-i2c
          - st,st21nfcd
then:
  properties:
    spi-max-frequency: false
else:
  $ref: /schemas/spi/spi-peripheral-props.yaml#
  required:
    - spi-max-frequency

unevaluatedProperties: false

examples:
  - |
    #include <dt-bindings/gpio/gpio.h>
    #include <dt-bindings/interrupt-controller/irq.h>

    i2c {
        #address-cells = <1>;
        #size-cells = <0>;

        nfc@8 {
            compatible = "st,st21nfcb-i2c";
            reg = <0x08>;

            interrupt-parent = <&gpio5>;
            interrupts = <2 IRQ_TYPE_LEVEL_HIGH>;
            reset-gpios = <&gpio5 29 GPIO_ACTIVE_HIGH>;

            ese-present;
            uicc-present;
        };
    };

  - |
    #include <dt-bindings/gpio/gpio.h>
    #include <dt-bindings/interrupt-controller/irq.h>

    i2c {
        #address-cells = <1>;
        #size-cells = <0>;

        nfc@8 {
            compatible = "st,st21nfcd";
            reg = <0x08>;

            interrupt-parent = <&gpio5>;
            interrupts = <2 IRQ_TYPE_LEVEL_HIGH>;
            reset-gpios = <&gpio5 29 GPIO_ACTIVE_HIGH>;

            clocks = <&clk>;
            vdd-io-supply = <&vdd_io>;
        };
    };

  - |
    #include <dt-bindings/gpio/gpio.h>
    #include <dt-bindings/interrupt-controller/irq.h>

    spi {
        #address-cells = <1>;
        #size-cells = <0>;

        nfc@0 {
            compatible = "st,st21nfcb-spi";
            reg = <0>;

            spi-max-frequency = <4000000>;

            interrupt-parent = <&gpio5>;
            interrupts = <2 IRQ_TYPE_EDGE_RISING>;
            reset-gpios = <&gpio5 29 GPIO_ACTIVE_HIGH>;

            ese-present;
            uicc-present;
        };
    };
```

## Documentation/devicetree/bindings/net/nuvoton,ma35d1-dwmac.yaml
```yaml
# SPDX-License-Identifier: (GPL-2.0-only OR BSD-2-Clause)
%YAML 1.2
---
$id: http://devicetree.org/schemas/net/nuvoton,ma35d1-dwmac.yaml#
$schema: http://devicetree.org/meta-schemas/core.yaml#

title: Nuvoton DWMAC glue layer controller

maintainers:
  - Joey Lu <yclu4@nuvoton.com>

description:
  Nuvoton 10/100/1000Mbps Gigabit Ethernet MAC Controller is based on
  Synopsys DesignWare MAC (version 3.73a).

# We need a select here so we don't match all nodes with 'snps,dwmac'
select:
  properties:
    compatible:
      contains:
        enum:
          - nuvoton,ma35d1-dwmac
  required:
    - compatible

allOf:
  - $ref: snps,dwmac.yaml#

properties:
  compatible:
    oneOf:
      - enum:
          - nuvoton,ma35d1-dwmac
      - const: snps,dwmac-3.70a

  reg:
    description:
      Register range should be one of the GMAC interface.

  interrupts:
    maxItems: 1

  clocks:
    items:
      - description: MAC clock
      - description: PTP clock

  clock-names:
    items:
      - const: stmmaceth
      - const: ptp_ref

  nuvoton,sys:
    $ref: /schemas/types.yaml#/definitions/phandle-array
    items:
      - items:
          - description: phandle to access syscon registers.
          - description: GMAC interface ID.
            enum:
              - 0
              - 1
    description:
      A phandle to the syscon with one argument that configures system registers
      for MA35D1's two GMACs. The argument specifies the GMAC interface ID.

  resets:
    maxItems: 1

  reset-names:
    items:
      - const: stmmaceth

  phy-mode:
    enum:
      - rmii
      - rgmii
      - rgmii-id
      - rgmii-txid
      - rgmii-rxid

  phy-handle:
    $ref: /schemas/types.yaml#/definitions/phandle
    description:
      Specifies a reference to a node representing a PHY device.

  tx-internal-delay-ps:
    enum: [0, 2000]
    default: 0
    description:
      RGMII TX path delay used only when PHY operates in RGMII mode with
      internal delay (phy-mode is 'rgmii-id' or 'rgmii-txid') in pico-seconds.

  rx-internal-delay-ps:
    enum: [0, 2000]
    default: 0
    description:
      RGMII RX path delay used only when PHY operates in RGMII mode with
      internal delay (phy-mode is 'rgmii-id' or 'rgmii-rxid') in pico-seconds.

  mdio:
    $ref: /schemas/net/mdio.yaml#

required:
  - compatible
  - reg
  - interrupts
  - interrupt-names
  - clocks
  - clock-names
  - nuvoton,sys
  - resets
  - reset-names
  - phy-mode

unevaluatedProperties: false

examples:
  - |
    #include <dt-bindings/interrupt-controller/arm-gic.h>
    #include <dt-bindings/clock/nuvoton,ma35d1-clk.h>
    #include <dt-bindings/reset/nuvoton,ma35d1-reset.h>
    //Example 1
    gmac0: ethernet@40120000 {
        compatible = "nuvoton,ma35d1-dwmac";
        reg = <0x0 0x40120000 0x0 0x10000>;
        interrupts = <GIC_SPI 23 IRQ_TYPE_LEVEL_HIGH>;
        interrupt-names = "macirq";
        clocks = <&clk EMAC0_GATE>, <&clk EPLL_DIV8>;
        clock-names = "stmmaceth", "ptp_ref";

        nuvoton,sys = <&sys 0>;
        resets = <&sys MA35D1_RESET_GMAC0>;
        reset-names = "stmmaceth";

        phy-mode = "rgmii-id";
        phy-handle = <&eth_phy0>;
        mdio0: mdio {
            compatible = "snps,dwmac-mdio";
            #address-cells = <1>;
            #size-cells = <0>;

            eth_phy0: ethernet-phy@0 {
                reg = <0>;
            };
        };
    };

  - |
    //Example 2
    gmac1: ethernet@40130000 {
        compatible = "nuvoton,ma35d1-dwmac";
        reg = <0x0 0x40130000 0x0 0x10000>;
        interrupts = <GIC_SPI 24 IRQ_TYPE_LEVEL_HIGH>;
        interrupt-names = "macirq";
        clocks = <&clk EMAC1_GATE>, <&clk EPLL_DIV8>;
        clock-names = "stmmaceth", "ptp_ref";

        nuvoton,sys = <&sys 1>;
        resets = <&sys MA35D1_RESET_GMAC1>;
        reset-names = "stmmaceth";

        phy-mode = "rmii";
        phy-handle = <&eth_phy1>;
        mdio1: mdio {
            compatible = "snps,dwmac-mdio";
            #address-cells = <1>;
            #size-cells = <0>;

            eth_phy1: ethernet-phy@1 {
                reg = <1>;
            };
        };
    };
```
