## Documentation/devicetree/bindings/net/xilinx,pcs.yaml
```yaml
# SPDX-License-Identifier: (GPL-2.0 OR BSD-2-Clause)
%YAML 1.2
---
$id: http://devicetree.org/schemas/net/xilinx,pcs.yaml#
$schema: http://devicetree.org/meta-schemas/core.yaml#

title: Xilinx 1G/2.5G Ethernet PCS/PMA or SGMII LogiCORE IP

maintainers:
  - Sean Anderson <sean.anderson@seco.com>

description: >
  This is a soft device which implements the PCS and (depending on
  configuration) PMA layers of an IEEE Ethernet PHY. On the MAC side, it
  implements GMII. It may have an attached SERDES (internal or external), or
  may directly use LVDS IO resources. Depending on the configuration, it may
  implement 1000BASE-X, SGMII, 2500BASE-X, or 2.5G SGMII.

  This device has a notion of "shared logic" such as reset and clocking
  resources which must be shared between multiple PCSs using the same I/O
  banks. Each PCS can be configured to have the shared logic in the "core"
  (instantiated internally and made available to other PCSs) or in the "example
  design" (provided by another PCS). PCSs with shared logic in the core provide
  a clock for other PCSs in the same bank.

properties:
  compatible:
    items:
      - const: xlnx,pcs-16.2
      - const: xlnx,pcs

  reg:
    maxItems: 1

  "#clock-cells":
    const: 0

  clocks:
    items:
      - description:
          The reference clock for the PCS. Depending on your setup, this may be
          the gtrefclk, refclk, clk125m signal, or clocks from another PCS.

  clock-names:
    const: refclk

  done-gpios:
    maxItems: 1
    description:
      GPIO connected to the reset-done output, if present.

  interrupts:
    items:
      - description:
          The an_interrupt autonegotiation-complete interrupt.

  interrupt-names:
    const: an

  xlnx,pcs-modes:
    description:
      The interfaces that the PCS supports. Multiple interfaces may be
      specified if dynamic reconfiguration is enabled.
    oneOf:
      - const: sgmii
      - const: 1000base-x
      - const: 2500base-x
      - items:
          - const: sgmii
          - const: 1000base-x

  reset-gpios:
    maxItems: 1
    description:
      GPIO connected to the reset input.

required:
  - compatible
  - reg
  - xlnx,pcs-modes

additionalProperties: false

examples:
  - |
    #include <dt-bindings/gpio/gpio.h>
    #include <dt-bindings/interrupt-controller/arm-gic.h>
    #include <dt-bindings/interrupt-controller/irq.h>

    mdio {
        #address-cells = <1>;
        #size-cells = <0>;

        pcs0: ethernet-pcs@0 {
            compatible = "xlnx,pcs-16.2", "xlnx,pcs";
            reg = <0>;
            #clock-cells = <0>;
            clocks = <&si570>;
            clock-names = "refclk";
            interrupts-extended = <&gic GIC_SPI 106 IRQ_TYPE_LEVEL_HIGH>;
            interrupt-names = "an";
            reset-gpios = <&gpio 5 GPIO_ACTIVE_HIGH>;
            done-gpios = <&gpio 6 GPIO_ACTIVE_HIGH>;
            xlnx,pcs-modes = "sgmii", "1000base-x";
        };

        pcs1: ethernet-pcs@1 {
            compatible = "xlnx,pcs-16.2", "xlnx,pcs";
            reg = <1>;
            xlnx,pcs-modes = "sgmii";
            clocks = <&pcs0>;
            clock-names = "refclk";
        };
    };
```

## Documentation/devicetree/bindings/net/xlnx,tsn-endpoint-ethernet-mac.yaml
```yaml
# SPDX-License-Identifier: (GPL-2.0-only OR BSD-2-Clause)
%YAML 1.2
---
$id: http://devicetree.org/schemas/net/xlnx,tsn-endpoint-ethernet-mac.yaml#
$schema: http://devicetree.org/meta-schemas/core.yaml#

title: Xilinx TSN Endpoint Ethernet MAC

description:
  TSN Endpoint Ethernet MAC IP implements IEEE 802.1 Time-Sensitive Networking (TSN)
  standards and provides low-latency network connectivity in either Endpoint-only or
  Bridged Endpoint configurations. In the Bridged Endpoint mode, the IP integrates a
  three-port switch, with two ports connected to the external network and one port
  connected to an internal endpoint.It also supports GMII/RGMII interfaces for
  connection to an external PHY, enabling full-duplex operation at 100 Mb/s and
  1 Gb/s speeds.

maintainers:
  - Neeli Srinivas <srinivas.neeli@amd.com>

properties:
  compatible:
    enum:
      - xlnx,tsn-endpoint-ethernet-mac-3.0
  reg:
    maxItems: 1

  clocks:
    minItems: 6

  clock-names:
    items:
      - const: gtx
      - const: gtx90
      - const: host_rxfifo
      - const: host_txfifo
      - const: ref
      - const: s_axi

  dmas:
    minItems: 2
    maxItems: 32

  dma-names:
    items:
      pattern: "^[tr]x_chan([0-9]|1[0-5])$"
    description:
      Should be "tx_chan0", "tx_chan1" ... "tx_chan15" for DMA Tx channel
      Should be "rx_chan0", "rx_chan1" ... "rx_chan15" for DMA Rx channel
    minItems: 2
    maxItems: 32

  ranges: true

  xlnx,num-priorities:
    $ref: /schemas/types.yaml#/definitions/uint32
    minimum: 2
    maximum: 8
    description:
      Number of traffic classes (priorities) configured in the IP.
      This is an IP configuration parameter that determines the number of
      priority queues available for QoS scheduling. Traffic classes map to
      IEEE 802.1Q priority levels (0-7).

  xlnx,tsn-tx-config:
    $ref: /schemas/types.yaml#/definitions/phandle
    description:
      Multiple TX Queue parameters. Phandle to a node that implements
      the tx-queues-config.

  tx-queues-config:
    type: object
    description:
      TX queue configuration node that maps IP priority queues to
      DMA TX channels. The TSN IP supports multiple priority queues for QoS
      scheduling, and each queue can be connected to a specific DMA channel.
      This mapping defines which DMA TX channel is used to transmit packets
      for each priority queue. For example, queue0 with xlnx,dma-channel-num
      set to 5 means priority queue 0 uses tx_chan5 for data transfer.

    patternProperties:
      "^queue[0-7]$":
        description:
          Each subnode represents a priority queue. The xlnx,dma-channel-num
          property specifies which DMA TX channel (tx_chan0 to tx_chan15)
          is connected to this queue for transmitting packets.
        type: object
        properties:
          xlnx,dma-channel-num:
            $ref: /schemas/types.yaml#/definitions/uint32
            description:
              DMA TX channel number connected to this priority queue.
            minimum: 0
            maximum: 15

        additionalProperties: false
    additionalProperties: false

  '#address-cells':
    const: 1

  '#size-cells':
    const: 1

patternProperties:
  "^ethernet-mac@":
    type: object
    $ref: /schemas/net/ethernet-controller.yaml#
    required:
      - reg
      - phy-mode
    properties:
      reg:
        maxItems: 1

      phy-mode:
        enum:
          - gmii
          - rgmii
          - rgmii-id

      phy-handle:
        $ref: /schemas/types.yaml#/definitions/phandle

      mdio:
        type: object
    additionalProperties: false

  "^ep-mac@":
    type: object
    $ref: /schemas/net/ethernet-controller.yaml#
    properties:
      reg:
        maxItems: 1

    additionalProperties: false

  "^switch@":
    type: object
    $ref: /schemas/net/ethernet-switch.yaml#
    unevaluatedProperties: false

    properties:
      reg:
        maxItems: 1

      ethernet-ports:
        type: object
        unevaluatedProperties: false

        properties:
          '#address-cells':
            const: 1
          '#size-cells':
            const: 0

        patternProperties:
          "^port@[0-2]$":
            type: object
            $ref: ethernet-switch-port.yaml#
            unevaluatedProperties: false

            properties:
              reg:
                maximum: 2
              ethernet:
                description: Phandle to associated MAC or endpoint node
                $ref: /schemas/types.yaml#/definitions/phandle
            required:
              - reg
              - ethernet
        required:
          - "#address-cells"
          - "#size-cells"
    required:
      - reg
additionalProperties: false

required:
  - compatible
  - reg
  - clocks
  - clock-names
  - dmas
  - dma-names
  - xlnx,num-priorities
  - ranges

examples:
  - |
    tsn_ip: tsn@80040000 {
        compatible = "xlnx,tsn-endpoint-ethernet-mac-3.0";
        reg = <0x80040000 0x40000>;
        clocks = <&misc_clk_2>, <&misc_clk_2>, <&misc_clk_1>, <&misc_clk_1>, <&misc_clk_3>, <&misc_clk_0>;
        clock-names = "gtx", "gtx90", "host_rxfifo", "host_txfifo", "ref", "s_axi";
        dmas = <&axi_mcdma_0 0>, <&axi_mcdma_0 1>, <&axi_mcdma_0 2>, <&axi_mcdma_0 3>,
               <&axi_mcdma_0 4>, <&axi_mcdma_0 5>, <&axi_mcdma_0 6>, <&axi_mcdma_0 7>,
               <&axi_mcdma_0 16>, <&axi_mcdma_0 17>, <&axi_mcdma_0 18>, <&axi_mcdma_0 19>,
               <&axi_mcdma_0 20>, <&axi_mcdma_0 21>, <&axi_mcdma_0 22>, <&axi_mcdma_0 23>;
        dma-names = "tx_chan0","tx_chan1","tx_chan2","tx_chan3","tx_chan4","tx_chan5","tx_chan6",
                    "tx_chan7","rx_chan0","rx_chan1","rx_chan2","rx_chan3","rx_chan4","rx_chan5",
                    "rx_chan6","rx_chan7";
        xlnx,num-priorities = <8>;
        #address-cells = <1>;
        #size-cells = <1>;
        ranges = <0x0 0x80040000 0x40000>;
        xlnx,tsn-tx-config = <&tsn_tx_config>;
        tsn_tx_config: tx-queues-config {
            queue0 {
                xlnx,dma-channel-num = <0x5>;
            };
            queue1 {
                 xlnx,dma-channel-num = <0x4>;
            };
            queue2 {
                 xlnx,dma-channel-num = <0x3>;
            };
            queue3 {
                 xlnx,dma-channel-num = <0x2>;
            };
            queue4 {
                 xlnx,dma-channel-num = <0x1>;
            };
            queue5 {
                 xlnx,dma-channel-num = <0x0>;
            };
        };
        // MAC 1 Node
        mac1: ethernet-mac@0 {
            reg = <0x0 0x14000>;
            phy-mode = "rgmii-id";
            phy-handle = <&phy0>;
            mdio {
            #address-cells = <1>;
            #size-cells = <0>;
            phy0: ethernet-phy@0 {
                device_type = "ethernet-phy";
                reg = <0>;
            };
            };
        };

        // MAC 2 Node
        mac2: ethernet-mac@20000 {
            reg = <0x20000 0x14000>;
            phy-mode = "rgmii-id";
            phy-handle = <&phy1>;
            mdio {
            #address-cells = <1>;
            #size-cells = <0>;
            phy1: ethernet-phy@1 {
                device_type = "ethernet-phy";
                reg = <1>;
            };
            };
        };

        // Endpoint Node
        ep_mac: ep-mac@16000 {
            reg = <0x16000 0xa000>;
        };

        // Switch Node
        tsn_switch: switch@38000 {
            reg = <0x38000 0x8000>;

            ethernet-ports {
                #address-cells = <1>;
                #size-cells = <0>;

                port@0 {
                    reg = <0>;
                    ethernet = <&ep_mac>;
                };

                port@1 {
                    reg = <1>;
                    ethernet = <&mac1>;
                };

                port@2 {
                    reg = <2>;
                    ethernet = <&mac2>;
                };
            };
        };
    };
```

## Documentation/devicetree/bindings/net/xlnx,xxv-ethernet.yaml
```yaml
# SPDX-License-Identifier: (GPL-2.0-only OR BSD-2-Clause)
%YAML 1.2
---
$id: http://devicetree.org/schemas/net/xlnx,xxv-ethernet.yaml#
$schema: http://devicetree.org/meta-schemas/core.yaml#

title: Xilinx XXV 10G/25G Ethernet Subsystem

maintainers:
  - Radhey Shyam Pandey <radhey.shyam.pandey@amd.com>
  - Suraj Gupta <suraj.gupta2@amd.com>

description:
  The Xilinx XXV Ethernet Subsystem implements a 10G/25G Ethernet MAC with an
  in-core PCS/PMA driving a high-speed serial transceiver. It supports the
  10GBASE-R and 25GBASE-R line rates, with 25G operation following the 25G
  Ethernet Consortium specification. It has no external MDIO PHY, and its
  payload is moved by an external AXI DMA (or multichannel DMA) controller
  referenced through the "dmas" property.

properties:
  compatible:
    const: xlnx,xxv-ethernet-1.0

  reg:
    maxItems: 1
    description: MAC control and status register space.

  clocks:
    items:
      - description: RX AXI4-Stream clock.
      - description: GT DRP clock.
      - description: AXI4-Lite register clock.

  clock-names:
    items:
      - const: rx_core
      - const: drp
      - const: s_axi

  phy-mode:
    enum:
      - 10gbase-r
      - 25gbase-r

  xlnx,rxmem:
    description:
      Size in bytes of the Rx/Tx packet buffer memory built into the IP. It is
      fixed by the hardware design and bounds the largest frame (jumbo MTU) the
      device can accept.
    $ref: /schemas/types.yaml#/definitions/uint32

  dmas:
    minItems: 2
    maxItems: 32
    description: TX and RX DMA channel phandle.

  dma-names:
    items:
      pattern: "^[tr]x_chan([0-9]|1[0-5])$"
    description:
      Should be "tx_chan0", "tx_chan1" ... "tx_chan15" for DMA Tx channel and
      "rx_chan0", "rx_chan1" ... "rx_chan15" for DMA Rx channel.
    minItems: 2
    maxItems: 32

required:
  - compatible
  - reg
  - clocks
  - clock-names
  - phy-mode
  - xlnx,rxmem
  - dmas
  - dma-names

allOf:
  - $ref: /schemas/net/ethernet-controller.yaml#

unevaluatedProperties: false

examples:
  # Single AXI DMA channel pair
  - |
    ethernet@80000000 {
        compatible = "xlnx,xxv-ethernet-1.0";
        reg = <0x80000000 0x10000>;
        clock-names = "rx_core", "drp", "s_axi";
        clocks = <&rx_clk>, <&drp_clk>, <&axi_clk>;
        dma-names = "tx_chan0", "rx_chan0";
        dmas = <&axi_dma 0>, <&axi_dma 1>;
        phy-mode = "25gbase-r";
        xlnx,rxmem = <0x8000>;
    };
  # Multichannel DMA (MCDMA) with multiple Tx/Rx channels
  - |
    ethernet@80010000 {
        compatible = "xlnx,xxv-ethernet-1.0";
        reg = <0x80010000 0x10000>;
        clock-names = "rx_core", "drp", "s_axi";
        clocks = <&rx_clk>, <&drp_clk>, <&axi_clk>;
        dma-names = "tx_chan0", "tx_chan1", "rx_chan0", "rx_chan1";
        dmas = <&axi_mcdma 0>, <&axi_mcdma 1>,
               <&axi_mcdma 16>, <&axi_mcdma 17>;
        phy-mode = "10gbase-r";
        xlnx,rxmem = <0x8000>;
    };
```
