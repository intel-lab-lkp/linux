## Documentation/devicetree/bindings/net/realtek,r8169.yaml
```yaml
# SPDX-License-Identifier: (GPL-2.0-only OR BSD-2-Clause)
%YAML 1.2
---
$id: http://devicetree.org/schemas/net/realtek,r8169.yaml#
$schema: http://devicetree.org/meta-schemas/core.yaml#

title: Realtek r8169 family PCIe Ethernet Controllers

maintainers:
  - Heiner Kallweit <hkallweit1@gmail.com>

description:
  PCI function node properties for fixed/soldered Realtek Ethernet
  controllers driven by the r8169 driver.

allOf:
  - $ref: ethernet-controller.yaml#

properties:
  compatible:
    enum:
      - pci10ec,8125  # RTL8125 2.5GbE
      - pci10ec,8126  # RTL8126 5GbE
      - pci10ec,8127  # RTL8127
      - pci10ec,8161  # RTL8168 variant
      - pci10ec,8162  # RTL8168 variant
      - pci10ec,8168  # RTL8168/8111 GbE

  reg:
    maxItems: 1

  local-mac-address: true
  mac-address: true
  nvmem-cells: true
  nvmem-cell-names: true

required:
  - compatible
  - reg

additionalProperties: false

examples:
  - |
    pcie {
        #address-cells = <3>;
        #size-cells = <2>;

        ethernet@0,0 {
            compatible = "pci10ec,8125";
            reg = <0x10000 0 0 0 0>;
            local-mac-address = [00 00 00 00 00 00];
        };
    };
```

## Documentation/devicetree/bindings/net/realtek,rtl9301-mdio.yaml
```yaml
# SPDX-License-Identifier: (GPL-2.0-only OR BSD-2-Clause)
%YAML 1.2
---
$id: http://devicetree.org/schemas/net/realtek,rtl9301-mdio.yaml#
$schema: http://devicetree.org/meta-schemas/core.yaml#

title: Realtek RTL9300 MDIO Controller

maintainers:
  - Chris Packham <chris.packham@alliedtelesis.co.nz>

allOf:
  - $ref: mdio.yaml#

properties:
  compatible:
    oneOf:
      - items:
          - enum:
              - realtek,rtl9302b-mdio
              - realtek,rtl9302c-mdio
              - realtek,rtl9303-mdio
          - const: realtek,rtl9301-mdio
      - const: realtek,rtl9301-mdio

  '#address-cells':
    const: 1

  '#size-cells':
    const: 0

  reg:
    maxItems: 1

patternProperties:
  '^ethernet-phy(@[a-f0-9]+)?':
    type: object
    $ref: ethernet-phy.yaml#

    properties:
      reg:
        description:
          The MDIO communication on the RTL9300 is abstracted by the switch. At
          the software level communication uses the switch port to address the
          PHY with the actual MDIO bus and address having been setup via the
          realtek,smi-address property.

      realtek,smi-address:
        $ref: /schemas/types.yaml#/definitions/uint32-array
        description: SMI interface and address for the connected PHY
        items:
          - description: SMI interface number associated with the port.
          - description: SMI address of the PHY for the port.

    unevaluatedProperties: false

required:
  - compatible
  - reg

unevaluatedProperties: false

examples:
  - |
    mdio@ca00 {
        compatible = "realtek,rtl9301-mdio";
        reg = <0xca00 0x200>;
        #address-cells = <1>;
        #size-cells = <0>;

        ethernet-phy@0 {
            compatible = "ethernet-phy-ieee802.3-c45";
            reg = <0>;
            realtek,smi-address = <0 1>;
        };

        ethernet-phy@8 {
            compatible = "ethernet-phy-ieee802.3-c45";
            reg = <8>;
            realtek,smi-address = <1 1>;
        };
    };
```

## Documentation/devicetree/bindings/net/silabs,cpc-spi.yaml
```yaml
# SPDX-License-Identifier: (GPL-2.0-only OR BSD-2-Clause)
# Copyright 2024 Silicon Labs Inc.
%YAML 1.2
---
$id: http://devicetree.org/schemas/net/silabs,cpc-spi.yaml#
$schema: http://devicetree.org/meta-schemas/core.yaml#

title: SPI driver for CPC

maintainers:
  - Damien Riégel <damien.riegel@silabs.com>

description: |
  This binding is for the implementation of CPC protocol over SPI. The protocol
  consists of a chain of header+payload frames. The interrupt is used by the
  device to signal it has a frame to transmit, but also between headers and
  payloads to signal that it is ready to receive payload.

properties:
  compatible:
    enum:
      - silabs,cpc-spi

  reg:
    maxItems: 1

  interrupts:
    maxItems: 1

required:
  - compatible
  - reg
  - interrupt

allOf:
  - $ref: /schemas/spi/spi-peripheral-props.yaml#

unevaluatedProperties: false

examples:
  - |
    #include <dt-bindings/interrupt-controller/irq.h>
    spi {
            #address-cells = <1>;
            #size-cells = <0>;

            cpcspi@0 {
                  compatible = "silabs,cpc-spi";
                  reg = <0>;
                  spi-max-frequency = <1000000>;
                  interrupt-parent = <&gpio>;
                  interrupts = <23 IRQ_TYPE_EDGE_FALLING>;
            };
    };
```

## Documentation/devicetree/bindings/net/socfpga,dwmac.yaml
```yaml
# SPDX-License-Identifier: GPL-2.0-only OR BSD-2-Clause
%YAML 1.2
---
$id: http://devicetree.org/schemas/net/socfpga,dwmac.yaml#
$schema: http://devicetree.org/meta-schemas/core.yaml#

title: Altera SOCFPGA SoC DWMAC controller

maintainers:
  - Matthew Gerlach <matthew.gerlach@altera.com>

select:
  properties:
    compatible:
      contains:
        enum:
          - altr,socfpga-stmmac
          - altr,socfpga-stmmac-a10-s10
  required:
    - altr,sysmgr-syscon

properties:
  compatible:
    oneOf:
      - items:
          - const: altr,socfpga-stmmac
          - const: snps,dwmac-3.70a
          - const: snps,dwmac
      - items:
          - const: altr,socfpga-stmmac-a10-s10
          - const: snps,dwmac-3.74a
          - const: snps,dwmac
      - items:
          - const: altr,socfpga-stmmac-a10-s10
          - const: snps,dwmac-3.72a
          - const: snps,dwmac

  clocks:
    minItems: 1
    maxItems: 4

  clock-names:
    minItems: 1
    maxItems: 4

  phy-mode:
    enum:
      - rgmii
      - sgmii
      - gmii

  altr,emac-splitter:
    $ref: /schemas/types.yaml#/definitions/phandle
    description:
      Should be the phandle to the emac splitter soft IP node if DWMAC
      controller is connected an emac splitter.

  altr,f2h_ptp_ref_clk:
    $ref: /schemas/types.yaml#/definitions/phandle
    description:
      Phandle to Precision Time Protocol reference clock. This clock is
      common to gmac instances and defaults to osc1.

  altr,gmii-to-sgmii-converter:
    $ref: /schemas/types.yaml#/definitions/phandle
    description:
      Should be the phandle to the gmii to sgmii converter soft IP.

  altr,sysmgr-syscon:
    $ref: /schemas/types.yaml#/definitions/phandle-array
    description:
      Should be the phandle to the system manager node that encompass
      the glue register, the register offset, and the register shift.
      On Cyclone5/Arria5, the register shift represents the PHY mode
      bits, while on the Arria10/Stratix10/Agilex platforms, the
      register shift represents bit for each emac to enable/disable
      signals from the FPGA fabric to the EMAC modules.
    minItems: 1
    items:
      - description: phandle to the system manager node
      - description: offset of the control register
      - description: shift within the control register

allOf:
  - $ref: snps,dwmac.yaml#

additionalProperties: true

examples:

  - |
    #include <dt-bindings/interrupt-controller/arm-gic.h>
    #include <dt-bindings/interrupt-controller/irq.h>
    soc {
            #address-cells = <1>;
            #size-cells = <1>;
            gmac0: ethernet@ff700000 {
                    compatible = "altr,socfpga-stmmac", "snps,dwmac-3.70a",
                    "snps,dwmac";
                    altr,sysmgr-syscon = <&sysmgr 0x60 0>;
                    reg = <0xff700000 0x2000>;
                    interrupts = <GIC_SPI 116 IRQ_TYPE_LEVEL_HIGH>;
                    interrupt-names = "macirq";
                    mac-address = [00 00 00 00 00 00]; /* Filled in by U-Boot */
                    clocks = <&emac_0_clk>;
                    clock-names = "stmmaceth";
                    phy-mode = "sgmii";
            };
    };
```

## Documentation/devicetree/bindings/net/socfpga-dwmac.yaml
```yaml
# SPDX-License-Identifier: (GPL-2.0-only OR BSD-2-Clause)
%YAML 1.2
---
$id: http://devicetree.org/schemas/net/socfpga-dwmac.yaml#
$schema: http://devicetree.org/meta-schemas/core.yaml#

title: Altera SOCFPGA SoC DWMAC controller

maintainers:
  - Dinh Nguyen <dinguyen@altera.com>

description:
  This is a variant of the dwmac/stmmac driver an inherits all descriptions
  present in Documentation/devicetree/bindings/net/stmmac.txt.

# We need a select here so we don't match all nodes with 'snps,dwmac'
select:
  properties:
    compatible:
      contains:
        enum:
          - altr,socfpga-stmmac # For Cyclone5/Arria5 SoCs
          - altr,socfpga-stmmac-a10-s10 # For Arria10/Agilex/Stratix10 SoCs
  required:
    - compatible

allOf:
  - $ref: snps,dwmac.yaml#

properties:
  compatible:
    oneOf:
      - items:
          - enum:
              - altr,socfpga-stmmac
          - const: snps,dwmac-3.70a
          - const: snps,dwmac
      - items:
          - enum:
              - altr,socfpga-stmmac-a10-s10
          - const: snps,dwmac-3.72a
          - const: snps,dwmac
      - items:
          - enum:
              - altr,socfpga-stmmac-a10-s10
          - const: snps,dwmac-3.74a
          - const: snps,dwmac

  altr,sysmgr-syscon:
    $ref: /schemas/types.yaml#/definitions/phandle-array
    items:
      - items:
          - description: phandle to the sysmgr node
          - description: register offset that controls the PHY mode or FPGA signals
          - description: register shift for the PHY mode bits or FPGA signals
    description:
      Should be the phandle to the system manager node that
      encompasses the glue register, the register offset, and the register shift.
      On Cyclone5/Arria5, the register shift represents the PHY mode bits, while
      on the Arria10/Stratix10/Agilex platforms, the register shift represents
      bit for each emac to enable/disable signals from the FPGA fabric to the
      EMAC modules.

  altr,f2h_ptp_ref_clk:
    $ref: /schemas/types.yaml#/definitions/phandle
    description:
      Use f2h_ptp_ref_clk instead of default eosc1 clock
      for ptp ref clk. This affects all emacs as the clock is common.

  altr,emac-splitter:
    $ref: /schemas/types.yaml#/definitions/phandle
    description:
      Should be the phandle to the emac splitter soft IP node if
      DWMAC controller is connected emac splitter.

  altr,gmii-to-sgmii-converter:
    $ref: /schemas/types.yaml#/definitions/phandle
    description:
      Phandle to the TSE SGMII converter.

required:
  - compatible
  - reg
  - altr,sysmgr-syscon

additionalProperties: true

examples:
  - |
    //Example 1
    gmac0: ethernet@ff700000 {
          compatible = "altr,socfpga-stmmac", "snps,dwmac-3.70a", "snps,dwmac";
          altr,sysmgr-syscon = <&sysmgr 0x60 0>;
          reg = <0xff700000 0x2000>;
          interrupts = <0 115 4>;
          interrupt-names = "macirq";
          mac-address = [00 00 00 00 00 00];/* Filled in by U-Boot */
          clocks = <&emac_0_clk>;
          clock-names = "stmmaceth";
          phy-mode = "sgmii";
          altr,gmii-to-sgmii-converter = <&gmii_to_sgmii_converter>;
    };
```

## Documentation/devicetree/bindings/net/tesla,ethqos.yaml
```yaml
# SPDX-License-Identifier: GPL-2.0-only OR BSD-2-Clause
%YAML 1.2
---
$id: http://devicetree.org/schemas/net/tesla,ethqos.yaml#
$schema: http://devicetree.org/meta-schemas/core.yaml#

title: FSD Ethernet Quality of Service

maintainers:
  - Sriranjani P <sriranjani.p@samsung.com>
  - Swathi K S <swathi.ks@samsung.com>

description:
  dwmmac based tesla ethernet devices which support Gigabit
  ethernet.

allOf:
  - $ref: snps,dwmac.yaml#

properties:
  compatible:
    const: tesla,fsd-ethqos-4.21.yaml

  reg:
    maxItems: 1

  interrupts:
    maxItems: 1

  clocks:
    minItems: 5
    maxItems: 10

  clock-names:
    minItems: 5
    maxItems: 10
    items:
      - const: ptp_ref
      - const: master_bus
      - const: slave_bus
      - const: tx
      - const: rx
      - const: master2_bus
      - const: slave2_bus
      - const: eqos_rxclk_mux
      - const: eqos_phyrxclk
      - const: dout_peric_rgmii_clk

  fsd-rx-clock-skew:
    $ref: /schemas/types.yaml#/definitions/phandle-array
    items:
      - items:
          - description: phandle to the syscon node
          - description: offset of the control register
    description:
      Should be phandle/offset pair. The phandle to the syscon node.

  iommus:
    maxItems: 1

  phy-mode:
    $ref: ethernet-controller.yaml#/properties/phy-connection-type

required:
  - compatible
  - reg
  - interrupts
  - clocks
  - clock-names
  - rx-clock-skew
  - iommus
  - phy-mode

unevaluatedProperties: false

examples:
  - |
    #include <dt-bindings/clock/fsd-clk.h>
    #include <dt-bindings/interrupt-controller/arm-gic.h>

    ethernet_1: ethernet@14300000 {
              compatible = "tesla,dwc-qos-ethernet-4.21";
              reg = <0x0 0x14300000 0x0 0x10000>;
              interrupts = <GIC_SPI 176 IRQ_TYPE_LEVEL_HIGH>;
              clocks = <&clock_peric PERIC_EQOS_TOP_IPCLKPORT_CLK_PTP_REF_I>,
                       <&clock_peric PERIC_EQOS_TOP_IPCLKPORT_ACLK_I>,
                       <&clock_peric PERIC_EQOS_TOP_IPCLKPORT_HCLK_I>,
                       <&clock_peric PERIC_EQOS_TOP_IPCLKPORT_RGMII_CLK_I>,
                       <&clock_peric PERIC_EQOS_TOP_IPCLKPORT_CLK_RX_I>,
                       <&clock_peric PERIC_BUS_D_PERIC_IPCLKPORT_EQOSCLK>,
                       <&clock_peric PERIC_BUS_P_PERIC_IPCLKPORT_EQOSCLK>,
                       <&clock_peric PERIC_EQOS_PHYRXCLK_MUX>,
                       <&clock_peric PERIC_EQOS_PHYRXCLK>,
                       <&clock_peric PERIC_DOUT_RGMII_CLK>;
              clock-names = "ptp_ref",
                            "master_bus",
                            "slave_bus",
                            "tx",
                            "rx",
                            "master2_bus",
                            "slave2_bus",
                            "eqos_rxclk_mux",
                            "eqos_phyrxclk",
                            "dout_peric_rgmii_clk";
              pinctrl-names = "default";
              pinctrl-0 = <&eth1_tx_clk>, <&eth1_tx_data>, <&eth1_tx_ctrl>,
                          <&eth1_phy_intr>, <&eth1_rx_clk>, <&eth1_rx_data>,
                          <&eth1_rx_ctrl>, <&eth1_mdio>;
              fsd-rx-clock-skew = <&sysreg_peric 0x10>;
              iommus = <&smmu_peric 0x0 0x1>;
              phy-mode = "rgmii";
    };

...
```
