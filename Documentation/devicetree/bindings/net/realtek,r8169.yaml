## Documentation/devicetree/bindings/net/ti,davinci-emac.yaml
```yaml
# SPDX-License-Identifier: (GPL-2.0-only OR BSD-2-Clause)
%YAML 1.2
---
$id: http://devicetree.org/schemas/net/ti,davinci-emac.yaml#
$schema: http://devicetree.org/meta-schemas/core.yaml#

title: TI DaVinci EMAC Ethernet Controller

maintainers:
  - Tony Lindgren <tony@atomide.com>

properties:
  compatible:
    enum:
      - ti,davinci-dm6467-emac
      - ti,am3517-emac
      - ti,dm816-emac

  reg:
    minItems: 1
    maxItems: 2

  interrupts:
    items:
      - description: Receive Threshold
      - description: Receive
      - description: Transmit
      - description: Miscellaneous

  clocks:
    maxItems: 1

  clock-names:
    const: ick

  ti,davinci-ctrl-reg-offset:
    $ref: /schemas/types.yaml#/definitions/uint32
    description: offset to control register

  ti,davinci-ctrl-mod-reg-offset:
    $ref: /schemas/types.yaml#/definitions/uint32
    description: offset to control module register

  ti,davinci-ctrl-ram-offset:
    $ref: /schemas/types.yaml#/definitions/uint32
    description: offset to control module ram

  ti,davinci-ctrl-ram-size:
    $ref: /schemas/types.yaml#/definitions/uint32
    description: size of control module ram

  ti,davinci-rmii-en:
    $ref: /schemas/types.yaml#/definitions/uint8
    description: Set to 1 to enable RMII (Reduced MII) mode.

  ti,davinci-no-bd-ram:
    type: boolean
    description:
      Indicates that the EMAC does not have on-chip buffer descriptor RAM.

  syscon:
    $ref: /schemas/types.yaml#/definitions/phandle
    description:
      Phandle to a syscon node providing access to the System Control
      Module (SCM) registers. Used on AM3517 and DM816x to read
      factory-programmed MAC addresses from eFuse registers.

  ti,hwmods:
    $ref: /schemas/types.yaml#/definitions/string
    description: TI hwmod name
    deprecated: true

  power-domains:
    maxItems: 1

required:
  - compatible
  - reg
  - interrupts
  - ti,davinci-ctrl-reg-offset
  - ti,davinci-ctrl-mod-reg-offset
  - ti,davinci-ctrl-ram-offset
  - ti,davinci-ctrl-ram-size
  - clocks

allOf:
  - $ref: ethernet-controller.yaml#
  - if:
      properties:
        compatible:
          contains:
            const: ti,davinci-dm6467-emac
    then:
      properties:
        syscon: false
        clock-names: false

unevaluatedProperties: false

examples:
  - |
    ethernet@220000 {
        compatible = "ti,davinci-dm6467-emac";
        reg = <0x220000 0x4000>;
        ti,davinci-ctrl-reg-offset = <0x3000>;
        ti,davinci-ctrl-mod-reg-offset = <0x2000>;
        ti,davinci-ctrl-ram-offset = <0>;
        ti,davinci-ctrl-ram-size = <0x2000>;
        local-mac-address = [ 00 00 00 00 00 00 ];
        interrupts = <33>, <34>, <35>, <36>;
        clocks = <&psc1 5>;
        power-domains = <&psc1 5>;
    };
```

## Documentation/devicetree/bindings/net/ti,dp83640.yaml
```yaml
# SPDX-License-Identifier: (GPL-2.0-only OR BSD-2-Clause)
# Copyright 2024 Nanometrics Inc
%YAML 1.2
---
$id: http://devicetree.org/schemas/net/ti,dp83640.yaml#
$schema: http://devicetree.org/meta-schemas/core.yaml#

title: TI DP83640 ethernet PHY

allOf:
  - $ref: ethernet-controller.yaml#

maintainers:
  - Bastien Curutchet <bastien.curutchet@bootlin.com>

description: |
  The DP83640 Precision PHYTER device delivers the highest level of precision
  clock synchronization for real time industrial connectivity based on the
  IEEE 1588 standard. The DP83640 has deterministic, low latency and allows
  choice of microcontroller with no hardware customization required

  This device interfaces directly to the MAC layer through the
  IEEE 802.3 Standard Media Independent Interface (MII), or Reduced MII (RMII).

  Specifications about the Ethernet PHY can be found at:
    https://www.ti.com/lit/gpn/dp83640

properties:
  reg:
    maxItems: 1

  ti,clk-output:
    $ref: /schemas/types.yaml#/definitions/uint32
    enum: [0, 1]
    description: |
      If present, enables or disables the CLK_OUT pin.
      CLK_OUT pin disabling can also be strapped. If the strap pin is not set
      correctly or not set at all then this can be used to configure it.
       - 0     = CLK_OUT pin disabled
       - 1     = CLK_OUT pin enabled
       - unset = Configured by straps

  ti,led-config:
    $ref: /schemas/types.yaml#/definitions/uint32
    enum: [1, 2, 3]
    description: |
      If present, configures the LED Mode (values defined in
      dt-bindings/net/ti-dp83640.h).
      LED configuration can also be strapped. If the strap pin is not set
      correctly or not set at all then this can be used to configure it.
       - 1     = Mode 1
        LED_LINK = ON for Good Link, OFF for No Link
        LED_SPEED = ON in 100 Mb/s, OFF in 10 Mb/s
        LED_ACT = ON for Activity, OFF for No Activity
       - 2     = Mode 2
        LED_LINK = ON for Good Link, BLINK for Activity
        LED_SPEED = ON in 100 Mb/s, OFF in 10 Mb/s
        LED_ACT = ON for Collision, OFF for No Collision
       - 3     = Mode 3
        LED_LINK = ON for Good Link, BLINK for Activity
        LED_SPEED = ON in 100 Mb/s, OFF in 10 Mb/s
        LED_ACT = ON for Full Duplex, OFF for Half Duplex
       - unset = Configured by straps

  ti,phy-control-frames:
    $ref: /schemas/types.yaml#/definitions/uint32
    enum: [0, 1]
    description: |
      If present, enables or disables the PHY control frames.
      PHY Control Frames support can also be strapped. If the strap pin is not
      set correctly or not set at all then this can be used to configure it.
       - 0     = PHY Control Frames disabled
       - 1     = PHY Control Frames enabled
       - unset = Configured by straps

  ti,fiber-mode:
    $ref: /schemas/types.yaml#/definitions/uint32
    enum: [0, 1]
    description: |
      If present, enables or disables the FX Fiber Mode.
      Fiber mode support can also be strapped. If the strap pin is not set
      correctly or not set at all then this can be used to configure it.
       - 0     = FX Fiber Mode disabled
       - 1     = FX Fiber Mode enabled
       - unset = Configured by straps

  ti,energy-detect-en:
    $ref: /schemas/types.yaml#/definitions/flag
    description: |
      If present, Energy Detect Mode is enabled. If not present, Energy Detect
      Mode is disabled. This feature can not be strapped.

required:
  - reg

unevaluatedProperties: false

examples:
  - |
    #include <dt-bindings/net/ti-dp83640.h>

    mdio0 {
      #address-cells = <1>;
      #size-cells = <0>;
      ethphy0: ethernet-phy@0 {
        reg = <0>;
        ti,clk-output = <0>;
        ti,energy-detect-en;
        ti,led-config = <DP83640_PHYCR_LED_CNFG_MODE_3>;
        ti,phy-control-frames = <1>;
        ti,fiber-mode = <1>;
      };
    };
```

## Documentation/devicetree/bindings/net/ti,dp83td510.yaml
```yaml
# SPDX-License-Identifier: GPL-2.0-only OR BSD-2-Clause
%YAML 1.2
---
$id: http://devicetree.org/schemas/net/ti,dp83td510.yaml#
$schema: http://devicetree.org/meta-schemas/core.yaml#

title: TI DP83TD510 10BaseT1L PHY

maintainers:
  - Oleksij Rempel <o.rempel@pengutronix.de>

description:
  DP83TD510E Ultra Low Power 802.3cg 10Base-T1L 10M Single Pair Ethernet PHY

allOf:
  - $ref: ethernet-phy.yaml#

properties:
  compatible:
    enum:
      - ethernet-phy-id2000.0181

unevaluatedProperties: false

examples:
  - |
    mdio {
        #address-cells = <1>;
        #size-cells = <0>;

        ethernet-phy@0 {
            compatible = "ethernet-phy-id2000.0181";
            reg = <0>;
        };
    };
```

## Documentation/devicetree/bindings/net/ti,icssm-prueth.yaml
```yaml
# SPDX-License-Identifier: (GPL-2.0-only OR BSD-2-Clause)
%YAML 1.2
---
$id: http://devicetree.org/schemas/net/ti,icssm-prueth.yaml#
$schema: http://devicetree.org/meta-schemas/core.yaml#

title: Texas Instruments ICSSM PRUSS Ethernet

maintainers:
  - Roger Quadros <rogerq@ti.com>
  - Andrew F. Davis <afd@ti.com>
  - Parvathi Pudi <parvathi@couthit.com>
  - Basharath Hussain Khaja <basharath@couthit.com>

description:
  Ethernet based on the Programmable Real-Time Unit and Industrial
  Communication Subsystem.

properties:
  compatible:
    enum:
      - ti,am57-prueth     # for AM57x SoC family

  sram:
    $ref: /schemas/types.yaml#/definitions/phandle
    description:
      phandle to OCMC SRAM node

  ti,mii-rt:
    $ref: /schemas/types.yaml#/definitions/phandle
    description:
      phandle to MII_RT module's syscon regmap

  ti,iep:
    $ref: /schemas/types.yaml#/definitions/phandle
    description:
      phandle to IEP (Industrial Ethernet Peripheral) for ICSS

  ti,ecap:
    $ref: /schemas/types.yaml#/definitions/phandle
    description:
      phandle to Enhanced Capture (eCAP) event for ICSS

  interrupts:
    items:
      - description: High priority Rx Interrupt specifier.
      - description: Low priority Rx Interrupt specifier.

  interrupt-names:
    items:
      - const: rx_hp
      - const: rx_lp

  ethernet-ports:
    type: object
    additionalProperties: false

    properties:
      '#address-cells':
        const: 1
      '#size-cells':
        const: 0

    patternProperties:
      ^ethernet-port@[0-1]$:
        type: object
        description: ICSSM PRUETH external ports
        $ref: ethernet-controller.yaml#
        unevaluatedProperties: false

        properties:
          reg:
            items:
              - enum: [0, 1]
            description: ICSSM PRUETH port number

          interrupts:
            maxItems: 3

          interrupt-names:
            items:
              - const: rx
              - const: emac_ptp_tx
              - const: hsr_ptp_tx

        required:
          - reg

    anyOf:
      - required:
          - ethernet-port@0
      - required:
          - ethernet-port@1

required:
  - compatible
  - sram
  - ti,mii-rt
  - ti,iep
  - ti,ecap
  - ethernet-ports
  - interrupts
  - interrupt-names

allOf:
  - $ref: /schemas/remoteproc/ti,pru-consumer.yaml#

unevaluatedProperties: false

examples:
  - |
    /* Dual-MAC Ethernet application node on PRU-ICSS2 */
    pruss2_eth: pruss2-eth {
      compatible = "ti,am57-prueth";
      ti,prus = <&pru2_0>, <&pru2_1>;
      sram = <&ocmcram1>;
      ti,mii-rt = <&pruss2_mii_rt>;
      ti,iep = <&pruss2_iep>;
      ti,ecap = <&pruss2_ecap>;
      interrupts = <20 2 2>, <21 3 3>;
      interrupt-names = "rx_hp", "rx_lp";
      interrupt-parent = <&pruss2_intc>;

      ethernet-ports {
        #address-cells = <1>;
        #size-cells = <0>;
        pruss2_emac0: ethernet-port@0 {
          reg = <0>;
          phy-handle = <&pruss2_eth0_phy>;
          phy-mode = "mii";
          interrupts = <20 2 2>, <26 6 6>, <23 6 6>;
          interrupt-names = "rx", "emac_ptp_tx", "hsr_ptp_tx";
          /* Filled in by bootloader */
          local-mac-address = [00 00 00 00 00 00];
        };

        pruss2_emac1: ethernet-port@1 {
          reg = <1>;
          phy-handle = <&pruss2_eth1_phy>;
          phy-mode = "mii";
          interrupts = <21 3 3>, <27 9 7>, <24 9 7>;
          interrupt-names = "rx", "emac_ptp_tx", "hsr_ptp_tx";
          /* Filled in by bootloader */
          local-mac-address = [00 00 00 00 00 00];
        };
      };
    };
```

## Documentation/devicetree/bindings/net/ti,rpmsg-eth.yaml
```yaml
# SPDX-License-Identifier: GPL-2.0-only OR BSD-2-Clause
%YAML 1.2
---
$id: http://devicetree.org/schemas/net/ti,rpmsg-eth.yaml#
$schema: http://devicetree.org/meta-schemas/core.yaml#

title: Texas Instruments RPMsg channel nodes for Ethernet communication

description: |
  RPMsg Ethernet subnode represents the communication interface between host
  processor and a remote processor.

maintainers:
  - MD Danish Anwar <danishanwar@ti.com>

properties:
  memory-region:
    $ref: /schemas/types.yaml#/definitions/phandle
    description: |
      Phandle to the shared memory region used for communication between the
      host processor and the remote processor.
      This shared memory region is used to exchange Ethernet packets.

required:
  - memory-region

additionalProperties: false

examples:
  - |
    main_r5fss0_core0 {
        mboxes = <&mailbox0_cluster2 &mbox_main_r5fss0_core0>;
        memory-region = <&main_r5fss0_core0_dma_memory_region>,
                        <&main_r5fss0_core0_memory_region>;
        rpmsg-eth {
            memory-region = <&main_r5fss0_core0_memory_region_shm>;
        };
    };
```

## Documentation/devicetree/bindings/net/wireless/nordic,nrf70.yaml
```yaml
# SPDX-License-Identifier: (GPL-2.0-only OR BSD-2-Clause)
%YAML 1.2
---
$id: http://devicetree.org/schemas/net/wireless/nordic,nrf70.yaml#
$schema: http://devicetree.org/meta-schemas/core.yaml#

title: Nordic Semiconductor nRF70 series wireless companion IC

maintainers:
  - Artur Rojek <artur@conclusive.tech>

properties:
  compatible:
    const: nordic,nrf70

  reg:
    maxItems: 1

  interrupts:
    maxItems: 1
    description: HOST_IRQ line, used for host processor interrupt requests.

  interrupt-names:
    description: Name for the HOST_IRQ line. This must be set to "host-irq".
    const: host-irq

  vpwr-supply:
    description: BUCKEN line, used for PWR IP state control.

  vio-supply:
    description: IOVDD line, used for I/O pins voltage control. Optional.

required:
  - compatible
  - reg
  - interrupts
  - interrupt-names
  - vpwr-supply

allOf:
  - $ref: /schemas/spi/spi-peripheral-props.yaml#

unevaluatedProperties: false

examples:
  - |
    #include <dt-bindings/gpio/gpio.h>

    reg_nrf70_buck: regulator-nrf70-buck {
        compatible = "regulator-fixed";
        regulator-name = "nrf70_buck";
        gpio = <&gpio2 24 GPIO_ACTIVE_HIGH>;
        enable-active-high;
    };

    spi {
        #address-cells = <1>;
        #size-cells = <0>;

        nrf7002@0 {
            compatible = "nordic,nrf70";
            reg = <0>;
            spi-max-frequency = <32000000>;
            interrupt-parent = <&gpio2>;
            interrupts = <13 GPIO_ACTIVE_HIGH>;
            interrupt-names = "host-irq";
            vpwr-supply = <&reg_nrf70_buck>;
            spi-rx-bus-width = <4>;
            spi-tx-bus-width = <4>;
        };
    };
```

## Documentation/devicetree/bindings/net/wireless/qcom,ath12k-pci.yaml
```yaml
# SPDX-License-Identifier: (GPL-2.0-only OR BSD-2-Clause)
# Copyright (c) 2024 Linaro Limited
%YAML 1.2
---
$id: http://devicetree.org/schemas/net/wireless/qcom,ath12k-pci.yaml#
$schema: http://devicetree.org/meta-schemas/core.yaml#

title: Qualcomm Technologies ath12k wireless devices (PCIe)

maintainers:
  - Kalle Valo <kvalo@kernel.org>
  - Jeff Johnson <jjohnson@kernel.org>

description: |
  Qualcomm Technologies IEEE 802.11ax PCIe devices

properties:
  compatible:
    enum:
      - pci17cb,1107  # WCN7850

  reg:
    maxItems: 1

  qcom,ath12k-calibration-variant:
    $ref: /schemas/types.yaml#/definitions/string
    description: |
      string to uniquely identify variant of the calibration data for designs
      with colliding bus and device ids

required:
  - compatible
  - reg

additionalProperties: false

examples:
  - |
    pcie {
        #address-cells = <3>;
        #size-cells = <2>;

        pcie@0 {
            device_type = "pci";
            reg = <0x0 0x0 0x0 0x0 0x0>;
            #address-cells = <3>;
            #size-cells = <2>;
            ranges;

            bus-range = <0x01 0xff>;

            wifi@0 {
                compatible = "pci17cb,1107";
                reg = <0x10000 0x0 0x0 0x0 0x0>;

                qcom,ath12k-calibration-variant = "LES790";
            };
        };
    };
```
