## Documentation/devicetree/bindings/net/wireless/ralink,rt2800.yaml
```yaml
# SPDX-License-Identifier: (GPL-2.0-only OR BSD-2-Clause)
%YAML 1.2
---
$id: http://devicetree.org/schemas/net/wireless/ralink,rt2800.yaml#
$schema: http://devicetree.org/meta-schemas/core.yaml#

title: Ralink RT2800 wireless devices

maintainers:
  - Stanislaw Gruszka <stf_xl@wp.pl>

description: |
  This node provides properties for configuring RT2800 SOC wifi device.
  The node is expected to be specified as a root node of the device.

allOf:
  - $ref: ieee80211.yaml#

properties:
  compatible:
    enum:
      - ralink,rt2800-wifi

  reg:
    maxItems: 1

  clocks:
    maxItems: 1

  interrupt-parent:
    maxItems: 1

  interrupts:
    maxItems: 1

required:
  - compatible
  - reg

additionalProperties: false

examples:
    wifi@110180000 {
      compatible = "ralink,rt2880-wifi";
      reg = <0x10180000 0x40000>;
      clocks = <&sysc 16>;
      interrupt-parent = <&cpuintc>;
      interrupts = <6>;
    };
```

## Documentation/devicetree/bindings/net/wiznet,w5x00.yaml
```yaml
# SPDX-License-Identifier: (GPL-2.0-only OR BSD-2-Clause)
%YAML 1.2
---
$id: http://devicetree.org/schemas/net/wiznet,w5x00.yaml#
$schema: http://devicetree.org/meta-schemas/core.yaml#

title: Wiznet w5x00 SPI Ethernet Controller

description: |
  This is a standalone 10/100 MBit Ethernet controller with SPI interface.

  For each device connected to a SPI bus, define a child node within the SPI master node.

allOf:
  - $ref: /schemas/net/ethernet-controller.yaml#
  - $ref: /schemas/spi/spi-peripheral-props.yaml#

properties:
  compatible:
    enum:
      - wiznet,w5100
      - wiznet,w5200
      - wiznet,w5500

  reg:
    description: Specify the SPI chip select the chip is wired to.
    maxItems: 1
    minItems: 1

  interrupts:
    description:
      Specify the interrupt index within the interrupt controller (referred to
      above in interrupt-parent) and interrupt type. w5x00 natively generates
      falling edge interrupts, however, additional board logic might invert the
      signal.
    maxItems: 1
    minItems: 1

  pinctrl-names:
    description:
      List of assigned state names, see pinctrl binding documentation.
    enum:
      - default
    minItems: 1

  pinctrl-0:
    description:
      List of phandles to configure the GPIO pin used as interrupt line, see
      also generic and your platform specific pinctrl binding documentation.
    minItems: 1

  local-mac-address: true

  spi-max-frequency:
    description:
      Maximum frequency of the SPI bus when accessing the w5500. According to
      the w5500 datasheet, the chip allows a maximum of 80 MHz, however, board
      designs may need to limit this value.
    maximum: 80000000

  link-gpios:
    description: A GPIO line used for the link detection interrupt.
    maxItems: 1

required:
  - compatible
  - reg
  - interrupts
  - pinctrl-names
  - pinctrl-0

unevaluatedProperties: false

examples:
  - |
    /* Example (for Raspberry Pi with pin control stuff for GPIO irq) */

    #include <dt-bindings/gpio/gpio.h>
    #include <dt-bindings/interrupt-controller/irq.h>

    spi {
        #address-cells = <1>;
        #size-cells = <0>;

        ethernet@0: w5500@0 {
          compatible = "wiznet,w5500";
            reg = <0>;
            pinctrl-names = "default";
            pinctrl-0 = <&eth1_pins>;
            interrupt-parent = <&gpio>;
            interrupts = <25 IRQ_TYPE_EDGE_FALLING>;
            spi-max-frequency = <30000000>;
            link-gpios = <&gpio 4 GPIO_ACTIVE_HIGH>;
            local-mac-address = [ a0 b0 c0 d0 e0 f0 ];
        };
    };

    &gpio {
      eth1_pins: eth1_pins {
        brcm,pins = <25 4>;
        brcm,function = <0 0>; /* in */
        brcm,pull = <0 0>; /* none */
    };
```

## Documentation/devicetree/bindings/net/x-powers,ac200-ephy-ctl.yaml
```yaml
# SPDX-License-Identifier: (GPL-2.0-only OR BSD-2-Clause)
%YAML 1.2
---
$id: http://devicetree.org/schemas/net/x-powers,ac200-ephy-ctl.yaml#
$schema: http://devicetree.org/meta-schemas/core.yaml#

title: X-Powers AC200 Ethernet PHY control

maintainers:
  - James Hilliard <james.hilliard1@gmail.com>

description:
  The AC200 Ethernet PHY control function configures and powers the Fast
  Ethernet PHY in the AC200. Its registers are accessed through the parent
  AC200 I2C regmap.

properties:
  compatible:
    const: x-powers,ac200-ephy-ctl

  nvmem-cells:
    maxItems: 1
    description:
      Optional SoC SID cell containing the Ethernet PHY calibration value
      written to the AC200 BPS_EFFUSE field after adding 3 modulo 16, as
      prescribed by the vendor initialization sequence. If omitted, the
      driver reads the AC200's internal copy of the calibration eFuse.

  nvmem-cell-names:
    const: calibration

required:
  - compatible

dependentRequired:
  nvmem-cells: [ nvmem-cell-names ]

additionalProperties: false
...
```

## Documentation/devicetree/bindings/net/x-powers,ac300-ephy-ctl.yaml
```yaml
# SPDX-License-Identifier: (GPL-2.0-only OR BSD-2-Clause)
%YAML 1.2
---
$id: http://devicetree.org/schemas/net/x-powers,ac300-ephy-ctl.yaml#
$schema: http://devicetree.org/meta-schemas/core.yaml#

title: X-Powers AC300 Ethernet PHY control interface

maintainers:
  - James Hilliard <james.hilliard1@gmail.com>

description:
  The AC300 Fast Ethernet PHY has a separate control interface accessed as a
  non-PHY Clause 22 device. Its address is 16 plus the address of the link PHY.

properties:
  compatible:
    const: x-powers,ac300-ephy-ctl

  reg:
    minimum: 16
    maximum: 23

  clocks:
    maxItems: 1
    description:
      AC300 input clock. Its configured rate must be 24, 25, or 27 MHz and
      determines the corresponding EPHY_CLK_SEL value.

  vcc1-supply:
    description:
      3.3 V supply for the AC300 I/O, bandgap, Ethernet PHY analog front end,
      and internal digital LDO

  nvmem-cells:
    maxItems: 1
    description:
      SoC SID cell containing the Ethernet PHY calibration value written to
      the AC300 BGS_EFFUSE field after adding 3 modulo 16, as prescribed by
      the vendor initialization sequence.

  nvmem-cell-names:
    const: calibration

required:
  - compatible
  - reg
  - clocks
  - vcc1-supply
  - nvmem-cells
  - nvmem-cell-names

additionalProperties: false

examples:
  - |
    mdio {
        #address-cells = <1>;
        #size-cells = <0>;

        ethernet-phy-control@10 {
            compatible = "x-powers,ac300-ephy-ctl";
            reg = <0x10>;
            clocks = <&pwm 5>;
            vcc1-supply = <&reg_3v3>;
            nvmem-cells = <&ephy_calibration>;
            nvmem-cell-names = "calibration";
        };
    };
...
```

## Documentation/devicetree/bindings/net/x-powers,acx00-ephy-package.yaml
```yaml
# SPDX-License-Identifier: (GPL-2.0-only OR BSD-2-Clause)
%YAML 1.2
---
$id: http://devicetree.org/schemas/net/x-powers,acx00-ephy-package.yaml#
$schema: http://devicetree.org/meta-schemas/core.yaml#

title: X-Powers AC200 and AC300 Ethernet PHY packages

maintainers:
  - James Hilliard <james.hilliard1@gmail.com>

description:
  The AC200 and AC300 contain compatible Fast Ethernet PHY blocks which report
  the same Clause 22 PHY ID and use the same link-side register layout. The
  package control paths differ. AC200 control registers are part of an I2C MFD,
  while AC300 control registers occupy a second Clause 22 address fixed at 16
  plus the link PHY address.

  Systems with a known package use the corresponding AC200 or AC300 compatible.
  Systems which can contain either package use the ACx00 compatible and a
  packed NVMEM configuration field to select the backend at runtime.

  The link PHY cannot report its ID until the package control sequence has
  completed, so its child node supplies the documented PHY ID. The package and
  child use the same base address. The AC200 driver programs that address into
  the package, while the AC300 driver derives its control address from it.

select:
  properties:
    compatible:
      enum:
        - x-powers,ac200-ephy-package
        - x-powers,ac300-ephy-package
        - x-powers,acx00-ephy-package
  required:
    - compatible

properties:
  compatible:
    enum:
      - x-powers,ac200-ephy-package
      - x-powers,ac300-ephy-package
      - x-powers,acx00-ephy-package

  reg:
    maximum: 31

  clocks:
    maxItems: 1
    description:
      AC300 input clock, running at 24, 25, or 27 MHz. The AC200 input clock
      belongs to the referenced AC200 MFD instead.

  vcc1-supply:
    description:
      3.3 V supply for the AC300 I/O, bandgap, Ethernet PHY analog front end,
      and internal digital LDO

  nvmem-cells:
    maxItems: 1
    description:
      Packed EPHY configuration field. Bits 3 through 0 contain the analog
      calibration code, bits 7 through 4 are reserved, bit 8 selects AC300
      when set and AC200 when clear, and bit 9 requests the AC300
      low-calibration tuning sequence. A fixed AC200 package may provide only
      the low calibration bits or omit the cell and use its internal eFuse
      copy instead.

  nvmem-cell-names:
    const: configuration

  x-powers,ac200:
    $ref: /schemas/types.yaml#/definitions/phandle
    description: Reference to the AC200 MFD containing this Ethernet PHY

  x-powers,xmii-rx-clock-inverted:
    type: boolean
    description:
      Invert the xMII receive clock inside the PHY. This is required by some
      SoC integrations, including the Allwinner H6 AC200 connection.

patternProperties:
  ^ethernet-phy@[a-f0-9]+$:
    $ref: ethernet-phy.yaml#
    properties:
      compatible:
        const: ethernet-phy-id0044.1400
    required:
      - compatible
    unevaluatedProperties: false

required:
  - compatible

dependentRequired:
  nvmem-cells: [ nvmem-cell-names ]
  nvmem-cell-names: [ nvmem-cells ]

allOf:
  - $ref: ethernet-phy-package.yaml#
  - if:
      properties:
        compatible:
          const: x-powers,ac200-ephy-package
    then:
      properties:
        clocks: false
        vcc1-supply: false
      required:
        - x-powers,ac200
  - if:
      properties:
        compatible:
          const: x-powers,ac300-ephy-package
    then:
      properties:
        reg:
          maximum: 7
        x-powers,ac200: false
      required:
        - clocks
        - vcc1-supply
        - nvmem-cells
        - nvmem-cell-names
  - if:
      properties:
        compatible:
          const: x-powers,acx00-ephy-package
    then:
      properties:
        reg:
          maximum: 7
      required:
        - clocks
        - vcc1-supply
        - nvmem-cells
        - nvmem-cell-names
        - x-powers,ac200

unevaluatedProperties: false

examples:
  - |
    mdio {
        #address-cells = <1>;
        #size-cells = <0>;

        ethernet-phy-package@0 {
            compatible = "x-powers,acx00-ephy-package";
            reg = <0>;
            #address-cells = <1>;
            #size-cells = <0>;
            clocks = <&pwm 5>;
            vcc1-supply = <&reg_3v3>;
            nvmem-cells = <&ephy_configuration>;
            nvmem-cell-names = "configuration";
            x-powers,ac200 = <&ac200>;

            ethernet-phy@0 {
                compatible = "ethernet-phy-id0044.1400";
                reg = <0>;
            };
        };
    };

  - |
    mdio {
        #address-cells = <1>;
        #size-cells = <0>;

        ethernet-phy-package@0 {
            compatible = "x-powers,ac300-ephy-package";
            reg = <0>;
            #address-cells = <1>;
            #size-cells = <0>;
            clocks = <&pwm 5>;
            vcc1-supply = <&reg_3v3>;
            nvmem-cells = <&ephy_configuration>;
            nvmem-cell-names = "configuration";

            ethernet-phy@0 {
                compatible = "ethernet-phy-id0044.1400";
                reg = <0>;
            };
        };
    };

  - |
    mdio {
        #address-cells = <1>;
        #size-cells = <0>;

        ethernet-phy-package@1 {
            compatible = "x-powers,ac200-ephy-package";
            reg = <1>;
            #address-cells = <1>;
            #size-cells = <0>;
            x-powers,ac200 = <&ac200>;
            nvmem-cells = <&ephy_configuration>;
            nvmem-cell-names = "configuration";

            ethernet-phy@1 {
                compatible = "ethernet-phy-id0044.1400";
                reg = <1>;
            };
        };
    };
...
```

## Documentation/devicetree/bindings/net/x-powers,acx00-ephy.yaml
```yaml
# SPDX-License-Identifier: (GPL-2.0-only OR BSD-2-Clause)
%YAML 1.2
---
$id: http://devicetree.org/schemas/net/x-powers,acx00-ephy.yaml#
$schema: http://devicetree.org/meta-schemas/core.yaml#

title: X-Powers AC200 and AC300 Ethernet PHY

maintainers:
  - James Hilliard <james.hilliard1@gmail.com>

description:
  The AC200 and AC300 expose Fast Ethernet MDIO link interfaces which report
  the same PHY ID and use a compatible link-side paged register layout. Each
  package uses a different control interface to make its MDIO endpoint
  accessible. A fixed board references its enabled AC200 or AC300 control
  device. The PHY node's reg value is programmed through the AC200 interface;
  for AC300 it must match the address selected by the package straps.

select:
  properties:
    compatible:
      contains:
        const: ethernet-phy-id0044.1400
  required:
    - compatible
  anyOf:
    - required:
        - x-powers,ac200-control
    - required:
        - x-powers,ac300-control

properties:
  compatible:
    const: ethernet-phy-id0044.1400

  nvmem-cells:
    maxItems: 1
    description:
      Optional two-bit SoC SID configuration field. Bit 0 selects the package
      variant, with zero for AC200 and one for AC300, and must agree with the
      described control device. Bit 1 selects the AC300 vendor low-calibration
      tuning sequence. Omitting the field selects the normal tuning sequence
      without validating the package variant.

  nvmem-cell-names:
    const: configuration

  x-powers,ac200-control:
    $ref: /schemas/types.yaml#/definitions/phandle
    description: Reference to the AC200 Ethernet PHY control function

  x-powers,ac300-control:
    $ref: /schemas/types.yaml#/definitions/phandle
    description: Reference to the AC300 MDIO Ethernet PHY control device

  x-powers,xmii-rx-clock-inverted:
    type: boolean
    description:
      Invert the xMII receive clock inside the PHY. This is required by some
      SoC integrations, including the Allwinner H6 AC200 connection.

required:
  - compatible

oneOf:
  - properties:
      x-powers,ac300-control: false
    required:
      - x-powers,ac200-control
  - properties:
      x-powers,ac200-control: false
    required:
      - x-powers,ac300-control

dependentRequired:
  nvmem-cells: [ nvmem-cell-names ]

allOf:
  - $ref: ethernet-phy.yaml#
  - if:
      required:
        - x-powers,ac300-control
    then:
      properties:
        reg:
          maximum: 7

unevaluatedProperties: false

examples:
  - |
    mdio {
        #address-cells = <1>;
        #size-cells = <0>;

        ethernet-phy@0 {
            compatible = "ethernet-phy-id0044.1400";
            reg = <0>;
            nvmem-cells = <&ephy_configuration>;
            nvmem-cell-names = "configuration";
            x-powers,ac300-control = <&ac300_ephy_ctl>;
        };
    };

  - |
    mdio {
        #address-cells = <1>;
        #size-cells = <0>;

        ethernet-phy@1 {
            compatible = "ethernet-phy-id0044.1400";
            reg = <1>;
            x-powers,ac200-control = <&ac200_ephy_ctl>;
        };
    };
...
```
