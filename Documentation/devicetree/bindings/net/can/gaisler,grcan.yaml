## Documentation/devicetree/bindings/net/dsa/motorcomm,yt921x.yaml
```yaml
# SPDX-License-Identifier: (GPL-2.0-only OR BSD-2-Clause)
%YAML 1.2
---
$id: http://devicetree.org/schemas/net/dsa/motorcomm,yt921x.yaml#
$schema: http://devicetree.org/meta-schemas/core.yaml#

title: Motorcomm YT921x Ethernet switch family

maintainers:
  - David Yang <mmyangfl@gmail.com>

description: |
  The Motorcomm YT921x series is a family of Ethernet switches with up to 8
  internal GbE PHYs and up to 2 GMACs, including:

    - YT9215S / YT9215RB / YT9215SC: 5 GbE PHYs (Port 0-4) + 2 GMACs (Port 8-9)
    - YT9213NB: 2 GbE PHYs (Port 1/3) + 1 GMAC (Port 9)
    - YT9214NB: 2 GbE PHYs (Port 1/3) + 2 GMACs (Port 8-9)
    - YT9218N: 8 GbE PHYs (Port 0-7)
    - YT9218MB: 8 GbE PHYs (Port 0-7) + 2 GMACs (Port 8-9)

  Any port can be used as the CPU port.

properties:
  compatible:
    const: motorcomm,yt9215

  reg:
    maxItems: 1

  reset-gpios:
    maxItems: 1

  motorcomm,switch-id:
    $ref: /schemas/types.yaml#/definitions/uint32
    description: |
      Value selected by Pin SWITCH_ID_1 / SWITCH_ID_0.

      Up to 4 chips can share the same MII port ('reg' in DT) by giving
      different SWITCH_ID values. The default value should work if only one chip
      is present.
    enum: [0, 1, 2, 3]
    default: 0

  mdio:
    $ref: /schemas/net/mdio.yaml#
    unevaluatedProperties: false
    description: |
      Internal MDIO bus for the internal GbE PHYs. PHYs 0-7 are used for Port
      0-7 respectively.

  mdio-external:
    $ref: /schemas/net/mdio.yaml#
    unevaluatedProperties: false
    description: |
      External MDIO bus to access external components. External PHYs for GMACs
      (Port 8-9) are expected to be connected to the external MDIO bus in
      vendor's reference design, but that is not a hard limitation from the
      chip.

allOf:
  - $ref: dsa.yaml#/$defs/ethernet-ports

required:
  - compatible
  - reg

unevaluatedProperties: false

examples:
  - |
    #include <dt-bindings/gpio/gpio.h>

    mdio {
        #address-cells = <1>;
        #size-cells = <0>;

        switch@1d {
            compatible = "motorcomm,yt9215";
            /* default 0x1d, alternate 0x0 */
            reg = <0x1d>;
            motorcomm,switch-id = <0>;
            reset-gpios = <&tlmm 39 GPIO_ACTIVE_LOW>;

            mdio {
                #address-cells = <1>;
                #size-cells = <0>;

                sw_phy0: phy@0 {
                    reg = <0x0>;
                };
            };

            mdio-external {
                #address-cells = <1>;
                #size-cells = <0>;

                phy1: phy@b {
                    reg = <0xb>;
                };
            };

            ports {
                #address-cells = <1>;
                #size-cells = <0>;

                /* phy-handle is optional for internal PHYs */
                port@0 {
                    reg = <0>;
                    label = "lan1";
                    phy-mode = "internal";
                    phy-handle = <&sw_phy0>;
                };

                port@1 {
                    reg = <1>;
                    label = "lan2";
                    phy-mode = "internal";
                };

                port@2 {
                    reg = <2>;
                    label = "lan3";
                    phy-mode = "internal";
                };

                port@3 {
                    reg = <3>;
                    label = "lan4";
                    phy-mode = "internal";
                };

                port@4 {
                    reg = <4>;
                    label = "lan5";
                    phy-mode = "internal";
                };

                /* CPU port */
                port@8 {
                    reg = <8>;
                    phy-mode = "sgmii";
                    ethernet = <&eth0>;

                    fixed-link {
                        speed = <1000>;
                        full-duplex;
                        pause;
                        asym-pause;
                    };
                };

                /* if external phy is connected to a MAC */
                port@9 {
                    reg = <9>;
                    label = "wan";
                    phy-mode = "rgmii";
                    phy-handle = <&phy1>;
                };
            };
        };
    };
```

## Documentation/devicetree/bindings/net/dsa/nxp,imxrt1180-netc-switch.yaml
```yaml
# SPDX-License-Identifier: (GPL-2.0-only OR BSD-2-Clause)
%YAML 1.2
---
$id: http://devicetree.org/schemas/net/dsa/nxp,imxrt1180-netc-switch.yaml#
$schema: http://devicetree.org/meta-schemas/core.yaml#

title: NXP i.MX RT1180 NETC Ethernet Switch

description: |
  The NXP i.MX RT1180 integrates a TSN-capable NETC Ethernet switch.

  The i.MX RT1180 is an MCU and does not run Linux. In heterogeneous multi-SoC
  systems, the RT1180 runs firmware that manages the switch, while the host SoC
  runs Linux and exposes the switch ports using the DSA framework, with a
  dedicated CPU (conduit) port connected to a host Ethernet controller.

  The switch control plane is accessed through a management link to the
  companion MCU. Current systems may use SPI, but other transports may be used
  in the future (for example, in-band management over an Ethernet port).

maintainers:
  - Minghuan Lian <minghuan.lian@nxp.com>

allOf:
  # Base: always a DSA switch
  - $ref: /schemas/net/dsa/dsa.yaml#

  # If the SPI-specific compatible is used, allow SPI properties and require reg.
  - if:
      properties:
        compatible:
          type: array
          contains:
            const: nxp,imxrt1180-netc-switch-spi
    then:
      $ref: /schemas/spi/spi-peripheral-props.yaml#
      required:
        - reg

properties:
  compatible:
    oneOf:
      # SPI-attached switch representation (current integration)
      - items:
          - const: nxp,imxrt1180-netc-switch-spi
          - const: nxp,imxrt1180-netc-switch
      # Transport-agnostic representation (future integration)
      - const: nxp,imxrt1180-netc-switch

  reg:
    description: |
      SPI chip select number (only for SPI-attached deployments).
    maxItems: 1

required:
  - compatible

unevaluatedProperties: false

examples:
  - |
    spi {
        #address-cells = <1>;
        #size-cells = <0>;

        ethernet-switch@0 {
            compatible = "nxp,imxrt1180-netc-switch-spi",
                         "nxp,imxrt1180-netc-switch";
            reg = <0>;
            spi-max-frequency = <12000000>;

            ports {
                #address-cells = <1>;
                #size-cells = <0>;

                port@0 {
                    reg = <0>;
                    label = "hms0p0";
                    phy-mode = "internal";
                    fixed-link {
                        speed = <100>;
                        full-duplex;
                    };
                };

                port@1 {
                    reg = <1>;
                    label = "hms0p1";
                    phy-mode = "internal";
                    fixed-link {
                        speed = <1000>;
                        full-duplex;
                    };
                };

                port@2 {
                    reg = <2>;
                    label = "hms0p2";
                    phy-mode = "internal";
                    fixed-link {
                        speed = <1000>;
                        full-duplex;
                    };
                };

                port@3 {
                    reg = <3>;
                    label = "cpu";
                    ethernet = <&eth0>;
                    phy-mode = "internal";
                    fixed-link {
                        speed = <1000>;
                        full-duplex;
                    };
                };
            };
        };
    };
```

## Documentation/devicetree/bindings/net/eswin,eic7700-eth.yaml
```yaml
# SPDX-License-Identifier: (GPL-2.0-only OR BSD-2-Clause)
%YAML 1.2
---
$id: http://devicetree.org/schemas/net/eswin,eic7700-eth.yaml#
$schema: http://devicetree.org/meta-schemas/core.yaml#

title: Eswin EIC7700 SOC Eth Controller

maintainers:
  - Shuang Liang <liangshuang@eswincomputing.com>
  - Zhi Li <lizhi2@eswincomputing.com>
  - Shangjuan Wei <weishangjuan@eswincomputing.com>

description:
  The eth controller registers are part of the syscrg block on
  the EIC7700 SoC.

select:
  properties:
    compatible:
      contains:
        enum:
          - eswin,eic7700-qos-eth
  required:
    - compatible

allOf:
  - $ref: snps,dwmac.yaml#

properties:
  compatible:
    items:
      - const: eswin,eic7700-qos-eth
      - const: snps,dwmac-5.20

  reg:
    minItems: 1

  interrupt-names:
    const: macirq

  interrupts:
    maxItems: 1

  phy-mode:
    $ref: /schemas/types.yaml#/definitions/string
    enum:
      - rgmii
      - rgmii-rxid
      - rgmii-txid
      - rgmii-id

  phy-handle:
    $ref: /schemas/types.yaml#/definitions/phandle
    description: Reference to the PHY device

  clocks:
    minItems: 2
    maxItems: 2

  clock-names:
    minItems: 2
    maxItems: 2
    contains:
      enum:
        - stmmaceth
        - tx

  resets:
    maxItems: 1

  reset-names:
    items:
      - const: stmmaceth

  rx-internal-delay-ps:
    description:
      RGMII Receive Clock Delay defined in pico seconds. This is used for
      controllers that have configurable RX internal delays. If this
      property is present then the MAC applies the RX delay.

  tx-internal-delay-ps:
    description:
      RGMII Transmit Clock Delay defined in pico seconds. This is used for
      controllers that have configurable TX internal delays. If this
      property is present then the MAC applies the TX delay.

  eswin,hsp-sp-csr:
    $ref: /schemas/types.yaml#/definitions/phandle-array
    items:
      - description: Phandle to HSP(High-Speed Peripheral) device
      - description: Control register offset
      - description: Status register offset
      - description: Interrupt register offset
    description: |
      A phandle to hsp-sp-csr with three arguments that configure
      HSP(High-Speed Peripheral) device. The argument one is the
      offset of control register, the argument two is the offset
      of status register, the argument three is the offset of
      interrupt register.

  eswin,syscrg-csr:
    $ref: /schemas/types.yaml#/definitions/phandle-array
    items:
      - description:
          Phandle to system CRG(System Clock and Reset Generator)
          device
      - description: Clock control register offset
      - description: Reset control register offset
    description: |
      A phandle to syscrg-csr with two arguments that configure
      CRG(System Clock and Reset Generator) device. The argument
      one is the offset of clock control register, the argument
      two is the offset of reset control register.

  eswin,dly-hsp-reg:
    $ref: /schemas/types.yaml#/definitions/uint32-array
    items:
      - description: Control the delay of TXD
      - description: Control the CLK delay of TX and RX
      - description: Control the delay of RXD
    description: |
      An array to dly-hsp-reg with three arguments that
      configure delay. The argument one is used to control the
      delay of TXD, the argument two is used to control the
      CLK delay of TX and RX, the argument three is used to
      control the delay of RXD.

required:
  - compatible
  - reg
  - interrupt-names
  - interrupts
  - phy-mode
  - rx-internal-delay-ps
  - tx-internal-delay-ps
  - clocks
  - clock-names
  - resets
  - reset-names
  - eswin,hsp-sp-csr
  - eswin,syscrg-csr
  - eswin,dly-hsp-reg

unevaluatedProperties: false

examples:
  - |
    ethernet@50400000 {
        compatible = "eswin,eic7700-qos-eth", "snps,dwmac-5.20";
        reg = <0x50400000 0x10000>;
        interrupt-parent = <&plic>;
        interrupt-names = "macirq";
        interrupts = <61>;
        phy-mode = "rgmii";
        phy-handle = <&phy0>;
        rx-internal-delay-ps = <9000>;
        tx-internal-delay-ps = <2200>;
        clocks = <&clock 417>, <&clock 418>;
        clock-names = "stmmaceth", "tx";
        resets = <&reset 95>;
        reset-names = "stmmaceth";
        eswin,hsp-sp-csr = <&hsp_sp_csr 0x1030 0x100 0x108>;
        eswin,syscrg-csr = <&sys_crg 0x148 0x14c>;
        eswin,dly-hsp-reg = <0x114 0x118 0x11c>;
        snps,axi-config = <&stmmac_axi_setup>;
        snps,fixed-burst;
        snps,aal;
        snps,tso;
        stmmac_axi_setup: stmmac-axi-config {
            snps,blen = <0 0 0 0 16 8 4>;
            snps,rd_osr_lmt = <2>;
            snps,wr_osr_lmt = <2>;
        };
    };
```

## Documentation/devicetree/bindings/net/ethernet-connector.yaml
```yaml
# SPDX-License-Identifier: (GPL-2.0-only OR BSD-2-Clause)
%YAML 1.2
---
$id: http://devicetree.org/schemas/net/ethernet-connector.yaml#
$schema: http://devicetree.org/meta-schemas/core.yaml#

title: Generic Ethernet Connector

maintainers:
  - Maxime Chevallier <maxime.chevallier@bootlin.com>

description:
  An Ethernet Connectr represents the output of a network component such as
  a PHY, an Ethernet controller with no PHY, or an SFP module.

properties:

  lanes:
    description:
      Defines the number of lanes on the port, that is the number of physical
      channels used to convey the data with the link partner.
    $ref: /schemas/types.yaml#/definitions/uint32

  media:
    description:
      The mediums, as defined in 802.3, that can be used on the port.
    items:
      enum:
        - BaseT
        - BaseK
        - BaseS
        - BaseC
        - BaseL
        - BaseD
        - BaseE
        - BaseF
        - BaseV
        - BaseMLD
        - BaseX

required:
  - lanes
  - media

additionalProperties: true

...
```

## Documentation/devicetree/bindings/net/ethernet-phy-package.yaml
```yaml
# SPDX-License-Identifier: GPL-2.0-only OR BSD-2-Clause
%YAML 1.2
---
$id: http://devicetree.org/schemas/net/ethernet-phy-package.yaml#
$schema: http://devicetree.org/meta-schemas/core.yaml#

title: Ethernet PHY Package Common Properties

maintainers:
  - Christian Marangi <ansuelsmth@gmail.com

select:
  properties:
    $nodename:
      pattern: "^ethernet-phy-package(@[a-f0-9]+)?$"

  required:
    - $nodename

properties:
  $nodename:
    pattern: "^ethernet-phy-package(@[a-f0-9]+)?$"

  reg:
    minimum: 0
    maximum: 31
    description:
      The ID number for the PHY.

  '#address-cells':
    const: 1

  '#size-cells':
    const: 0

patternProperties:
  ^ethernet-phy(@[a-f0-9]+)?$:
    $ref: /schemas/net/ethernet-phy.yaml#

required:
  - reg

additionalProperties: true

examples:
  - |
    mdio {
        #address-cells = <1>;
        #size-cells = <0>;

        ethernet-phy-package@0 {
            #address-cells = <1>;
            #size-cells = <0>;
            reg = <0>;

            ethernet-phy@0 {
              compatible = "ethernet-phy-ieee802.3-c22";
              reg = <0>;
            };

            phy4: ethernet-phy@4 {
              compatible = "ethernet-phy-ieee802.3-c22";
              reg = <4>;
            };
        };
    };
```
