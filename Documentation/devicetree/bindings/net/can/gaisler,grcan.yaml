## Documentation/devicetree/bindings/net/dsa/airoha,an8855.yaml
```yaml
# SPDX-License-Identifier: (GPL-2.0-only OR BSD-2-Clause)
%YAML 1.2
---
$id: http://devicetree.org/schemas/net/dsa/airoha,an8855.yaml#
$schema: http://devicetree.org/meta-schemas/core.yaml#

title: Airoha AN8855 Gigabit switch

maintainers:
  - Christian Marangi <ansuelsmth@gmail.com>

description:
  Airoha AN8855 is a 5-port Gigabit Switch.

  The switch node requires an additional mdio node to describe each internal
  PHY relative offset as the PHY address for the switch match the one for
  the PHY ports. On top of internal PHY address, the switch base PHY address
  is added.

  Also the switch base PHY address can be configured and changed after the
  first initialization. On reset, the switch PHY address is ALWAYS 1.

properties:
  compatible:
    const: airoha,an8855

  reg:
    maxItems: 1

  reset-gpios:
    description:
      GPIO to be used to reset the whole device
    maxItems: 1

  airoha,base_smi_address:
    $ref: /schemas/types.yaml#/definitions/uint32
    description:
      Configure and change the base switch PHY address to a new address on
      the bus.
      On reset, the switch PHY address is ALWAYS 1.
    default: 1
    maximum: 31

  airoha,ext_surge:
    $ref: /schemas/types.yaml#/definitions/flag
    description:
      Calibrate the internal PHY with the calibration values stored in EFUSE
      for the r50Ohm values.

  mdio:
    $ref: /schemas/net/mdio.yaml#
    unevaluatedProperties: false
    description: Define the relative address of the internal PHY for each port.
      Each reg for the PHY is relative to the switch base PHY address.

$ref: dsa.yaml#

required:
  - compatible
  - reg

unevaluatedProperties: false

examples:
  - |
    #include <dt-bindings/gpio/gpio.h>

    mdio {
        #address-cells = <1>;
        #size-cells = <0>;

        switch@1 {
            compatible = "airoha,an8855";
            reg = <1>;
            reset-gpios = <&pio 39 0>;

            airoha,ext_surge;

            ports {
                #address-cells = <1>;
                #size-cells = <0>;

                port@0 {
                    reg = <0>;
                    label = "lan1";
                    phy-mode = "internal";
                    phy-handle = <&internal_phy0>;
                };

                port@1 {
                    reg = <1>;
                    label = "lan2";
                    phy-mode = "internal";
                    phy-handle = <&internal_phy1>;
                };

                port@2 {
                    reg = <2>;
                    label = "lan3";
                    phy-mode = "internal";
                    phy-handle = <&internal_phy2>;
                };

                port@3 {
                    reg = <3>;
                    label = "lan4";
                    phy-mode = "internal";
                    phy-handle = <&internal_phy3>;
                };

                port@5 {
                    reg = <5>;
                    label = "cpu";
                    ethernet = <&gmac0>;
                    phy-mode = "2500base-x";

                    fixed-link {
                        speed = <2500>;
                        full-duplex;
                        pause;
                    };
                };
            };

            mdio {
                #address-cells = <1>;
                #size-cells = <0>;

                internal_phy0: phy@0 {
                    reg = <0>;
                };

                internal_phy1: phy@1 {
                    reg = <1>;
                };

                internal_phy2: phy@2 {
                    reg = <2>;
                };

                internal_phy3: phy@3 {
                    reg = <3>;
                };
            };
        };
    };
```

## Documentation/devicetree/bindings/net/dsa/marvell,mv88e6xxx.yaml
```yaml
# SPDX-License-Identifier: (GPL-2.0-only OR BSD-2-Clause)
%YAML 1.2
---
$id: http://devicetree.org/schemas/net/dsa/marvell,mv88e6xxx.yaml#
$schema: http://devicetree.org/meta-schemas/core.yaml#

title: Marvell MV88E6xxx DSA switch family

maintainers:
  - Andrew Lunn <andrew@lunn.ch>

description:
  The Marvell MV88E6xxx switch series has been produced and sold
  by Marvell since at least 2010. The switch has a few compatibles which
  just indicate the base address of the switch, then operating systems
  can investigate switch ID registers to find out which actual version
  of the switch it is dealing with.

properties:
  compatible:
    oneOf:
      - enum:
          - marvell,mv88e6085
          - marvell,mv88e6190
          - marvell,mv88e6250
    description: |
      marvell,mv88e6085: This switch uses base address 0x10.
        This switch and its siblings will be autodetected from
        ID registers found in the switch, so only "marvell,mv88e6085" should be
        specified. This includes the following list of MV88Exxxx switches:
        6085, 6095, 6097, 6123, 6131, 6141, 6161, 6165, 6171, 6172, 6175, 6176,
        6185, 6240, 6320, 6321, 6341, 6350, 6351, 6352
      marvell,mv88e6190: This switch uses base address 0x00.
        This switch and its siblings will be autodetected from
        ID registers found in the switch, so only "marvell,mv88e6190" should be
        specified. This includes the following list of MV88Exxxx switches:
        6190, 6190X, 6191, 6290, 6361, 6390, 6390X
      marvell,mv88e6250: This switch uses base address 0x08 or 0x18.
        This switch and its siblings will be autodetected from
        ID registers found in the switch, so only "marvell,mv88e6250" should be
        specified. This includes the following list of MV88Exxxx switches:
        6220, 6250

  reg:
    maxItems: 1

  eeprom-length:
    $ref: /schemas/types.yaml#/definitions/uint32
    description: Set to the length of an EEPROM connected to the switch. Must be
      set if the switch can not detect the presence and/or size of a connected
      EEPROM, otherwise optional.

  reset-gpios:
    description:
      GPIO to be used to reset the whole device
    maxItems: 1

  interrupts:
    description: The switch provides an external interrupt line, but it is
      not always used by target systems.
    maxItems: 1

  interrupt-controller:
    description: The switch has an internal interrupt controller used by
      the different sub-blocks.

  '#interrupt-cells':
    description: The internal interrupt controller only supports triggering
      on active high level interrupts so the second cell must alway be set to
      IRQ_TYPE_LEVEL_HIGH.
    const: 2

  mdio:
    $ref: /schemas/net/mdio.yaml#
    unevaluatedProperties: false
    description: Marvell MV88E6xxx switches have an varying combination of
    internal and external MDIO buses, in some cases a combined bus that
    can be used both internally and externally. This node is for the
    primary bus, used internally and sometimes also externally.

  mdio-external:
    $ref: /schemas/net/mdio.yaml#
    unevaluatedProperties: false
    description: Marvell MV88E6xxx switches that have a separate external
      MDIO bus use this port to access external components on the MDIO bus.

    properties:
      compatible:
        const: marvell,mv88e6xxx-mdio-external

    required:
      - compatible

$ref: dsa.yaml#

patternProperties:
  "^(ethernet-)?ports$":
    type: object
    patternProperties:
      "^(ethernet-)?port@[0-9]+$":
        type: object
        description: Ethernet switch ports

        $ref: dsa-port.yaml#

        unevaluatedProperties: false

oneOf:
  - required:
      - ports
  - required:
      - ethernet-ports

required:
  - compatible
  - reg

unevaluatedProperties: false

examples:
  - |
    #include <dt-bindings/gpio/gpio.h>
    #include <dt-bindings/interrupt-controller/irq.h>
    mdio {
        #address-cells = <1>;
        #size-cells = <0>;

        switch0: switch@0 {
            compatible = "marvell,mv88e6085";
            reg = <0>;
            reset-gpios = <&gpio5 1 GPIO_ACTIVE_LOW>;
            interrupt-parent = <&gpio0>;
            interrupts = <27 IRQ_TYPE_LEVEL_LOW>;
            interrupt-controller;
            #interrupt-cells = <2>;

            ports {
                #address-cells = <1>;
                #size-cells = <0>;

                port@0 {
                    reg = <0>;
                    label = "lan1";
                };
                port@1 {
                    reg = <1>;
                    label = "lan2";
                };
                port@2 {
                    reg = <2>;
                    label = "lan3";
                };
                port@3 {
                    reg = <3>;
                    label = "lan4";
                };
                port@4 {
                    reg = <4>;
                    label = "wan";
                };

                port@5 {
                    reg = <5>;
                    phy-mode = "sgmii";
                    ethernet = <&eth2>;

                    fixed-link {
                        speed = <1000>;
                        full-duplex;
                    };
                };
            };

            mdio {
                #address-cells = <1>;
                #size-cells = <0>;
                switch0phy0: switch0phy@0 {
                    reg = <0>;
                    interrupt-parent = <&switch0>;
                    interrupts = <0 IRQ_TYPE_LEVEL_HIGH>;
                };
            };
        };
    };

  - |
    #include <dt-bindings/gpio/gpio.h>
    #include <dt-bindings/interrupt-controller/irq.h>
    mdio {
        #address-cells = <1>;
        #size-cells = <0>;

        switch1: switch@0 {
            compatible = "marvell,mv88e6190";
            reg = <0>;
            reset-gpios = <&gpio5 1 GPIO_ACTIVE_LOW>;
            interrupt-parent = <&gpio0>;
            interrupts = <27 IRQ_TYPE_LEVEL_LOW>;
            interrupt-controller;
            #interrupt-cells = <2>;

            ports {
                #address-cells = <1>;
                #size-cells = <0>;

                port@0 {
                    reg = <0>;
                    label = "lan1";
                };
                port@1 {
                    reg = <1>;
                    label = "lan2";
                };
                port@2 {
                    reg = <2>;
                    label = "lan3";
                };
                port@3 {
                    reg = <3>;
                    label = "lan4";
                };
            };

            mdio {
                #address-cells = <1>;
                #size-cells = <0>;
                switch1phy0: switch1phy@0 {
                    reg = <0>;
                    interrupt-parent = <&switch1>;
                    interrupts = <0 IRQ_TYPE_LEVEL_HIGH>;
                };
            };

            mdio-external {
                compatible = "marvell,mv88e6xxx-mdio-external";
                #address-cells = <1>;
                #size-cells = <0>;
                switch1phy9: switch1phy@9 {
                    reg = <9>;
                };
            };
        };
    };
```

## Documentation/devicetree/bindings/net/dsa/mediatek,mt7628-esw.yaml
```yaml
# SPDX-License-Identifier: (GPL-2.0-only OR BSD-2-Clause)
%YAML 1.2
---
$id: http://devicetree.org/schemas/net/dsa/mediatek,mt7628-esw.yaml#
$schema: http://devicetree.org/meta-schemas/core.yaml#

title: Mediatek MT7628 Embedded Ethernet Switch

maintainers:
  - Joris Vaisvila <joey@tinyisr.com>

description:
  The MT7628 SoC's built-in Ethernet Switch is a five port switch with
  integrated 10/100 PHYs. The switch registers are directly mapped in the SoC's
  memory. The switch has an internally connected 1G CPU port and 5 user ports
  connected to the built-in Fast Ethernet PHYs.

unevaluatedProperties: false

allOf:
  - $ref: dsa.yaml#/$defs/ethernet-ports

properties:
  compatible:
    const: mediatek,mt7628-esw

  reg:
    maxItems: 1

  resets:
    items:
      - description: internal switch block reset
      - description: internal phy package reset

  reset-names:
    items:
      - const: esw
      - const: ephy

  mdio:
    $ref: /schemas/net/mdio.yaml#
    unevaluatedProperties: false

required:
  - compatible
  - reg
  - resets
  - reset-names
  - ethernet-ports

examples:
  - |
    switch0: switch@10110000 {
        compatible = "mediatek,mt7628-esw";

        reg = <0x10110000 0x8000>;

        resets = <&sysc 23>, <&sysc 24>;
        reset-names = "esw", "ephy";

        ethernet-ports {
            #address-cells = <1>;
            #size-cells = <0>;

            ethernet-port@0 {
                reg = <0>;
                phy-mode = "internal";
            };

            ethernet-port@1 {
                reg = <1>;
                phy-mode = "internal";
            };

            ethernet-port@2 {
                reg = <2>;
                phy-mode = "internal";
            };

            ethernet-port@3 {
                reg = <3>;
                phy-mode = "internal";
            };

            ethernet-port@4 {
                reg = <4>;
                phy-mode = "internal";
            };

            ethernet-port@6 {
                reg = <6>;
                phy-mode = "internal";
                ethernet = <&ethernet>;

                fixed-link {
                    speed = <1000>;
                    full-duplex;
                };
            };
        };
    };
```

## Documentation/devicetree/bindings/net/dsa/micrel,ks8995.yaml
```yaml
# SPDX-License-Identifier: (GPL-2.0-only OR BSD-2-Clause)
%YAML 1.2
---
$id: http://devicetree.org/schemas/net/dsa/micrel,ks8995.yaml#
$schema: http://devicetree.org/meta-schemas/core.yaml#

title: Micrel KS8995 Family DSA Switches

maintainers:
  - Linus Walleij <linus.walleij@linaro.org>

description:
  The Micrel KS8995 DSA Switches were produced in the early-to-mid 2000s.
  The chip features a CPU port and four outgoing ports, each with an
  internal PHY. The chip is managed over SPI.

properties:
  compatible:
    enum:
      - micrel,ks8995
      - micrel,ksz8795
      - micrel,ksz8864

  reg:
    maxItems: 1

  reset-gpios:
    description: GPIO to be used to reset the whole device
    maxItems: 1

allOf:
  - $ref: dsa.yaml#/$defs/ethernet-ports
  - $ref: /schemas/spi/spi-peripheral-props.yaml#

required:
  - compatible
  - reg

unevaluatedProperties: false

examples:
  - |
    #include <dt-bindings/gpio/gpio.h>

    spi {
      #address-cells = <1>;
      #size-cells = <0>;

      ethernet-switch@0 {
        compatible = "micrel,ks8995";
        reg = <0>;
        spi-max-frequency = <25000000>;

        ethernet-ports {
          #address-cells = <1>;
          #size-cells = <0>;

          ethernet-port@0 {
            reg = <0>;
            label = "lan1";
          };
          ethernet-port@1 {
            reg = <1>;
            label = "lan2";
          };
          ethernet-port@2 {
            reg = <2>;
            label = "lan3";
          };
          ethernet-port@3 {
            reg = <3>;
            label = "lan4";
          };
          ethernet-port@4 {
            reg = <4>;
            ethernet = <&gmac1>;
            phy-mode = "rgmii-id";
            fixed-link {
              speed = <1000>;
              full-duplex;
              pause;
            };
          };
        };
      };
    };
```
