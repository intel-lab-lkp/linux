## Documentation/devicetree/bindings/net/ethernet-port.yaml
```yaml
# SPDX-License-Identifier: (GPL-2.0-only OR BSD-2-Clause)
%YAML 1.2
---
$id: http://devicetree.org/schemas/net/ethernet-port.yaml#
$schema: http://devicetree.org/meta-schemas/core.yaml#

title: Generic Ethernet Port

maintainers:
  - Maxime Chevallier <maxime.chevallier@bootlin.com>

description:
  An Ethernet port represents an output, such as a connector, of a network
  component such as a PHY, an Ethernet controller with no PHY, or an SFP module.

properties:

  lanes:
    description:
      Defines the number of lanes on the port, that is the number of physical
      channels used to convey the data with the link partner.
    $ref: /schemas/types.yaml#/definitions/uint32

  media:
    description:
      The mediums, as defined in 802.3, that can be used on the port.
    items:
      enum:
        - BaseT
        - BaseK
        - BaseS
        - BaseC
        - BaseL
        - BaseD
        - BaseE
        - BaseF
        - BaseV
        - BaseMLD
        - BaseX

required:
  - lanes
  - media

additionalProperties: true

...
```

## Documentation/devicetree/bindings/net/fsl,fman.yaml
```yaml
# SPDX-License-Identifier: (GPL-2.0-only OR BSD-2-Clause)
%YAML 1.2
---
$id: http://devicetree.org/schemas/net/fsl,fman.yaml#
$schema: http://devicetree.org/meta-schemas/core.yaml#

title: Freescale Frame Manager Device

maintainers:
  - Frank Li <Frank.Li@nxp.com>

description:
  Due to the fact that the FMan is an aggregation of sub-engines (ports, MACs,
  etc.) the FMan node will have child nodes for each of them.

properties:
  compatible:
    enum:
      - fsl,fman
    description:
      FMan version can be determined via FM_IP_REV_1 register in the
      FMan block. The offset is 0xc4 from the beginning of the
      Frame Processing Manager memory map (0xc3000 from the
      beginning of the FMan node).

  cell-index:
    $ref: /schemas/types.yaml#/definitions/uint32
    description: |
      Specifies the index of the FMan unit.

      The cell-index value may be used by the SoC, to identify the
      FMan unit in the SoC memory map. In the table below,
      there's a description of the cell-index use in each SoC:

      - P1023:
      register[bit]      FMan unit  cell-index
      ============================================================
      DEVDISR[1]      1    0

      - P2041, P3041, P4080 P5020, P5040:
      register[bit]      FMan unit  cell-index
      ============================================================
      DCFG_DEVDISR2[6]    1    0
      DCFG_DEVDISR2[14]    2    1
        (Second FM available only in P4080 and P5040)

      - B4860, T1040, T2080, T4240:
      register[bit]      FMan unit  cell-index
      ============================================================
      DCFG_CCSR_DEVDISR2[24]    1    0
      DCFG_CCSR_DEVDISR2[25]    2    1
        (Second FM available only in T4240)

      DEVDISR, DCFG_DEVDISR2 and DCFG_CCSR_DEVDISR2 are located in
      the specific SoC "Device Configuration/Pin Control" Memory
      Map.

  reg:
    items:
      - description: BMI configuration registers.
      - description: QMI configuration registers.
      - description: DMA configuration registers.
      - description: FPM configuration registers.
      - description: FMan controller configuration registers.
    minItems: 1

  ranges: true

  clocks:
    maxItems: 1

  clock-names:
    items:
      - const: fmanclk

  interrupts:
    items:
      - description: The first element is associated with the event interrupts.
      - description: the second element is associated with the error interrupts.

  fsl,qman-channel-range:
    $ref: /schemas/types.yaml#/definitions/uint32-array
    description:
      Specifies the range of the available dedicated
      channels in the FMan. The first cell specifies the beginning
      of the range and the second cell specifies the number of
      channels
    items:
      - description: The first cell specifies the beginning of the range.
      - description: |
          The second cell specifies the number of channels.
          Further information available at:
          "Work Queue (WQ) Channel Assignments in the QMan" section
          in DPAA Reference Manual.

  fsl,qman:
    $ref: /schemas/types.yaml#/definitions/phandle
    description: See soc/fsl/qman.txt

  fsl,bman:
    $ref: /schemas/types.yaml#/definitions/phandle
    description: See soc/fsl/bman.txt

  fsl,erratum-a050385:
    $ref: /schemas/types.yaml#/definitions/flag
    description: A boolean property. Indicates the presence of the
      erratum A050385 which indicates that DMA transactions that are
      split can result in a FMan lock.

  "#address-cells": true

  "#size-cells": true

patternProperties:
  '^muram@[a-f0-9]+$':
    $ref: fsl,fman-muram.yaml

  '^port@[a-f0-9]+$':
    $ref: fsl,fman-port.yaml

  '^ethernet@[a-f0-9]+$':
    $ref: fsl,fman-dtsec.yaml

  '^mdio@[a-f0-9]+$':
    $ref: fsl,fman-mdio.yaml

  '^ptp\-timer@[a-f0-9]+$':
    $ref: /schemas/ptp/ptp-qoriq.yaml

required:
  - compatible
  - cell-index
  - reg
  - ranges
  - clocks
  - clock-names
  - interrupts
  - fsl,qman-channel-range

additionalProperties: false

examples:
  - |
    fman@400000 {
        #address-cells = <1>;
        #size-cells = <1>;
        cell-index = <1>;
        compatible = "fsl,fman";
        ranges = <0 0x400000 0x100000>;
        reg = <0x400000 0x100000>;
        clocks = <&fman_clk>;
        clock-names = "fmanclk";
        interrupts = <96 2>,
                     <16 2>;
        fsl,qman-channel-range = <0x40 0xc>;

        muram@0 {
            compatible = "fsl,fman-muram";
            reg = <0x0 0x28000>;
            ranges = <0x0 0x0 0x1000 0x1000>;
        };

        port@81000 {
            cell-index = <1>;
            compatible = "fsl,fman-v2-port-oh";
            reg = <0x81000 0x1000>;
        };

        port@82000 {
            cell-index = <2>;
            compatible = "fsl,fman-v2-port-oh";
            reg = <0x82000 0x1000>;
        };

        port@83000 {
            cell-index = <3>;
            compatible = "fsl,fman-v2-port-oh";
            reg = <0x83000 0x1000>;
        };

        port@84000 {
            cell-index = <4>;
            compatible = "fsl,fman-v2-port-oh";
            reg = <0x84000 0x1000>;
        };

        port@85000 {
            cell-index = <5>;
            compatible = "fsl,fman-v2-port-oh";
            reg = <0x85000 0x1000>;
        };

        port@86000 {
            cell-index = <6>;
            compatible = "fsl,fman-v2-port-oh";
            reg = <0x86000 0x1000>;
        };

        fman1_rx_0x8: port@88000 {
            cell-index = <0x8>;
            compatible = "fsl,fman-v2-port-rx";
            reg = <0x88000 0x1000>;
        };

        fman1_rx_0x9: port@89000 {
            cell-index = <0x9>;
            compatible = "fsl,fman-v2-port-rx";
            reg = <0x89000 0x1000>;
        };

        fman1_rx_0xa: port@8a000 {
            cell-index = <0xa>;
            compatible = "fsl,fman-v2-port-rx";
            reg = <0x8a000 0x1000>;
        };

        fman1_rx_0xb: port@8b000 {
            cell-index = <0xb>;
            compatible = "fsl,fman-v2-port-rx";
            reg = <0x8b000 0x1000>;
        };

        fman1_rx_0xc: port@8c000 {
            cell-index = <0xc>;
            compatible = "fsl,fman-v2-port-rx";
            reg = <0x8c000 0x1000>;
        };

        fman1_rx_0x10: port@90000 {
            cell-index = <0x10>;
            compatible = "fsl,fman-v2-port-rx";
            reg = <0x90000 0x1000>;
        };

        fman1_tx_0x28: port@a8000 {
            cell-index = <0x28>;
            compatible = "fsl,fman-v2-port-tx";
            reg = <0xa8000 0x1000>;
        };

        fman1_tx_0x29: port@a9000 {
            cell-index = <0x29>;
            compatible = "fsl,fman-v2-port-tx";
            reg = <0xa9000 0x1000>;
        };

        fman1_tx_0x2a: port@aa000 {
            cell-index = <0x2a>;
            compatible = "fsl,fman-v2-port-tx";
            reg = <0xaa000 0x1000>;
        };

        fman1_tx_0x2b: port@ab000 {
            cell-index = <0x2b>;
            compatible = "fsl,fman-v2-port-tx";
            reg = <0xab000 0x1000>;
        };

        fman1_tx_0x2c: port@ac0000 {
            cell-index = <0x2c>;
            compatible = "fsl,fman-v2-port-tx";
            reg = <0xac000 0x1000>;
        };

        fman1_tx_0x30: port@b0000 {
            cell-index = <0x30>;
            compatible = "fsl,fman-v2-port-tx";
            reg = <0xb0000 0x1000>;
        };

        ethernet@e0000 {
            compatible = "fsl,fman-dtsec";
            cell-index = <0>;
            reg = <0xe0000 0x1000>;
            ptp-timer = <&ptp_timer>;
            fsl,fman-ports = <&fman1_rx_0x8 &fman1_tx_0x28>;
            tbi-handle = <&tbi5>;
        };

        ethernet@e2000 {
            compatible = "fsl,fman-dtsec";
            reg = <0xe2000 0x1000>;
            cell-index = <1>;
            ptp-timer = <&ptp_timer>;
            fsl,fman-ports = <&fman1_rx_0x9 &fman1_tx_0x29>;
            tbi-handle = <&tbi6>;
        };

        ethernet@e4000 {
            compatible = "fsl,fman-dtsec";
            reg = <0xe4000 0x1000>;
            cell-index = <2>;
            ptp-timer = <&ptp_timer>;
            fsl,fman-ports = <&fman1_rx_0xa &fman1_tx_0x2a>;
            tbi-handle = <&tbi7>;
        };

        ethernet@e6000 {
            compatible = "fsl,fman-dtsec";
            reg = <0xe6000 0x1000>;
            cell-index = <3>;
            ptp-timer = <&ptp_timer>;
            fsl,fman-ports = <&fman1_rx_0xb &fman1_tx_0x2b>;
            tbi-handle = <&tbi8>;
        };

        ethernet@e8000 {
            compatible = "fsl,fman-dtsec";
            reg = <0xf0000 0x1000>;
            cell-index = <4>;
            ptp-timer = <&ptp_timer>;
            fsl,fman-ports = <&fman1_rx_0xc &fman1_tx_0x2c>;
            tbi-handle = <&tbi9>;
        };

        ethernet@f0000 {
            compatible = "fsl,fman-xgec";
            reg = <0xf0000 0x1000>;
            ptp-timer = <&ptp_timer>;
            cell-index = <8>;
            fsl,fman-ports = <&fman1_rx_0x10 &fman1_tx_0x30>;
        };

        ptp_timer: ptp-timer@fe000 {
            compatible = "fsl,fman-ptp-timer";
            reg = <0xfe000 0x1000>;
            interrupts = <12 0x8>, <13 0x8>;
        };

        mdio@f1000 {
            compatible = "fsl,fman-xmdio";
            reg = <0xf1000 0x1000>;
            interrupts = <101 2>;
        };
    };
```
