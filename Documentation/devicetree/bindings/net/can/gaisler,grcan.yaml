## Documentation/devicetree/bindings/net/can/gaisler,grcan.yaml
```yaml
# SPDX-License-Identifier: (GPL-2.0-only OR BSD-2-Clause)
%YAML 1.2
---
$id: http://devicetree.org/schemas/net/can/gaisler,grcan.yaml#
$schema: http://devicetree.org/meta-schemas/core.yaml#

title: Aeroflex Gaisler GRCAN, GRHCAN and GRCANFD CAN controllers.

description: |
  GRCAN, GRCANFD, GRHCAN controllers are available in the GRLIB VHDL
  IP core library.
  For further information look in the documentation for the GRLIB IP library:
  https://download.gaisler.com/products/GRLIB/doc/grip.pdf

maintainers:
  - Arun Muthusamy <arun.muthusamy@gaisler.com>
  - Andreas Larsson <andreas@gaisler.com>

allOf:
  - $ref: can-controller.yaml#

properties:
  compatible:
    enum:
      - gaisler,grcan
      - gaisler,grcanfd

  reg:
    maxItems: 1

  interrupts:
    maxItems: 1

  clocks:
    maxItems: 1

  freq:
    $ref: /schemas/types.yaml#/definitions/uint32
    description: |
      Frequency of the external oscillator clock in Hz (the frequency of the
      AMBA bus in the ordinary case).
      This property should be used by systems where the common clock
      framework is not supported.

required:
  - compatible
  - reg
  - interrupts

unevaluatedProperties: false

examples:
  - |
    #include <dt-bindings/interrupt-controller/irq.h>

    can@ff400000 {
        compatible = "gaisler,grcanfd";
        clocks = <&sysclock>;
        reg = <0xff400000 0x400>;
        interrupt-parent = <&plic0>;
        interrupts = <6>;
    };
```

## Documentation/devicetree/bindings/net/can/holt,hi311x.yaml
```yaml
# SPDX-License-Identifier: (GPL-2.0-only OR BSD-2-Clause)
%YAML 1.2
---
$id: http://devicetree.org/schemas/net/can/holt,hi311x.yaml#
$schema: http://devicetree.org/meta-schemas/core.yaml#

title: Holt HI-311X stand-alone CAN controller

maintainers:
  - Marc Kleine-Budde <mkl@pengutronix.de>

description:
  The Holt HI-3110 is a stand-alone CAN controller with an SPI interface.

allOf:
  - $ref: can-controller.yaml#
  - $ref: /schemas/spi/spi-peripheral-props.yaml#

properties:
  compatible:
    const: holt,hi3110

  reg:
    description: SPI chip select.
    maxItems: 1

  clocks:
    description:
      The clock feeding the CAN controller. If this property is not present
      clock-frequency must be specified instead.
    maxItems: 1

  clock-frequency:
    description:
      Frequency of the clock feeding the CAN controller, in Hz. Used when
      no clocks property is provided.
    $ref: /schemas/types.yaml#/definitions/uint32
    maximum: 40000000

  interrupts:
    description: IRQ line for the CAN controller.
    maxItems: 1

  vdd-supply:
    description: Regulator that powers the CAN controller.

  xceiver-supply:
    description: Regulator that powers the CAN transceiver.

required:
  - compatible
  - reg
  - interrupts

anyOf:
  - required:
      - clocks
  - required:
      - clock-frequency

unevaluatedProperties: false

examples:
  - |
    #include <dt-bindings/interrupt-controller/irq.h>

    spi {
        #address-cells = <1>;
        #size-cells = <0>;

        can@1 {
            compatible = "holt,hi3110";
            reg = <1>;
            clocks = <&clk32m>;
            interrupt-parent = <&gpio4>;
            interrupts = <13 IRQ_TYPE_LEVEL_HIGH>;
            vdd-supply = <&reg5v0>;
            xceiver-supply = <&reg5v0>;
        };
    };
...
```

## Documentation/devicetree/bindings/net/can/ifi,canfd.yaml
```yaml
# SPDX-License-Identifier: (GPL-2.0-only OR BSD-2-Clause)
%YAML 1.2
---
$id: http://devicetree.org/schemas/net/can/ifi,canfd.yaml#
$schema: http://devicetree.org/meta-schemas/core.yaml#

title: IFI CAN-FD Controller

maintainers:
  - Quchaosheng <quchaosheng000406@163.com>

description:
  The I/F/I CAN-FD soft IP block connected to the platform bus. It is most
  often synthesised into an FPGA or CPLD.

allOf:
  - $ref: can-controller.yaml#

properties:
  compatible:
    const: ifi,canfd-1.0

  reg:
    maxItems: 1

  interrupts:
    maxItems: 1

required:
  - compatible
  - reg
  - interrupts

unevaluatedProperties: false

examples:
  - |
    canfd0: can@ff220000 {
        compatible = "ifi,canfd-1.0";
        reg = <0xff220000 0x1000>;
        interrupts = <0 43 0>;
    };
...
```

## Documentation/devicetree/bindings/net/can/microchip,mcp251x.yaml
```yaml
# SPDX-License-Identifier: (GPL-2.0-only OR BSD-2-Clause)
%YAML 1.2
---
$id: http://devicetree.org/schemas/can/microchip,mcp251x.yaml#
$schema: http://devicetree.org/meta-schemas/core.yaml#

title: Microchip MCP251X stand-alone CAN controller

maintainers:
  - Frank Li <Frank.Li@nxp.com>

properties:
  compatible:
    enum:
      - microchip,mcp2510
      - microchip,mcp2515
      - microchip,mcp25625

  reg:
    maxItems: 1

  clocks:
    maxItems: 1

  interrupts:
    maxItems: 1

  vdd-supply:
    description: Regulator that powers the CAN controller.

  xceiver-supply:
    description: Regulator that powers the CAN transceiver.

  gpio-controller: true

  "#gpio-cells":
    const: 2

required:
  - compatible
  - reg
  - clocks
  - interrupts

allOf:
  - $ref: /schemas/spi/spi-peripheral-props.yaml#

unevaluatedProperties: false

examples:
  - |
    #include <dt-bindings/interrupt-controller/irq.h>

    spi {
        #address-cells = <1>;
        #size-cells = <0>;

        can0: can@1 {
             compatible = "microchip,mcp2515";
             reg = <1>;
             clocks = <&clk24m>;
             interrupt-parent = <&gpio4>;
             interrupts = <13 IRQ_TYPE_LEVEL_LOW>;
             vdd-supply = <&reg5v0>;
             xceiver-supply = <&reg5v0>;
             gpio-controller;
             #gpio-cells = <2>;
        };
    };
```

## Documentation/devicetree/bindings/net/can/ti,tcan4x5x.yaml
```yaml
# SPDX-License-Identifier: (GPL-2.0-only OR BSD-2-Clause)
%YAML 1.2
---
$id: http://devicetree.org/schemas/net/can/ti,tcan4x5x.yaml#
$schema: http://devicetree.org/meta-schemas/core.yaml#

title: Texas Instruments TCAN4x5x CAN Controller

maintainers:
  - Marc Kleine-Budde <mkl@pengutronix.de>

allOf:
  - $ref: can-controller.yaml#

properties:
  compatible:
    oneOf:
      - enum:
          - ti,tcan4552
          - ti,tcan4553
          - ti,tcan4x5x

  reg:
    maxItems: 1

  interrupts:
    maxItems: 1

  clocks:
    maxItems: 1

  vdd-supply:
    description: Regulator that powers the CAN controller.

  xceiver-supply:
    description: Regulator that powers the CAN transceiver.

  reset-gpios:
    description: Hardwired output GPIO. If not defined then software reset.
    maxItems: 1

  device-state-gpios:
    description: Input GPIO that indicates if the device is in a sleep state or if the device is active.
      Not available with tcan4552/4553.
    maxItems: 1

  device-wake-gpios:
    description: Wake up GPIO to wake up the TCAN device. Not available with tcan4552/4553.
    maxItems: 1

  bosch,mram-cfg:
    $ref: bosch,m_can.yaml#

  spi-max-frequency:
    description:
      Must be half or less of "clocks" frequency.
    maximum: 10000000

  wakeup-source:
    $ref: /schemas/types.yaml#/definitions/flag
    description:
      Enable CAN remote wakeup.

required:
  - compatible
  - reg
  - interrupts
  - clocks
  - bosch,mram-cfg

additionalProperties: false

examples:
  - |
    #include <dt-bindings/gpio/gpio.h>
    #include <dt-bindings/interrupt-controller/irq.h>

    spi {
        #address-cells = <1>;
        #size-cells = <0>;

        can@0 {
            compatible = "ti,tcan4x5x";
            reg = <0>;
            clocks = <&can0_osc>;
            pinctrl-names = "default";
            pinctrl-0 = <&can0_pins>;
            spi-max-frequency = <10000000>;
            bosch,mram-cfg = <0x0 0 0 16 0 0 1 1>;
            interrupt-parent = <&gpio1>;
            interrupts = <14 IRQ_TYPE_LEVEL_LOW>;
            device-state-gpios = <&gpio3 21 GPIO_ACTIVE_HIGH>;
            device-wake-gpios = <&gpio1 15 GPIO_ACTIVE_HIGH>;
            reset-gpios = <&gpio1 27 GPIO_ACTIVE_HIGH>;
            wakeup-source;
        };
    };
```

## Documentation/devicetree/bindings/net/dapu,dap8211r.yaml
```yaml
# SPDX-License-Identifier: (GPL-2.0-only OR BSD-2-Clause)
%YAML 1.2
---
$id: http://devicetree.org/schemas/net/dapu,dap8211r.yaml#
$schema: http://devicetree.org/meta-schemas/core.yaml#

title: DAPU Telecom DAP8211R(I) Gigabit Ethernet PHY

maintainers:
  - Artem Shimko <a.shimko.dev@gmail.com>

description: |
  The DAP8211R(I) is a Gigabit Ethernet PHY with RGMII interface,
  supporting IEEE 802.3az Energy Efficient Ethernet, IEEE 1588 SyncE,
  and an internal packet generator for diagnostics.

  Specifications:
    - 10BASE-Te, 100BASE-TX, 1000BASE-T
    - RGMII with configurable TX/RX clock delays (150 ps steps, 0-2250 ps)
    - IEEE 802.3az-2010 Energy Efficient Ethernet
    - IEEE 1588 SyncE support
    - Internal packet generator and checker for link diagnostics

allOf:
  - $ref: ethernet-phy.yaml#

properties:
  compatible:
    const: ethernet-phy-id0008.011b

  reg:
    maxItems: 1

  rx-internal-delay-ps:
    description:
      RGMII RX clock delay in picoseconds. The PHY supports 150 ps steps
      from 0 to 2250 ps. If not specified, defaults to 1950 ps. If the
      requested value does not exactly match a supported step, the driver
      selects the nearest supported value and issues a warning.
    enum: [0, 150, 300, 450, 600, 750, 900, 1050, 1200, 1350, 1500,
           1650, 1800, 1950, 2100, 2250]
    default: 1950

  tx-internal-delay-ps:
    description:
      RGMII TX clock delay in picoseconds. The PHY supports 150 ps steps
      from 0 to 2250 ps. If not specified, defaults to 1950 ps. If the
      requested value does not exactly match a supported step, the driver
      selects the nearest supported value and issues a warning.
    enum: [0, 150, 300, 450, 600, 750, 900, 1050, 1200, 1350, 1500,
           1650, 1800, 1950, 2100, 2250]
    default: 1950

  tx-inverted-clk:
    $ref: /schemas/types.yaml#/definitions/flag
    description:
      If present, the RGMII TX clock to the MAC is inverted (180 degree
      phase shift relative to the data lines). This is a vendor-specific
      extension for boards where PCB trace length or MAC requirements
      necessitate clock inversion. Only use this property after hardware
      signal integrity validation.

unevaluatedProperties: false

examples:
  - |
    mdio {
        #address-cells = <1>;
        #size-cells = <0>;

        ethernet-phy@1 {
            compatible = "ethernet-phy-ieee802.3-c22";
            reg = <1>;
            rx-internal-delay-ps = <1050>;
            tx-internal-delay-ps = <1150>;
            tx-inverted-clk;
        };
    };
```

## Documentation/devicetree/bindings/net/dsa/airoha,an8855-switch.yaml
```yaml
# SPDX-License-Identifier: (GPL-2.0-only OR BSD-2-Clause)
%YAML 1.2
---
$id: http://devicetree.org/schemas/net/dsa/airoha,an8855-switch.yaml#
$schema: http://devicetree.org/meta-schemas/core.yaml#

title: Airoha AN8855 Gigabit Switch

maintainers:
  - Christian Marangi <ansuelsmth@gmail.com>

description: >
  Airoha AN8855 is a 5-port Gigabit Switch.

  It does expose the 5 Internal PHYs on the MDIO bus and each port
  can access the Switch register space by configurting the PHY page.

  Each internal PHY might require calibration with the fused EFUSE on
  the switch exposed by the Airoha AN8855 SoC NVMEM.

$ref: dsa.yaml#

properties:
  compatible:
    const: airoha,an8855-switch

  reset-gpios:
    description:
      GPIO to be used to reset the whole device
    maxItems: 1

  airoha,ext-surge:
    $ref: /schemas/types.yaml#/definitions/flag
    description:
      Calibrate the internal PHY with the calibration values stored in EFUSE
      for the r50Ohm values.

required:
  - compatible

unevaluatedProperties: false

examples:
  - |
    #include <dt-bindings/gpio/gpio.h>

    ethernet-switch {
        compatible = "airoha,an8855-switch";
        reset-gpios = <&pio 39 0>;

        airoha,ext-surge;

        ports {
            #address-cells = <1>;
            #size-cells = <0>;

            port@0 {
                reg = <0>;
                label = "lan1";
                phy-mode = "internal";
                phy-handle = <&internal_phy1>;
            };

            port@1 {
                reg = <1>;
                label = "lan2";
                phy-mode = "internal";
                phy-handle = <&internal_phy2>;
            };

            port@2 {
                reg = <2>;
                label = "lan3";
                phy-mode = "internal";
                phy-handle = <&internal_phy3>;
            };

            port@3 {
                reg = <3>;
                label = "lan4";
                phy-mode = "internal";
                phy-handle = <&internal_phy4>;
            };

            port@4 {
                reg = <4>;
                label = "wan";
                phy-mode = "internal";
                phy-handle = <&internal_phy5>;
            };

            port@5 {
                reg = <5>;
                label = "cpu";
                ethernet = <&gmac0>;
                phy-mode = "2500base-x";

                fixed-link {
                    speed = <2500>;
                    full-duplex;
                    pause;
                };
            };
        };
    };
```
