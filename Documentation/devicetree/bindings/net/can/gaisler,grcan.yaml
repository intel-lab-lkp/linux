## Documentation/devicetree/bindings/net/fsl,gianfar.yaml
```yaml
# SPDX-License-Identifier: GPL-2.0
%YAML 1.2
---
$id: http://devicetree.org/schemas/net/fsl,gianfar.yaml#
$schema: http://devicetree.org/meta-schemas/core.yaml#

title: Freescale Three-Speed Ethernet Controller (TSEC), "Gianfar"

maintainers:
  - J. Neuschäfer <j.ne@posteo.net>

properties:
  compatible:
    enum:
      - gianfar
      - fsl,etsec2

  device_type:
    const: network

  model:
    enum:
      - FEC
      - TSEC
      - eTSEC

  reg:
    maxItems: 1

  ranges: true

  "#address-cells": true

  "#size-cells": true

  cell-index:
    $ref: /schemas/types.yaml#/definitions/uint32

  interrupts:
    maxItems: 3

  dma-coherent:
    type: boolean

  fsl,magic-packet:
    $ref: /schemas/types.yaml#/definitions/flag
    description:
      If present, indicates that the hardware supports waking up via magic packet.

  fsl,wake-on-filer:
    type: boolean
    description:
      If present, indicates that the hardware supports waking up by Filer
      General Purpose Interrupt (FGPI) asserted on the Rx int line. This is
      an advanced power management capability allowing certain packet types
      (user) defined by filer rules to wake up the system.

  bd-stash:
    type: boolean
    description:
      If present, indicates that the hardware supports stashing buffer
      descriptors in the L2.

  rx-stash-len:
    type: boolean
    description:
      Denotes the number of bytes of a received buffer to stash in the L2.

  tx-stash-len:
    type: boolean
    description:
      Denotes the index of the first byte from the received buffer to stash in
      the L2.

  fsl,num_rx_queues:
    $ref: /schemas/types.yaml#/definitions/uint32
    description: Number of receive queues

  fsl,num_tx_queues:
    $ref: /schemas/types.yaml#/definitions/uint32
    description: Number of transmit queues

  tbi-handle:
    $ref: /schemas/types.yaml#/definitions/phandle
    description: Reference (phandle) to the TBI node

required:
  - compatible
  - model

patternProperties:
  "^mdio@[0-9a-f]+$":
    type: object
    # TODO: reference to gianfar MDIO binding

allOf:
  - $ref: ethernet-controller.yaml#

  # compatible = "gianfar" requires device_type = "network"
  - if:
      properties:
        compatible:
          contains:
            const: gianfar
    then:
      required:
        - device_type

  # eTSEC2 controller nodes have "queue group" subnodes and don't need a "reg"
  # property.
  - if:
      properties:
        compatible:
          contains:
            const: fsl,etsec2
    then:
      patternProperties:
        "^queue-group@[0-9a-f]+$":
          type: object

          properties:
            "#address-cells": true

            "#size-cells": true

            reg:
              maxItems: 1

            interrupts:
              maxItems: 3

          required:
            - reg
            - interrupts

          additionalProperties: false
    else:
      required:
        - reg

  # TSEC and eTSEC devices require three interrupts
  - if:
      properties:
        model:
          contains:
            enum: [ TSEC, eTSEC ]
    then:
      properties:
        interrupts:
          items:
            - description: Transmit interrupt
            - description: Receive interrupt
            - description: Error interrupt



unevaluatedProperties: false

examples:
  - |
    ethernet@24000 {
        device_type = "network";
        model = "TSEC";
        compatible = "gianfar";
        reg = <0x24000 0x1000>;
        local-mac-address = [ 00 E0 0C 00 73 00 ];
        interrupts = <29 2>, <30 2>, <34 2>;
        interrupt-parent = <&mpic>;
        phy-handle = <&phy0>;
    };

  - |
    #include <dt-bindings/interrupt-controller/irq.h>

    soc1 {
        #address-cells = <1>;
        #size-cells = <1>;

        ethernet@24000 {
            compatible = "gianfar";
            reg = <0x24000 0x1000>;
            ranges = <0x0 0x24000 0x1000>;
            #address-cells = <1>;
            #size-cells = <1>;
            cell-index = <0>;
            device_type = "network";
            model = "eTSEC";
            local-mac-address = [ 00 00 00 00 00 00 ];
            interrupts = <32 IRQ_TYPE_LEVEL_LOW>,
                         <33 IRQ_TYPE_LEVEL_LOW>,
                         <34 IRQ_TYPE_LEVEL_LOW>;
            interrupt-parent = <&ipic>;

            mdio@520 {
                #address-cells = <1>;
                #size-cells = <0>;
                compatible = "fsl,gianfar-mdio";
                reg = <0x520 0x20>;
            };
        };
    };

  - |
    #include <dt-bindings/interrupt-controller/irq.h>
    #include <dt-bindings/interrupt-controller/arm-gic.h>

    soc2 {
        #address-cells = <2>;
        #size-cells = <2>;

        ethernet {
            compatible = "fsl,etsec2";
            ranges;
            device_type = "network";
            #address-cells = <2>;
            #size-cells = <2>;
            interrupt-parent = <&gic>;
            model = "eTSEC";
            fsl,magic-packet;
            dma-coherent;

            queue-group@2d10000 {
                #address-cells = <2>;
                #size-cells = <2>;
                reg = <0x0 0x2d10000 0x0 0x1000>;
                interrupts = <GIC_SPI 144 IRQ_TYPE_LEVEL_HIGH>,
                             <GIC_SPI 145 IRQ_TYPE_LEVEL_HIGH>,
                             <GIC_SPI 146 IRQ_TYPE_LEVEL_HIGH>;
            };

            queue-group@2d14000  {
                #address-cells = <2>;
                #size-cells = <2>;
                reg = <0x0 0x2d14000 0x0 0x1000>;
                interrupts = <GIC_SPI 147 IRQ_TYPE_LEVEL_HIGH>,
                             <GIC_SPI 148 IRQ_TYPE_LEVEL_HIGH>,
                             <GIC_SPI 149 IRQ_TYPE_LEVEL_HIGH>;
            };
        };
    };

...
```

## Documentation/devicetree/bindings/net/fsl-enetc-ierb.yaml
```yaml
# SPDX-License-Identifier: (GPL-2.0-only OR BSD-2-Clause)
%YAML 1.2
---
$id: http://devicetree.org/schemas/net/fsl-enetc-ierb.yaml#
$schema: http://devicetree.org/meta-schemas/core.yaml#

title: Integrated Endpoint Register Block

description:
  The fsl_enetc driver can probe on the Integrated Endpoint Register
  Block, which preconfigures the FIFO limits for the ENETC ports.

maintainers:
  - Frank Li <Frank.Li@nxp.com>

properties:
  compatible:
    enum:
      - fsl,ls1028a-enetc-ierb

  reg:
    maxItems: 1

required:
  - compatible
  - reg

additionalProperties: false

examples:
  - |
    ierb@1f0800000 {
        compatible = "fsl,ls1028a-enetc-ierb";
        reg = <0xf0800000 0x10000>;
    };
```

## Documentation/devicetree/bindings/net/fsl-enetc-mdio.yaml
```yaml
# SPDX-License-Identifier: (GPL-2.0-only OR BSD-2-Clause)
%YAML 1.2
---
$id: http://devicetree.org/schemas/net/fsl-enetc-mdio.yaml#
$schema: http://devicetree.org/meta-schemas/core.yaml#

title: ENETC the central MDIO PCIe endpoint device

description:
  In this case, the mdio node should be defined as another PCIe
  endpoint node, at the same level with the ENETC port nodes

maintainers:
  - Frank Li <Frank.Li@nxp.com>.

properties:
  compatible:
    items:
      - enum:
          - pci1957,ee01
      - const: fsl,enetc-mdio

  reg:
    maxItems: 1

required:
  - compatible
  - reg

allOf:
  - $ref: mdio.yaml

unevaluatedProperties: false

examples:
  - |
    mdio@0,3 {
        compatible = "pci1957,ee01", "fsl,enetc-mdio";
        reg = <0x000300 0>;
        #address-cells = <1>;
        #size-cells = <0>;

        sgmii_phy0: ethernet-phy@2 {
            reg = <0x2>;
        };
    };
```

## Documentation/devicetree/bindings/net/fsl-enetc.yaml
```yaml
# SPDX-License-Identifier: (GPL-2.0-only OR BSD-2-Clause)
%YAML 1.2
---
$id: http://devicetree.org/schemas/net/fsl-enetc.yaml#
$schema: http://devicetree.org/meta-schemas/core.yaml#

title: ENETC ethernet

description:
  Depending on board design and ENETC port type (internal or
  external) there are two supported link modes specified by
  below device tree bindings.

maintainers:
  - Frank Li <Frank.Li@nxp.com>

properties:
  compatible:
    items:
      - enum:
          - pci1957,e100
      - const: fsl,enetc

  reg:
    maxItems: 1

required:
  - compatible
  - reg

allOf:
  - $ref: ethernet-controller.yaml

unevaluatedProperties: false

examples:
  - |
    ethernet@0,0 {
        compatible = "pci1957,e100", "fsl,enetc";
        reg = <0x000000 0>;
        phy-handle = <&sgmii_phy0>;
        phy-connection-type = "sgmii";
    };
```
