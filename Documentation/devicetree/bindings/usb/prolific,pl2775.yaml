## Documentation/devicetree/bindings/usb/rohm,bm92t.yaml
```yaml
# SPDX-License-Identifier: (GPL-2.0 OR BSD-2-Clause)
%YAML 1.2
---
$id: http://devicetree.org/schemas/usb/rohm,bm92t.yaml#
$schema: http://devicetree.org/meta-schemas/core.yaml#

title: Rohm BM92TXX USB Type-C and Power Delivery controller

maintainers:
  - CTCaer <ctcaer@gmail.com>
  - Alexandre Hamamdjian <azkali.limited@gmail.com>

description:
  The Rohm BM92TXX is a family of USB Type-C and Power Delivery
  controllers with an integrated MCU. The host communicates with the
  device over I2C and is notified of state changes through a dedicated
  interrupt line.

properties:
  compatible:
    const: rohm,bm92t

  reg:
    maxItems: 1

  interrupts:
    maxItems: 1

  vbus-supply:
    description: VBUS sink regulator.

  vbus-source-supply:
    description: VBUS source (provider) regulator.

  pd_bat_chg-supply:
    description: Battery charger regulator gated by Power Delivery state.

  rohm,vconn-en-gpio:
    maxItems: 1
    description: GPIO controlling the external VCONN switch.

  rohm,dp-disable:
    type: boolean
    description: Disable DisplayPort alternate-mode handling.

  rohm,dp-alerts-enable:
    type: boolean
    description: Enable DisplayPort status alerts.

  rohm,dp-signal-toggle-on-resume:
    type: boolean
    description:
      Toggle the DisplayPort signal on resume to work around sinks that
      do not re-train after system resume.

  rohm,dp-lanes:
    $ref: /schemas/types.yaml#/definitions/uint32
    enum: [2, 4]
    default: 2
    description: Number of DisplayPort lanes to negotiate.

  rohm,led-static-on-suspend:
    type: boolean
    description:
      Keep the charge LED in a static state during system suspend
      instead of letting the controller animate it.

  rohm,dock-power-limit-disable:
    type: boolean
    description:
      Disable the lower power limit applied when a dock is detected.

  rohm,pd-5v-current-limit-ma:
    $ref: /schemas/types.yaml#/definitions/uint32
    description: Charging current limit in mA when 5V PD contract is active.

  rohm,pd-9v-current-limit-ma:
    $ref: /schemas/types.yaml#/definitions/uint32
    description: Charging current limit in mA when 9V PD contract is active.

  rohm,pd-12v-current-limit-ma:
    $ref: /schemas/types.yaml#/definitions/uint32
    description: Charging current limit in mA when 12V PD contract is active.

  rohm,pd-15v-current-limit-ma:
    $ref: /schemas/types.yaml#/definitions/uint32
    description: Charging current limit in mA when 15V PD contract is active.

  port:
    $ref: /schemas/graph.yaml#/properties/port
    description:
      Output port linking to a USB role switch consumer endpoint.

required:
  - compatible
  - reg
  - interrupts
  - port

additionalProperties: false

examples:
  - |
    #include <dt-bindings/interrupt-controller/irq.h>

    i2c {
        #address-cells = <1>;
        #size-cells = <0>;

        typec@18 {
            compatible = "rohm,bm92t";
            reg = <0x18>;
            interrupt-parent = <&gpio>;
            interrupts = <42 IRQ_TYPE_LEVEL_LOW>;

            vbus-supply = <&vbus_reg>;
            vbus-source-supply = <&vbus_src_reg>;
            pd_bat_chg-supply = <&pd_bat_chg_reg>;

            rohm,dp-lanes = <4>;
            rohm,pd-5v-current-limit-ma = <2000>;
            rohm,pd-9v-current-limit-ma = <2000>;
            rohm,pd-12v-current-limit-ma = <1500>;
            rohm,pd-15v-current-limit-ma = <1200>;

            port {
                bm92t_ep: endpoint {
                    remote-endpoint = <&usb_role_sw>;
                };
            };
        };
    };
```

## Documentation/devicetree/bindings/usb/samsung,snps-dwc3.yaml
```yaml
# SPDX-License-Identifier: (GPL-2.0 OR BSD-2-Clause)
%YAML 1.2
---
$id: http://devicetree.org/schemas/usb/samsung,snps-dwc3.yaml#
$schema: http://devicetree.org/meta-schemas/core.yaml#

title: Samsung Exynos SoC DWC3 USB Controller

maintainers:
  - Krzysztof Kozlowski <krzk@kernel.org>
  - Selvarasu Ganesan <selvarasu.g@samsung.com>

description:
  Describes the DWC3 USB controller block implemented on Samsung Exynos SoCs.

select:
  properties:
    compatible:
      contains:
        const: samsung,snps-dwc3
  required:
    - compatible

properties:
  compatible:
    items:
      - enum:
          - samsung,exynos8855-dwc3
      - const: samsung,snps-dwc3

  reg:
    maxItems: 1

  power-domains:
    maxItems: 1

  interrupts:
    maxItems: 1

  clocks:
    description: |
      Several clocks are used, depending on the variant. Typical ones are:
       - ref: Reference clock for SOF/ITP generation.
       - bus: Bus (APB) clock for register access.
    minItems: 1
    maxItems: 4

  clock-names:
    minItems: 1
    maxItems: 4

required:
  - compatible
  - reg
  - clocks
  - clock-names
  - interrupts

allOf:
  - $ref: snps,dwc3-common.yaml#

  - if:
      properties:
        compatible:
          contains:
            const: samsung,exynos8855-dwc3
    then:
      properties:
        clocks:
          minItems: 2
          maxItems: 2
        clock-names:
          items:
            - const: ref
            - const: bus

unevaluatedProperties: false

examples:
  - |
    #include <dt-bindings/interrupt-controller/arm-gic.h>

    usb@13200000 {
        compatible = "samsung,exynos8855-dwc3",
                     "samsung,snps-dwc3";
        reg = <0x13200000 0x10000>;
        interrupts = <GIC_SPI 436 IRQ_TYPE_LEVEL_HIGH>;
        clocks = <&usb_clk 0>,
                 <&usb_clk 1>;
        clock-names = "ref", "bus";
        dr_mode = "peripheral";
        phys = <&usbdrd_phy 0>;
        phy-names = "usb2-phy";
        snps,quirk-frame-length-adjustment = <0x20>;
        snps,dis-u2-freeclk-exists-quirk;
        snps,gfladj-refclk-lpm-sel-quirk;
    };
...
```

## Documentation/devicetree/bindings/usb/sprd,pmic_typec.yaml
```yaml
# SPDX-License-Identifier: (GPL-2.0-only OR BSD-2-Clause)
%YAML 1.2
---
$id: http://devicetree.org/schemas/usb/sprd,pmic-typec.yaml#
$schema: http://devicetree.org/meta-schemas/core.yaml#

title: Unisoc SC27xx Type-C port controller

maintainers:
  - Xinhu Wu <xinhu.wu@unisoc.com>

description:
  Supports the typec found on these PMICs.

properties:
  compatible:
    enum:
      - sprd,sc2730-typec

  reg:
    maxItems: 1

  interrupts:
    maxItems: 1

  sprd,mode:
    maxItems: 1
      description: the number indicates src, snk or drp.
      enum: [0, 1, 2]

  nvmem-cells:
    maxItems: 2
      description:
      A phandle to the 'cc resistance' trim data provided by
      a nvmem device.

  nvmem-cell-names:
    items:
    - const: typec_cc1_cal
    - const: typec_cc2_cal

required:
  - compatible
  - reg
  - interrupts
  - sprd,mode
  - nvmem-cells
  - nvmem-cell-names

examples:
  - |
    #include <dt-bindings/interrupt-controller/irq.h>
    pmic {
        #address-cells = <1>;
        #size-cells = <0>;
        pmic_typec: typec@380 {
            compatible = "sprd,sc2730-typec";
            reg = <0x380>;
            interrupt-parent = <&sc2730_pmic>;
            interrupts = <8>;
            sprd,mode = <2>;
            nvmem-cells = <&typec_cc1_cal>, <&typec_ccc2_cal>;
            nvmem-cell-names = "typec_cc1_cal","typec_cc2_cal";
        };
    };
```

## Documentation/devicetree/bindings/usb/st,st-ehci-300x.yaml
```yaml
# SPDX-License-Identifier: (GPL-2.0-only OR BSD-2-Clause)
%YAML 1.2
---
$id: http://devicetree.org/schemas/usb/st,st-ehci-300x.yaml#
$schema: http://devicetree.org/meta-schemas/core.yaml#

title: STMicroelectronics USB EHCI Controller (ST EHCI 300x)

maintainers:
  - Peter Griffin <peter.griffin@linaro.org>

description:
  The STMicroelectronics EHCI 300x controller is a USB 2.0 Enhanced Host
  Controller Interface used in several ST SoCs. It provides high-speed USB
  host functionality and interfaces with an external USB PHY. The controller
  requires clock, reset, interrupt, and pin control configuration along with
  PHY connection information to operate correctly.

allOf:
  - $ref: usb-hcd.yaml#

properties:
  compatible:
    const: st,st-ehci-300x

  reg:
    maxItems: 1

  interrupts:
    maxItems: 1

  pinctrl-names:
    const: default

  pinctrl-0:
    maxItems: 1

  clocks:
    maxItems: 2

  clock-names:
    items:
      - const: ic
      - const: clk48

  phys:
    maxItems: 1

  phy-names:
    const: usb

  resets:
    maxItems: 2

  reset-names:
    items:
      - const: power
      - const: softreset

required:
  - compatible
  - reg
  - interrupts
  - pinctrl-names
  - pinctrl-0
  - clocks
  - clock-names
  - phys
  - phy-names
  - resets
  - reset-names

unevaluatedProperties: false

examples:
  - |
    #include <dt-bindings/interrupt-controller/arm-gic.h>
    #include <dt-bindings/clock/stih410-clks.h>
    #include <dt-bindings/reset/stih407-resets.h>
    usb@fe203e00 {
        compatible = "st,st-ehci-300x";
        reg = <0xfe203e00 0x100>;
        interrupts = <GIC_SPI 148 IRQ_TYPE_NONE>;
        pinctrl-names = "default";
        pinctrl-0 = <&pinctrl_usb1>;
        clocks = <&clk_s_c0_flexgen CLK_TX_ICN_DISP_0>,
                 <&clk_s_c0_flexgen CLK_RX_ICN_DISP_0>;
        clock-names = "ic", "clk48";
        phys = <&usb2_phy>;
        phy-names = "usb";
        resets = <&powerdown STIH407_USB2_PORT0_POWERDOWN>,
                 <&softreset STIH407_USB2_PORT0_SOFTRESET>;
        reset-names = "power", "softreset";
    };
...
```

## Documentation/devicetree/bindings/usb/st,stih407-dwc3.yaml
```yaml
# SPDX-License-Identifier: GPL-2.0-only OR BSD-2-Clause
%YAML 1.2
---
$id: http://devicetree.org/schemas/usb/st,stih407-dwc3.yaml#
$schema: http://devicetree.org/meta-schemas/core.yaml#

title: ST DWC3 glue logic

description:
  This binding describes the parameters for the dwc3-st driver,
  which controls the glue logic used to configure the DWC3 core on
  STiH407-based platforms.

maintainers:
  - Mauro Carvalho Chehab <mchehab@kernel.org>

properties:
  compatible:
    const: st,stih407-dwc3

  reg:
    # minItems: 2
    items:
      - description: Glue logic base address.
      - description: USB syscfg ctrl register offset.

  reg-names:
    # minItems: 2
    items:
      - const: reg-glue
      - const: syscfg-reg

  st,syscon:
    $ref: /schemas/types.yaml#/definitions/phandle
    description: Phandle to system configuration node which.

  resets:
    maxItems: 2

  reset-names:
    items:
      - const: powerdown
      - const: softreset

  st,syscfg:
    maxItems: 1

  '#address-cells':
    const: 1

  '#size-cells':
    const: 1

  pinctrl-names:
    items:
      - const: default

  pinctrl-0:
    $ref: /schemas/types.yaml#/definitions/phandle-array
    description: |
      Pin control group
      See: Documentation/devicetree/bindings/pinctrl/pinctrl-bindings.txt

  ranges:
    description: Valid 1:1 translation between child's and parent's address space.

required:
  - compatible
  - reg
  - reg-names
  - resets
  - reset-names
  - pinctrl-names
  - pinctrl-0
  - ranges

additionalProperties: false

patternProperties:
  "^usb@[0-9a-f]+$":
    type: object
    description: DWC3 core sub-node
    $ref: snps,dwc3.yaml#
    unevaluatedProperties: false
    properties:
      dr_mode:
        enum:
          - host
          - device
        description: |
          Specifies the operating mode. The default value "otg" is not
          supported by this SoC. Valid values are "host" or "device".
          See: Documentation/devicetree/bindings/usb/usb-drd.yaml

examples:
  - |
    #include <dt-bindings/phy/phy.h>
    #include <dt-bindings/reset/stih407-resets.h>
    #include <dt-bindings/interrupt-controller/arm-gic.h>

    st_dwc3: dwc3@8f94000 {
        compatible	= "st,stih407-dwc3";
        reg		= <0x08f94000 0x1000>, <0x110 0x4>;
        reg-names	= "reg-glue", "syscfg-reg";
        st,syscfg	= <&syscfg_core>;
        resets		= <&powerdown STIH407_USB3_POWERDOWN>,
              <&softreset STIH407_MIPHY2_SOFTRESET>;
        reset-names	= "powerdown", "softreset";
        #address-cells	= <1>;
        #size-cells	= <1>;
        pinctrl-names	= "default";
        pinctrl-0	= <&pinctrl_usb3>;
        ranges;

        dwc3: usb@9900000 {
            compatible	= "snps,dwc3";
            reg		= <0x09900000 0x100000>;
            interrupts	= <GIC_SPI 155 IRQ_TYPE_NONE>;
            dr_mode		= "host";
            phy-names	= "usb2-phy", "usb3-phy";
            phys		= <&usb2_picophy2>, <&phy_port2 PHY_TYPE_USB3>;
        };
    };
```

## Documentation/devicetree/bindings/usb/st,stm32mp25-dwc3.yaml
```yaml
# SPDX-License-Identifier: (GPL-2.0 OR BSD-2-Clause)
%YAML 1.2
---
$id: http://devicetree.org/schemas/usb/st,stm32mp25-dwc3.yaml#
$schema: http://devicetree.org/meta-schemas/core.yaml#

title: STMicroelectronics STM32 MPU DWC3 USB SoC controller

description:
  The STM32 MPU DWC3 USB SoC controller block supports both
  Host(SS/HS/FS/LS) and Device(SS/HS/FS) mode operation

maintainers:
  - Fabrice Gasnier <fabrice.gasnier@foss.st.com>
  - Marek Vasut <marex@nabladev.com>

properties:
  compatible:
    const: st,stm32mp25-dwc3

  reg:
    maxItems: 1

  access-controllers:
    maxItems: 1

  clocks:
    minItems: 3
    maxItems: 3

  clock-names:
    items:
      - const: ref
      - const: bus_early
      - const: suspend

  dr_mode:
    $ref: /schemas/types.yaml#/definitions/string
    enum: [host, peripheral, otg]

  interrupts:
    maxItems: 1

  phys:
    minItems: 1
    maxItems: 2

  phy-names:
    minItems: 1
    items:
      - const: usb2-phy
      - const: usb3-phy

  resets:
    minItems: 1

  st,syscfg:
    $ref: /schemas/types.yaml#/definitions/phandle-array
    description: Phandle to system configuration controller.
    items:
      - items:
          - description: phandle to syscfg
          - description: USB3DR control offset within syscfg

  st,enable-port-power-control:
    type: boolean
    description: Enable Host-Mode Port Power Control (bit-3 of capability param HCCPARAMS)

  st,ovrcur-active-low:
    type: boolean
    description: Over-Current signal polarity is active-low

  st,vbusen-active-low:
    type: boolean
    description: VBUS-ENABLE signal polarity is active-low

required:
  - compatible
  - reg
  - clocks
  - clock-names
  - interrupts
  - phys
  - phy-names
  - resets
  - st,syscfg

unevaluatedProperties: false

examples:
  - |
    #include <dt-bindings/clock/st,stm32mp25-rcc.h>
    #include <dt-bindings/interrupt-controller/arm-gic.h>
    #include <dt-bindings/reset/st,stm32mp25-rcc.h>

    usb3dr: usb@48300000 {
        compatible = "st,stm32mp25-dwc3";
        reg = <0x48300000 0x100000>;
        clocks = <&rcc CK_KER_USB2PHY2>, <&rcc CK_BUS_USB3DR>, <&rcc CK_KER_USB2PHY2>;
        clock-names = "ref", "bus_early", "suspend";
        interrupts = <GIC_SPI 228 IRQ_TYPE_LEVEL_HIGH>;
        phys = <&usb2_phy>, <&usb3_phy>;
        phy-names = "usb2-phy", "usb3-phy";
        resets = <&rcc USB3DR_R>;
        st,ovrcur-active-low;
        st,syscfg = <&syscfg 0x4800>;
        st,vbusen-active-low;
    };
```
