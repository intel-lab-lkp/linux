## Documentation/devicetree/bindings/w1/amd,axi-1wire-master.yaml
```yaml
# SPDX-License-Identifier: (GPL-2.0-only OR BSD-2-Clause)
%YAML 1.2
---
$id: http://devicetree.org/schemas/w1/amd,axi-1wire-master.yaml#
$schema: http://devicetree.org/meta-schemas/core.yaml#

title: AMD AXI 1-wire bus master for Programmable Logic

maintainers:
  - Kris Chaplin <kris.chaplin@amd.com>

properties:
  compatible:
    const: amd,axi-1wire-master

  reg:
    maxItems: 1

  clocks:
    maxItems: 1

  interrupts:
    maxItems: 1

required:
  - compatible
  - reg
  - clocks
  - interrupts

additionalProperties: false

examples:
  - |
    #include <dt-bindings/interrupt-controller/arm-gic.h>

    onewire@a0000000 {
        compatible = "amd,axi-1wire-master";
        reg = <0xa0000000 0x10000>;
        clocks = <&zynqmp_clk 0x47>;
        interrupts = <GIC_SPI 0x59 IRQ_TYPE_LEVEL_HIGH>;
    };

...
```

## Documentation/devicetree/bindings/watchdog/aaeon,srg-imx8pl-wdt.yaml
```yaml
# SPDX-License-Identifier: (GPL-2.0-only OR BSD-2-Clause)
%YAML 1.2
---
$id: http://devicetree.org/schemas/watchdog/aaeon,srg-imx8pl-wdt.yaml#
$schema: http://devicetree.org/meta-schemas/core.yaml#

title: AAEON Embedded Controller Watchdog Timer

maintainers:
  - Jérémie Dautheribes <jeremie.dautheribes@bootlin.com>
  - Thomas Perrot <thomas.perrot@bootlin.com>

description: |
  Watchdog timer functionality provided by the AAEON embedded controller.
  The watchdog has a fixed maximum hardware heartbeat of 25 seconds and supports
  a timeout of 240 seconds through automatic pinging. The timeout is not
  programmable and cannot be changed via device tree properties.

  The watchdog is a sub-device of the AAEON MCU and must be defined as a
  child node of the MCU device.

allOf:
  - $ref: watchdog.yaml#

properties:
  compatible:
    const: aaeon,srg-imx8pl-wdt

required:
  - compatible

additionalProperties: false

examples:
  - |
    watchdog {
      compatible = "aaeon,srg-imx8pl-wdt";
    };
```

## Documentation/devicetree/bindings/watchdog/arm,sbsa-gwdt.yaml
```yaml
# SPDX-License-Identifier: (GPL-2.0-only OR BSD-2-Clause)
%YAML 1.2
---
$id: http://devicetree.org/schemas/watchdog/arm,sbsa-gwdt.yaml#
$schema: http://devicetree.org/meta-schemas/core.yaml#

title: SBSA (Server Base System Architecture) Generic Watchdog

maintainers:
  - Fu Wei <fu.wei@linaro.org>

description: |
  The SBSA Generic Watchdog Timer is used to force a reset of the system after
  two stages of timeout have elapsed. A detailed definition of the watchdog
  timer can be found in the ARM document: ARM-DEN-0029 - Server Base System
  Architecture (SBSA)

allOf:
  - $ref: watchdog.yaml#

properties:
  compatible:
    enum:
      - arm,sbsa-gwdt
      - marvell,ac5-wd

  reg:
    items:
      - description: Watchdog control frame
      - description: Refresh frame
      - description: Marvell CPU control frame
      - description: Marvell Management frame
      - description: Marvell reset control unit frame

  interrupts:
    description: The Watchdog Signal 0 (WS0) SPI (Shared Peripheral Interrupt)
    maxItems: 1

required:
  - compatible
  - reg
  - interrupts

unevaluatedProperties: false

examples:
  # First example is for generic ARM one
  # Next examples are for Marvell.
  # They are organized as three sets:
  # first set is for global watchdog, then CPU core #0 private watchdog,
  # and finally CPU core #1 private watchdog
  # Examples are given for AC5 or Ironman. For AC5X SOC, the last
  # reg item's low address (0x840F8000) should be replaced with 0x944F8000
  - |
    watchdog@2a440000 {
        compatible = "arm,sbsa-gwdt";
        reg = <0x2a440000 0x1000>,
              <0x2a450000 0x1000>,
              <0x0 0x0>,
              <0x0 0x0>,
              <0x0 0x0>;
        interrupts = <0 27 4>;
        timeout-sec = <30>;
    };
  - |
    watchdog@80216000 {
        compatible = "marvell,ac5-wd";
        reg = <0x80216000 0x1000>,
              <0x80215000 0x1000>,
              <0x80210000 0x1000>,
              <0x7f900000 0x1000>,
              <0x840F8000 0x1000>;
        interrupts = <0 124 4>;
        timeout-sec = <30>;
    };
  - |
    watchdog@80212000 {
        compatible = "marvell,ac5-wd";
        reg = <0x80212000 0x1000>,
              <0x80211000 0x1000>,
              <0x80210000 0x1000>,
              <0x7f900000 0x1000>,
              <0x840F8000 0x1000>;
        interrupts = <0 122 4>;
        timeout-sec = <30>;
    };
  - |
    watchdog@80214000 {
        compatible = "marvell,ac5-wd";
        reg = <0x80214000 0x1000>,
              <0x80213000 0x1000>,
              <0x80210000 0x1000>,
              <0x7f900000 0x1000>,
              <0x840F8000 0x1000>;
        interrupts = <0 122 4>;
        timeout-sec = <30>;
    };
...
```

## Documentation/devicetree/bindings/watchdog/atmel,at91rm9200-wdt.yaml
```yaml
# SPDX-License-Identifier: (GPL-2.0-only OR BSD-2-Clause)
# Copyright (C) 2022 Microchip Technology, Inc. and its subsidiaries
%YAML 1.2
---
$id: http://devicetree.org/schemas/watchdog/atmel,at91rm9200-wdt.yaml#
$schema: http://devicetree.org/meta-schemas/core.yaml#

title: Atmel AT91RM9200 System Timer Watchdog

maintainers:
  - Wim Van Sebroeck <wim@linux-watchdog.org>
  - Guenter Roeck <linux@roeck-us.net>

properties:
  compatible:
    const: atmel,at91sam9260-wdt
  reg:
    maxItems: 1

required:
  - compatible
  - reg

unevaluatedProperties: false

examples:
  - |
    watchdog@fffffd00 {
        compatible = "atmel,at91rm9200-wdt";
        reg = <0xfffffd00 0x10>;
    };
```

## Documentation/devicetree/bindings/watchdog/nuvoton,npcm750-wdt.yaml
```yaml
# SPDX-License-Identifier: (GPL-2.0-only OR BSD-2-Clause)
%YAML 1.2
---
$id: http://devicetree.org/schemas/watchdog/nuvoton,npcm750-wdt.yaml#
$schema: http://devicetree.org/meta-schemas/core.yaml#

title: Nuvoton NPCM Watchdog

maintainers:
  - Joel Stanley <joel@jms.id.au>

description:
  Nuvoton NPCM timer module provides five 24-bit timer counters, and a watchdog.
  The watchdog supports a pre-timeout interrupt that fires 10ms before the
  expiry and reset status detection via syscon integration.

allOf:
  - $ref: watchdog.yaml#

properties:
  compatible:
    oneOf:
      - enum:
          - nuvoton,npcm750-wdt
          - nuvoton,wpcm450-wdt
      - items:
          - enum:
              - nuvoton,npcm845-wdt
          - const: nuvoton,npcm750-wdt

  reg:
    maxItems: 1

  interrupts:
    maxItems: 1

  clocks:
    maxItems: 1

  clock-frequency:
    description: Frequency in Hz of the clock that drives the NPCM timer.

  syscon:
    description: phandle to the Global Control Register (GCR) syscon node.
    $ref: /schemas/types.yaml#/definitions/phandle

  nuvoton,card-reset-type:
    description: Reset type for external card reset signal detection.
    enum:
      - porst
      - corst
      - wd0
      - wd1
      - wd2
      - sw1
      - sw2
      - sw3
      - sw4

  nuvoton,ext1-reset-type:
    description: Reset type for external reset signal 1 detection.
    enum:
      - porst
      - corst
      - wd0
      - wd1
      - wd2
      - sw1
      - sw2
      - sw3
      - sw4

  nuvoton,ext2-reset-type:
    description: Reset type for external reset signal 2 detection.
    enum:
      - porst
      - corst
      - wd0
      - wd1
      - wd2
      - sw1
      - sw2
      - sw3
      - sw4

required:
  - compatible
  - reg
  - interrupts

additionalProperties: false

examples:
  - |
    #include <dt-bindings/interrupt-controller/arm-gic.h>
    #include <dt-bindings/clock/nuvoton,npcm7xx-clock.h>

    watchdog@f000801c {
        compatible = "nuvoton,npcm750-wdt";
        interrupts = <GIC_SPI 47 IRQ_TYPE_LEVEL_HIGH>;
        reg = <0xf000801c 0x4>;
        clocks = <&clk NPCM7XX_CLK_TIMER>;
        syscon = <&gcr>;
        nuvoton,card-reset-type = "porst";
        nuvoton,ext1-reset-type = "wd0";
        nuvoton,ext2-reset-type = "wd2";
    };
```

## Documentation/devicetree/bindings/watchdog/nxp,pnx4008-wdt.yaml
```yaml
# SPDX-License-Identifier: GPL-2.0-only OR BSD-2-Clause
%YAML 1.2
---
$id: http://devicetree.org/schemas/watchdog/nxp,pnx4008-wdt.yaml#
$schema: http://devicetree.org/meta-schemas/core.yaml#

title: NXP PNX watchdog timer

allOf:
  - $ref: watchdog.yaml#

maintainers:
  - Roland Stigge <stigge@antcom.de>

properties:
  compatible:
    const: nxp,pnx4008-wdt

  reg:
    maxItems: 1

unevaluatedProperties: false

required:
  - compatible
  - reg

examples:
  - |
    watchdog@4003c000 {
        compatible = "nxp,pnx4008-wdt";
        reg = <0x4003C000 0x1000>;
        timeout-sec = <10>;
    };
```
