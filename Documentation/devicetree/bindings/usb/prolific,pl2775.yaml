## Documentation/devicetree/bindings/usb/prolific,pl2775.yaml
```yaml
# SPDX-License-Identifier: GPL-2.0-only OR BSD-2-Clause
%YAML 1.2
---
$id: http://devicetree.org/schemas/usb/prolific,pl2775.yaml#
$schema: http://devicetree.org/meta-schemas/core.yaml#

title: Prolific PL2775 USB 3.0 to SATA bridge

maintainers:
  - Dmitry Baryshkov <dmitry.baryshkov@oss.qualcomm.com>

description:
  Device tree properties for hard wired Prolific PL2775 USB 3.0 to
  SATA bridge controllers.

allOf:
  - $ref: usb-device.yaml#

properties:
  compatible:
    const: usb67b,2775

  reg: true

  reset-gpios:
    description: GPIO connected to the RESET_N pin.
    maxItems: 1

  vdd-supply:
    description: Power supply of the controller.

required:
  - compatible
  - reg

additionalProperties: false

examples:
  - |
    #include <dt-bindings/gpio/gpio.h>

    usb {
        #address-cells = <1>;
        #size-cells = <0>;

        device@1 {
            compatible = "usb67b,2775";
            reg = <1>;
            reset-gpios = <&gpio1 11 GPIO_ACTIVE_LOW>;
        };
    };
```

## Documentation/devicetree/bindings/usb/qcom,pmi8998-typec.yaml
```yaml
# SPDX-License-Identifier: (GPL-2.0-only OR BSD-2-Clause)
%YAML 1.2
---
$id: http://devicetree.org/schemas/usb/qcom,pmi8998-typec.yaml#
$schema: http://devicetree.org/meta-schemas/core.yaml#

title: Qualcomm PMI8998 USB Type-C role-switch controller

maintainers:
  - Maxim Furman <taygoth@gmail.com>

description:
  The PMI8998 PMIC integrates a USB Type-C detection block inside its SMB2
  charger USBIN region at offset 0x1300. CC sensing, debounce and Rp/Rd
  resolution are performed in hardware, and the negotiated role is reported
  through a single consolidated "type-c-change" interrupt.

  This block is distinct from the TCPM-based qcom,pmic-typec controllers
  (PM8150B, PMI632, etc.) — PMI8998 lacks the granular per-event interrupt
  topology those parts expose and the driver therefore translates the
  hardware-decided role directly into a usb_role_switch_set_role() call
  rather than running a software TCPM state machine. Power Delivery is not
  supported by this binding.

properties:
  compatible:
    const: qcom,pmi8998-typec

  reg:
    maxItems: 1
    description: Type-C SPMI register base offset (typically 0x1300).

  interrupts:
    maxItems: 1

  interrupt-names:
    items:
      - const: type-c-change

  vdd-vbus-supply:
    description:
      VBUS source regulator enabled when the controller transitions to
      USB host mode so bus-powered downstream peripherals can be powered.

  connector:
    type: object
    $ref: /schemas/connector/usb-connector.yaml#
    unevaluatedProperties: false

required:
  - compatible
  - reg
  - interrupts
  - interrupt-names
  - connector

additionalProperties: false

examples:
  - |
    #include <dt-bindings/interrupt-controller/irq.h>

    pmic {
        #address-cells = <1>;
        #size-cells = <0>;

        typec@1300 {
            compatible = "qcom,pmi8998-typec";
            reg = <0x1300>;

            interrupts = <0x2 0x13 0x7 IRQ_TYPE_EDGE_BOTH>;
            interrupt-names = "type-c-change";

            vdd-vbus-supply = <&pmi8998_vbus>;

            connector {
                compatible = "usb-c-connector";
                label = "USB-C";
                power-role = "dual";
                data-role = "dual";
                try-power-role = "sink";

                ports {
                    #address-cells = <1>;
                    #size-cells = <0>;

                    port@0 {
                        reg = <0>;
                        pmi8998_hs_in: endpoint {
                            remote-endpoint = <&usb_1_dwc3_hs>;
                        };
                    };
                };
            };
        };
    };
...
```

## Documentation/devicetree/bindings/usb/qcom,sa8255p-dwc3.yaml
```yaml
# SPDX-License-Identifier: (GPL-2.0 OR BSD-2-Clause)
%YAML 1.2
---
$id: http://devicetree.org/schemas/usb/qcom,sa8255p-dwc3.yaml#
$schema: http://devicetree.org/meta-schemas/core.yaml#

title: Qualcomm SA8255P USB3 Controller with Firmware-Managed Resources

maintainers:
  - Wesley Cheng <wesley.cheng@oss.qualcomm.com>
  - Faisal Hassan <faisal.hassan@oss.qualcomm.com>

description:
  USB controller on Qualcomm SA8255P automotive SoC where platform resources
  such as clocks, interconnects, resets, regulators and the GDSC are
  abstracted and managed collectively by firmware through SCMI (System
  Control and Management Interface).

  Access to these firmware-managed resources is exposed as two power
  domains, one gating the power supply (GDSC) to the controller, and one
  gating the clocks and interconnects used for data transfer.

properties:
  compatible:
    const: qcom,sa8255p-dwc3

  reg:
    maxItems: 1

  interrupts:
    minItems: 1
    maxItems: 6

  interrupt-names:
    minItems: 1
    maxItems: 6

  power-domains:
    description: |
      Power domains are provided by SCMI (System Control and Management
      Interface). See Documentation/devicetree/bindings/firmware/arm,scmi.yaml
      for details.

      Exactly two power domains must be specified:
        - "power": controls power supply (GDSC) to the USB controller
        - "bus": controls clocks and interconnects used for data transfer
    minItems: 2
    maxItems: 2

  power-domain-names:
    description: Names for the power domains specified in the power-domains property.
    items:
      - const: power
      - const: bus

  resets:
    description: |
      Reset provided by SCMI firmware. See
      Documentation/devicetree/bindings/firmware/arm,scmi.yaml for details.
    maxItems: 1

  iommus:
    maxItems: 1

  phys:
    minItems: 1
    maxItems: 2

  phy-names:
    minItems: 1
    maxItems: 2

  # Firmware-managed platforms do not use direct clock/interconnect control
  clocks: false
  clock-names: false
  interconnects: false
  interconnect-names: false

required:
  - compatible
  - reg
  - interrupts
  - interrupt-names
  - power-domains
  - power-domain-names
  - resets

allOf:
  - $ref: snps,dwc3-common.yaml#

unevaluatedProperties: false

examples:
  - |
    #include <dt-bindings/interrupt-controller/arm-gic.h>
    #include <dt-bindings/interrupt-controller/irq.h>

    usb@a800000 {
        compatible = "qcom,sa8255p-dwc3";
        reg = <0x0a800000 0x10000>;

        interrupts-extended = <&intc GIC_SPI 349 IRQ_TYPE_LEVEL_HIGH>,
                              <&intc GIC_SPI 352 IRQ_TYPE_LEVEL_HIGH>,
                              <&intc GIC_SPI 351 IRQ_TYPE_LEVEL_HIGH>,
                              <&pdc 8 IRQ_TYPE_EDGE_BOTH>,
                              <&pdc 7 IRQ_TYPE_EDGE_BOTH>,
                              <&pdc 13 IRQ_TYPE_LEVEL_HIGH>;
        interrupt-names = "dwc_usb3",
                          "pwr_event",
                          "hs_phy_irq",
                          "dp_hs_phy_irq",
                          "dm_hs_phy_irq",
                          "ss_phy_irq";

        power-domains = <&scmi_pd 1>, <&scmi_pd 2>;
        power-domain-names = "power", "bus";
        resets = <&scmi_rst 0>;

        iommus = <&apps_smmu 0x0a0 0x0>;
        phys = <&usb_1_hsphy>, <&usb_1_qmpphy>;
        phy-names = "usb2-phy", "usb3-phy";
    };
...
```

## Documentation/devicetree/bindings/usb/realtek,rts5411.yaml
```yaml
# SPDX-License-Identifier: GPL-2.0-only OR BSD-2-Clause
%YAML 1.2
---
$id: http://devicetree.org/schemas/usb/realtek,rts5411.yaml#
$schema: http://devicetree.org/meta-schemas/core.yaml#

title: Realtek RTS5411 USB 3.0 hub controller

maintainers:
  - Matthias Kaehlcke <mka@chromium.org>

allOf:
  - $ref: usb-hub.yaml#

properties:
  compatible:
    items:
      - enum:
          - usbbda,5411
          - usbbda,411

  reg: true

  '#address-cells': true

  '#size-cells': true

  vdd-supply:
    description:
      phandle to the regulator that provides power to the hub.

  peer-hub: true

  ports:
    $ref: /schemas/graph.yaml#/properties/ports
    properties:
      '#address-cells': true

      '#size-cells': true

    patternProperties:
      '^port@[1-4]$': true

    additionalProperties: false

patternProperties:
  '^.*@[1-4]$': true

required:
  - peer-hub
  - compatible
  - reg

additionalProperties: false

examples:
  - |
    usb {
        dr_mode = "host";
        #address-cells = <1>;
        #size-cells = <0>;

        /* 2.0 hub on port 1 */
        hub_2_0: hub@1 {
            compatible = "usbbda,5411";
            reg = <1>;
            vdd-supply = <&pp3300_hub>;
            peer-hub = <&hub_3_0>;
            #address-cells = <1>;
            #size-cells = <0>;
            /* USB 2.0 device on port 2 */
            device@2 {
                compatible = "usb123,4567";
                reg = <2>;
            };
        };

        /* 3.0 hub on port 2 */
        hub_3_0: hub@2 {
            compatible = "usbbda,411";
            reg = <2>;
            vdd-supply = <&pp3300_hub>;
            peer-hub = <&hub_2_0>;

            ports {
                #address-cells = <1>;
                #size-cells = <0>;
                /* Type-A connector on port 4 */
                port@4 {
                    reg = <4>;
                    endpoint {
                      remote-endpoint = <&usb_a0_ss>;
                    };
                };
            };
        };
    };
```

## Documentation/devicetree/bindings/usb/renesas,rcar-gen5-dwc3.yaml
```yaml
# SPDX-License-Identifier: (GPL-2.0-only OR BSD-2-Clause)
%YAML 1.2
---
$id: http://devicetree.org/schemas/usb/renesas,rcar-gen5-dwc3.yaml#
$schema: http://devicetree.org/meta-schemas/core.yaml#

title: Renesas R-Car Gen5 DWC3 xHCI USB controller

maintainers:
  - Marek Vasut <marek.vasut+renesas@mailbox.org>

allOf:
  - $ref: snps,dwc3-common.yaml#

properties:
  compatible:
    items:
      - const: renesas,r8a78000-dwc3
      - const: renesas,rcar-gen5-dwc3

  reg:
    maxItems: 2

  reg-names:
    items:
      - const: dwc3
      - const: glue

  clocks:
    maxItems: 1

  interrupts:
    maxItems: 1

  power-domains:
    maxItems: 1

  resets:
    maxItems: 1

required:
  - compatible
  - reg
  - reg-names
  - clocks
  - interrupts
  - phys
  - phy-names
  - power-domains
  - resets

unevaluatedProperties: false

examples:
  - |
    #include <dt-bindings/interrupt-controller/arm-gic.h>

    usb@c8800000 {
        compatible = "renesas,r8a78000-dwc3", "renesas,rcar-gen5-dwc3";
        reg = <0xc8800000 0x100000>, <0xc9c54000 0x2000>;
        reg-names = "dwc3", "glue";
        clocks = <&scmi_clk 336>;
        interrupts = <GIC_SPI 795 IRQ_TYPE_LEVEL_HIGH>;
        phys = <&usb30_phy>, <&mp_phy 2>;
        phy-names = "usb2-phy", "usb3-phy";
        power-domains = <&scmi_devpd 16>;
        resets = <&scmi_reset 336>;
    };
```

## Documentation/devicetree/bindings/usb/renesas,rcar-gen5-usb.yaml
```yaml
# SPDX-License-Identifier: (GPL-2.0-only OR BSD-2-Clause)
%YAML 1.2
---
$id: http://devicetree.org/schemas/usb/renesas,rcar-gen5-usb.yaml#
$schema: http://devicetree.org/meta-schemas/core.yaml#

title: Renesas R-Car Gen5 DWC3 xHCI USB controller

maintainers:
  - Marek Vasut <marek.vasut+renesas@mailbox.org>

properties:
  compatible:
    items:
      - const: renesas,r8a78000-usb
      - const: renesas,rcar-gen5-usb

  '#address-cells':
    const: 2

  '#size-cells':
    const: 2

  ranges: true

  reg:
    maxItems: 1

  clocks:
    maxItems: 1

  power-domains:
    maxItems: 1

  resets:
    maxItems: 1

patternProperties:
  '^usb@':
    $ref: snps,dwc3.yaml#

required:
  - compatible
  - '#address-cells'
  - '#size-cells'
  - ranges
  - reg
  - clocks
  - power-domains
  - resets

additionalProperties: false

examples:
  - |
    #include <dt-bindings/interrupt-controller/arm-gic.h>

    bus {
        #address-cells = <2>;
        #size-cells = <2>;

        usb@c9c54000 {
            compatible = "renesas,r8a78000-usb", "renesas,rcar-gen5-usb";
            reg = <0 0xc9c54000 0 0x2000>;
            clocks = <&scmi_clk 336>;
            power-domains = <&scmi_devpd 16>;
            resets = <&scmi_reset 336>;

            #address-cells = <2>;
            #size-cells = <2>;
            ranges = <0x0 0xc8800000 0x0 0xc8800000 0x0 0x100000>;

            usb@c8800000 {
                compatible = "synopsys,dwc3";
                reg = <0x0 0xc8800000 0x0 0x100000>;
                interrupts = <GIC_SPI 795 IRQ_TYPE_LEVEL_HIGH>;
                maximum-speed = "super-speed-plus";
                phys = <&mp_phy 2>;
                phy-names = "usb3-phy";
            };
        };
    };
```
