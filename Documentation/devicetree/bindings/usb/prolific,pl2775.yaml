## Documentation/devicetree/bindings/usb/st,stm32mp25-ucpd.yaml
```yaml
# SPDX-License-Identifier: GPL-2.0-only OR BSD-2-Clause
%YAML 1.2
---
$id: http://devicetree.org/schemas/usb/st,stm32mp25-ucpd.yaml#
$schema: http://devicetree.org/meta-schemas/core.yaml#

title: STMicroelectronics STM32MP25 UCPD Type-C controller

maintainers:
  - Marek Vasut <marex@nabladev.com>

description:
  The UCPD integrates the physical layer of the Power Delivery (PD),
  with CC signaling method, for operation with Type-C cables. Vbus
  and Vconn control is performed using an external chip, usually
  ST TCPP01/TCPP02/TCPP03 or similar.

properties:
  compatible:
    const: st,stm32mp25-ucpd

  reg:
    maxItems: 1

  access-controllers:
    maxItems: 1

  clocks:
    minItems: 2
    maxItems: 2

  clock-names:
    items:
      - const: apb
      - const: ker

  interrupts:
    maxItems: 1

  nvmem-cells:
    maxItems: 1

  nvmem-cell-names:
    const: trim

  power-domains:
    maxItems: 1

  resets:
    maxItems: 1

  reset-names:
    const: phy

  vconn-gpios:
    description: GPIOs used to control CC1 and CC2 Vconn

  vdd33-supply:
    description: Regulator that supplies the CC lines driver

  connector:
    type: object
    $ref: /schemas/connector/usb-connector.yaml#
    unevaluatedProperties: false

    properties:
      compatible:
        const: usb-c-connector

      power-role: true

      typec-power-opmode: true

    required:
      - compatible

required:
  - compatible
  - reg
  - clocks
  - clock-names
  - interrupts
  - nvmem-cells
  - nvmem-cell-names
  - power-domains
  - resets
  - reset-names

unevaluatedProperties: false

examples:
  - |
    #include <dt-bindings/clock/st,stm32mp25-rcc.h>
    #include <dt-bindings/interrupt-controller/arm-gic.h>
    #include <dt-bindings/reset/st,stm32mp25-rcc.h>

    ucpd: phy@480a0000 {
        compatible = "st,stm32mp25-ucpd";
        reg = <0x480a0000 0x1000>;
        access-controllers = <&rifsc 69>;
        clocks = <&rcc CK_BUS_USBTC>, <&rcc CK_KER_USBTC>;
        clock-names = "apb", "ker";
        interrupts = <46 IRQ_TYPE_LEVEL_HIGH>;
        nvmem-cells = <&ucpdtrim>;
        nvmem-cell-names = "trim";
        power-domains = <&cluster_pd>;
        resets = <&rcc USBTC_R>;
        reset-names = "phy";

        vconn-gpios = <&tcpp 0 0>, <&tcpp 1 0>;
        vdd33-supply = <&scmi_vdd33ucpd>;

        connector {
            compatible = "usb-c-connector";
            label = "USB-C";
            data-role = "dual";
            power-role = "source";
            self-powered;
            vbus-gpios = <&gpioa 10 0>;
            vbus-supply = <&reg_usbc_vbus>;

            altmodes {
                displayport {
                    svid = /bits/ 16 <0xff01>;
                    vdo = <0xffffffff>;
                };
            };

            ports {
                #address-cells = <1>;
                #size-cells = <0>;

                port@0 {
                    reg = <0>;
                    usbc0_hs_ep: endpoint {
                        remote-endpoint = <&usb_drd0_hs_ep>;
                    };
                };
                port@1 {
                    reg = <1>;
                    usbc0_ss_ep: endpoint {
                        remote-endpoint = <&usb_drd0_ss_ep>;
                    };
                };

                port@2 {
                    reg = <2>;
                    usbc0_sbu_ep: endpoint {
                        remote-endpoint = <&usb_sbu_ep>;
                    };
                };
            };
        };
    };
```

## Documentation/devicetree/bindings/usb/ti,da830-ohci.yaml
```yaml
# SPDX-License-Identifier: (GPL-2.0-only OR BSD-2-Clause)
%YAML 1.2
---
$id: http://devicetree.org/schemas/usb/ti,da830-ohci.yaml#
$schema: http://devicetree.org/meta-schemas/core.yaml#

title: DA8XX USB OHCI controller

maintainers:
  - Axel Haslam <ahaslam@baylibre.com>

properties:
  compatible:
    const: ti,da830-ohci

  reg:
    maxItems: 1

  interrupts:
    maxItems: 1

  phys:
    maxItems: 1

  phy-names:
    const: usb-phy

  vbus-supply:
    description:
      phandle of regulator that controls vbus power / over-current

required:
  - compatible
  - reg
  - interrupts
  - phys
  - phy-names

additionalProperties: false

examples:
  - |
    usb@225000 {
        compatible = "ti,da830-ohci";
        reg = <0x225000 0x1000>;
        interrupts = <59>;
        phys = <&usb_phy 1>;
        phy-names = "usb-phy";
        vbus-supply = <&reg_usb_ohci>;
    };
```

## Documentation/devicetree/bindings/usb/ti,tps25750.yaml
```yaml
# SPDX-License-Identifier: (GPL-2.0-only OR BSD-2-Clause)
%YAML 1.2
---
$id: http://devicetree.org/schemas/usb/ti,tps25750.yaml#
$schema: http://devicetree.org/meta-schemas/core.yaml#

title: Texas Instruments 25750 Type-C Port Switch and Power Delivery controller

maintainers:
  - Abdel Alkuor <abdelalkuor@geotab.com>

description: |
  Texas Instruments 25750 Type-C Port Switch and Power Delivery controller

properties:
  compatible:
    enum:
      - ti,tps25750
  reg:
    maxItems: 1

  interrupts:
    description: |
    maxItems: 1

  interrupt-names:
    items:
      - const: irq

  firmware-name:
    description: |
      Should contain the name of the default patch binary
      file located on the firmware search path which is
      used to switch the controller into APP mode

  connector:
    type: object
    $ref: ../connector/usb-connector.yaml#
    description:
      Properties for usb c connector.
    required:
      - data-role

required:
  - compatible
  - reg
  - interrupts
  - connector

additionalProperties: true

examples:
  - |
    #include <dt-bindings/interrupt-controller/irq.h>
    i2c {
        #address-cells = <1>;
        #size-cells = <0>;

        tps25750: tps25750@21 {
            compatible = "ti,tps25750";
            reg = <0x21>;

            interrupt-parent = <&msmgpio>;
            interrupts = <107 IRQ_TYPE_LEVEL_LOW>;
            interrupt-names = "irq";

            firmware-name = "tps25750.bin";

            pinctrl-names = "default";
            pinctrl-0 = <&typec_pins>;

            typec_con: connector {
                compatible = "usb-c-connector";
                label = "USB-C";
                data-role = "dual";
                port {
                    typec_ep: endpoint {
                        remote-endpoint = <&otg_ep>;
                    };
                };
            };
        };
    };
...
```

## Documentation/devicetree/bindings/usb/ti,tps6598x.yaml
```yaml
# SPDX-License-Identifier: (GPL-2.0-only OR BSD-2-Clause)
%YAML 1.2
---
$id: http://devicetree.org/schemas/usb/ti,tps6598x.yaml#
$schema: http://devicetree.org/meta-schemas/core.yaml#

title: Texas Instruments 6598x Type-C Port Switch and Power Delivery controller

maintainers:
  - Bryan O'Donoghue <bryan.odonoghue@linaro.org>

description: |
  Texas Instruments 6598x Type-C Port Switch and Power Delivery controller

  A variant of this controller known as Apple CD321x or Apple ACE is also
  present on hardware with Apple SoCs such as the M1.

properties:
  compatible:
    enum:
      - ti,tps6598x
      - apple,cd321x
      - ti,tps25750

  reg:
    maxItems: 1

  wakeup-source: true

  interrupts:
    maxItems: 1

  interrupt-names:
    items:
      - const: irq

  firmware-name:
    description: |
      Should contain the name of the default patch binary
      file located on the firmware search path which is
      used to switch the controller into APP mode.
      This is used when tps25750 doesn't have an EEPROM
      connected to it.
    maxItems: 1

  ti,patch-address:
    description: |
      One of PBMs command data field is I2C slave address
      which is used when writing the patch for TPS25750.
      The slave address can be any value except 0x00, 0x20,
      0x21, 0x22, and 0x23
    $ref: /schemas/types.yaml#/definitions/uint8
    minimum: 1
    maximum: 0x7e

required:
  - compatible
  - reg

allOf:
  - if:
      properties:
        compatible:
          contains:
            const: ti,tps25750
    then:
      required:
        - ti,patch-address
        - connector

      properties:
        connector:
          required:
            - data-role

additionalProperties: true

examples:
  - |
    #include <dt-bindings/interrupt-controller/irq.h>
    i2c {
        #address-cells = <1>;
        #size-cells = <0>;

        tps6598x: tps6598x@38 {
            compatible = "ti,tps6598x";
            reg = <0x38>;
            wakeup-source;

            interrupt-parent = <&msmgpio>;
            interrupts = <107 IRQ_TYPE_LEVEL_LOW>;
            interrupt-names = "irq";

            pinctrl-names = "default";
            pinctrl-0 = <&typec_pins>;

            typec_con: connector {
                compatible = "usb-c-connector";
                label = "USB-C";
                port {
                    typec_ep: endpoint {
                        remote-endpoint = <&otg_ep>;
                    };
                };
            };
        };
    };

  - |
    #include <dt-bindings/interrupt-controller/irq.h>
    i2c {
        #address-cells = <1>;
        #size-cells = <0>;

        typec@21 {
            compatible = "ti,tps25750";
            reg = <0x21>;

            interrupt-parent = <&msmgpio>;
            interrupts = <100 IRQ_TYPE_LEVEL_LOW>;
            interrupt-names = "irq";
            firmware-name = "tps25750.bin";

            pinctrl-names = "default";
            pinctrl-0 = <&typec_pins>;

            ti,patch-address = /bits/ 8 <0x0f>;

            typec_con0: connector {
                compatible = "usb-c-connector";
                label = "USB-C";
                data-role = "dual";
                port {
                    typec_ep0: endpoint {
                        remote-endpoint = <&otg_ep>;
                    };
                };
            };
        };
    };
...
```

## Documentation/devicetree/bindings/usb/ti,tusb73x0-pci.yaml
```yaml
# SPDX-License-Identifier: (GPL-2.0-only OR BSD-2-Clause)
%YAML 1.2
---
$id: http://devicetree.org/schemas/usb/ti,tusb73x0-pci.yaml#
$schema: http://devicetree.org/meta-schemas/core.yaml#

title: TUSB73x0 USB 3.0 xHCI Host Controller (PCIe)

maintainers:
  - Francesco Dolcini <francesco.dolcini@toradex.com>

description:
  TUSB73x0 USB 3.0 xHCI Host Controller via PCIe x1 Gen2 interface.
  The TUSB7320 supports up to two downstream ports, the TUSB7340 supports up
  to four downstream ports.

properties:
  compatible:
    const: pci104c,8241

  reg:
    maxItems: 1

  ti,tusb7320-pwron-active-high:
    $ref: /schemas/types.yaml#/definitions/flag
    description:
      Configure the polarity of the PWRONx# signals. When this is present, the PWRONx#
      pins are active high and their internal pull-down resistors are disabled.
      When this is absent, the PWRONx# pins are active low (default) and their internal
      pull-down resistors are enabled.

required:
  - compatible
  - reg

additionalProperties: false

examples:
  - |
    pcie {
        #address-cells = <3>;
        #size-cells = <2>;

        pcie@0 {
            device_type = "pci";
            reg = <0x0 0x0 0x0 0x0 0x0>;
            bus-range = <0x01 0xff>;

            #address-cells = <3>;
            #size-cells = <2>;
            ranges;

            usb@0 {
                  compatible = "pci104c,8241";
                  reg = <0x10000 0x0 0x0 0x0 0x0>;

                  ti,tusb7320-pwron-active-high;
            };
        };
    };
```

## Documentation/devicetree/bindings/usb/ti,twl6030-usb.yaml
```yaml
# SPDX-License-Identifier: (GPL-2.0-only OR BSD-2-Clause)
%YAML 1.2
---
$id: http://devicetree.org/schemas/usb/ti,twl6030-usb.yaml#
$schema: http://devicetree.org/meta-schemas/core.yaml#

title: Texas Instruments TWL6030 USB Comparator

maintainers:
  - Peter Ujfalusi <peter.ujfalusi@gmail.com>

description:
  Bindings for the USB comparator module found within the TWL6030
  family of companion chips.

properties:
  compatible:
    const: ti,twl6030-usb

  interrupts:
    description:
      Interrupts for ID and VBUS events, two interrupts must be specified,
      the first is the OTG interrupt for ID events (host mode), the second
      is the USB interrupt for VBUS events (device mode).
    minItems: 2
    maxItems: 2

  usb-supply:
    description:
      Phandle to the VUSB regulator. For TWL6030, this should be the 'vusb'
      regulator. For TWL6032 subclass, it should be the 'ldousb' regulator.

required:
  - compatible
  - interrupts
  - usb-supply

additionalProperties: false

examples:
  - |
    #include <dt-bindings/interrupt-controller/irq.h>

    usb {
        compatible = "ti,twl6030-usb";

        interrupts = <4 IRQ_TYPE_LEVEL_HIGH>, <10 IRQ_TYPE_LEVEL_HIGH>;
        interrupt-parent = <&gic>;

        usb-supply = <&reg_vusb>;
    };
```

## Documentation/devicetree/bindings/usb/ti,twlxxxx-usb.yaml
```yaml
# SPDX-License-Identifier: (GPL-2.0-only OR BSD-2-Clause)
%YAML 1.2
---
$id: http://devicetree.org/schemas/usb/ti,twlxxxx-usb.yaml#
$schema: http://devicetree.org/meta-schemas/core.yaml#

title: Texas Instruments TWL4030/6030 USB PHY and Comparator

maintainers:
  - Peter Ujfalusi <peter.ujfalusi@gmail.com>

description: |
  Bindings for the USB PHY and comparator module found within the
  TWL4030 and TWL6030 family of companion chips.

  TWL6030: USB COMPARATOR
  TWL4030: USB COMPARATOR & PHY

  If a sibling node is compatible with "ti,twl4030-bci", the driver for
  that node will query this device for USB power status.

properties:
  compatible:
    enum:
      - ti,twl4030-usb
      - ti,twl6030-usb

  interrupts:
    description: |
      Interrupts for ID and VBUS events.
      For "ti,twl6030-usb", two interrupts must be specified:
        - The first is the OTG interrupt for ID events (host mode).
        - The second is the USB interrupt for VBUS events (device mode).
      For "ti,twl4030-usb", one or two interrupts can be specified:
        - The first is the OTG interrupt for both ID and VBUS events.
        - The second is optional.
    minItems: 1
    maxItems: 2

  usb-supply:
    description:
      Phandle to the VUSB regulator. For TWL6030, this should be the 'vusb'
      regulator. For TWL6032 subclass, it should be the 'ldousb' regulator.

  usb1v5-supply:
    description: Phandle to the VUSB1V5 regulator (for TWL4030).

  usb1v8-supply:
    description: Phandle to the VUSB1V8 regulator (for TWL4030).

  usb3v1-supply:
    description: Phandle to the USB3V1 regulator (for TWL4030).

  usb_mode:
    description: |
      The mode used by the PHY (TWL4030 ONLY) to connect to the controller:
        1: ULPI mode
        2: CEA2011_3PIN mode
    $ref: /schemas/types.yaml#/definitions/uint32
    enum: [1, 2]

  '#phy-cells':
    const: 0

required:
  - compatible
  - interrupts

additionalProperties: false

if:
  properties:
    compatible:
      contains:
        const: ti,twl6030-usb
then:
  required:
    - usb-supply
  properties:
    interrupts:
      minItems: 2
else:
  required:
    - usb1v5-supply
    - usb1v8-supply
    - usb3v1-supply
    - usb_mode

examples:
  - |
    #include <dt-bindings/interrupt-controller/arm-gic.h>

    usb-phy{
        compatible = "ti,twl4030-usb";

        // 1 interrupt: OTG (ID & VBUS events)
        interrupts = <10 IRQ_TYPE_LEVEL_HIGH>;
        interrupt-parent = <&gic>;

        usb1v5-supply = <&reg_vusb1v5>;
        usb1v8-supply = <&reg_vusb1v8>;
        usb3v1-supply  = <&reg_vusb3v1>;
        usb_mode = <1>;

        #phy-cells = <0>;
    };
  - |
    usb{
        compatible = "ti,twl6030-usb";

        // 2 interrupts: OTG & USB
        interrupts = <4 IRQ_TYPE_LEVEL_HIGH>, <10 IRQ_TYPE_LEVEL_HIGH>;
        interrupt-parent = <&gic>;

        usb-supply = <&reg_vusb>;
    };
```
