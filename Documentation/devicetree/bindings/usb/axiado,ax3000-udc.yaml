## Documentation/devicetree/bindings/usb/cix,sky1-usbssp.yaml
```yaml
# SPDX-License-Identifier: (GPL-2.0-only OR BSD-2-Clause)
%YAML 1.2
---
$id: http://devicetree.org/schemas/usb/cix,sky1-usbssp.yaml#
$schema: http://devicetree.org/meta-schemas/core.yaml#

title: CIX Sky1 Cadence USBSSP Controller

maintainers:
  - Hongliang Yang <hongliang.yang@cixtech.com>

description:
  The CIX Sky1 USBSSP controller is based on the Cadence USBSSP DRD
  controller. The integration adds glue registers and mode strap controls
  in the Sky1 S5 system controller. The CIX glue node wraps a Cadence
  USBSSP core as a child node.

properties:
  compatible:
    const: cix,sky1-usbssp

  reg:
    items:
      - description: AXI property configuration register
      - description: Controller status register

  reg-names:
    items:
      - const: axi
      - const: controller

  clocks:
    items:
      - description: Start-of-frame clock
      - description: AXI bus clock
      - description: Low-power mode clock
      - description: APB register interface clock

  clock-names:
    items:
      - const: sof
      - const: axi
      - const: lpm
      - const: apb

  resets:
    items:
      - description: APB register reset
      - description: Controller reset

  reset-names:
    items:
      - const: apb
      - const: core

  cix,usb-syscon:
    $ref: /schemas/types.yaml#/definitions/phandle
    description:
      Phandle to the Sky1 S5 system controller used to program USB mode
      strap controls.

  "#address-cells":
    const: 2

  "#size-cells":
    const: 2

  ranges: true

patternProperties:
  "^usb@[0-9a-f]+$":
    $ref: cdns,usb3.yaml#

required:
  - compatible
  - reg
  - reg-names
  - clocks
  - clock-names
  - resets
  - reset-names
  - cix,usb-syscon
  - "#address-cells"
  - "#size-cells"
  - ranges

unevaluatedProperties: false

examples:
  - |
    #include <dt-bindings/clock/cix,sky1.h>
    #include <dt-bindings/interrupt-controller/arm-gic.h>
    #include <dt-bindings/reset/cix,sky1-s5-system-control.h>

    soc {
        #address-cells = <2>;
        #size-cells = <2>;

        usb@91c0314 {
            compatible = "cix,sky1-usbssp";
            reg = <0x00 0x091c0314 0x00 0x4>,
                  <0x00 0x091c0400 0x00 0x4>;
            reg-names = "axi", "controller";
            ranges;
            #address-cells = <2>;

            clocks = <&scmi_clk CLK_TREE_USB3A_H0_CLK_SOF>,
                     <&scmi_clk CLK_TREE_USB3A_0_AXI_GATE>,
                     <&scmi_clk CLK_TREE_USB3A_H0_CLK_LPM>,
                     <&scmi_clk CLK_TREE_USB3A_0_APB_GATE>;
            clock-names = "sof", "axi", "lpm", "apb";
            resets = <&src SKY1_USBC_SS2_PRST_N>,
                     <&src SKY1_USBC_SS2_RST_N>;
            reset-names = "apb", "core";
            #size-cells = <2>;
            cix,usb-syscon = <&src>;

            usb@91d0000 {
                compatible = "cdns,usb3";
                reg = <0x00 0x91d0000 0x00 0x4000>,
                      <0x00 0x91d8000 0x00 0x8000>,
                      <0x00 0x91d4000 0x00 0x4000>;
                reg-names = "otg", "xhci", "dev";
                dr_mode = "otg";

                interrupts = <GIC_SPI 168 IRQ_TYPE_LEVEL_HIGH>,
                             <GIC_SPI 169 IRQ_TYPE_LEVEL_HIGH>,
                             <GIC_SPI 170 IRQ_TYPE_LEVEL_HIGH>,
                             <GIC_SPI 171 IRQ_TYPE_LEVEL_HIGH>;
                interrupt-names = "host", "peripheral", "otg", "wakeup";
                maximum-speed = "super-speed-plus";

                phys = <&usb3_phy4_0>, <&usb2_phy6>;
                phy-names = "cdns3,usb3-phy", "cdns3,usb2-phy";
            };
        };
    };
```

## Documentation/devicetree/bindings/usb/cypress,cypd4226.yaml
```yaml
# SPDX-License-Identifier: (GPL-2.0 OR BSD-2-Clause)
%YAML 1.2
---
$id: http://devicetree.org/schemas/usb/cypress,cypd4226.yaml#
$schema: http://devicetree.org/meta-schemas/core.yaml#

title: Cypress cypd4226/cypd6129/cypd6229 Type-C Controller

maintainers:
  - Wayne Chang <waynec@nvidia.com>
  - Akash Kumar <akash.kumar@oss.qualcomm.com>

description:
  The Cypress cypd4226 is a dual Type-C controller, and the cypd6129 and
  cypd6229 are dual Type-C PD controllers. All are controlled via an I2C
  interface.

properties:
  compatible:
    oneOf:
      - const: cypress,cypd4226
      - const: cypress,cypd6129
      - items:
          - const: cypress,cypd6229
          - const: cypress,cypd6129

  '#address-cells':
    const: 1

  '#size-cells':
    const: 0

  reg:
    maxItems: 1

  interrupts:
    maxItems: 1

  firmware-name:
    enum:
      - nvidia,gpu
      - nvidia,jetson-agx-xavier
    description: |
      The name of the CCGx firmware built for product series.
      should be set one of following:
      - "nvidia,gpu" for the NVIDIA RTX product series
      - "nvidia,jetson-agx-xavier" for the NVIDIA Jetson product series

  pinctrl-0: true
  pinctrl-1: true

  pinctrl-names:
    minItems: 1
    items:
      - const: default
      - const: sleep

  wakeup-source:
    description: enable IRQ remote wakeup, see power/wakeup-source.txt
    type: boolean

patternProperties:
  '^connector@[01]$':
    $ref: /schemas/connector/usb-connector.yaml#
    required:
      - reg

required:
  - compatible
  - reg
  - interrupts

anyOf:
  - required:
      - connector@0
  - required:
      - connector@1

allOf:
  - if:
      properties:
        compatible:
          contains:
            const: cypress,cypd4226
    then:
      properties:
        reg:
          const: 0x08
        pinctrl-0: false
        pinctrl-1: false
        pinctrl-names: false
        wakeup-source: false
    else:
      properties:
        firmware-name: false

additionalProperties: false

examples:
  - |
    #include <dt-bindings/interrupt-controller/arm-gic.h>
    i2c {
      #address-cells = <1>;
      #size-cells = <0>;

      typec@8 {
        compatible = "cypress,cypd4226";
        reg = <0x08>;
        interrupts = <2 IRQ_TYPE_LEVEL_LOW>;
        firmware-name = "nvidia,jetson-agx-xavier";
        #address-cells = <1>;
        #size-cells = <0>;
        connector@0 {
          compatible = "usb-c-connector";
          reg = <0>;
          label = "USB-C";
          data-role = "dual";
          ports {
            #address-cells = <1>;
            #size-cells = <0>;
            port@0 {
              reg = <0>;
              endpoint {
                remote-endpoint = <&usb_role_switch0>;
              };
            };
          };
        };
      };
    };
  - |
    #include <dt-bindings/interrupt-controller/irq.h>
    i2c {
        #address-cells = <1>;
        #size-cells = <0>;

        typec@40 {
            compatible = "cypress,cypd6129";
            reg = <0x40>;
            interrupts-extended = <&tlmm 136 IRQ_TYPE_LEVEL_LOW>;
            pinctrl-0 = <&usb0_intr_state>;
            pinctrl-names = "default";
            wakeup-source;

            #address-cells = <1>;
            #size-cells = <0>;

            connector@0 {
                compatible = "usb-c-connector";
                reg = <0>;
                label = "USB-C";
                data-role = "dual";
                power-role = "dual";

                ports {
                    #address-cells = <1>;
                    #size-cells = <0>;

                    port@0 {
                        reg = <0>;

                        endpoint {
                            remote-endpoint = <&usb_role_switch0>;
                        };
                    };
                };
            };
        };
    };
```

## Documentation/devicetree/bindings/usb/diodes,pi5usb30213a.yaml
```yaml
# SPDX-License-Identifier: (GPL-2.0-only OR BSD-2-Clause)
%YAML 1.2
---
$id: http://devicetree.org/schemas/usb/diodes,pi5usb30213a.yaml#
$schema: http://devicetree.org/meta-schemas/core.yaml#

title: PI5USB30213A Type-C port controller

maintainers:
  - Petr Benes <petr.benes@ysoft.com>

description:
  Diodes Incorporated PI5USB30213A Type-C Controller supports host,
  device, and dual-role mode based on voltage levels detected on CC
  pin. Dual differential channel, 2:1 USB 3.0 Mux/Demux, USB Type-C
  specification 1.1 compliant.

properties:
  compatible:
    enum:
      - diodes,pi5usb30213a

  reg:
    maxItems: 1

  interrupts:
    maxItems: 1

  connector:
    type: object
    $ref: /schemas/connector/usb-connector.yaml#
    unevaluatedProperties: false

required:
  - compatible
  - reg
  - interrupts
  - connector

additionalProperties: false

examples:
  - |
    #include <dt-bindings/interrupt-controller/irq.h>

    i2c {
      #address-cells = <1>;
      #size-cells = <0>;

      typec@d {
        compatible = "diodes,pi5usb30213a";
        reg = <0xd>;
        pinctrl-names = "default";
        pinctrl-0 = <&pinctrl_typec>;
        interrupts-extended = <&gpio1 5 IRQ_TYPE_LEVEL_LOW>;

        connector {
          compatible = "usb-c-connector";
          label = "USB-C";
          vbus-supply = <&reg_typec>;
          power-role = "source";
          data-role = "dual";
          typec-power-opmode = "default";
          pd-disable;

          ports {
            #address-cells = <1>;
            #size-cells = <0>;

            port@0 {
              reg = <0>;

              usb_con_hs: endpoint {
                remote-endpoint = <&typec_hs>;
              };
            };

            port@1 {
              reg = <1>;

              usb_con_ss: endpoint {
                remote-endpoint = <&typec_ss>;
              };
            };
          };
        };
      };
    };
```

## Documentation/devicetree/bindings/usb/dwc3-altera.yaml
```yaml
# SPDX-License-Identifier: (GPL-2.0-only OR BSD-2-Clause)
%YAML 1.2
---
$id: http://devicetree.org/schemas/usb/dwc3-altera.yaml#
$schema: http://devicetree.org/meta-schemas/core.yaml#

title: Altera DWC3 USB Controller Wrapper

maintainers:
  - Adrian Ng <adrianhoyin.ng@altera.com>

description: |
  The Altera SoCFPGA wrapper around the Synopsys DesignWare USB3 (DWC3) core.
  The wrapper provides SoC-specific integration such as reset and clock control.

properties:
  compatible:
    const: altr,agilex5-dwc3

  reg:
    maxItems: 1

  clocks:
    minItems: 1
    maxItems: 2

  resets:
    minItems: 1
    maxItems: 2

  "#address-cells":
    const: 1

  "#size-cells":
    const: 1

  ranges: true

required:
  - compatible
  - reg
  - ranges
  - clocks
  - resets

patternProperties:
  "^usb(@[0-9a-f]+)?$":
    type: object
    $ref: /schemas/usb/snps,dwc3.yaml#

unevaluatedProperties: false

examples:
  - |
    usb@11000000 {
        compatible = "altr,agilex5-dwc3";
        reg = <0x11000000 0x100000>;
        ranges = <0x0 0x11000000 0x100000>;
        #address-cells = <1>;
        #size-cells = <1>;
        clocks = <&clkmgr 54>, <&clkmgr 55>;
        resets = <&rst 36>, <&rst 44>;

        dwc3: usb@0 {
            compatible = "snps,dwc3";
            reg = <0x0 0x100000>;
            interrupts = <0 94 4>;
            iommus = <&smmu 7>;
            phys = <&usbphy0>, <&usbphy0>;
            phy-names = "usb2-phy", "usb3-phy";
            dr_mode = "host";
            maximum-speed = "super-speed";
            snps,dis_u2_susphy_quirk;
            snps,dis_u3_susphy_quirk;
            status = "okay";
        };
    };
...
```
