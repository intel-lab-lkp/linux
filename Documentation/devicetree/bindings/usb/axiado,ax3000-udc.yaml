## Documentation/devicetree/bindings/usb/nvidia,lstp.yaml
```yaml
# SPDX-License-Identifier: (GPL-2.0-only OR BSD-2-Clause)
# SPDX-FileCopyrightText: Copyright (c) 2026 NVIDIA CORPORATION & AFFILIATES. All rights reserved.
%YAML 1.2
---
$id: http://devicetree.org/schemas/usb/nvidia,lstp.yaml#
$schema: http://devicetree.org/meta-schemas/core.yaml#

title: NVIDIA LSTP USB Multi-Function Device

maintainers:
  - Adrian Ambrozewicz <aambrozewicz@nvidia.com>
  - Donald Shannon <donalds@nvidia.com>

description: |
  The NVIDIA LSTP (Low-Speed Transport Protocol) device is a USB device
  that exposes function channels (SPI, I2C, GPIO, IPMI, UART) over one USB
  interface.  Channel traffic is multiplexed over the bulk endpoints of
  that interface.

  The device reports its channels, their types and their IDs itself, so
  it needs no device tree to work.  A node adds only what the device
  cannot report: peripherals on its SPI and I2C buses, GPIO line names
  and hogs, and LEDs.  As for any USB device, a node is matched to the
  device by position alone, each level by the port number in reg, so a
  node suits only an LSTP device hard-wired on the board.

  Each channel node is matched to a firmware-reported channel by reg (the
  channel ID) and compatible (the channel type).  A channel without a node
  is still usable.  A channel whose node has status = "disabled" is not
  used at all.

  Where the channel nodes go follows the rules for USB device and
  interface nodes in usb-device.yaml, which depend on the device's
  descriptors and not on its compatible:

  - A device of class 0 with one configuration and one interface has a
    combined node.  The channels go directly under the device node, which
    has #address-cells = <1>.
  - Any other device has an interface node for the LSTP interface,
    interface@N with reg = <N C> (interface number, configuration value).
    The channels go under it, and the device node has
    #address-cells = <2>.

  For interface 2, in configuration 1, of a device on port 3 of a hub on
  root port 1, the path from the host controller node is hub@1, then the
  device node with reg = <3>, then interface@2 with reg = <2 1>.

  The reg of a node on a root-hub port, hub@1 here, is the host
  controller's port number, which is not always the port number in the
  USB path.  On an xHCI controller it is the one-based index of the
  port's register set, and the USB 2 and USB 3 ports share that one
  numbering.  A node on a port of an external hub uses the hub's port
  number, as the USB path shows it.

allOf:
  - $ref: /schemas/usb/usb-device.yaml#
  - $ref: "#/$defs/channels"
  - if:
      properties:
        "#address-cells":
          const: 1
    then:
      patternProperties:
        "^interface@": false
    else:
      patternProperties:
        "^(spi|i2c|gpio|serial|ipmi)@": false

properties:
  compatible:
    enum:
      - usb955,cf11
      - usb424,4940
      - usb174c,2214

  reg:
    description: Port number on the parent hub or host controller.
    maxItems: 1

  "#address-cells":
    enum: [1, 2]

  "#size-cells":
    const: 0

patternProperties:
  "^interface@[0-9a-f]{1,2}(,[0-9a-f]{1,2})?$":
    type: object
    description: |
      Interface node for the interface that carries the LSTP channels.  The
      configuration component of the unit address is omitted for
      configuration 1.

      status = "disabled" disables the interface, and with it every
      channel below it.

    $ref: "#/$defs/channels"

    properties:
      compatible:
        pattern: "^usbif[0-9a-f]{1,4},[0-9a-f]{1,4}\\.config[0-9a-f]{1,2}\\.[0-9a-f]{1,2}$"

      reg:
        description: Interface number, then configuration value.
        maxItems: 1

      "#address-cells":
        const: 1

      "#size-cells":
        const: 0

    required:
      - reg
      - "#address-cells"
      - "#size-cells"

    unevaluatedProperties: false

$defs:
  channels:
    patternProperties:
      "^spi@[0-9a-f]+$":
        $ref: /schemas/spi/nvidia,lstp-spi.yaml#

      "^i2c@[0-9a-f]+$":
        $ref: /schemas/i2c/nvidia,lstp-i2c.yaml#

      "^gpio@[0-9a-f]+$":
        $ref: /schemas/gpio/nvidia,lstp-gpio.yaml#

      "^serial@[0-9a-f]+$":
        type: object
        description: |
          UART channel.

          The device firmware sets the baud rate, framing, parity and flow
          control and reports them to the host; the host cannot change them.

        properties:
          compatible:
            const: nvidia,lstp-uart

          reg:
            description: Channel ID reported by the device firmware.
            maxItems: 1

        required:
          - compatible
          - reg

        additionalProperties: false

      "^ipmi@[0-9a-f]+$":
        type: object
        description: |
          IPMI message channel, on a device attached to a BMC.  The device
          firmware terminates the managed host's IPMI transport, passes each
          request to the BMC over this channel and returns the BMC's response.

        properties:
          compatible:
            const: nvidia,lstp-ipmi

          reg:
            description: Channel ID reported by the device firmware.
            maxItems: 1

        required:
          - compatible
          - reg

        additionalProperties: false

required:
  - compatible
  - reg
  - "#address-cells"
  - "#size-cells"

unevaluatedProperties: false

examples:
  - |
    usb {
        #address-cells = <1>;
        #size-cells = <0>;

        hub@1 {
            reg = <1>;
            #address-cells = <1>;
            #size-cells = <0>;

            /* Three interfaces; the LSTP channels are on interface 2. */
            device@3 {
                compatible = "usb955,cf11";
                reg = <3>;
                #address-cells = <2>;
                #size-cells = <0>;

                interface@2 {
                    compatible = "usbif955,cf11.config1.2";
                    reg = <2 1>;
                    #address-cells = <1>;
                    #size-cells = <0>;

                    spi@1 {
                        compatible = "nvidia,lstp-spi";
                        reg = <1>;
                        #address-cells = <1>;
                        #size-cells = <0>;

                        flash@0 {
                            compatible = "jedec,spi-nor";
                            reg = <0>;
                            spi-max-frequency = <18750000>;
                        };
                    };

                    i2c@2 {
                        compatible = "nvidia,lstp-i2c";
                        reg = <2>;
                        #address-cells = <1>;
                        #size-cells = <0>;

                        temperature-sensor@48 {
                            compatible = "ti,tmp102";
                            reg = <0x48>;
                        };
                    };

                    gpio@3 {
                        compatible = "nvidia,lstp-gpio";
                        reg = <3>;
                        gpio-controller;
                        #gpio-cells = <2>;
                        gpio-line-names = "LED", "INT";
                    };

                    ipmi@4 {
                        compatible = "nvidia,lstp-ipmi";
                        reg = <4>;
                    };

                    serial@5 {
                        compatible = "nvidia,lstp-uart";
                        reg = <5>;
                    };
                };
            };
        };
    };

  - |
    usb {
        #address-cells = <1>;
        #size-cells = <0>;

        /* Class 0, one interface: a combined node carries the channels. */
        device@2 {
            compatible = "usb424,4940";
            reg = <2>;
            #address-cells = <1>;
            #size-cells = <0>;

            i2c@1 {
                compatible = "nvidia,lstp-i2c";
                reg = <1>;
                #address-cells = <1>;
                #size-cells = <0>;
            };

            gpio@2 {
                compatible = "nvidia,lstp-gpio";
                reg = <2>;
                gpio-controller;
                #gpio-cells = <2>;
            };
        };
    };
```

## Documentation/devicetree/bindings/usb/nxp,ptn5110.yaml
```yaml
# SPDX-License-Identifier: (GPL-2.0 OR BSD-2-Clause)
%YAML 1.2
---
$id: http://devicetree.org/schemas/usb/nxp,ptn5110.yaml#
$schema: http://devicetree.org/meta-schemas/core.yaml#

title: NXP PTN5110 Type-C Port Controller

maintainers:
  - Li Jun <jun.li@nxp.com>

properties:
  compatible:
    items:
      - const: nxp,ptn5110
      - const: tcpci

  reg:
    maxItems: 1

  interrupts:
    maxItems: 1

  TX_BUF_BYTE_x_hidden:
    description:
      True when TX_BUF_BYTE_x can only be accessed through
      I2C_WRITE_BYTE_COUNT.
    type: boolean

  RX_BUF_BYTE_x_hidden:
    description:
      True when RX_BUF_BYTE_x can only be accessed through
      READABLE_BYTE_COUNT.
    type: boolean

  auto_discharge_disconnect:
    description:
      True when TCPC can autonomously discharge vbus on disconnect.
    type: boolean

  vbus_vsafe0v:
    description:
      True when TCPC can detect whether vbus is at VSAFE0V.
    type: boolean

  connector:
    type: object
    $ref: /schemas/connector/usb-connector.yaml#
    unevaluatedProperties: false

required:
  - compatible
  - reg
  - interrupts
  - connector

additionalProperties: false

examples:
  - |
    #include <dt-bindings/interrupt-controller/arm-gic.h>
    #include <dt-bindings/usb/pd.h>
    i2c {
        #address-cells = <1>;
        #size-cells = <0>;

        tcpci@50 {
            compatible = "nxp,ptn5110", "tcpci";
            reg = <0x50>;
            interrupt-parent = <&gpio3>;
            interrupts = <3 IRQ_TYPE_LEVEL_LOW>;

            usb_con: connector {
                compatible = "usb-c-connector";
                label = "USB-C";
                data-role = "dual";
                power-role = "dual";
                try-power-role = "sink";
                source-pdos = <PDO_FIXED(5000, 2000, PDO_FIXED_USB_COMM)>;
                sink-pdos = <PDO_FIXED(5000, 2000, PDO_FIXED_USB_COMM) PDO_VAR(5000, 12000, 2000)>;
                op-sink-microwatt = <10000000>;

                ports {
                    #address-cells = <1>;
                    #size-cells = <0>;

                    port@0 {
                       reg = <0>;
                       typec1_dr_sw: endpoint {
                           remote-endpoint = <&usb1_drd_sw>;
                       };
                    };
                };
            };
        };
    };
```

## Documentation/devicetree/bindings/usb/parade,ps5169.yaml
```yaml
# SPDX-License-Identifier: GPL-2.0-only OR BSD-2-Clause
%YAML 1.2
---
$id: http://devicetree.org/schemas/usb/parade,ps5169.yaml#
$schema: http://devicetree.org/meta-schemas/core.yaml#

title: Parade PS5169 USB Type-C linear redriver

maintainers:
  - Esteban Urrutia <esteuwu@proton.me>

properties:
  compatible:
    oneOf:
      - items:
          - const: parade,ps5170
          - const: parade,ps5169
      - const: parade,ps5169

  reg:
    maxItems: 1

  vcc-supply:
    description: 1.8V power supply

  reset-gpios:
    maxItems: 1

  orientation-switch: true
  retimer-switch: true

  parade,dp-eq-db:
    description:
      Equalization for DP channels.
      For example, <6 5> denotes an equalization of 6.5 dB.
    oneOf:
      - items:
          - enum: [ 2, 8, 10 ]
          - const: 0
      - items:
          - enum: [ 5, 6, 7, 8, 9 ]
          - const: 5

  parade,usb-rx-eq-db:
    description:
      Equalization for USB receive channels.
      For example, <5 2> denotes an equalization of 5.2 dB.
    oneOf:
      - items:
          - enum: [ 5, 11 ]
          - const: 2
      - items:
          - enum: [ 6, 7, 8 ]
          - const: 0
      - items:
          - const: 8
          - const: 8
      - items:
          - const: 9
          - const: 6
      - items:
          - const: 10
          - const: 4

  parade,usb-tx-eq-db:
    description:
      Equalization for USB transmit channels.
      For example, <6 5> denotes an equalization of 6.5 dB.
    oneOf:
      - items:
          - enum: [ 2, 8, 10 ]
          - const: 0
      - items:
          - enum: [ 5, 6, 7, 8, 9 ]
          - const: 5

  parade,fine-tune-lfps-swing:
    type: boolean
    description:
      Set a 50 ohm termination for USB receive channels.
      Usage of this property is design-specific.

  parade,dp-set-gain:
    type: boolean
    description:
      Set a -0.9 dB gain for DP channels.

  parade,usb-rx-set-gain:
    type: boolean
    description:
      Set a -0.9 dB gain for USB receive channels.

  parade,usb-tx-set-gain:
    type: boolean
    description:
      Set a -0.9 dB gain for USB transmit channels.

  ports:
    $ref: /schemas/graph.yaml#/properties/ports
    properties:
      port@0:
        $ref: /schemas/graph.yaml#/properties/port
        description: Super Speed (SS) Output endpoint to the Type-C connector

      port@1:
        $ref: /schemas/graph.yaml#/properties/port
        description: Super Speed (SS) Input endpoint from the Super-Speed PHY
        unevaluatedProperties: false

      port@2:
        $ref: /schemas/graph.yaml#/properties/port
        description:
          Sideband Use (SBU) AUX lines endpoint to the Type-C connector for the purpose of
          handling altmode muxing and orientation switching.

required:
  - compatible
  - reg
  - vcc-supply
  - reset-gpios
  - orientation-switch
  - retimer-switch

allOf:
  - $ref: usb-switch.yaml#
  - $ref: usb-switch-ports.yaml#
  - if:
      properties:
        compatible:
          contains:
            const: parade,ps5170
    then:
      properties:
        ports:
          required:
            - port@2

    else:
      properties:
        ports:
          properties:
            # PS5169 only performs AUX channel monitoring and doesn't have an integrated AUX switch
            port@2: false

additionalProperties: false

examples:
  - |
    #include <dt-bindings/gpio/gpio.h>

    i2c {
        #address-cells = <1>;
        #size-cells = <0>;

        typec-retimer@30 {
            compatible = "parade,ps5169";
            reg = <0x30>;

            vcc-supply = <&vreg_s10b_1p8>;
            reset-gpios = <&tlmm 54 GPIO_ACTIVE_LOW>;

            orientation-switch;
            retimer-switch;

            parade,dp-eq-db     = <2 0>; /* 2   dB */
            parade,usb-rx-eq-db = <5 2>; /* 5.2 dB */
            parade,usb-tx-eq-db = <2 0>; /* 2   dB */

            parade,fine-tune-lfps-swing;

            ports {
                #address-cells = <1>;
                #size-cells = <0>;

                port@0 {
                    reg = <0>;
                    usb_con_ss: endpoint {
                        remote-endpoint = <&typec_con_ss>;
                    };
                };

                port@1 {
                    reg = <1>;
                    phy_con_ss: endpoint {
                        remote-endpoint = <&usb_phy_ss>;
                    };
                };

                /* PS5169 doesn't have an integrated AUX switch, so no port@2 */
            };
        };
    };
...
```
