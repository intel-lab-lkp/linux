## Documentation/devicetree/bindings/usb/ite,it8851.yaml
```yaml
# SPDX-License-Identifier: (GPL-2.0-only OR BSD-2-Clause)
%YAML 1.2
---
$id: http://devicetree.org/schemas/usb/ite,it8851.yaml#
$schema: http://devicetree.org/meta-schemas/core.yaml#

title: ITE IT8851/IT8853 USB Type-C Power Delivery Controller

maintainers:
  - Jeson Yang <jeson.yang@ite.com.tw>

description:
  The ITE IT8851 is an I2C-based USB Type-C Power Delivery (PD) controller
  supporting one Type-C port.
  The IT8853 is the two-port variant sharing the same programming interface.

properties:
  compatible:
    enum:
      - ite,it8851
      - ite,it8853

  reg:
    maxItems: 1

  interrupts:
    maxItems: 1

  wakeup-source: true

  '#address-cells':
    const: 1

  '#size-cells':
    const: 0

patternProperties:
  "^connector@[01]$":
    $ref: /schemas/connector/usb-connector.yaml#
    unevaluatedProperties: false

required:
  - compatible
  - reg
  - interrupts

allOf:
  - if:
      properties:
        compatible:
          contains:
            const: ite,it8851
    then:
      properties:
        connector@1: false

unevaluatedProperties: false

examples:
  - |
    #include <dt-bindings/interrupt-controller/irq.h>

    i2c {
        #address-cells = <1>;
        #size-cells = <0>;

        typec@40 {
            compatible = "ite,it8853";
            reg = <0x40>;
            interrupts-extended = <&tlmm 129 IRQ_TYPE_EDGE_FALLING>;
            wakeup-source;

            #address-cells = <1>;
            #size-cells = <0>;

            connector@0 {
                compatible = "usb-c-connector";
                reg = <0>;
                label = "USB-C-0";
                power-role = "dual";
                data-role = "dual";

                ports {
                    #address-cells = <1>;
                    #size-cells = <0>;

                    port@0 {
                        reg = <0>;
                        endpoint {
                            remote-endpoint = <&eud_con>;
                        };
                    };

                    port@1 {
                        reg = <1>;
                        endpoint {
                            remote-endpoint = <&redriver_ss_out>;
                        };
                    };

                    port@2 {
                        reg = <2>;
                        endpoint {
                            remote-endpoint = <&fsa4480_sbu_mux>;
                        };
                    };
                };
            };

            connector@1 {
                compatible = "usb-c-connector";
                reg = <1>;
                label = "USB-C-1";
                power-role = "dual";
                data-role = "dual";

                ports {
                    #address-cells = <1>;
                    #size-cells = <0>;

                    port@0 {
                        reg = <0>;
                        endpoint {
                          remote-endpoint = <&usb1_hs_con>;
                        };
                    };
                    port@1 {
                        reg = <1>;
                        endpoint {
                          remote-endpoint = <&redriver1_ss_out>;
                        };
                    };
                    port@2 {
                        reg = <2>;
                        endpoint {
                          remote-endpoint = <&sbu_mux1>;
                        };
                    };
                };
            };
        };
    };
```

## Documentation/devicetree/bindings/usb/ite,itepd-it885x.yaml
```yaml
# SPDX-License-Identifier: (GPL-2.0-only OR BSD-2-Clause)
%YAML 1.2
---
$id: http://devicetree.org/schemas/usb/ite,itepd-it885x.yaml#
$schema: http://devicetree.org/meta-schemas/core.yaml#

title: ITE IT885x USB Type-C Power Delivery Controller

maintainers:
  - Jeson Yang <jeson.yang@ite.com.tw>

description:
  The ITE IT885x is an I2C-based USB Type-C Power Delivery (PD) controller.

properties:
  compatible:
    const: ite,itepd-it885x

  reg:
    maxItems: 1

  interrupts:
    maxItems: 1

  wakeup-source: true

  pinctrl-names:
    minItems: 1

  pinctrl-0: true

  '#address-cells':
    const: 1

  '#size-cells':
    const: 0

patternProperties:
  "^connector(@[0-9a-f]+)?$":
    $ref: /schemas/connector/usb-connector.yaml#
    unevaluatedProperties: false

required:
  - compatible
  - reg
  - interrupts

unevaluatedProperties: false

examples:
  - |
    #include <dt-bindings/gpio/gpio.h>
    #include <dt-bindings/interrupt-controller/irq.h>

    i2c {
        #address-cells = <1>;
        #size-cells = <0>;

        typec@40 {
            compatible = "ite,itepd-it885x";
            reg = <0x40>;
            interrupts-extended = <&tlmm 129 IRQ_TYPE_EDGE_FALLING>;
            wakeup-source;

            pinctrl-names = "default";
            pinctrl-0 = <&itepd_int_default>;

            #address-cells = <1>;
            #size-cells = <0>;

            connector@0 {
                compatible = "usb-c-connector";
                reg = <0>;
                label = "USB-C";
                power-role = "dual";
                data-role = "dual";

                ports {
                    #address-cells = <1>;
                    #size-cells = <0>;

                    port@0 {
                        reg = <0>;
                        endpoint {
                            remote-endpoint = <&eud_con>;
                        };
                    };

                    port@1 {
                        reg = <1>;
                        endpoint {
                            remote-endpoint = <&redriver_ss_out>;
                        };
                    };

                    port@2 {
                        reg = <2>;
                        endpoint {
                            remote-endpoint = <&fsa4480_sbu_mux>;
                        };
                    };
                };
            };
        };
    };
```

## Documentation/devicetree/bindings/usb/marvell,pxa-ohci.yaml
```yaml
# SPDX-License-Identifier: (GPL-2.0-only OR BSD-2-Clause)
%YAML 1.2
---
$id: http://devicetree.org/schemas/usb/marvell,pxa-ohci.yaml#
$schema: http://devicetree.org/meta-schemas/core.yaml#

title: Marvell PXA OHCI USB Host Controller

maintainers:
  - Greg Kroah-Hartman <gregkh@linuxfoundation.org>
  - Alan Stern <stern@rowland.harvard.edu>

allOf:
  - $ref: usb-hcd.yaml#

properties:
  compatible:
    const: marvell,pxa-ohci

  reg:
    maxItems: 1

  interrupts:
    maxItems: 1

  clocks:
    maxItems: 1

  marvell,enable-port1:
    type: boolean
    description: Enable USB port 1 if present.

  marvell,enable-port2:
    type: boolean
    description: Enable USB port 2 if present.

  marvell,enable-port3:
    type: boolean
    description: Enable USB port 3 if present.

  marvell,port-sense-low:
    type: boolean
    description: Port sense pin in low-active.

  marvell,power-control-low:
    type: boolean
    description: Power control pin is low-active.

  marvell,no-oc-protection:
    type: boolean
    description: Disable over-current protection.

  marvell,oc-mode-perport:
    type: boolean
    description: Enable per-port over-current protection.

  marvell,power-on-delay:
    $ref: /schemas/types.yaml#/definitions/uint32
    description: Power On to Power Good time in milliseconds.

  marvell,port-mode:
    $ref: /schemas/types.yaml#/definitions/uint32
    enum: [1, 2, 3]
    description: |
      Selects the mode of the ports.
        1 = PMM_NPS_MODE
        2 = PMM_GLOBAL_MODE
        3 = PMM_PERPORT_MODE

  marvell,power-budget:
    $ref: /schemas/types.yaml#/definitions/uint32
    description: USB power budget.

  vbus1-supply:
    description: Regulator supplying VBUS for port 1.

  vbus2-supply:
    description: Regulator supplying VBUS for port 2.

  vbus3-supply:
    description: Regulator supplying VBUS for port 3.

required:
  - compatible
  - reg
  - interrupts
  - clocks

unevaluatedProperties: false

examples:
  - |
    usb@4c000000 {
        compatible = "marvell,pxa-ohci";
        reg = <0x4c000000 0x100000>;
        interrupts = <3>;
        clocks = <&clks 11>;
        marvell,enable-port1;
        marvell,port-mode = <2>; /* PMM_GLOBAL_MODE */
    };
```

## Documentation/devicetree/bindings/usb/marvell,pxa270-udc.yaml
```yaml
# SPDX-License-Identifier: (GPL-2.0-only OR BSD-2-Clause)
%YAML 1.2
---
$id: http://devicetree.org/schemas/usb/marvell,pxa270-udc.yaml#
$schema: http://devicetree.org/meta-schemas/core.yaml#

title: Marvell PXA27x USB Device Controller (UDC)

maintainers:
  - Greg Kroah-Hartman <gregkh@linuxfoundation.org>

properties:
  compatible:
    const: marvell,pxa270-udc

  reg:
    maxItems: 1

  interrupts:
    maxItems: 1

  clocks:
    maxItems: 1

  gpios:
    maxItems: 1
    description: GPIO to control the USB D+ pullup.

  phys:
    maxItems: 1

required:
  - compatible
  - reg
  - interrupts
  - clocks

additionalProperties: false

examples:
  - |
    #include <dt-bindings/gpio/gpio.h>

    udc@40600000 {
        compatible = "marvell,pxa270-udc";
        reg = <0x40600000 0x10000>;
        interrupts = <11>;
        clocks = <&clks 11>;
        gpios = <&gpio 22 GPIO_ACTIVE_LOW>;
    };
```

## Documentation/devicetree/bindings/usb/maxim,3421.yaml
```yaml
# SPDX-License-Identifier: (GPL-2.0 OR BSD-2-Clause)
%YAML 1.2
---
$id: http://devicetree.org/schemas/usb/maxim,3421.yaml#
$schema: http://devicetree.org/meta-schemas/core.yaml#

title: MAXIM MAX3421e USB Peripheral/Host Controller

maintainers:
  - David Mosberger <davidm@egauge.net>

description: |
  The controller provides USB2.0 compliant with Full Speed or Low Speed when in
  the host mode. At peripheral, it operates at Full Speed. At both cases, it
  uses a SPI interface.
  Datasheet at:
    https://www.analog.com/media/en/technical-documentation/data-sheets/max3421e.pdf

properties:
  compatible:
    oneOf:
      - items:
          - enum:
              - maxim,max3421e
          - const: maxim,max3421
      - const: maxim,max3421

  reg:
    maxItems: 1

  interrupts:
    maxItems: 1

  spi-max-frequency:
    $ref: /schemas/types.yaml#/definitions/uint32
    maximum: 26000000
    description:
      SPI interface that operates up to 26MHz in Hz.

  maxim,vbus-en-pin:
    $ref: /schemas/types.yaml#/definitions/uint32-array
    description:
      One of eight GPOUT pins to control external VBUS power and the polarity
      of the active level. It's an array of GPIO number and the active level of it.
    minItems: 2
    maxItems: 2

  maxim,gpx-pin:
    $ref: /schemas/types.yaml#/definitions/uint32
    description: A property to define the behavior of the GPX pin, which is an
      output that may be selected in a 4-way multiplexer between OPERATE(0),
      VBUS_DETECT(1), BUSACT/INIRQ(2) and SOF(3) signals.
    enum: [0, 1, 2, 3]
    default: 0

  reset-gpios:
    description: Active low to clear all of the internal registers except for
                 PINCTL (R17), USBCTL (R15), and SPI logic.

  vdd-supply: true

  vlogic-supply: true

required:
  - compatible
  - reg
  - interrupts
  - maxim,vbus-en-pin

additionalProperties: false

examples:
  - |
    #include <dt-bindings/gpio/gpio.h>
    #include <dt-bindings/interrupt-controller/irq.h>
    spi {
        #address-cells = <1>;
        #size-cells = <0>;

        usb@0 {
          compatible = "maxim,max3421";
          reg = <0>;
          maxim,vbus-en-pin = <3 1>;
          spi-max-frequency = <26000000>;
          interrupt-parent = <&gpio>;
          interrupts = <42>;
        };
    };
```
