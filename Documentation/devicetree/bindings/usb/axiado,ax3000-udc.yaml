## Documentation/devicetree/bindings/usb/axiado,ax3000-udc.yaml
```yaml
# SPDX-License-Identifier: (GPL-2.0-only OR BSD-2-Clause)
%YAML 1.2
---
$id: http://devicetree.org/schemas/usb/axiado,ax3000-udc.yaml#
$schema: http://devicetree.org/meta-schemas/core.yaml#

title: Axiado AX3000 USB Device Controller (Corigine-based)

maintainers:
  - Krutik Shah <krutikshah@axiado.com>
  - Prasad Bolisetty <pbolisetty@axiado.com>
  - Vladimir Moravcevic <vmoravcevic@axiado.com>

description: |
  Axiado AX3000 USB Device Controller (UDC) is used on
  AX3000 SoCs and evaluation boards. This controller is based on a
  Corigine USB IP core and provides SuperSpeed (5 Gb/s), High-Speed
  (480 Mb/s). It supports control, bulk, interrupt, and isochronous
  transfer types across multiple configurable endpoints. The node
  describes the memory-mapped register region, interrupt line, and
  other required properties for the UDC hardware.

properties:
  compatible:
    enum:
      - axiado,ax3000-udc         # AX3000 UDC (USB 2.0/High-Speed)
      - axiado,ax3000-udc-gen3    # AX3000 UDC (USB 3.0/SuperSpeed)

  reg:
    maxItems: 1
    description: Base address and size of the UDC register space.

  interrupts:
    maxItems: 1
    description: Interrupt line for the UDC.

required:
  - compatible
  - reg
  - interrupts

additionalProperties: false

examples:
  - |
    #include <dt-bindings/interrupt-controller/arm-gic.h>
    #include <dt-bindings/interrupt-controller/irq.h>

    soc {
        #address-cells = <2>;
        #size-cells = <2>;

        usb@81200000 {
            compatible = "axiado,ax3000-udc";
            reg = <0x0 0x81200000 0x0 0x00100000>;
            interrupt-parent = <&gic500>;
            interrupts = <GIC_SPI 21 IRQ_TYPE_LEVEL_HIGH>;
        };
    };
```

## Documentation/devicetree/bindings/usb/cdns,usb3.yaml
```yaml
# SPDX-License-Identifier: GPL-2.0-only OR BSD-2-Clause
%YAML 1.2
---
$id: http://devicetree.org/schemas/usb/cdns,usb3.yaml#
$schema: http://devicetree.org/meta-schemas/core.yaml#

title: Cadence USBSS and USBSSP DRD controller

maintainers:
  - Pawel Laszczak <pawell@cadence.com>

description:
  Cadence USB dual-role controller. Covers USBSS (SuperSpeed, USB 3.0) and
  USBSSP (SuperSpeed Plus, USB 3.1 gen2x1). Both variants share the same
  DRD/OTG register interface, so the driver auto-detects the controller
  version at runtime.

properties:
  compatible:
    const: cdns,usb3

  reg:
    minItems: 2
    items:
      - description: OTG controller registers
      - description: XHCI Host controller registers
      - description: DEVICE controller registers

  reg-names:
    minItems: 2
    items:
      - enum: [ otg, xhci, dev ]
      - enum: [ otg, xhci, dev ]
      - enum: [ otg, xhci, dev ]

  interrupts:
    minItems: 2
    items:
      - description: XHCI host controller interrupt
      - description: Device controller interrupt
      - description: OTG/DRD controller interrupt
      - description: interrupt used to wake up core, e.g when usbcmd.rs is
                     cleared by xhci core, this interrupt is optional

  interrupt-names:
    minItems: 2
    items:
      - enum: [ host, peripheral, otg, wakeup ]
      - enum: [ host, peripheral, otg, wakeup ]
      - enum: [ host, peripheral, otg, wakeup ]
      - enum: [ host, peripheral, otg, wakeup ]

  port:
    $ref: /schemas/graph.yaml#/properties/port
    description:
      This port is used with the 'usb-role-switch' property to connect the
      cdns3 to type C connector.

  maximum-speed:
    enum: [super-speed-plus, super-speed, high-speed, full-speed]

  phys:
    minItems: 1
    maxItems: 2

  phy-names:
    minItems: 1
    maxItems: 2
    items:
      anyOf:
        - const: cdns3,usb2-phy
        - const: cdns3,usb3-phy

  cdns,on-chip-buff-size:
    description:
      size of memory intended as internal memory for endpoints
      buffers expressed in KB
    $ref: /schemas/types.yaml#/definitions/uint16

  cdns,phyrst-a-enable:
    description: Enable resetting of PHY if Rx fail is detected
    type: boolean

  no_drd:
    description:
      Indicates that the Dual-Role Device (DRD) register block is not
      implemented or is inaccessible. In this case, the controller
      must operate in a fixed peripheral or host mode.
    type: boolean

dependencies:
  port: [ usb-role-switch ]

required:
  - compatible
  - reg
  - reg-names
  - interrupts
  - interrupt-names

allOf:
  - $ref: usb-drd.yaml#
  - $ref: usb-xhci.yaml#

  - if:
      properties:
        no_drd: true
      required:
        - no_drd
    then:
      required:
        - dr_mode
      properties:
        reg:
          maxItems: 2
        reg-names:
          items:
            - const: xhci
            - const: dev
        interrupts:
          maxItems: 2
        interrupt-names:
          items:
            - const: host
            - const: peripheral
        dr_mode:
          enum: [host, peripheral]
    else:
      properties:
        reg:
          minItems: 3
        reg-names:
          items:
            - const: otg
            - const: xhci
            - const: dev
        interrupts:
          minItems: 3
          maxItems: 4
        interrupt-names:
          minItems: 3
          items:
            - const: host
            - const: peripheral
            - const: otg
            - const: wakeup

unevaluatedProperties: false

examples:
  - |
    #include <dt-bindings/interrupt-controller/arm-gic.h>
    bus {
        #address-cells = <2>;
        #size-cells = <2>;

        usb@6000000 {
            compatible = "cdns,usb3";
            reg = <0x00 0x6000000 0x00 0x10000>,
                  <0x00 0x6010000 0x00 0x10000>,
                  <0x00 0x6020000 0x00 0x10000>;
            reg-names = "otg", "xhci", "dev";
            interrupts = <GIC_SPI 96 IRQ_TYPE_LEVEL_HIGH>,
                         <GIC_SPI 102 IRQ_TYPE_LEVEL_HIGH>,
                         <GIC_SPI 120 IRQ_TYPE_LEVEL_HIGH>;
            interrupt-names = "host", "peripheral", "otg";
            maximum-speed = "super-speed";
            dr_mode = "otg";
        };
    };
```

## Documentation/devicetree/bindings/usb/chipidea,usb2-tegra.yaml
```yaml
# SPDX-License-Identifier: (GPL-2.0-only OR BSD-2-Clause)
%YAML 1.2
---
$id: http://devicetree.org/schemas/usb/chipidea,usb2-tegra.yaml#
$schema: http://devicetree.org/meta-schemas/core.yaml#

title: Tegra USB2 ChipIdea USB controller

maintainers:
  - Svyatoslav Ryhel <clamor95@gmail.com>

properties:
  compatible:
    oneOf:
      - enum:
          - nvidia,tegra20-ehci
          - nvidia,tegra20-udc
          - nvidia,tegra30-ehci
          - nvidia,tegra30-udc
          - nvidia,tegra114-udc
          - nvidia,tegra124-udc
      - items:
          - enum:
              - nvidia,tegra114-ehci
              - nvidia,tegra124-ehci
              - nvidia,tegra210-ehci
          - const: nvidia,tegra30-ehci

  operating-points-v2:
    description: A phandle to the OPP table containing the performance states.
    $ref: /schemas/types.yaml#/definitions/phandle

  nvidia,phy:
    description: phandle of usb phy that connects to the port. Use "phys" instead.
    $ref: /schemas/types.yaml#/definitions/phandle
    deprecated: true

  nvidia,needs-double-reset:
    description: Indicates double reset or not.
    type: boolean
    deprecated: true

required:
  - compatible
  - reg
  - interrupts
  - clocks
  - resets

allOf:
  - $ref: chipidea,usb2-common.yaml#

unevaluatedProperties: false

examples:
  - |
    #include <dt-bindings/clock/tegra30-car.h>
    #include <dt-bindings/interrupt-controller/arm-gic.h>

    usb@7d000000 {
        compatible = "nvidia,tegra30-udc";
        reg = <0x7d000000 0x4000>;
        interrupts = <GIC_SPI 20 IRQ_TYPE_LEVEL_HIGH>;
        phy_type = "utmi";
        clocks = <&tegra_car TEGRA30_CLK_USBD>;
        resets = <&tegra_car 22>;
        reset-names = "usb";
        phys = <&phy1>;
        power-domains = <&pd_core>;
        operating-points-v2 = <&usbd_dvfs_opp_table>;

        dr_mode = "otg";

        hnp-disable;
        srp-disable;
        adp-disable;

        usb-role-switch;
        extcon = <&charger>, <&extcon>; /* vbus, id */
        vbus-supply = <&usb_otg_vbus>;

        port {
            usb_in: endpoint {
                remote-endpoint = <&connector_out>;
            };
        };
    };
...
```

## Documentation/devicetree/bindings/usb/cix,sky1-cdns3.yaml
```yaml
# SPDX-License-Identifier: (GPL-2.0-only OR BSD-2-Clause)
%YAML 1.2
---
$id: http://devicetree.org/schemas/usb/cix,sky1-cdns3.yaml#
$schema: http://devicetree.org/meta-schemas/core.yaml#

title: CIX Sky1 Cadence USB3 Controller

maintainers:
  - Peter Chen <peter.chen@cixtech.com>

description:
  The CIX Sky1 USB3 controller is based on the Cadence USBSSP DRD
  controller. The integration adds glue registers and mode strap controls
  in the Sky1 S5 system controller.

allOf:
  - $ref: usb-drd.yaml#
  - $ref: usb-xhci.yaml#

properties:
  compatible:
    items:
      - const: cix,sky1-usb3
      - const: cix,cdns-usb3

  reg:
    items:
      - description: OTG controller registers
      - description: Device controller registers
      - description: XHCI host controller registers
      - description: Sky1 USB glue registers

  reg-names:
    items:
      - const: otg
      - const: dev
      - const: xhci
      - const: glue

  interrupts:
    items:
      - description: XHCI host controller interrupt
      - description: Device controller interrupt
      - description: OTG/DRD controller interrupt
      - description: Wakeup interrupt

  interrupt-names:
    items:
      - const: host
      - const: peripheral
      - const: otg
      - const: wakeup

  clocks:
    items:
      - description: Start-of-frame clock
      - description: AXI bus clock
      - description: Low-power mode clock
      - description: APB register interface clock

  clock-names:
    items:
      - const: sof
      - const: aclk
      - const: lpm
      - const: pclk

  resets:
    items:
      - description: APB register reset
      - description: Controller reset

  reset-names:
    items:
      - const: prst
      - const: rst

  cix,syscon-usb:
    $ref: /schemas/types.yaml#/definitions/phandle
    description:
      Phandle to the Sky1 S5 system controller used to program USB mode
      strap controls.

  dma-coherent: true

  maximum-speed:
    enum: [super-speed-plus, super-speed, high-speed, full-speed]

  phys:
    minItems: 1
    maxItems: 2

  phy-names:
    minItems: 1
    maxItems: 2
    items:
      anyOf:
        - const: cdns3,usb2-phy
        - const: cdns3,usb3-phy

required:
  - compatible
  - reg
  - reg-names
  - interrupts
  - interrupt-names
  - clocks
  - clock-names
  - resets
  - reset-names
  - cix,syscon-usb

unevaluatedProperties: false

examples:
  - |
    #include <dt-bindings/clock/cix,sky1.h>
    #include <dt-bindings/interrupt-controller/arm-gic.h>
    #include <dt-bindings/reset/cix,sky1-s5-system-control.h>

    soc {
        #address-cells = <2>;
        #size-cells = <2>;

        usb@91d0000 {
            compatible = "cix,sky1-usb3", "cix,cdns-usb3";
            reg = <0x00 0x91d0000 0x00 0x4000>,
                  <0x00 0x91d4000 0x00 0x4000>,
                  <0x00 0x91d8000 0x00 0x8000>,
                  <0x00 0x91c0314 0x00 0x4>;
            reg-names = "otg", "dev", "xhci", "glue";
            interrupts = <GIC_SPI 252 IRQ_TYPE_LEVEL_HIGH 0>,
                         <GIC_SPI 252 IRQ_TYPE_LEVEL_HIGH 0>,
                         <GIC_SPI 253 IRQ_TYPE_LEVEL_HIGH 0>,
                         <GIC_SPI 252 IRQ_TYPE_LEVEL_HIGH 0>;
            interrupt-names = "host", "peripheral", "otg", "wakeup";
            clocks = <&scmi_clk CLK_TREE_USB3A_H0_CLK_SOF>,
                     <&scmi_clk CLK_TREE_USB3A_0_AXI_GATE>,
                     <&scmi_clk CLK_TREE_USB3A_H0_CLK_LPM>,
                     <&scmi_clk CLK_TREE_USB3A_0_APB_GATE>;
            clock-names = "sof", "aclk", "lpm", "pclk";
            resets = <&s5_syscon SKY1_USBC_SS2_PRST_N>,
                     <&s5_syscon SKY1_USBC_SS2_RST_N>;
            reset-names = "prst", "rst";
            cix,syscon-usb = <&s5_syscon>;
            dma-coherent;
            maximum-speed = "super-speed-plus";
            dr_mode = "otg";
        };
    };
```
