## Documentation/devicetree/bindings/usb/google,snps-dwc3.yaml
```yaml
# SPDX-License-Identifier: (GPL-2.0 OR BSD-2-Clause)
# Copyright (c) 2025, Google LLC
%YAML 1.2
---
$id: http://devicetree.org/schemas/usb/google,snps-dwc3.yaml#
$schema: http://devicetree.org/meta-schemas/core.yaml#

title: Google DWC3 USB SoC Controller

maintainers:
  - Roy Luo <royluo@google.com>

description:
  Describes the Google DWC3 USB block, based on Synopsys DWC3 IP.

properties:
  compatible:
    items:
      - enum:
          - google,lga-dwc3
      - const: google,snps-dwc3

  reg:
    minItems: 3
    maxItems: 3

  reg-names:
    description: |
      The following memory regions must present:
        - dwc3_core: Core DWC3 IP registers.
        - host_cfg_csr: Hibernation control registers.
        - usbint_csr: Hibernation interrupt registers.
    items:
      - const: dwc3_core
      - const: host_cfg_csr
      - const: usbint_csr

  interrupts:
    minItems: 3
    maxItems: 3

  interrupt-names:
    description: |
      The following interrupts must present:
        - dwc_usb3: Core DWC3 interrupt.
        - hs_pme_irq: High speed remote wakeup interrupt for hibernation.
        - ss_pme_irq: Super speed remote wakeup interrupt for hibernation.
    items:
      - const: dwc_usb3
      - const: hs_pme_irq
      - const: ss_pme_irq

  clocks:
    minItems: 3
    maxItems: 3

  clock-names:
    minItems: 3
    maxItems: 3

  resets:
    minItems: 5
    maxItems: 5

  reset-names:
    items:
      - const: usbc_non_sticky
      - const: usbc_sticky
      - const: usb_drd_bus
      - const: u2phy_apb
      - const: usb_top_csr

  power-domains:
    minItems: 2
    maxItems: 2

  power-domain-names:
    description: |
      The following power domain must present:
          - usb_psw_pd: The child power domain of usb_top_pd. Turning it on puts the controller
                         into full power state, turning it off puts the controller into power
                         gated state.
          - usb_top_pd: The parent power domain of usb_psw_pd. Turning it on puts the controller
                         into power gated state, turning it off completely shuts off the
                         controller.
    items:
      - const: usb_psw_pd
      - const: usb_top_pd

  iommus:
    maxItems: 1

required:
  - compatible
  - reg
  - reg-names
  - interrupts
  - interrupt-names
  - clocks
  - resets
  - reset-names
  - power-domains
  - power-domain-names

allOf:
  - $ref: snps,dwc3-common.yaml#

unevaluatedProperties: false

examples:
  - |
    #include <dt-bindings/interrupt-controller/arm-gic.h>
    #include <dt-bindings/interrupt-controller/irq.h>
    soc {
        #address-cells = <2>;
        #size-cells = <2>;

        usb@c400000 {
            compatible = "google,lga-dwc3", "google,snps-dwc3";
            reg = <0 0x0c400000  0 0xd060>, <0 0x0c450000 0 0x14>, <0 0x0c450020 0 0x8>;
            reg-names = "dwc3_core", "host_cfg_csr", "usbint_csr";
            interrupts = <GIC_SPI 580 IRQ_TYPE_LEVEL_HIGH 0>,
                         <GIC_SPI 597 IRQ_TYPE_LEVEL_HIGH 0>,
                         <GIC_SPI 598 IRQ_TYPE_LEVEL_HIGH 0>;
            interrupt-names = "dwc_usb3", "hs_pme_irq", "ss_pme_irq";
            clocks = <&hsion_usbc_non_sticky_clk>,  <&hsion_usbc_sticky_clk>,
                     <&hsion_u2phy_apb_clk>;
            clock-names = "usbc_non_sticky", "usbc_sticky", "u2phy_apb";
            resets = <&hsion_resets_usbc_non_sticky>, <&hsion_resets_usbc_sticky>,
                     <&hsion_resets_usb_drd_bus>, <&hsion_resets_u2phy_apb>,
                     <&hsion_resets_usb_top_csr>;
            reset-names = "usbc_non_sticky", "usbc_sticky",
                     "usb_drd_bus", "u2phy_apb",
                     "usb_top_csr";
            power-domains = <&hsio_n_usb_psw_pd>, <&hsio_n_usb_pd>;
            power-domain-names = "usb_psw_pd", "usb_top_pd";
            phys = <&usb_phy 0>;
            phy-names = "usb2-phy";
            snps,quirk-frame-length-adjustment = <0x20>;
            snps,gfladj-refclk-lpm-sel-quirk;
            snps,incr-burst-type-adjustment = <4>;
        };
    };
...
```

## Documentation/devicetree/bindings/usb/hisilicon,hi3798mv200-dwc3.yaml
```yaml
# SPDX-License-Identifier: (GPL-2.0 OR BSD-2-Clause)
%YAML 1.2
---
$id: http://devicetree.org/schemas/usb/hisilicon,hi3798mv200-dwc3.yaml#
$schema: http://devicetree.org/meta-schemas/core.yaml#

title: HiSilicon Hi3798MV200 DWC3 USB SoC controller

maintainers:
  - Yang Xiwen <forbidden405@foxmail.com>

properties:
  compatible:
    const: hisilicon,hi3798mv200-dwc3

  '#address-cells':
    const: 1

  '#size-cells':
    const: 1

  ranges: true

  clocks:
    items:
      - description: Controller bus clock
      - description: Controller suspend clock
      - description: Controller reference clock
      - description: Controller gm clock
      - description: Controller gs clock
      - description: Controller utmi clock
      - description: Controller pipe clock

  clock-names:
    items:
      - const: bus
      - const: suspend
      - const: ref
      - const: gm
      - const: gs
      - const: utmi
      - const: pipe

  resets:
    maxItems: 1

  reset-names:
    const: soft

patternProperties:
  '^usb@[0-9a-z]+$':
    $ref: snps,dwc3.yaml#

additionalProperties: false

required:
  - compatible
  - '#address-cells'
  - '#size-cells'
  - ranges
  - clocks
  - clock-names
  - resets
  - reset-names

examples:
  - |
    #include <dt-bindings/clock/histb-clock.h>
    #include <dt-bindings/interrupt-controller/arm-gic.h>

    usb@98a0000 {
            compatible = "hisilicon,hi3798mv200-dwc3";
            #address-cells = <1>;
            #size-cells = <1>;
            ranges;
            clocks = <&crg HISTB_USB3_BUS_CLK>,
                     <&crg HISTB_USB3_SUSPEND_CLK>,
                     <&crg HISTB_USB3_REF_CLK>,
                     <&crg HISTB_USB3_GM_CLK>,
                     <&crg HISTB_USB3_GS_CLK>,
                     <&crg HISTB_USB3_UTMI_CLK>,
                     <&crg HISTB_USB3_PIPE_CLK>;
            clock-names = "bus", "suspend", "ref", "gm", "gs", "utmi", "pipe";
            resets = <&crg 0xb0 12>;
            reset-names = "soft";

            usb@98a0000 {
                    compatible = "snps,dwc3";
                    reg = <0x98a0000 0x10000>;
                    interrupts = <GIC_SPI 69 IRQ_TYPE_LEVEL_HIGH>;
                    clocks = <&crg HISTB_USB3_BUS_CLK>,
                             <&crg HISTB_USB3_SUSPEND_CLK>,
                             <&crg HISTB_USB3_REF_CLK>;
                    clock-names = "bus_early", "suspend", "ref";
                    phys = <&usb2_phy1_port2>, <&combphy0 0>;
                    phy-names = "usb2-phy", "usb3-phy";
                    maximum-speed = "super-speed";
                    dr_mode = "host";
            };
    };
```

## Documentation/devicetree/bindings/usb/hynetek,husb320.yaml
```yaml
# SPDX-License-Identifier: (GPL-2.0-only OR BSD-2-Clause)
%YAML 1.2
---
$id: http://devicetree.org/schemas/usb/hynetek,husb320.yaml#
$schema: http://devicetree.org/meta-schemas/core.yaml#

title: Hynetek HUSB320 USB Type-C controller

maintainers:
  - Hongyang Zhao <hongyang.zhao@163.com>

description:
  The HUSB320 is an autonomous USB Type-C Configuration Channel controller.
  It supports source, sink and dual-role port configurations, including
  optional Try.SRC and Try.SNK role preferences. The controller reports cable
  attachment, orientation, advertised current and accessory detection over
  I2C and an active-low interrupt.

properties:
  compatible:
    const: hynetek,husb320

  reg:
    description:
      7-bit I2C address selected by the ADDR/ORIENT pin strap. Ground selects
      0x21 and VDD selects 0x31. These correspond to the 8-bit write addresses
      0x42 and 0x62 shown in the datasheet.
    enum: [0x21, 0x31]

  interrupts:
    maxItems: 1

  wakeup-source: true

  vdd-supply:
    description: Power supply for the controller

  enable-gpios:
    description: Active-low controller enable
    maxItems: 1

  connector:
    type: object
    $ref: /schemas/connector/usb-connector.yaml#
    unevaluatedProperties: false
    description:
      USB Type-C connector managed by the controller. A dual-role data port
      requires a High-Speed graph connection to a USB role-switch provider.

    properties:
      compatible:
        const: usb-c-connector

      try-power-role:
        enum: [source, sink]

    required:
      - compatible
      - pd-disable
      - power-role
      - typec-power-opmode

    allOf:
      - if:
          properties:
            power-role:
              enum: [source, dual]
        then:
          required:
            - vbus-supply

      - if:
          properties:
            power-role:
              const: source
        then:
          properties:
            data-role:
              const: host
            try-power-role: false

      - if:
          properties:
            power-role:
              const: sink
        then:
          properties:
            data-role:
              const: device
            try-power-role: false

      - if:
          properties:
            power-role:
              const: dual
        then:
          properties:
            data-role:
              const: dual

      - if:
          required:
            - data-role
          properties:
            data-role:
              const: dual
        then:
          anyOf:
            - required:
                - port
            - required:
                - ports

required:
  - compatible
  - reg
  - interrupts
  - connector

additionalProperties: false

examples:
  - |
    #include <dt-bindings/gpio/gpio.h>
    #include <dt-bindings/interrupt-controller/irq.h>

    i2c {
        #address-cells = <1>;
        #size-cells = <0>;

        typec@31 {
            compatible = "hynetek,husb320";
            reg = <0x31>;
            vdd-supply = <&vreg_3v3>;
            enable-gpios = <&gpio 54 GPIO_ACTIVE_LOW>;
            interrupts-extended = <&gpio 55 IRQ_TYPE_LEVEL_LOW>;
            wakeup-source;

            connector {
                compatible = "usb-c-connector";
                label = "USB-C";
                vbus-supply = <&usb_vbus>;
                data-role = "dual";
                power-role = "dual";
                try-power-role = "sink";
                typec-power-opmode = "default";
                pd-disable;

                ports {
                    #address-cells = <1>;
                    #size-cells = <0>;

                    port@0 {
                        reg = <0>;

                        endpoint {
                            remote-endpoint = <&usb_role>;
                        };
                    };

                    port@1 {
                        reg = <1>;

                        endpoint {
                            remote-endpoint = <&usb_ss>;
                        };
                    };
                };
            };
        };
    };
```

## Documentation/devicetree/bindings/usb/ite,it5271.yaml
```yaml
# SPDX-License-Identifier: (GPL-2.0-only OR BSD-2-Clause)
%YAML 1.2
---
$id: http://devicetree.org/schemas/usb/ite,it5271.yaml#
$schema: http://devicetree.org/meta-schemas/core.yaml#

title: ITE IT5271/IT5272/IT5273/IT5274 USB Type-C Power Delivery Controller

maintainers:
  - Amber Kao <amber.kao@ite.com.tw>

description: |
  The ITE IT527x series are I2C-based USB Type-C Power Delivery (PD)
  controllers.
  All variants support DFP/UFP/DRP roles, USB PD 3.1, Fast Role Swap,
  USB4, and TBT3/TBT4 alternate modes.

  The series comprises four ordering part numbers built on identical
  silicon; port count and PD power range support are configured via
  firmware/OTP rather than differing in the register interface itself:
    - IT5271: single-port variant, SPR
    - IT5272: two-port variant, SPR
    - IT5273: single-port variant, EPR
    - IT5274: two-port variant, EPR

properties:
  compatible:
    oneOf:
      - const: ite,it5271
      - items:
          - const: ite,it5272
          - const: ite,it5271
      - items:
          - const: ite,it5273
          - const: ite,it5271
      - items:
          - const: ite,it5274
          - const: ite,it5271

  reg:
    maxItems: 1

  interrupts:
    maxItems: 1

  wakeup-source: true

  '#address-cells':
    const: 1

  '#size-cells':
    const: 0

patternProperties:
  '^connector@[01]$':
    $ref: /schemas/connector/usb-connector.yaml#
    properties:
      reg:
        maxItems: 1
    required:
      - reg
    unevaluatedProperties: false

required:
  - compatible
  - reg
  - interrupts

anyOf:
  - required:
      - connector@0
  - required:
      - connector@1

allOf:
  - if:
      not:
        properties:
          compatible:
            contains:
              enum:
                - ite,it5272
                - ite,it5274
    then:
      properties:
        connector@1: false

unevaluatedProperties: false

examples:
  - |
    #include <dt-bindings/interrupt-controller/irq.h>

    i2c {
        #address-cells = <1>;
        #size-cells = <0>;

        /* IT5274: two-port, EPR variant */
        typec@26 {
            compatible = "ite,it5274", "ite,it5271";
            reg = <0x26>;
            interrupts-extended = <&tlmm 129 IRQ_TYPE_EDGE_FALLING>;
            wakeup-source;

            #address-cells = <1>;
            #size-cells = <0>;

            connector@0 {
                compatible = "usb-c-connector";
                reg = <0>;
                label = "USB-C-0";
                power-role = "dual";
                data-role = "dual";

                ports {
                    #address-cells = <1>;
                    #size-cells = <0>;

                    port@0 {
                        reg = <0>;
                        endpoint {
                            remote-endpoint = <&eud_con>;
                        };
                    };

                    port@1 {
                        reg = <1>;
                        endpoint {
                            remote-endpoint = <&redriver_ss_out>;
                        };
                    };

                    port@2 {
                        reg = <2>;
                        endpoint {
                            remote-endpoint = <&dp_phy_out>;
                        };
                    };
                };
            };

            connector@1 {
                compatible = "usb-c-connector";
                reg = <1>;
                label = "USB-C-1";
                power-role = "dual";
                data-role = "dual";

                ports {
                    #address-cells = <1>;
                    #size-cells = <0>;

                    port@0 {
                        reg = <0>;
                        endpoint {
                            remote-endpoint = <&usb1_hs_con>;
                        };
                    };

                    port@1 {
                        reg = <1>;
                        endpoint {
                            remote-endpoint = <&redriver1_ss_out>;
                        };
                    };

                    port@2 {
                        reg = <2>;
                        endpoint {
                            remote-endpoint = <&dp_phy1_out>;
                        };
                    };
                };
            };
        };
    };
```
