## Documentation/devicetree/bindings/usb/dwc3-xilinx.yaml
```yaml
# SPDX-License-Identifier: (GPL-2.0 OR BSD-2-Clause)
%YAML 1.2
---
$id: http://devicetree.org/schemas/usb/dwc3-xilinx.yaml#
$schema: http://devicetree.org/meta-schemas/core.yaml#

title: Xilinx SuperSpeed DWC3 USB SoC controller

maintainers:
  - Radhey Shyam Pandey <radhey.shyam.pandey@amd.com>

properties:
  compatible:
    items:
      - enum:
          - xlnx,zynqmp-dwc3
          - xlnx,versal-dwc3
          - xlnx,versal2-mmi-dwc3

  reg:
    maxItems: 1

  "#address-cells":
    enum: [ 1, 2 ]

  "#size-cells":
    enum: [ 1, 2 ]

  ranges: true

  dma-coherent: true

  power-domains:
    description: specifies a phandle to PM domain provider node
    maxItems: 1

  clocks:
    description:
      A list of phandle and clock-specifier pairs for the clocks
      listed in clock-names.
    items:
      - description: Master/Core clock, has to be >= 156.25 MHz in SSP
          mode, >= 125 MHz for SS operation and >= 60 MHz for HS
          operation.
      - description: Clock source to core during PHY power down.

  clock-names:
    items:
      - const: bus_clk
      - const: ref_clk

  resets:
    minItems: 1
    description:
      A list of phandles for resets listed in reset-names.

    items:
      - description: USB core reset
      - description: USB hibernation reset
      - description: USB APB reset

  reset-names:
    minItems: 1
    items:
      - const: usb_crst
      - const: usb_hibrst
      - const: usb_apbrst

  phys:
    minItems: 1
    maxItems: 2

  phy-names:
    minItems: 1
    maxItems: 2
    items:
      enum:
        - usb2-phy
        - usb3-phy

  reset-gpios:
    description: GPIO used for the reset ulpi-phy
    maxItems: 1

  xlnx,usb-syscon:
    description:
      Phandle to the MMI UDH system-level control register (SLCR) syscon
      node, with four cells specifying the register offsets for USB2 PHY,
      USB3 PHY, USB DRD, and USB power configuration respectively.
    $ref: /schemas/types.yaml#/definitions/phandle-array
    items:
      - items:
          - description: phandle to MMI UDH SLCR syscon node
          - description: USB2 PHY register offset within SLCR
          - description: USB3 PHY register offset within SLCR
          - description: USB DRD register offset within SLCR
          - description: USB power register offset within SLCR

# Required child node:

patternProperties:
  "^usb@[0-9a-f]+$":
    $ref: snps,dwc3.yaml#

required:
  - compatible
  - "#address-cells"
  - "#size-cells"
  - ranges
  - power-domains
  - clocks
  - clock-names
  - resets
  - reset-names

allOf:
  - if:
      properties:
        compatible:
          contains:
            enum:
              - xlnx,versal-dwc3
              - xlnx,versal2-mmi-dwc3
    then:
      properties:
        resets:
          maxItems: 1
        reset-names:
          maxItems: 1
    else:
      properties:
        resets:
          minItems: 3
        reset-names:
          minItems: 3

  - if:
      properties:
        compatible:
          contains:
            enum:
              - xlnx,zynqmp-dwc3
              - xlnx,versal-dwc3
    then:
      required:
        - reg

  - if:
      properties:
        compatible:
          contains:
            const: xlnx,versal2-mmi-dwc3
    then:
      required:
        - xlnx,usb-syscon

additionalProperties: false

examples:
  - |
    #include <dt-bindings/dma/xlnx-zynqmp-dpdma.h>
    #include <dt-bindings/power/xlnx-zynqmp-power.h>
    #include <dt-bindings/reset/xlnx-zynqmp-resets.h>
    #include <dt-bindings/reset/xlnx-zynqmp-resets.h>
    #include <dt-bindings/phy/phy.h>
    axi {
        #address-cells = <2>;
        #size-cells = <2>;

        usb@0 {
            #address-cells = <0x2>;
            #size-cells = <0x2>;
            compatible = "xlnx,zynqmp-dwc3";
            reg = <0x0 0xff9d0000 0x0 0x100>;
            clocks = <&zynqmp_clk 32>, <&zynqmp_clk 34>;
            clock-names = "bus_clk", "ref_clk";
            power-domains = <&zynqmp_firmware PD_USB_0>;
            resets = <&zynqmp_reset ZYNQMP_RESET_USB1_CORERESET>,
                     <&zynqmp_reset ZYNQMP_RESET_USB1_HIBERRESET>,
                     <&zynqmp_reset ZYNQMP_RESET_USB1_APB>;
            reset-names = "usb_crst", "usb_hibrst", "usb_apbrst";
            phys = <&psgtr 2 PHY_TYPE_USB3 0 2>;
            phy-names = "usb3-phy";
            ranges;

            usb@fe200000 {
                compatible = "snps,dwc3";
                reg = <0x0 0xfe200000 0x0 0x40000>;
                interrupt-names = "host", "otg";
                interrupts = <0 65 4>, <0 69 4>;
                dr_mode = "host";
                dma-coherent;
            };
        };
    };
  - |
    #include <dt-bindings/power/xlnx-zynqmp-power.h>
    #include <dt-bindings/reset/xlnx-zynqmp-resets.h>
    #include <dt-bindings/phy/phy.h>
    usb {
        #address-cells = <1>;
        #size-cells = <1>;
        compatible = "xlnx,versal2-mmi-dwc3";
        clocks = <&zynqmp_clk 32>, <&zynqmp_clk 34>;
        clock-names = "bus_clk", "ref_clk";
        power-domains = <&zynqmp_firmware PD_USB_0>;
        resets = <&zynqmp_reset ZYNQMP_RESET_USB1_CORERESET>;
        reset-names = "usb_crst";
        phys = <&psgtr 2 PHY_TYPE_USB3 0 2>;
        phy-names = "usb3-phy";
        xlnx,usb-syscon = <&udh_slcr 0x005c 0x0070 0x00c4 0x00f8>;
        ranges;

        usb@fe200000 {
            compatible = "snps,dwc3";
            reg = <0xfe200000 0x40000>;
            interrupt-names = "host", "otg";
            interrupts = <0 65 4>, <0 69 4>;
            dr_mode = "host";
            dma-coherent;
        };
    };
```

## Documentation/devicetree/bindings/usb/eswin,eic7700-usb.yaml
```yaml
# SPDX-License-Identifier: (GPL-2.0-only OR BSD-2-Clause)
%YAML 1.2
---
$id: http://devicetree.org/schemas/usb/eswin,eic7700-usb.yaml#
$schema: http://devicetree.org/meta-schemas/core.yaml#

title: ESWIN EIC7700 SoC Usb Controller

maintainers:
  - Wei Yang <yangwei1@eswincomputing.com>
  - Senchuan Zhang <zhangsenchuan@eswincomputing.com>
  - Hang Cao <caohang@eswincomputing.com>

description:
  The Usb controller on EIC7700 SoC.

allOf:
  - $ref: snps,dwc3-common.yaml#

properties:
  compatible:
    const: eswin,eic7700-dwc3

  reg:
    maxItems: 1

  interrupts:
    maxItems: 1

  interrupt-names:
    items:
      - const: peripheral

  clocks:
    maxItems: 2

  clock-names:
    items:
      - const: aclk
      - const: cfg

  resets:
    maxItems: 1

  reset-names:
    items:
      - const: vaux

  eswin,hsp-sp-csr:
    description:
      HSP CSR is to control and get status of different high-speed peripherals
      (such as Ethernet, USB, SATA, etc.) via register, which can close
      module's clock,reset module independently and tune board-level's
      parameters of PHY, etc.
    $ref: /schemas/types.yaml#/definitions/phandle-array
    items:
      - items:
          - description: phandle to HSP Register Controller hsp_sp_csr node.
          - description: usb bus register offset.
          - description: axi low power register offset.
          - description: vbus frequency register offset.
          - description: mpll register offset.

required:
  - compatible
  - reg
  - clocks
  - clock-names
  - interrupts
  - interrupt-names
  - resets
  - reset-names
  - eswin,hsp-sp-csr

unevaluatedProperties: false

examples:
  - |
    usb@50480000 {
        compatible = "eswin,eic7700-dwc3";
        reg = <0x50480000 0x10000>;
        clocks = <&clock 170>,
                 <&clock 171>;
        clock-names = "aclk", "cfg";
        interrupt-parent = <&plic>;
        interrupts = <85>;
        interrupt-names = "peripheral";
        resets = <&reset 84>;
        reset-names = "vaux";
        dr_mode = "peripheral";
        maximum-speed = "high-speed";
        phy_type = "utmi";
        snps,dis_enblslpm_quirk;
        snps,dis-u2-freeclk-exists-quirk;
        snps,dis_u2_susphy_quirk;
        snps,dis-del-phy-power-chg-quirk;
        snps,parkmode-disable-ss-quirk;
        eswin,hsp-sp-csr = <&hsp_sp_csr 0x800 0x818 0x83c 0x840>;
    };
```

## Documentation/devicetree/bindings/usb/fsl,ls-dwc3.yaml
```yaml
# SPDX-License-Identifier: (GPL-2.0-only OR BSD-2-Clause)
%YAML 1.2
---
$id: http://devicetree.org/schemas/usb/fsl,ls-dwc3.yaml#
$schema: http://devicetree.org/meta-schemas/core.yaml#

title: Freescale layerscape DWC3 USB controller

maintainers:
  - Frank Li <Frank.Li@nxp.com>

properties:
  compatible:
    const: fsl,ls1028a-dwc3

  ranges: true

  '#address-cells':
    enum: [ 1, 2 ]

  '#size-cells':
    enum: [ 1, 2 ]

# Required child node:

patternProperties:
  "^usb@[0-9a-f]+$":
    $ref: snps,dwc3.yaml#

required:
  - compatible

additionalProperties: false

examples:
  - |
    #include <dt-bindings/interrupt-controller/arm-gic.h>
    usb {
        compatible = "fsl,ls1028a-dwc3";
        ranges;
        #address-cells = <1>;
        #size-cells = <1>;

        usb@31000000 {
             compatible = "snps,dwc3";
             reg = <0x31000000 0x10000>;
             interrupts = <GIC_SPI 91 IRQ_TYPE_LEVEL_HIGH>;
             dr_mode = "peripheral";
        };
    };
```

## Documentation/devicetree/bindings/usb/genesys,gl850g.yaml
```yaml
# SPDX-License-Identifier: GPL-2.0-only OR BSD-2-Clause
%YAML 1.2
---
$id: http://devicetree.org/schemas/usb/genesys,gl850g.yaml#
$schema: http://devicetree.org/meta-schemas/core.yaml#

title: Genesys Logic GL850G USB 2.0 hub controller

maintainers:
  - Icenowy Zheng <uwu@icenowy.me>

allOf:
  - $ref: usb-device.yaml#

properties:
  compatible:
    enum:
      - usb5e3,608
      - usb5e3,610
      - usb5e3,620

  reg: true

  reset-gpios:
    maxItems: 1
    description: GPIO controlling the RESET# pin.

  vdd-supply:
    description:
      the regulator that provides 3.3V core power to the hub.

  peer-hub:
    $ref: /schemas/types.yaml#/definitions/phandle
    description:
      phandle to the peer hub on the controller.

required:
  - compatible
  - reg
  - reset-gpios
  - vdd-supply
  - peer-hub

additionalProperties: false

examples:
  - |
    #include <dt-bindings/gpio/gpio.h>

    usb {
        dr_mode = "host";
        #address-cells = <1>;
        #size-cells = <0>;

        /* 2.0 hub on port 1 */
        hub_2_0: hub@1 {
            compatible = "usb5e3,610";
            reg = <1>;
            vdd-supply = <&vcc_5v>;
            peer-hub = <&hub_3_0>;
            reset-gpios = <&gpio 20 GPIO_ACTIVE_LOW>;
        };

        /* 3.1 hub on port 4 */
        hub_3_0: hub@2 {
            compatible = "usb5e3,620";
            reg = <2>;
            vdd-supply = <&vcc_5v>;
            peer-hub = <&hub_2_0>;
            reset-gpios = <&gpio 20 GPIO_ACTIVE_LOW>;
        };
    };
```

## Documentation/devicetree/bindings/usb/google,gs5-dwc3.yaml
```yaml
# SPDX-License-Identifier: (GPL-2.0 OR BSD-2-Clause)
# Copyright (c) 2025, Google LLC
%YAML 1.2
---
$id: http://devicetree.org/schemas/usb/google,gs5-dwc3.yaml#
$schema: http://devicetree.org/meta-schemas/core.yaml#

title: Google Tensor Series (G5+) DWC3 USB SoC Controller

maintainers:
  - Roy Luo <royluo@google.com>

description:
  Describes the DWC3 USB controller block implemented on Google Tensor SoCs,
  starting with the G5 generation. Based on Synopsys DWC3 IP, the controller
  features Dual-Role Device single port with hibernation add-on.

properties:
  compatible:
    const: google,gs5-dwc3

  reg:
    items:
      - description: Core DWC3 IP registers.
      - description: USB host controller configuration registers.
      - description: USB custom interrrupts control registers.

  reg-names:
    items:
      - const: dwc3_core
      - const: host_cfg
      - const: usbint_cfg

  interrupts:
    items:
      - description: Core DWC3 interrupt.
      - description: High speed power management event for remote wakeup.
      - description: Super speed power management event for remote wakeup.

  interrupt-names:
    items:
      - const: core
      - const: hs_pme
      - const: ss_pme

  clocks:
    items:
      - description: Non-sticky module clock.
      - description: Sticky module clock.

  clock-names:
    items:
      - const: non_sticky
      - const: sticky

  resets:
    items:
      - description: Non-sticky module reset.
      - description: Sticky module reset.
      - description: DRD bus reset.
      - description: Top-level reset.

  reset-names:
    items:
      - const: non_sticky
      - const: sticky
      - const: drd_bus
      - const: top

  power-domains:
    items:
      - description: Power switchable domain, the child of top domain.
          Turning it on puts the controller into full power state,
          turning it off puts the controller into power gated state.
      - description: Top domain, the parent of power switchable domain.
          Turning it on puts the controller into power gated state,
          turning it off completely shuts off the controller.

  power-domain-names:
    items:
      - const: psw
      - const: top

  iommus:
    maxItems: 1

required:
  - compatible
  - reg
  - reg-names
  - interrupts
  - interrupt-names
  - clocks
  - clock-names
  - resets
  - reset-names
  - power-domains
  - power-domain-names

allOf:
  - $ref: snps,dwc3-common.yaml#

unevaluatedProperties: false

examples:
  - |
    #include <dt-bindings/interrupt-controller/arm-gic.h>
    #include <dt-bindings/interrupt-controller/irq.h>
    soc {
        #address-cells = <2>;
        #size-cells = <2>;

        usb@c400000 {
            compatible = "google,gs5-dwc3";
            reg = <0 0x0c400000  0 0xd060>, <0 0x0c450000 0 0x14>, <0 0x0c450020 0 0x43>;
            reg-names = "dwc3_core", "host_cfg", "usbint_cfg";
            interrupts = <GIC_SPI 580 IRQ_TYPE_LEVEL_HIGH 0>,
                         <GIC_SPI 597 IRQ_TYPE_LEVEL_HIGH 0>,
                         <GIC_SPI 598 IRQ_TYPE_LEVEL_HIGH 0>;
            interrupt-names = "core", "hs_pme", "ss_pme";
            clocks = <&hsion_usbc_non_sticky_clk>,  <&hsion_usbc_sticky_clk>;
            clock-names = "non_sticky", "sticky";
            resets = <&hsion_resets_usbc_non_sticky>, <&hsion_resets_usbc_sticky>,
                     <&hsion_resets_usb_drd_bus>, <&hsion_resets_usb_top>;
            reset-names = "non_sticky", "sticky", "drd_bus", "top";
            power-domains = <&hsio_n_usb_psw>, <&hsio_n_usb>;
            power-domain-names = "psw", "top";
            phys = <&usb_phy 0>;
            phy-names = "usb2-phy";
            snps,quirk-frame-length-adjustment = <0x20>;
            snps,gfladj-refclk-lpm-sel-quirk;
            snps,incr-burst-type-adjustment = <4>;
        };
    };
...
```
