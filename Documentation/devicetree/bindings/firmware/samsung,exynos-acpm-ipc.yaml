## Documentation/devicetree/bindings/firmware/samsung,exynos-acpm-ipc.yaml
```yaml
# SPDX-License-Identifier: (GPL-2.0 OR BSD-2-Clause)
# Copyright 2024 Linaro Ltd.
%YAML 1.2
---
$id: http://devicetree.org/schemas/firmware/samsung,exynos-acpm-ipc.yaml#
$schema: http://devicetree.org/meta-schemas/core.yaml#

title: Samsung exynos ACPM mailbox protocol

maintainers:
  - Tudor Ambarus <tudor.ambarus@linaro.org>

description: |
  ACPM (Alive Clock and Power Manager) is a firmware that operates on the
  APM (Active Power Management) module that handles overall power management
  activities. ACPM and masters regard each other as independent hardware
  component and communicate with each other using mailbox messages and
  shared memory.

  This binding is intended to define the interface the firmware implementing
  ACPM provides for OSPM in the device tree.

properties:
  $nodename:
    const: acpm_ipc

  compatible:
    const: google,gs101-acpm-ipc

  mboxes:
    description:
      List of phandle and mailbox channel specifiers.
    maxItems: 1

  shmem:
    description:
      List of phandle pointing to the shared memory (SHM) area. The memory
      contains channels configuration data and the TX/RX ring buffers that
      are used for passing messages to/from the ACPM firmware.
    maxItems: 1

  initdata-base:
    $ref: /schemas/types.yaml#/definitions/uint32
    description:
      Base address of the configuration data in the shared memory.

additionalProperties: false

required:
  - compatible
  - mboxes
  - shmem
  - initdata-base

examples:
  - |
    firmware {
        acpm_ipc: acpm_ipc {
            compatible = "google,gs101-acpm-ipc";
            mboxes = <&ap2apm_mailbox 0>;
            shmem = <&apm_sram>;
            initdata-base = <0xa000>;
        };
    };
```

## Documentation/devicetree/bindings/fpga/altera-hps2fpga-bridge.yaml
```yaml
%YAML 1.2
---
$id: http://devicetree.org/schemas/fpga/altera-hps2fpga-bridge.yaml#
$schema: http://devicetree.org/meta-schemas/core.yaml#

title: Altera FPGA/HPS Bridge

maintainers:
  - Xu Yilun <yilun.xu@intel.com>

allOf:
  - $ref: fpga-bridge.yaml#

properties:
  compatible:
    enum:
      - altr,socfpga-lwhps2fpga-bridge
      - altr,socfpga-hps2fpga-bridge
      - altr,socfpga-fpga2hps-bridge

  reg:
    maxItems: 1

  resets:
    maxItems: 1

  clocks:
    maxItems: 1

required:
  - compatible
  - reg
  - clocks
  - resets

unevaluatedProperties: false

examples:
  - |
    #include <dt-bindings/reset/altr,rst-mgr.h>

    fpga-bridge@ff400000 {
      compatible = "altr,socfpga-lwhps2fpga-bridge";
      reg = <0xff400000 0x100000>;
      bridge-enable = <0>;
      clocks = <&l4_main_clk>;
      resets = <&rst LWHPS2FPGA_RESET>;
    };

    fpga_bridge1: fpga-bridge@ff500000 {
      compatible = "altr,socfpga-hps2fpga-bridge";
      reg = <0xff500000 0x10000>;
      bridge-enable = <1>;
      clocks = <&l4_main_clk>;
      resets = <&rst HPS2FPGA_RESET>;
    };

    fpga_bridge2: fpga-bridge@ff600000 {
      compatible = "altr,socfpga-fpga2hps-bridge";
      reg = <0xff600000 0x100000>;
      clocks = <&l4_main_clk>;
      resets = <&rst FPGA2HPS_RESET>;
    };
```

## Documentation/devicetree/bindings/fpga/efinix,trion-spi-passive.yaml
```yaml
# SPDX-License-Identifier: (GPL-2.0-only OR BSD-2-Clause)
%YAML 1.2
---
$id: http://devicetree.org/schemas/fpga/efinix,trion-spi-passive.yaml#
$schema: http://devicetree.org/meta-schemas/core.yaml#

title: Efinix SPI FPGA Manager

maintainers:
  - Ian Dannapel <iansdannapel@gmail.com>

description: |
  Efinix Trion and Titanium Series FPGAs support a method of loading the
  bitstream over what is referred to as "SPI Passive Programming".
  Only serial (1x bus width) is supported, setting the programming mode
  is not in the scope the this manager and must be done elsewhere.

  Warning: The slave serial link is not technically SPI and therefore it is
  not recommended to have other devices on the same bus since it might
  interfere or be interfered by other transmissions.

  References:
  - https://www.efinixinc.com/docs/an033-configuring-titanium-fpgas-v2.6.pdf
  - https://www.efinixinc.com/docs/an006-configuring-trion-fpgas-v6.0.pdf

allOf:
  - $ref: /schemas/spi/spi-peripheral-props.yaml#

properties:
  compatible:
    enum:
      - efinix,trion-spi-passive
      - efinix,titanium-spi-passive

  spi-cpha: true

  spi-cpol: true

  spi-max-frequency:
    maximum: 25000000

  reg:
    maxItems: 1

  creset-gpios:
    description:
      reset and re-configuration trigger pin (low active)
    maxItems: 1

  cs-gpios:
    description:
      chip-select pin (low active)
    maxItems: 1

  cdone-gpios:
    description:
      optional configuration done status pin (high active)
    maxItems: 1

required:
  - compatible
  - reg
  - creset-gpios
  - cs-gpios

additionalProperties: false

examples:
  - |
    #include <dt-bindings/gpio/gpio.h>
    spi {
      #address-cells = <1>;
      #size-cells = <0>;
      fpga-mgr@0 {
        compatible = "efinix,trion-spi-passive";
        reg = <0>;
        spi-max-frequency = <25000000>;
        spi-cpha;
        spi-cpol;
        creset-gpios = <&gpio4 17 GPIO_ACTIVE_LOW>;
        cs-gpios = <&gpio5 13 GPIO_ACTIVE_LOW>;
        cdone-gpios = <&gpio0 9 GPIO_ACTIVE_HIGH>;
      };
    };
...
```

## Documentation/devicetree/bindings/fpga/efinix,trion-spi.yaml
```yaml
# SPDX-License-Identifier: (GPL-2.0-only OR BSD-2-Clause)
%YAML 1.2
---
$id: http://devicetree.org/schemas/fpga/efinix,spi.yaml#
$schema: http://devicetree.org/meta-schemas/core.yaml#

title: Efinix SPI FPGA Manager

maintainers:
  - Ian Dannapel <iansdannapel@gmail.com>

description: |
  Efinix FPGAs (Trion, Topaz, and Titanium families) support loading bitstreams
  through "SPI Passive Mode".
  Note: Additional pins hogs for bus width configuration must be set
  elsewhere, if necessary. Only bus width 1x serial is supported.

  References:
  - https://www.efinixinc.com/docs/an006-configuring-trion-fpgas-v6.3.pdf
  - https://www.efinixinc.com/docs/an033-configuring-titanium-fpgas-v2.8.pdf
  - https://www.efinixinc.com/docs/an061-configuring-topaz-fpgas-v1.1.pdf

allOf:
  - $ref: /schemas/spi/spi-peripheral-props.yaml#

properties:
  compatible:
    enum:
      - efinix,trion-spi
      - efinix,titanium-spi
      - efinix,topaz-spi

  spi-cpha: true

  spi-cpol: true

  spi-max-frequency:
    maximum: 25000000

  reg:
    maxItems: 1

  reset-gpios:
    description:
      reset and re-configuration trigger pin (low active)
    maxItems: 1

  cdone-gpios:
    description:
      optional configuration done status pin (high active)
    maxItems: 1

required:
  - compatible
  - reg
  - reset-gpios

unevaluatedProperties: false

examples:
  - |
    #include <dt-bindings/gpio/gpio.h>
    spi {
      #address-cells = <1>;
      #size-cells = <0>;
      cs-gpios = <&gpio5 13 GPIO_ACTIVE_LOW>;
      fpga-mgr@0 {
        compatible = "efinix,trion-spi";
        reg = <0>;
        spi-max-frequency = <25000000>;
        spi-cpha;
        spi-cpol;
        reset-gpios = <&gpio4 17 GPIO_ACTIVE_LOW>;
        cdone-gpios = <&gpio0 9 GPIO_ACTIVE_HIGH>;
      };
    };
...
```

## Documentation/devicetree/bindings/fpga/efnx,fpga-passive-spi.yaml
```yaml
# SPDX-License-Identifier: (GPL-2.0-only OR BSD-2-Clause)
%YAML 1.2
---
$id: http://devicetree.org/schemas/fpga/efnx,fpga-passive-spi.yaml#
$schema: http://devicetree.org/meta-schemas/core.yaml#

title: Efinix SPI FPGA Manager

description: |
  Efinix Trion and Titanium Series FPGAs support a method of loading the
  bitstream over what is referred to as "SPI Passive Programming".
  Only serial (1x bus width) is supported, setting the programming mode
  is not in the scope the this manager and must be done elsewhere.

  References:
  - https://www.efinixinc.com/docs/an033-configuring-titanium-fpgas-v2.6.pdf
  - https://www.efinixinc.com/docs/an006-configuring-trion-fpgas-v6.0.pdf

allOf:
  - $ref: /schemas/spi/spi-peripheral-props.yaml#

properties:
  compatible:
    enum:
      - efnx,fpga-spi-passive

  spi-cpha: true
  spi-cpol: true

  spi-max-frequency:
    maximum: 25000000

  reg:
    maxItems: 1

  reset-gpios:
    description:
      reset pin (low active)
    maxItems: 1

  cs-gpios:
    description:
      chip-select pin (low active)
    maxItems: 1

  done-gpios:
    description:
      optional programming done pin, referred as CDONE (high active)
    maxItems: 1

required:
  - compatible
  - reg
  - reset-gpios
  - cs-gpios

additionalProperties: false

examples:
  - |
    &spi2 {
      #address-cells = <1>;
      #size-cells = <0>;

      fpga_mgr_spi: fpga-mgr@0 {
        compatible = "efnx,fpga-spi-passive";
        spi-max-frequency = <25000000>;
        spi-cpha;
        spi-cpol;
        reg = <0>;
        reset-gpios = <&gpio4 17 GPIO_ACTIVE_LOW>;
        cs-gpios = <&gpio5 13 GPIO_ACTIVE_LOW>;
        done-gpios = <&gpio0 9 GPIO_ACTIVE_HIGH>;
      };
    };
...
```

## Documentation/devicetree/bindings/fpga/intel,stratix10-soc-fpga-mgr.yaml
```yaml
# SPDX-License-Identifier: (GPL-2.0-only OR BSD-2-Clause)
%YAML 1.2
---
$id: http://devicetree.org/schemas/fpga/intel,stratix10-soc-fpga-mgr.yaml#
$schema: http://devicetree.org/meta-schemas/core.yaml#

title: Intel Stratix10 SoC FPGA Manager

maintainers:
  - Moritz Fischer <mdf@kernel.org>
  - Wu Hao <hao.wu@intel.com>
  - Xu Yilun <yilun.xu@intel.com>

description: |
  Bindings for the Intel Stratix10 SoC FPGA Manager.

properties:
  compatible:
    enum:
      - intel,stratix10-soc-fpga-mgr
      - intel,agilex-soc-fpga-mgr

required:
  - compatible

additionalProperties: false

examples:
  - |
    fpga-mgr {
      compatible = "intel,stratix10-soc-fpga-mgr";
    };
```

## Documentation/devicetree/bindings/fpga/technologic,ts73xx-fpga.yaml
```yaml
# SPDX-License-Identifier: (GPL-2.0-only OR BSD-2-Clause)
%YAML 1.2
---
$id: http://devicetree.org/schemas/fpga/technologic,ts73xx-fpga.yaml#
$schema: http://devicetree.org/meta-schemas/core.yaml#

title: Technologic Systems TS-73xx FPGA Manager

maintainers:
  - Florian Fainelli <f.fainelli@gmail.com>

description:
  FPGA manager for the Altera Cyclone II FPGA on Technologic Systems
  TS-7300 series boards. The FPGA is programmed via a CPLD interface
  at a memory-mapped register pair.

properties:
  compatible:
    const: technologic,ts73xx-fpga

  reg:
    maxItems: 1

required:
  - compatible
  - reg

additionalProperties: false

examples:
  - |
    bus {
        #address-cells = <1>;
        #size-cells = <1>;
        ranges;

        fpga-mgr@13c00000 {
            compatible = "technologic,ts73xx-fpga";
            reg = <0x13c00000 0x2>;
        };
    };
...
```

## Documentation/devicetree/bindings/fsi/fsi-controller.yaml
```yaml
# SPDX-License-Identifier: (GPL-2.0-only OR BSD-2-Clause)
%YAML 1.2
---
$id: http://devicetree.org/schemas/fsi/fsi-controller.yaml#
$schema: http://devicetree.org/meta-schemas/core.yaml#

title: FSI Controller Common Properties

maintainers:
  - Eddie James <eajames@linux.ibm.com>

description:
  FSI (FRU (Field Replaceable Unit) Service Interface) is a two wire bus. The
  FSI bus is connected to a CFAM (Common FRU Access Macro) which contains
  various engines such as I2C controllers, SPI controllers, etc.

properties:
  "#address-cells":
    const: 2

  "#size-cells":
    const: 0

  no-scan-on-init:
    $ref: /schemas/types.yaml#/definitions/flag
    description:
      The FSI controller cannot scan the bus during initialization.

patternProperties:
  "cfam@[0-9a-f],[0-9a-f]":
    type: object
    properties:
      chip-id:
        $ref: /schemas/types.yaml#/definitions/uint32
        description:
          Processor index

      reg:
        maxItems: 1

      "#address-cells":
        const: 1

      "#size-cells":
        const: 1

    required:
      - reg

    additionalProperties: true

additionalProperties: true

examples:
  - |
    fsi {
        #address-cells = <2>;
        #size-cells = <0>;

        cfam@0,0 {
            reg = <0 0>;
            #address-cells = <1>;
            #size-cells = <1>;
            chip-id = <0>;
        };
    };
```

## Documentation/devicetree/bindings/fsi/ibm,fsi2pib.yaml
```yaml
# SPDX-License-Identifier: (GPL-2.0-only OR BSD-2-Clause)
%YAML 1.2
---
$id: http://devicetree.org/schemas/fsi/ibm,fsi2pib.yaml#
$schema: http://devicetree.org/meta-schemas/core.yaml#

title: IBM FSI-attached SCOM engine

maintainers:
  - Eddie James <eajames@linux.ibm.com>

description:
  The SCOM engine is an interface to the POWER processor PIB (Pervasive
  Interconnect Bus). This node will always be a child of an FSI CFAM node;
  see fsi.txt for details on FSI slave and CFAM nodes.

properties:
  compatible:
    enum:
      - ibm,fsi2pib
      - ibm,i2cr-scom

  reg:
    items:
      - description: FSI slave address

required:
  - compatible
  - reg

additionalProperties: false

examples:
  - |
    scom@1000 {
        compatible = "ibm,fsi2pib";
        reg = <0x1000 0x400>;
    };
```

## Documentation/devicetree/bindings/fsi/ibm,hub-fsi-controller.yaml
```yaml
# SPDX-License-Identifier: (GPL-2.0-only OR BSD-2-Clause)
%YAML 1.2
---
$id: http://devicetree.org/schemas/fsi/ibm,hub-fsi-controller.yaml#
$schema: http://devicetree.org/meta-schemas/core.yaml#

title: IBM FSI-attached FSI Hub Controller

maintainers:
  - Eddie James <eajames@linux.ibm.com>

description: |
  The FSI Hub Controller is an FSI controller, providing a number of FSI links,
  located on a CFAM. Therefore this node will always be a child of an FSI CFAM
  node.

properties:
  compatible:
    enum:
      - ibm,hub-fsi-controller

  reg:
    items:
      - description: FSI slave address

allOf:
  - $ref: fsi-controller.yaml#

unevaluatedProperties: false

examples:
  - |
   fsi@3400 {
        #address-cells = <2>;
        #size-cells = <0>;
        compatible = "ibm,hub-fsi-controller";
        reg = <0x3400 0x400>;

        cfam@0,0 {
            #address-cells = <1>;
            #size-cells = <1>;
            reg = <0 0>;
        };
    };
```

## Documentation/devicetree/bindings/gpio/aaeon,srg-imx8pl-gpio.yaml
```yaml
# SPDX-License-Identifier: (GPL-2.0-only OR BSD-2-Clause)
%YAML 1.2
---
$id: http://devicetree.org/schemas/gpio/aaeon,srg-imx8pl-gpio.yaml#
$schema: http://devicetree.org/meta-schemas/core.yaml#

title: AAEON Embedded Controller GPIO

maintainers:
  - Jérémie Dautheribes <jeremie.dautheribes@bootlin.com>
  - Thomas Perrot <thomas.perrot@bootlin.com>

description: |
  GPIO controller functionality provided by the AAEON embedded controller.
  This controller provides 7 GPOs and 12 GPIOs.

  The GPIO controller is a sub-device of the AAEON MCU and must be defined
  as a child node of the MCU device.

properties:
  compatible:
    const: aaeon,srg-imx8pl-gpio

  gpio-controller: true

  "#gpio-cells":
    const: 2
    description: |
      The first cell is the GPIO number (0-6 for GPOs, 7-18 for
      general-purpose GPIOs).
      The second cell is the GPIO flags as defined in
      <dt-bindings/gpio/gpio.h>.

  ngpios:
    description: |
      Total number of GPIOs available (GPOs + GPIOs).
      This should be 19 (7 GPOs + 12 GPIOs).
    const: 19

required:
  - compatible
  - gpio-controller
  - "#gpio-cells"

additionalProperties: false

examples:
  - |
    gpio {
      compatible = "aaeon,srg-imx8pl-gpio";
      gpio-controller;
      #gpio-cells = <2>;
      ngpios = <19>;
    };
```
