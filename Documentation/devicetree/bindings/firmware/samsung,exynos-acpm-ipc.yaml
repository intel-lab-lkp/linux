## Documentation/devicetree/bindings/gpio/adi,adg1712.yaml
```yaml
# SPDX-License-Identifier: (GPL-2.0-only OR BSD-2-Clause)
%YAML 1.2
---
$id: http://devicetree.org/schemas/gpio/adi,adg1712.yaml#
$schema: http://devicetree.org/meta-schemas/core.yaml#

title: Analog Devices ADG1712 quad SPST switch GPIO controller

maintainers:
  - Antoniu Miclaus <antoniu.miclaus@analog.com>

description: |
  Bindings for Analog Devices ADG1712 quad single-pole, single-throw (SPST)
  switch controlled by GPIOs. The device features four independent switches,
  each controlled by a dedicated GPIO input pin.

  Each GPIO line exposed by this controller corresponds to one of the four
  switches (SW1-SW4) on the ADG1712. Setting a GPIO line high enables the
  corresponding switch, while setting it low disables the switch.

properties:
  compatible:
    const: adi,adg1712

  switch-gpios:
    description: |
      Array of GPIOs connected to the IN1-IN4 control pins.
      Index 0 corresponds to IN1 (controls SW1),
      Index 1 corresponds to IN2 (controls SW2),
      Index 2 corresponds to IN3 (controls SW3),
      Index 3 corresponds to IN4 (controls SW4).
    minItems: 4
    maxItems: 4

  gpio-controller: true

  "#gpio-cells":
    const: 2
    description: |
      The first cell is the GPIO number (0-3 corresponding to SW1-SW4).
      The second cell specifies GPIO flags.

required:
  - compatible
  - switch-gpios
  - gpio-controller
  - "#gpio-cells"

additionalProperties: false

examples:
  - |
    #include <dt-bindings/gpio/gpio.h>

    adg1712: gpio-expander {
        compatible = "adi,adg1712";
        gpio-controller;
        #gpio-cells = <2>;

        switch-gpios = <&gpio 10 GPIO_ACTIVE_HIGH>,
                       <&gpio 11 GPIO_ACTIVE_HIGH>,
                       <&gpio 12 GPIO_ACTIVE_HIGH>,
                       <&gpio 13 GPIO_ACTIVE_HIGH>;
    };
...
```

## Documentation/devicetree/bindings/gpio/adi,adp5585-gpio.yaml
```yaml
# SPDX-License-Identifier: (GPL-2.0-only OR BSD-2-Clause)
%YAML 1.2
---
$id: http://devicetree.org/schemas/gpio/adi,adp5585-gpio.yaml#
$schema: http://devicetree.org/meta-schemas/core.yaml#

title: Analog Devices ADP5585 GPIO Expander

maintainers:
  - Laurent Pinchart <laurent.pinchart@ideasonboard.com>

description: |
  The Analog Devices ADP5585 has up to 11 GPIOs represented by a "gpio" child
  node of the parent MFD device. See
  Documentation/devicetree/bindings/mfd/adi,adp5585.yaml for further details as
  well as an example.

properties:
  compatible:
    const: adi,adp5585-gpio

  gpio-controller: true

  '#gpio-cells':
    const: 2

  gpio-reserved-ranges: true

required:
  - compatible
  - gpio-controller
  - "#gpio-cells"

additionalProperties: false

...
```

## Documentation/devicetree/bindings/gpio/adi,ltc4283.yaml
```yaml
# SPDX-License-Identifier: (GPL-2.0 OR BSD-2-Clause)
%YAML 1.2
---
$id: http://devicetree.org/schemas/gpio/adi,ltc4283.yaml#
$schema: http://devicetree.org/meta-schemas/core.yaml#

title: GPIO LTC4283 Negative Voltage Hot Swap Controller

maintainers:
  - Nuno Sá <nuno.sa@analog.com>

description: |
  This module is part of the LTC4283 MFD device.
  See Documentation/devicetree/bindings/mfd/adi,ltc4283.yaml
  This implements the GPIO bindings for the LTC4283 negative voltage hot swap
  controller.

properties:
  compatible:
    enum:
      - adi,ltc4283-gpio

  gpio-controller: true

  '#gpio-cells':
    const: 2

required:
  - compatible
  - gpio-controller
  - '#gpio-cells'

additionalProperties: false
```

## Documentation/devicetree/bindings/gpio/arm,scmi-gpio.yaml
```yaml
# SPDX-License-Identifier: GPL-2.0-only OR BSD-2-Clause
%YAML 1.2
---
$id: http://devicetree.org/schemas/gpio/arm,scmi-gpio.yaml#
$schema: http://devicetree.org/meta-schemas/core.yaml#

title: SCMI pinctrl based generic GPIO controller

maintainers:
  - AKASHI Takahiro <akashi.takahiro@linaro.org>

properties:
  $nodename:
    pattern: "^scmi_gpio(@[0-9a-f]+)$"

  compatible:
    const: arm,scmi-gpio-generic

  gpio-controller: true

  "#gpio-cells":
    const: 2

  gpio-ranges: true

  gpio-ranges-group-names: true

patternProperties:
  "^.+-hog(-[0-9]+)?$":
    type: object
    properties:
      gpio-hog: true
      gpios: true
      input: true
      output-high: true
      output-low: true
      line-name: true

    required:
      - gpio-hog
      - gpios

    additionalProperties: false

required:
  - compatible
  - gpio-controller
  - "#gpio-cells"
  - gpio-ranges

additionalProperties: false

examples:
  - |
    #include <dt-bindings/gpio/gpio.h>

    scmi_gpio_0: scmi_gpio@0 {
        compatible = "arm,scmi-gpio";
        gpio-controller;
        #gpio-cells = <2>;
        gpio-ranges = <&scmi_pinctrl 0 10 5>,
                      <&scmi_pinctrl 5 0 0>;
        gpio-ranges-group-names = "",
                                  "pinmux_gpio";
    };

    // Consumer:
    sdhci0_pwrseq {
        compatible = "mmc-pwrseq-emmc";
        reset-gpios = <&scmi_gpio_0 0 GPIO_ACTIVE_LOW>;
    };
```

## Documentation/devicetree/bindings/gpio/axiado,sgpio.yaml
```yaml
# SPDX-License-Identifier: (GPL-2.0-only OR BSD-2-Clause)
%YAML 1.2
---
$id: http://devicetree.org/schemas/gpio/axiado,sgpio.yaml#
$schema: http://devicetree.org/meta-schemas/core.yaml#

title: Axiado SGPIO Controller

maintainers:
  - Petar Stepanovic <pstepanovic@axiado.com>
  - SriNavmani A <srinavmani@axiado.com>
  - Prasad Bolisetty <pbolisetty@axiado.com>

description: |
  The Axiado SGPIO controller provides a serial GPIO expansion interface
  that multiplexes multiple GPIO signals over a small set of physical lines.

  The controller operates as a shift-based interface, where output values
  are serialized on a data output line and input values are sampled from a
  data input line in synchronization with a shift clock. A latch signal is
  used to update output states after each transfer cycle.

  The interface uses data output (DOUT), data input (DIN), shift clock
  (SCLK), and latch signal (LATCH).

  Each SGPIO position provides one fixed-direction input GPIO and one
  fixed-direction output GPIO. Input GPIOs support edge-triggered
  interrupts.

  GPIOs are organized in banks of 32 signals, with registers controlling
  output values, input sampling, and interrupt status. The number of GPIO
  lines depends on the hardware variant.

  The controller detects changes on input GPIOs. Interrupt events are
  aggregated and signaled through a single interrupt line to the parent
  interrupt controller.

  Register access is performed over the APB bus. The SGPIO shift clock is
  derived from the APB clock using a programmable divider.

properties:
  compatible:
    enum:
      - axiado,ax3000-sgpio
      - axiado,ax3005-sgpio

  reg:
    maxItems: 1

  clocks:
    description:
      APB clock used for register access and SGPIO shift clock generation
    maxItems: 1

  bus-frequency:
    description: SGPIO shift clock frequency in Hz
    minimum: 1

  gpio-controller: true

  '#gpio-cells':
    const: 2

  interrupt-controller: true

  '#interrupt-cells':
    const: 2

  interrupts:
    maxItems: 1

  ngpios:
    description:
      Number of SGPIO positions. Each position provides one input GPIO and
      one output GPIO.
    enum: [128, 512]

allOf:
  - if:
      properties:
        compatible:
          const: axiado,ax3000-sgpio
    then:
      properties:
        ngpios:
          const: 128

required:
  - compatible
  - reg
  - clocks
  - bus-frequency
  - gpio-controller
  - '#gpio-cells'
  - interrupt-controller
  - '#interrupt-cells'
  - interrupts
  - ngpios

additionalProperties: false

examples:
  - |
    #include <dt-bindings/interrupt-controller/irq.h>

    sgpio@a000 {
        compatible = "axiado,ax3005-sgpio";
        reg = <0xa000 0x800>;
        clocks = <&apb_clk>;
        bus-frequency = <1000000>;
        gpio-controller;
        #gpio-cells = <2>;
        interrupt-controller;
        #interrupt-cells = <2>;
        interrupt-parent = <&gpio6>;
        interrupts = <17 IRQ_TYPE_LEVEL_HIGH>;
        ngpios = <128>;
    };
```

## Documentation/devicetree/bindings/gpio/cavium,thunder-8890-gpio.yaml
```yaml
# SPDX-License-Identifier: (GPL-2.0-only OR BSD-2-Clause)
%YAML 1.2
---
$id: http://devicetree.org/schemas/gpio/cavium,thunder-8890-gpio.yaml#
$schema: http://devicetree.org/meta-schemas/core.yaml#

title: Cavium ThunderX/OCTEON-TX GPIO Controller

maintainers:
  - Robert Richter <rric@kernel.org>

properties:
  compatible:
    const: cavium,thunder-8890-gpio

  reg:
    maxItems: 1

  gpio-controller: true

  '#gpio-cells':
    const: 2

  interrupt-controller: true

  '#interrupt-cells':
    const: 2

required:
  - reg
  - gpio-controller
  - '#gpio-cells'

additionalProperties: false

examples:
  - |
    gpio_6_0: gpio@6,0 {
      compatible = "cavium,thunder-8890-gpio";
      reg = <0x3000 0x100>; /*  DEVFN = 0x30 (6:0) */
      gpio-controller;
      #gpio-cells = <2>;
      interrupt-controller;
      #interrupt-cells = <2>;
    };
```

## Documentation/devicetree/bindings/gpio/cavium-thunder-8890-gpio.yaml
```yaml
# SPDX-License-Identifier: (GPL-2.0-only OR BSD-2-Clause)
%YAML 1.2
---
$id: http://devicetree.org/schemas/gpio/cavium-thunder-8890-gpio.yaml#
$schema: http://devicetree.org/meta-schemas/core.yaml#

title: Cavium ThunderX GPIO controller

description: |
  Device Tree binding for the GPIO controller found in
  Cavium ThunderX and OCTEON-TX SoCs.

maintainers:
  - Linus Walleij <linusw@kernel.org>
  - Rob Herring <robh@kernel.org>

properties:
  compatible:
    enum:
      - cavium,thunder-8890-gpio

  reg:
    maxItems: 1

  gpio-controller: true

  "#gpio-cells":
    const: 2

  interrupt-controller: true

  "#interrupt-cells":
    const: 2

required:
  - compatible
  - reg
  - gpio-controller
  - '#gpio-cells'

additionalProperties: false

examples:
  - |
    gpio_6_0: gpio@6,0 {
      compatible = "cavium,thunder-8890-gpio";
      reg = <0x3000 0x100>; /*  DEVFN = 0x30 (6:0) */
      gpio-controller;
      #gpio-cells = <2>;
      interrupt-controller;
      #interrupt-cells = <2>;
    };
```

## Documentation/devicetree/bindings/gpio/gpio-aggregator.yaml
```yaml
# SPDX-License-Identifier: (GPL-2.0-only OR BSD-2-Clause)
%YAML 1.2
---
$id: http://devicetree.org/schemas/gpio/gpio-aggregator.yaml#
$schema: http://devicetree.org/meta-schemas/core.yaml#

title: GPIO aggregator controller

maintainers:
  - Alexander Stein <linux@ew.tq-group.com>

description:
  GPIO aggregator forwards selected GPIO lines from one or more GPIO
  controllers and exposes them as a virtual GPIO controller.

properties:
  compatible:
    const: gpio-aggregator

  "#gpio-cells":
    description: Specifies the line offset and GPIO flags.
    const: 2

  gpios:
    description: Array of GPIOs to aggregate
    minItems: 1
    maxItems: 32

  gpio-controller: true

  gpio-line-names:
    minItems: 1
    maxItems: 32

required:
  - compatible
  - "#gpio-cells"
  - gpio-controller
  - gpios

additionalProperties: false

examples:
  - |
    #include <dt-bindings/gpio/gpio.h>

    gpio_agg: gpio-aggregator {
        compatible = "gpio-aggregator";
        #gpio-cells = <2>;
        gpio-controller;
        gpios = <&gpio0 3 GPIO_ACTIVE_LOW>,
                <&gpio3 1 GPIO_ACTIVE_HIGH>;
        gpio-line-names = "modem-reset", "modem-enable";
    };
```

## Documentation/devicetree/bindings/gpio/gpio-cdns.yaml
```yaml
# SPDX-License-Identifier: (GPL-2.0 OR BSD-2-Clause)
%YAML 1.2
---
$id: http://devicetree.org/schemas/gpio/gpio-cdns.yaml#
$schema: http://devicetree.org/meta-schemas/core.yaml#

title: Cadence GPIO Controller

maintainers:
  - Linus Walleij <linus.walleij@linaro.org>
  - Bartosz Golaszewski <brgl@bgdev.pl>

properties:
  compatible:
    const: cdns,gpio-r1p02

  reg:
    minItems: 1

  clocks:
    maxItems: 1

  ngpios:
    $ref: /schemas/types.yaml#/definitions/uint32
    description: Number of GPIO lines supported, maximum 32.

  gpio-controller: true

  "#gpio-cells":
    const: 2
    description: |
      - First cell is the GPIO line number.
      - Second cell is flags as defined in <dt-bindings/gpio/gpio.h>,
        only GPIO_ACTIVE_HIGH and GPIO_ACTIVE_LOW supported.

  interrupt-controller: true

  "#interrupt-cells":
    const: 2
    description: |
      - First cell is the GPIO line number used as IRQ.
      - Second cell is the trigger type, as defined in
        <dt-bindings/interrupt-controller/irq.h>.

  interrupts:
    maxItems: 1

required:
  - compatible
  - reg
  - clocks
  - gpio-controller
  - "#gpio-cells"

if:
  required: [interrupt-controller]
then:
  required:
    - interrupts
    - "#interrupt-cells"

additionalProperties: false

examples:
  - |
    #include <dt-bindings/interrupt-controller/arm-gic.h>
    #include <dt-bindings/interrupt-controller/irq.h>
    gpio0: gpio-controller@fd060000 {
        compatible = "cdns,gpio-r1p02";
        reg = <0xfd060000 0x1000>;
        clocks = <&gpio_clk>;

        interrupt-parent = <&gic>;
        interrupts = <GIC_SPI 5 IRQ_TYPE_LEVEL_HIGH>;

        gpio-controller;
        #gpio-cells = <2>;

        interrupt-controller;
        #interrupt-cells = <2>;
    };
```

## Documentation/devicetree/bindings/gpio/gpio-exar.yaml
```yaml
# SPDX-License-Identifier: (GPL-2.0-only OR BSD-2-Clause)
%YAML 1.2
---
$id: http://devicetree.org/schemas/gpio/gpio-exar.yaml#
$schema: http://devicetree.org/meta-schemas/core.yaml#

title: Exportable MPIO interface of Exar UART chips

maintainers:
  - Sudip Mukherjee <sudipm.mukherjee@gmail.com>
  - Bartosz Golaszewski <brgl@kernel.org>

description: |
  Exar XR17V35x UART chips expose a subset of their MPIO lines as a GPIO
  controller. The GPIO controller is instantiated by the Exar 8250 PCI UART
  driver as a child platform device and consumes firmware properties from a
  child node describing the exported MPIO range.

select: false

properties:
  $nodename:
    pattern: "^gpio(@.*)?$"

  gpio-controller: true

  '#gpio-cells':
    const: 2

  gpio-line-names: true

  exar,first-pin:
    description:
      Number of the first exported MPIO pin.
    $ref: /schemas/types.yaml#/definitions/uint32
    minimum: 0
    maximum: 15

  ngpios:
    description: |
      Number of exported MPIO pins on the primary Exar device. The driver
      automatically doubles this for cascaded XR17V354 and XR17V358 devices.
    $ref: /schemas/types.yaml#/definitions/uint32
    minimum: 1
    maximum: 16

required:
  - gpio-controller
  - '#gpio-cells'
  - exar,first-pin
  - ngpios

additionalProperties: false

examples:
  - |
    serial@0 {
        reg = <0 0>;
        gpio {
            gpio-controller;
            #gpio-cells = <2>;
            exar,first-pin = <0>;
            ngpios = <16>;
        };
    };

...
```
