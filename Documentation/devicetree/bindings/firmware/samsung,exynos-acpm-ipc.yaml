## Documentation/devicetree/bindings/gpio/gpio-line-mux.yaml
```yaml
# SPDX-License-Identifier: (GPL-2.0-only OR BSD-2-Clause)
%YAML 1.2
---
$id: http://devicetree.org/schemas/gpio/gpio-line-mux.yaml#
$schema: http://devicetree.org/meta-schemas/core.yaml#

title: GPIO line mux

maintainers:
  - Jonas Jelonek <jelonek.jonas@gmail.com>

description:
  A GPIO controller to provide virtual GPIOs for a 1-to-many mapping backed by
  a single shared GPIO and a multiplexer. A simple illustrated example is

            +----- A
    IN/OUT /
    <-----o------- B
        / |\
        | | +----- C
        | |  \
        | |   +--- D
        | |
       M1 M0

    MUX CONTROL

     M1 M0   IN/OUT
      0  0   A
      0  1   B
      1  0   C
      1  1   D

  This can be used in case a real GPIO is connected to multiple inputs/outputs
  and controlled by a multiplexer, and another subsystem/driver does not work
  directly with the multiplexer subsystem.

properties:
  compatible:
    const: gpio-line-mux

  gpio-controller: true

  "#gpio-cells":
    const: 2

  gpio-line-mux-states:
    description: Mux states corresponding to the virtual GPIOs.
    minItems: 1
    items:
      type: string

  gpio-line-names: true

  mux-controls:
    maxItems: 1
    $ref: /schemas/mux/mux-controller.yaml#
    description:
      Phandle to the multiplexer to control access to the GPIOs.

  ngpios: false

  shared-gpio:
    description:
      GPIO which is the '1' in 1-to-many and is shared by the virtual GPIOs
      and controlled via the mux.

required:
  - compatible
  - gpio-controller
  - gpio-line-mux-states
  - mux-controls
  - shared-gpio

additionalProperties: false

examples:
  - |
    #include <dt-bindings/gpio/gpio.h>
    #include <dt-bindings/mux/mux.h>

    sfp_gpio_mux: gpio-mux {
        compatible = "gpio-mux";
        mux-gpios = <&gpio0 0 GPIO_ACTIVE_HIGH>,
                    <&gpio0 1 GPIO_ACTIVE_HIGH>;
        #mux-control-cells = <0>;
        idle-state = <MUX_IDLE_AS_IS>;
    };

    sfp1_gpio: sfp-gpio-1 {
        compatible = "gpio-line-mux";
        gpio-controller;
        #gpio-cells = <2>;

        mux-controls = <&sfp_gpio_mux>;
        shared-gpio = <&gpio0 2 GPIO_ACTIVE_HIGH>;

        gpio-line-names = "SFP1_LOS", "SFP1_MOD_ABS", "SFP1_TX_FAULT";
        gpio-line-mux-states = <0>, <1>, <3>;
    };

    sfp1: sfp-p1 {
        compatible = "sff,sfp";

        los-gpios = <&sfp1_gpio 0 GPIO_ACTIVE_HIGH>;
        mod-def0-gpios = <&sfp1_gpio 1 GPIO_ACTIVE_LOW>;
        tx-fault-gpios = <&sfp1_gpio 2 GPIO_ACTIVE_HIGH>;
    };
```

## Documentation/devicetree/bindings/gpio/gpio-rpmsg.yaml
```yaml
# SPDX-License-Identifier: (GPL-2.0-only OR BSD-2-Clause)
%YAML 1.2
---
$id: http://devicetree.org/schemas/gpio/gpio-rpmsg.yaml#
$schema: http://devicetree.org/meta-schemas/core.yaml#

title: Generic RPMSG GPIO Controller

maintainers:
  - Shenwei Wang <shenwei.wang@nxp.com>

description:
  On an AMP platform, some GPIO controllers are exposed by the remote processor
  through the RPMSG bus. The RPMSG GPIO transport protocol defines the packet
  structure and communication flow between Linux and the remote firmware. Those
  controllers are managed via this transport protocol. For more details of the
  protocol, check the document below.
  Documentation/driver-api/gpio/gpio-rpmsg.rst

properties:
  compatible:
    oneOf:
      - items:
          - enum:
              - fsl,rpmsg-gpio
          - const: rpmsg-gpio
      - const: rpmsg-gpio

  reg:
    description:
      The reg property represents the index of the GPIO controllers. Since
      the driver manages controllers on a remote system, this index tells
      the remote system which controller to operate.
    maxItems: 1

  "#gpio-cells":
    const: 2

  gpio-controller: true

  interrupt-controller: true

  "#interrupt-cells":
    const: 2

required:
  - compatible
  - reg
  - "#gpio-cells"
  - gpio-controller

allOf:
  - $ref: /schemas/gpio/gpio.yaml#

unevaluatedProperties: false
```

## Documentation/devicetree/bindings/gpio/gpio-split.yaml
```yaml
# SPDX-License-Identifier: (GPL-2.0-only OR BSD-2-Clause)
%YAML 1.2
---
$id: http://devicetree.org/schemas/gpio/gpio-split.yaml#
$schema: http://devicetree.org/meta-schemas/core.yaml#

title: GPIO split

maintainers:
  - Jonas Jelonek <jelonek.jonas@gmail.com>

description:
  A virtual GPIO controller to provide virtual GPIOs backed by a single real
  GPIO and a multiplexer. This controller may be used in case a real GPIO is
  connected to multiple inputs/outputs and controlled by a multiplexer, and
  another subsystem/driver is not able to work with multiplexer subsystem.

properties:
  compatible:
    const: gpio-split

  gpio-controller: true

  "#gpio-cells":
    const: 2

  gpio-line-names: true

  mux-controls:
    maxItems: 1

  ngpios: false

  shared-gpio:
    description:
      GPIO that is shared by the virtual GPIOs and controlled via the mux.

required:
  - compatible
  - gpio-controller
  - mux-controls
  - shared-gpio

additionalProperties: false

examples:
  - |
    #include <dt-bindings/gpio/gpio.h>
    #include <dt-bindings/mux/mux.h>

    sfp_gpio_mux: gpio-mux {
        compatible = "gpio-mux";
        mux-gpios = <&gpio0 12 GPIO_ACTIVE_HIGH>,
                    <&gpio0 14 GPIO_ACTIVE_HIGH>;
        #mux-control-cells = <0>;
        idle-state = <MUX_IDLE_AS_IS>;
    };

    sfp1_gpio: sfp-gpio-1 {
        compatible = "gpio-split";
        gpio-controller;
        #gpio-cells = <2>;

        mux-controls = <&sfp_gpio_mux>;
        shared-gpio = <&gpio0 19 GPIO_ACTIVE_HIGH>;

        gpio-line-names = "SFP1_LOS", "SFP1_MOD_ABS", "SFP1_TX_FAULT";
        gpio-0 {
            mux-state = <0>;
        };
        gpio-1 {
            mux-state = <1>;
        };
        gpio-2 {
            mux-state = <3>;
        };
    };
```
