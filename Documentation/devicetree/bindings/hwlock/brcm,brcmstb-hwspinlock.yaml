## Documentation/devicetree/bindings/hwmon/lltc,ltc4286.yaml
```yaml
# SPDX-License-Identifier: (GPL-2.0-only OR BSD-2-Clause)
%YAML 1.2
---
$id: http://devicetree.org/schemas/hwmon/lltc,ltc4286.yaml#
$schema: http://devicetree.org/meta-schemas/core.yaml#

title: LTC4286 power monitors

maintainers:
  - Delphine CC Chiu <Delphine_CC_Chiu@Wiwynn.com>

properties:
  compatible:
    enum:
      - lltc,ltc4286
      - lltc,ltc4287

  reg:
    maxItems: 1

  adi,vrange-select-25p6:
    description:
      This property is a bool parameter to represent the
      voltage range is 25.6 or not for this chip.
    type: boolean

  shunt-resistor-micro-ohms:
    description:
      Resistor value in micro-Ohm

required:
  - compatible
  - reg
  - shunt-resistor-micro-ohms

additionalProperties: false

examples:
  - |
    i2c {
        #address-cells = <1>;
        #size-cells = <0>;

        power-sensor@40 {
            compatible = "lltc,ltc4286";
            reg = <0x40>;
            adi,vrange-select-25p6;
            shunt-resistor-micro-ohms = <300>;
        };
    };
```

## Documentation/devicetree/bindings/hwmon/lm87.yaml
```yaml
# SPDX-License-Identifier: GPL-2.0-only OR BSD-2-Clause
%YAML 1.2
---
$id: http://devicetree.org/schemas/hwmon/lm87.yaml#
$schema: http://devicetree.org/meta-schemas/core.yaml#

title: LM87 hwmon sensor

maintainers:
  - Jean Delvare <jdelvare@suse.com>
  - Guenter Roeck <linux@roeck-us.net>

properties:
  compatible:
    const: ti,lm87

  reg:
    maxItems: 1

  has-temp3:
    $ref: /schemas/types.yaml#/definitions/flag
    description: |
      When set, pins 18 and 19 are configured to be used as a second
      remote temperature sensing channel. Otherwise the pins are
      configured as voltage input pins in0 and in5.

  has-in6:
    $ref: /schemas/types.yaml#/definitions/flag
    description: |
      When set, pin 5 is configured to be used as voltage input in6.
      Otherwise the pin is set as FAN1 input.

  has-in7:
    $ref: /schemas/types.yaml#/definitions/flag
    description: |
      When set, pin 6 is configured to be used as voltage input in7.
      Otherwise the pin is set as FAN2 input.

  vcc-supply:
    description: |
      A Phandle for the regulator supplying power, can be configured to
      measure 5.0V power supply. Default is 3.3V.

required:
  - compatible
  - reg

additionalProperties: false

examples:
  - |
    i2c {
      #address-cells = <1>;
      #size-cells = <0>;

      sensor@2e {
        compatible = "ti,lm87";
        reg = <0x2e>;
        has-temp3;
        vcc-supply = <&reg_5v0>;
      };
    };
```
