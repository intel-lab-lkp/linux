## Documentation/devicetree/bindings/hwmon/asteralabs,pt516xx.yaml
```yaml
# SPDX-License-Identifier: GPL-2.0-only OR BSD-2-Clause
%YAML 1.2
---
$id: http://devicetree.org/schemas/hwmon/asteralabs,pt516xx.yaml#
$schema: http://devicetree.org/meta-schemas/core.yaml#

title: PT5161L hwmon sensor

maintainers:
  - Cosmo Chou <cosmo.chou@quantatw.com>

properties:
  compatible:
    enum:
      - asteralabs,pt5161l

  reg:
    maxItems: 1

required:
  - compatible
  - reg

additionalProperties: false

examples:
  - |
    i2c {
      #address-cells = <1>;
      #size-cells = <0>;

      sensor@24 {
        compatible = "asteralabs,pt5161l";
        reg = <0x24>;
      };
    };
```

## Documentation/devicetree/bindings/hwmon/axiado,ax3000-pwm-fan.yaml
```yaml
# SPDX-License-Identifier: (GPL-2.0-only OR BSD-2-Clause)
%YAML 1.2
---
$id: http://devicetree.org/schemas/hwmon/axiado,ax3000-pwm-fan.yaml#
$schema: http://devicetree.org/meta-schemas/core.yaml#

title: Axiado AX3000 and AX3005 PWM Fan Controller

maintainers:
  - Petar Stepanovic <pstepanovic@axiado.com>
  - Akhila Kavi <akavi@axiado.com>
  - Prasad Bolisetty <pbolisetty@axiado.com>

description:
  The Axiado AX3000 and AX3005 fan controllers use a hardware tachometer
  block to measure fan speed. Fan speed is controlled through a PWM signal
  supplied by an external PWM controller.

properties:
  compatible:
    oneOf:
      - const: axiado,ax3000-pwm-fan
      - items:
          - const: axiado,ax3005-pwm-fan
          - const: axiado,ax3000-pwm-fan

  reg:
    maxItems: 1

  interrupts:
    maxItems: 1

  clocks:
    maxItems: 1

  pwms:
    maxItems: 1
    description:
      PWM specifier used to control fan speed.

  pulses-per-revolution:
    $ref: /schemas/types.yaml#/definitions/uint32
    minimum: 1
    default: 2
    description:
      Number of tachometer pulses generated per fan revolution.

required:
  - compatible
  - reg
  - interrupts
  - clocks
  - pwms

additionalProperties: false

examples:
  - |
    #include <dt-bindings/interrupt-controller/arm-gic.h>

    fan@33001400 {
        compatible = "axiado,ax3000-pwm-fan";
        reg = <0x0 0x33001400 0x0 0x400>;
        interrupts = <GIC_SPI 150 IRQ_TYPE_LEVEL_HIGH>;
        clocks = <&clk>;
        pwms = <&pwm0 0 400>;
    };
...
```

## Documentation/devicetree/bindings/hwmon/emc2305.yaml
```yaml
# SPDX-License-Identifier: (GPL-2.0-only OR BSD-2-Clause)
%YAML 1.2
---
$id: http://devicetree.org/schemas/hwmon/emc2305.yaml#
$schema: http://devicetree.org/meta-schemas/core.yaml#

title: EMC2305 i2c pwm fan controller

maintainers:
  - Michael Shych <michaelsh@nvidia.com>

description: |
  The driver implements support for Microchip EMC2301/2/3/5 PWM Fan Controller.
  The EMC2301 Fan Controller supports only one controlled PWM fan channel.
  The EMC2305 Fan Controller supports up to 5 independently
  controlled PWM fan drives.

properties:
  compatible:
    enum:
      - hwmon,emc2301
      - hwmon,emc2302
      - hwmon,emc2303
      - hwmon,emc2305

  reg:
    description: I2C address of the emc2305 device

  pwm_output:
    description: "PWM output type Push-Pull/ Open Drain"
    maxItems: 1

  pwm_polarity:
    description: "PWM polarity"
    maxItems: 1

  '#cooling-cells':
    description: "cooling state range"

required:
  - compatible
  - reg

additionalProperties: false

examples:
  - |
    thermal_zones {
        a55-thermal {
                trips {
                        atrip0: trip0 {
                                temperature = <55000>;
                                hysteresis = <2000>;
                                type = "active";
                        };

                        atrip1: trip1 {
                                temperature = <65000>;
                                hysteresis = <2000>;
                                type = "active";
                        };

                        atrip2: trip2 {
                                temperature = <75000>;
                                hysteresis = <2000>;
                                type = "active";
                        };
                };

                cooling-maps {
                        map1 {
                                trip = <&atrip0>;
                                cooling-device = <&emc2301 4 6>;
                        };

                        map2 {
                                trip = <&atrip1>;
                                cooling-device = <&emc2301 6 8>;
                        };

                        map3 {
                                trip = <&atrip2>;
                                cooling-device = <&emc2301 8 10>;
                        };
                };
        };

    }
    emc2301: pwm@2f {
       compatible = "hwmon,emc2301";
       reg = <0x2f>;
       #cooling-cells = <2>;
       pwm_output = <0x1>;
       pwm_polarity = <0x1>;
    };
```

## Documentation/devicetree/bindings/hwmon/eswin,eic7700-pvt.yaml
```yaml
# SPDX-License-Identifier: (GPL-2.0-only OR BSD-2-Clause)
%YAML 1.2
---
$id: http://devicetree.org/schemas/hwmon/eswin,eic7700-pvt.yaml#
$schema: http://devicetree.org/meta-schemas/core.yaml#

title: ESWIN EIC7700 PVT Sensor

maintainers:
  - Yulin Lu <luyulin@eswincomputing.com>
  - Huan He <hehuan1@eswincomputing.com>

description:
  ESWIN EIC7700 SoC integrates embedded process, voltage and temperature
  sensors to monitor the internal SoC environment. The system includes two
  PVT sensor instances. The PVT0 monitors the main SoC power domain. The
  PVT1 sensor monitors the DDR core power domain.

properties:
  compatible:
    const: eswin,eic7700-pvt

  reg:
    maxItems: 1

  clocks:
    maxItems: 1

  clock-names:
    items:
      - const: clk

  interrupts:
    maxItems: 1

  label:
    description:
      Human readable identifier used to distinguish between different PVT
      instances and generate descriptive sensor labels. Typically "pvt0"
      for SoC PVT sensor and "pvt1" for DDR core PVT sensor.

  resets:
    maxItems: 1

  reset-names:
    items:
      - const: rst

  '#thermal-sensor-cells':
    description: Thermal sensor cells if used for thermal sensoring.
    const: 0

additionalProperties: false

required:
  - compatible
  - reg
  - clocks
  - clock-names
  - interrupts
  - label
  - resets
  - reset-names

examples:
  - |
    pvt@50b00000 {
      compatible = "eswin,eic7700-pvt";
      reg = <0x50b00000 0x10000>;
      clocks = <&clocks 244>;
      clock-names = "clk";
      interrupts = <349>;
      interrupt-parent = <&plic>;
      label = "pvt0";
      resets = <&reset 111>;
      reset-names = "rst";
      #thermal-sensor-cells = <0>;
    };

    pvt@52360000 {
      compatible = "eswin,eic7700-pvt";
      reg = <0x52360000 0x20000>;
      clocks = <&clocks 245>;
      clock-names = "clk";
      interrupts = <350>;
      interrupt-parent = <&plic>;
      label = "pvt1";
      resets = <&reset 112>;
      reset-names = "rst";
      #thermal-sensor-cells = <0>;
    };
...
```

## Documentation/devicetree/bindings/hwmon/fan-common.yaml
```yaml
# SPDX-License-Identifier: GPL-2.0-or-later OR BSD-2-Clause
%YAML 1.2
---
$id: http://devicetree.org/schemas/hwmon/fan-common.yaml#
$schema: http://devicetree.org/meta-schemas/core.yaml#

title: Common Fan Properties

maintainers:
  - Naresh Solanki <naresh.solanki@9elements.com>
  - Billy Tsai <billy_tsai@aspeedtech.com>

properties:
  max-rpm:
    description:
      Max RPM supported by fan.
    $ref: /schemas/types.yaml#/definitions/uint32

  min-rpm:
    description:
      Min RPM supported by fan.
    $ref: /schemas/types.yaml#/definitions/uint32

  pulses-per-revolution:
    description:
      The number of pulse from fan sensor per revolution.
    $ref: /schemas/types.yaml#/definitions/uint32

  div:
    description:
      Fan clock divisor
    $ref: /schemas/types.yaml#/definitions/uint32

  target-rpm:
    description:
      Target RPM the fan should be configured during driver probe.
    $ref: /schemas/types.yaml#/definitions/uint32

  mode:
    description:
      Select the operational mode of the fan.
    $ref: /schemas/types.yaml#/definitions/uint32

  pwms:
    description:
      PWM provider.

  tach-ch:
    description:
      The tach channel used for the fan.
    $ref: /schemas/types.yaml#/definitions/uint32

  label:
    description:
      Optional fan label

  fan-supply:
    description:
      Power supply for fan.

additionalProperties: true

...
```

## Documentation/devicetree/bindings/hwmon/gmt,g76x.yaml
```yaml
# SPDX-License-Identifier: GPL-2.0-only OR BSD-2-Clause
%YAML 1.2
---
$id: http://devicetree.org/schemas/hwmon/gmt,g76x.yaml#
$schema: http://devicetree.org/meta-schemas/core.yaml#

title: GMT G761/G762/G763 PWM Fan controller

maintainers:
  - Christian Marangi <ansuelsmth@gmail.com>

description: |
  GMT G761/G762/G763 PWM Fan controller.

  If an optional property is not set in DT, then current value is kept
  unmodified (e.g. bootloader installed value).

  Additional information on operational parameters for the device is available
  in Documentation/hwmon/g762.rst. A detailed datasheet for the device is available
  at http://natisbad.org/NAS/refs/GMT_EDS-762_763-080710-0.2.pdf.

properties:
  compatible:
    enum:
      - gmt,g761
      - gmt,g762
      - gmt,g763

  reg:
    maxItems: 1

  clocks:
    description: a fixed clock providing input clock frequency on CLK
      pin of the chip.
    maxItems: 1

  fan_startv:
    description: Fan startup voltage step
    $ref: /schemas/types.yaml#/definitions/uint32
    enum: [0, 1, 2, 3]

  pwm_polarity:
    description: PWM polarity (psotivie or negative duty)
    $ref: /schemas/types.yaml#/definitions/uint32
    enum: [0, 1]

  fan_gear_mode:
    description: FAN gear mode. Configure High speed fan setting factor
    $ref: /schemas/types.yaml#/definitions/uint32
    enum: [0, 1, 2]

  gmt,internal-clock:
    description: Use the Internal clock instead of externally attached one
      via the CLK pin.
    type: boolean

required:
  - compatible
  - reg

allOf:
  - if:
      properties:
        compatible:
          contains:
            enum:
              - gmt,g762
              - gmt,g763
    then:
      properties:
        gmt,internal-clock: false

      required:
        - clocks

  - if:
      required:
        - gmt,internal-clock

    then:
      properties:
        clocks: false

additionalProperties: false

examples:
  - |
    clocks {
        #address-cells = <1>;
        #size-cells = <0>;

        g762_clk: fixedclk {
            compatible = "fixed-clock";
            #clock-cells = <0>;
            clock-frequency = <8192>;
        };
    };

    i2c {
        #address-cells = <1>;
        #size-cells = <0>;

        g762@3e {
            compatible = "gmt,g762";
            reg = <0x3e>;
            clocks = <&g762_clk>;
            fan_gear_mode = <0>;
            fan_startv = <1>;
            pwm_polarity = <0>;
        };

        g761@1e {
            compatible = "gmt,g761";
            reg = <0x1e>;
            gmt,internal-clock;
            fan_gear_mode = <0>;
            fan_startv = <1>;
            pwm_polarity = <0>;
        };
    };
```

## Documentation/devicetree/bindings/hwmon/ina233.txt
```
Bindings for the Maxim MAX31790 Intelligent Fan Controller
==========================================================

Reference:

https://pdf1.alldatasheet.com/datasheet-pdf/view/930928/TI1/INA233.html

The INA233 device is a current, voltage and power monitor with an I2C-, SMBus-,and PMBus-compatible interface
that is compliant with digital bus voltages from 1.8 V to 5.0 V.
The device monitors and reports values for current, voltage and power.
The integrated power accumulator can be used for energy or average power calculations.
Programmable calibration value, conversion times and averaging when combined with an internal multiplier
enable direct readouts of current in amperes and power in watts.

Required properties:
- compatible     	: ti,ina233
- reg            	: I2C address
- resistor-calibration  : MFR_CALIBRATION which will be set into register 0xd4
- current-lsb    	: Current_LSB for calibration
Example:

        ina233@45 {
                compatible = "ti,ina233";
                reg = <0x45>;
                resistor-calibration = /bits/ 16 <0x0a00>;
                current-lsb= /bits/ 16 <0x0001>;
        };
```

## Documentation/devicetree/bindings/hwmon/jedec,spd5118.yaml
```yaml
# SPDX-License-Identifier: (GPL-2.0-only OR BSD-2-Clause)
%YAML 1.2
---
$id: http://devicetree.org/schemas/hwmon/jedec,spd5118.yaml#
$schema: http://devicetree.org/meta-schemas/core.yaml#

title: JEDEC JESD300-5B (SPD5118) compatible DDR5 SPD hub

maintainers:
  - Guenter Roeck <linux@roeck-us.net>

description: |
  JEDEC JESD300-5B.01 SPD5118 Hub and Serial Presence Detect
  https://www.jedec.org/standards-documents/docs/jesd300-5b01

select:
  properties:
    compatible:
      const: jedec,spd5118

  required:
    - compatible
    - reg

properties:
  compatible:
    const: jedec,spd5118

  reg:
    maxItems: 1

required:
  - compatible
  - reg

additionalProperties: false

examples:
  - |
    i2c {
        #address-cells = <1>;
        #size-cells = <0>;

        temp-sensor@51 {
            compatible = "jedec,spd5118";
            reg = <0x51>;
        };
    };
```

## Documentation/devicetree/bindings/hwmon/kandou,kb9002.yaml
```yaml
# SPDX-License-Identifier: (GPL-2.0-only OR BSD-2-Clause)
%YAML 1.2
---
$id: http://devicetree.org/schemas/hwmon/kandou,kb9002.yaml#
$schema: http://devicetree.org/meta-schemas/core.yaml#

title: Kandou KB9002 PCIe 5.0 retimer

maintainers:
  - Andy Chung <andy.chung@amd.com>

description: |
  The Kandou KB9002 is an 8-lane PCIe 5.0 retimer that exposes a
  firmware-controlled SMBus 3.0 target on its sideband interface.
  The host can query the aggregated maximum die temperature and the
  running firmware version through that target.

  The 7-bit SMBus address is selected by three SMB_ADDR straps and
  ranges from 0x20 to 0x27.

properties:
  compatible:
    const: kandou,kb9002

  reg:
    items:
      - minimum: 0x20
        maximum: 0x27

required:
  - compatible
  - reg

additionalProperties: false

examples:
  - |
    i2c {
        #address-cells = <1>;
        #size-cells = <0>;

        retimer@20 {
            compatible = "kandou,kb9002";
            reg = <0x20>;
        };
    };
```

## Documentation/devicetree/bindings/hwmon/lantiq,cputemp.yaml
```yaml
# SPDX-License-Identifier: GPL-2.0-only OR BSD-2-Clause
%YAML 1.2
---
$id: http://devicetree.org/schemas/hwmon/lantiq,cputemp.yaml#
$schema: http://devicetree.org/meta-schemas/core.yaml#

title: Lantiq cpu temperature sensor

maintainers:
  - Florian Eckert <fe@dev.tdt.de>

properties:
  compatible:
    const: lantiq,cputemp

required:
  - compatible

additionalProperties: false

examples:
  - |
    cputemp {
        compatible = "lantiq,cputemp";
    };
```
