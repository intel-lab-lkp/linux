## Documentation/devicetree/bindings/hwmon/adi,ltc4296-1.yaml
```yaml
# SPDX-License-Identifier: (GPL-2.0 OR BSD-2-Clause)
%YAML 1.2
---

$id: http://devicetree.org/schemas/hwmon/adi,ltc4296-1.yaml#
$schema: http://devicetree.org/meta-schemas/core.yaml#

title: LTC4296-1 5-Port SPoE PSE Controller

maintainers:
  - Antoniu Miclaus <antoniu.miclaus@analog.com>

description: |
  The LTC4296-1 is an IEEE 802.3cg-compliant, five port, single-pair
  power over Ethernet (SPoE), power sourcing equipment (PSE)
  controller. SPoE simplifies system design and installation with
  standardized power and Ethernet data over a single-pair cable.

  Datasheet:
    https://www.analog.com/en/products/ltc4296-1.html

$ref: /schemas/spi/spi-peripheral-props.yaml#

properties:
  compatible:
    const: adi,ltc4296-1

  reg:
    maxItems: 1

  '#address-cells':
    const: 1

  '#size-cells':
    const: 0

  vin-supply: true

patternProperties:
  "^channel@[0-3]$":
    type: object
    description:
      Represents the current monitoring channels.

    properties:
      reg:
        description:
          The channel number. ltc4296-1 can monitor 5 currents.
        items:
          minimum: 0
          maximum: 4

      shunt-resistor-micro-ohms:
        description:
          The value of curent sense resistor in micro ohms.

    required:
      - reg

    additionalProperties: false

required:
  - compatible
  - reg
  - vin-supply

additionalProperties: false

examples:
  - |
    spi {
        #address-cells = <1>;
        #size-cells = <0>;

        hwmon@0 {
            compatible = "adi,ltc4296-1";
            reg = <0x0>;
            vin-supply = <&vcc>;
        };
    };
  - |
    spi {
        #address-cells = <1>;
        #size-cells = <0>;

        hwmon@0 {
            #address-cells = <1>;
            #size-cells = <0>;

            compatible = "adi,ltc4296-1";
            reg = <0x0>;
            vin-supply = <&vin>;

            channel@0 {
                    reg = <0x0>;
                    shunt-resistor-micro-ohms = <100000>;
            };

            channel@1 {
                    reg = <0x1>;
                    shunt-resistor-micro-ohms = <100000>;
            };
        };
    };
...
```

## Documentation/devicetree/bindings/hwmon/adt7462.yaml
```yaml
# SPDX-License-Identifier: (GPL-2.0-only OR BSD-2-Clause)
%YAML 1.2
---
$id: http://devicetree.org/schemas/hwmon/adt7462.yaml#
$schema: http://devicetree.org/meta-schemas/core.yaml#

title: ADT7462 hwmon sensor

maintainers:
  - Kory Maincent <kory.maincent@bootlin.com>

description: |
  The ADT7462 is a temperature and voltage monitor and a PWM fan controller.

  It can monitor temperature in up to three remote locations, as well as
  its ambient temperature.
  There are up to four PWM outputs to control fans.
  The ADT7462 supports high frequency PWM for 4-wire fans and low frequency
  PWM for 2-wire and 3-wire fans. Up to eight TACH inputs can be used to
  measure the speed of 3-wire and 4-wire fans. There are up to 13 voltage
  monitoring inputs, ranging from 12 V to 0.9 V.

  Datasheet:
  https://www.onsemi.com/pdf/datasheet/adt7462-d.pdf

  Description taken from onsemiconductors specification sheets, with minor
  rephrasing.

properties:
  compatible:
    enum:
      - adi,adt7462

  reg:
    maxItems: 1

required:
  - compatible
  - reg

additionalProperties: false

examples:
  - |
    i2c {
      #address-cells = <1>;
      #size-cells = <0>;

      hwmon@5c {
        compatible = "adi,adt7462";
        reg = <0x5c>;
      };
    };
```

## Documentation/devicetree/bindings/hwmon/altr,stratix10-hwmon.yaml
```yaml
# SPDX-License-Identifier: (GPL-2.0-only OR BSD-2-Clause)
%YAML 1.2
---
$id: http://devicetree.org/schemas/hwmon/altr,stratix10-hwmon.yaml#
$schema: http://devicetree.org/meta-schemas/core.yaml#

title: Altera Hardware Monitor for Stratix 10 SoC FPGA

maintainers:
  - Nazim Amirul <muhammad.nazim.amirul.nazle.asmade@altera.com>
  - Tze Yee Ng <tze.yee.ng@altera.com>

description: |
  The Altera Stratix 10 SoC FPGA hardware monitor unit provides on-chip
  voltage and temperature sensors. These sensors can be used to monitor
  external voltages and on-chip operating conditions such as internal
  power rails and on-chip junction temperatures.

  The specific sensor configuration varies by device. Check the device
  documentation to verify which sensors are available.

  Stratix 10 voltage sensors:

    page 0, channel 2 = 0.8V VCC
    page 0, channel 3 = 1.8V VCCIO_SDM
    page 0, channel 6 = 0.9V VCCERAM

  Stratix 10 temperature sensors:

    page 0, channel 0 = main die
    page 0, channel 1 = tile bottom left
    page 0, channel 2 = tile middle left
    page 0, channel 3 = tile top left
    page 0, channel 4 = tile bottom right
    page 0, channel 5 = tile middle right
    page 0, channel 6 = tile top right
    page 0, channel 7 = hbm2 bottom
    page 0, channel 8 = hbm2 top

properties:
  compatible:
    const: altr,stratix10-hwmon

  temperature:
    description:
      The temperature node specifies mappings of temperature sensor diodes on
      the Stratix 10 SoC FPGA main die and tile die.
    type: object
    properties:
      '#address-cells':
        const: 1
      '#size-cells':
        const: 0
    patternProperties:
      "^input(@[0-9a-f]+)?$":
        description:
          The input node specifies each individual temperature sensor.
        type: object
        properties:
          reg:
            description:
              Sensor channel index in the lower 16-bits (0-15). For temperature
              sensors, the page number is encoded in the upper 16-bits.
              The driver encodes the SMC request argument as a channel
              bitmask (1 << channel) in bits 0..15, with the page number
              placed in bits 16..31. Channel values >= 16 are rejected to
              avoid overlap with the page field. For example, reg = <2>
              selects channel 2 and the driver passes 0x4 to the service layer.
          label:
            description:
              A descriptive name for this channel (e.g. "Main Die" or
              "Tile Bottom Left").
        required:
          - reg
        additionalProperties: false
    required:
      - '#address-cells'
      - '#size-cells'
    additionalProperties: false

  voltage:
    description:
      The voltage node specifies mappings of voltage sensors on the Stratix 10
      SoC FPGA analog to digital converter of the Secure Device Manager (SDM).
    type: object
    properties:
      '#address-cells':
        const: 1
      '#size-cells':
        const: 0
    patternProperties:
      "^input(@[0-9a-f]+)?$":
        description:
          The input node specifies each individual voltage sensor.
        type: object
        properties:
          reg:
            description:
              Sensor channel index in the lower 16-bits (0-15). The driver
              encodes the SMC request argument as a channel bitmask
              (1 << channel). For example, reg = <2> selects channel 2 and
              the driver passes 0x4 to the service layer.
          label:
            description:
              A descriptive name for this channel (e.g. "0.8V VCC" or
              "1.8V VCCIO_SDM").
        required:
          - reg
        additionalProperties: false
    required:
      - '#address-cells'
      - '#size-cells'
    additionalProperties: false

required:
  - compatible

additionalProperties: false

examples:
  - |
    hwmon {
      compatible = "altr,stratix10-hwmon";

      voltage {
        #address-cells = <1>;
        #size-cells = <0>;

        input@2 {
          label = "0.8V VCC";
          reg = <2>;
        };

        input@3 {
          label = "1.8V VCCIO_SDM";
          reg = <3>;
        };

        input@6 {
          label = "0.9V VCCERAM";
          reg = <6>;
        };
      };

      temperature {
        #address-cells = <1>;
        #size-cells = <0>;

        input@0 {
          label = "Main Die";
          reg = <0>;
        };

        input@1 {
          label = "Tile Bottom Left";
          reg = <1>;
        };

        input@2 {
          label = "Tile Middle Left";
          reg = <2>;
        };
      };
    };
```

## Documentation/devicetree/bindings/hwmon/amphenol,chipcap2.yaml
```yaml
# SPDX-License-Identifier: (GPL-2.0-only OR BSD-2-Clause)
%YAML 1.2
---
$id: http://devicetree.org/schemas/hwmon/amphenol,chipcap2.yaml#
$schema: http://devicetree.org/meta-schemas/core.yaml#

title: ChipCap 2 humidity and temperature iio sensor

maintainers:
  - Javier Carrasco <javier.carrasco.cruz@gmail.com>

description: |
  Relative humidity and temperature sensor on I2C bus.

  Datasheets:
    https://www.amphenol-sensors.com/en/telaire/humidity/527-humidity-sensors/3095-chipcap-2

properties:
  compatible:
    enum:
      - amphenol,cc2dxx
      - amphenol,cc2dxxs

  reg:
    maxItems: 1

  interrupts:
    maxItems: 3
    description: |
      The device provides three optional interrupts. READY indicates that
      a measurement was finished. LOW indicates a low humidity alarm and
      HIGH a high humidity alarm.
      All interrupts must be IRQ_TYPE_RISING_EDGE.

  interrupt-names:
    items:
      - const: READY
      - const: LOW
      - const: HIGH

  vdd-supply:
    description:
      Dedicated, controllable supply-regulator to reset the device and
      enter in command mode. If defined, it must provide a GPIO for its
      control.
      If not defined, no alarms will be available.


required:
  - compatible
  - reg

additionalProperties: false

examples:
  - |
    #include <dt-bindings/interrupt-controller/irq.h>
    i2c {
        #address-cells = <1>;
        #size-cells = <0>;

        humidity@28 {
            compatible = "amphenol,cc2dxxs";
            reg = <0x28>;
            interrupt-parent = <&gpio>;
            interrupts = <4 IRQ_TYPE_EDGE_RISING>,
                         <5 IRQ_TYPE_EDGE_RISING>,
                         <6 IRQ_TYPE_EDGE_RISING>;
            interrupt-names = "READY", "LOW", "HIGH";
            vdd-supply = <&reg_vdd>;
        };
    };
```

## Documentation/devicetree/bindings/hwmon/ams,as6200.yaml
```yaml
# SPDX-License-Identifier: (GPL-2.0 OR BSD-2-Clause)
%YAML 1.2
---
$id: http://devicetree.org/schemas/hwmon/ams,as6200.yaml#
$schema: http://devicetree.org/meta-schemas/core.yaml#

title: AMS AS6200 Temperature Sensor

maintainers:
  - Abdel Alkuor <alkuor@gmail.com>

description: |
  as6200 is a temperature sensor with a range between -40°C to
  125°C degrees and an accuracy of ±0.4°C degree between 0
  and 65°C and ±1°C for the other ranges.
  https://ams.com/documents/20143/36005/AS6200_DS000449_4-00.pdf

properties:
  compatible:
    const: ams,as6200

  reg:
    maxItems: 1

  vdd-supply: true

  interrupts:
    maxItems: 1

required:
  - compatible
  - reg
  - vdd-supply

additionalProperties: false

examples:
  - |
    #include <dt-bindings/interrupt-controller/irq.h>
    i2c {
        #address-cells = <1>;
        #size-cells = <0>;

        temperature-sensor@48 {
            compatible = "ams,as6200";
            reg = <0x48>;
            vdd-supply = <&vdd>;
            interrupt-parent = <&gpio1>;
            interrupts = <17 IRQ_TYPE_EDGE_BOTH>;
        };
    };
...
```

## Documentation/devicetree/bindings/hwmon/aosong,aht10.yaml
```yaml
# SPDX-License-Identifier: (GPL-2.0-only OR BSD-2-Clause)
%YAML 1.2
---
$id: http://devicetree.org/schemas/hwmon/aosong,aht10.yaml#
$schema: http://devicetree.org/meta-schema.yaml#

title: Aosong AHT10/AHT20/DHT20 Temperature and Humidity Sensor

maintainers:
  - Hao Yu <haoyufine@gmail.com>

description: |
  The Aosong AHT10, AHT20, and DHT20 are I2C humidity and temperature sensors.

properties:
  compatible:
    enum:
      - aosong,aht10
      - aosong,aht20
      - aosong,dht20

  reg:
    maxItems: 1

required:
  - compatible
  - reg

additionalProperties: false

examples:
  - |
    i2c {
        #address-cells = <1>;
        #size-cells = <0>;

        sensor@38 {
            compatible = "aosong,aht20";
            reg = <0x38>;
        };
    };
```

## Documentation/devicetree/bindings/hwmon/aspeed,g6-pwm-tach.yaml
```yaml
# SPDX-License-Identifier: (GPL-2.0-only OR BSD-2-Clause)
# Copyright (C) 2021 Aspeed, Inc.
%YAML 1.2
---
$id: http://devicetree.org/schemas/hwmon/aspeed,g6-pwm-tach.yaml#
$schema: http://devicetree.org/meta-schemas/core.yaml#

title: ASPEED G6 PWM and Fan Tach controller device driver

maintainers:
  - Billy Tsai <billy_tsai@aspeedtech.com>

description: |
  The ASPEED PWM controller can support upto 16 PWM outputs.
  The ASPEED Fan Tacho controller can support upto 16 fan tach input.

properties:
  compatible:
    enum:
      - aspeed,ast2600-pwm-tach

  reg:
    maxItems: 1

  clocks:
    maxItems: 1

  resets:
    maxItems: 1

  "#pwm-cells":
    const: 3

  aspeed,fan-tach-ch:
    description: Specify the Fan tach input channels.
    $ref: "/schemas/types.yaml#/definitions/uint8-array"

required:
  - reg
  - clocks
  - resets
  - "#pwm-cells"
  - compatible

additionalProperties: false

examples:
  - |
    #include <dt-bindings/clock/aspeed-clock.h>
    pwm_tach: pwm-tach-controller@1e610000 {
      compatible = "aspeed,ast2600-pwm-tach";
      reg = <0x1e610000 0x100>;
      clocks = <&syscon ASPEED_CLK_AHB>;
      resets = <&syscon ASPEED_RESET_PWM>;
      #pwm-cells = <3>;
      aspeed,fan-tach-ch = /bits/ 8 <0x00 0x02 0x4>;
    };
```

## Documentation/devicetree/bindings/hwmon/aspeed,pwm-tacho.yaml
```yaml
# SPDX-License-Identifier: (GPL-2.0-only OR BSD-2-Clause)
# Copyright (C) 2023 Aspeed, Inc.
%YAML 1.2
---
$id: http://devicetree.org/schemas/hwmon/aspeed,g5-pwm-tacho.yaml#
$schema: http://devicetree.org/meta-schemas/core.yaml#

title: ASPEED AST2400/AST2500 PWM and Fan Tacho controller

maintainers:
  - Billy Tsai <billy_tsai@aspeedtech.com>

description: |
  The ASPEED PWM controller can support up to 8 PWM outputs. The ASPEED Fan
  Tacho controller can support up to 16 Fan tachometer inputs.

  There can be up to 8 fans supported. Each fan can have one PWM output and
  one/two Fan tach inputs.

properties:
  compatible:
    enum:
      - aspeed,ast2400-pwm-tacho
      - aspeed,ast2500-pwm-tacho

  "#address-cells":
    const: 1

  "#size-cells":
    const: 0

  reg:
    maxItems: 1

  clocks:
    maxItems: 1

  resets:
    maxItems: 1

patternProperties:
  "^fan@[0-9]+$":
    $ref: fan-common.yaml#
    unevaluatedProperties: false
    properties:
      aspeed,fan-tach-ch:
        description:
          The tach channel used for the fan.
        $ref: /schemas/types.yaml#/definitions/uint8-array

    required:
      - reg
      - aspeed,fan-tach-ch

required:
  - compatible
  - "#address-cells"
  - "#size-cells"
  - reg
  - pinctrl-names
  - pinctrl-0
  - clocks
  - resets

additionalProperties: false

examples:
  - |
    #include <dt-bindings/clock/aspeed-clock.h>
    pwm_tacho: pwmtachocontroller@1e786000 {
        #address-cells = <1>;
        #size-cells = <0>;
        #cooling-cells = <2>;
        reg = <0x1E786000 0x1000>;
        compatible = "aspeed,ast2500-pwm-tacho";
        clocks = <&syscon ASPEED_CLK_APB>;
        resets = <&syscon ASPEED_RESET_PWM>;
        pinctrl-names = "default";
        pinctrl-0 = <&pinctrl_pwm0_default &pinctrl_pwm1_default>;

        fan@0 {
                reg = <0x00>;
                cooling-levels = /bits/ 8 <125 151 177 203 229 255>;
                aspeed,fan-tach-ch = /bits/ 8 <0x00>;
        };

        fan@1 {
                reg = <0x01>;
                aspeed,fan-tach-ch = /bits/ 8 <0x01 0x02>;
        };
    };
```
