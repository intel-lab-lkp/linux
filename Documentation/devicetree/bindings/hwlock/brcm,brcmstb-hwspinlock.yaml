## Documentation/devicetree/bindings/hwlock/brcm,brcmstb-hwspinlock.yaml
```yaml
# SPDX-License-Identifier: (GPL-2.0-only OR BSD-2-Clause)
%YAML 1.2
---
$id: http://devicetree.org/schemas/hwlock/brcm,brcmstb-hwspinlock.yaml#
$schema: http://devicetree.org/meta-schemas/core.yaml#

title: Broadcom settop Hardware Spinlock

maintainers:
  - Kamal Dasu <kamal.dasu@broadcom.com>

properties:
  "#hwlock-cells":
    const: 1

  compatible:
    const: brcm,brcmstb-hwspinlock

  reg:
    maxItems: 1

required:
  - "#hwlock-cells"
  - compatible
  - reg

additionalProperties: false

examples:
  - |
    hwspinlock@8404038 {
        compatible = "brcm,brcmstb-hwspinlock";
        #hwlock-cells = <1>;
        reg = <0x8404038 0x40>;
    };
```

## Documentation/devicetree/bindings/hwlock/starfive,jhb100-hwspinlock.yaml
```yaml
# SPDX-License-Identifier: (GPL-2.0-only OR BSD-2-Clause)
%YAML 1.2
---
$id: http://devicetree.org/schemas/hwlock/starfive,jhb100-hwspinlock.yaml#
$schema: http://devicetree.org/meta-schemas/core.yaml#

title: StarFive Hardware Spinlock

maintainers:
  - Xingyu Wu <xingyu.wu@starfivetech.com>

properties:
  compatible:
    const: starfive,jhb100-hwspinlock

  reg:
    maxItems: 1

  resets:
    maxItems: 1

  "#hwlock-cells":
    const: 1

required:
  - compatible
  - reg
  - resets
  - "#hwlock-cells"

additionalProperties: false

examples:
  - |
    hwspinlock@13012000 {
        compatible = "starfive,jhb100-hwspinlock";
        reg = <0x13012000 0x400>;
        resets = <&sys0crg 0>;
        #hwlock-cells = <1>;
    };
```

## Documentation/devicetree/bindings/hwmon/adi,adt7470.yaml
```yaml
# SPDX-License-Identifier: (GPL-2.0 OR BSD-2-Clause)
%YAML 1.2
---
$id: http://devicetree.org/schemas/hwmon/adi,adt7470.yaml#
$schema: http://devicetree.org/meta-schemas/core.yaml#

title: Analog Devices ADT7470 hwmon sensor

maintainers:
  - Luiz Angelo Daros de Luca <luizluca@gmail.com>

description: |
  The ADT7470 is a temperature monitor and multiple PWM outputs.
  It supports monitoring up to 10 external temperature sensors and controlling
  up to four fans.

properties:
  compatible:
    const: adi,adt7470

  reg:
    maxItems: 1

  "#pwm-cells":
    const: 2
    description: |
      Number of cells in a PWM specifier.
      - The first cell is the PWM channel (0 to 3).
      - The second cell is the PWM period in nanoseconds.

  "#thermal-sensor-cells":
    const: 1
    description: |
      Number of cells required to uniquely identify the temperature sensors.
      Valid index values are 0 to 9, corresponding to temp1 through temp10.

required:
  - compatible
  - reg

additionalProperties: false

examples:
  - |
    i2c {
        #address-cells = <1>;
        #size-cells = <0>;

        adt7470: hwmon@2f {
            compatible = "adi,adt7470";
            reg = <0x2f>;
            #pwm-cells = <2>;
            #thermal-sensor-cells = <1>;
        };
    };

    fan0 {
        compatible = "pwm-fan";
        /* Connects to PWM channel 0 with a 50000 ns (20 kHz) period */
        pwms = <&adt7470 0 50000>;
        cooling-levels = <0 100 150 255>;
    };
```

## Documentation/devicetree/bindings/hwmon/adi,ltc4282.yaml
```yaml
# SPDX-License-Identifier: (GPL-2.0-only OR BSD-2-Clause)
%YAML 1.2
---
$id: http://devicetree.org/schemas/hwmon/adi,ltc4282.yaml#
$schema: http://devicetree.org/meta-schemas/core.yaml#

title: Analog Devices LTC4282 I2C High Current Hot Swap Controller over I2C

maintainers:
  - Nuno Sa <nuno.sa@analog.com>

description: |
  Analog Devices LTC4282 I2C High Current Hot Swap Controller over I2C.

  https://www.analog.com/media/en/technical-documentation/data-sheets/ltc4282.pdf

properties:
  compatible:
    enum:
      - adi,ltc4282

  reg:
    maxItems: 1

  vdd-supply: true

  clocks:
    maxItems: 1

  '#clock-cells':
    const: 0

  adi,rsense-nano-ohms:
    description: Value of the sense resistor.

  adi,vin-mode-microvolt:
    description:
      Selects operating range for the Undervoltage, Overvoltage and Foldback
      pins. Also for the ADC. Should be set to the nominal input voltage.
    enum: [3300000, 5000000, 12000000, 24000000]
    default: 12000000

  adi,fet-bad-timeout-ms:
    description:
      From the moment a FET bad conditions is present, this property selects the
      wait time/timeout for a FET-bad fault to be signaled. Setting this to 0,
      disables FET bad faults to be reported.
    default: 255
    maximum: 255

  adi,overvoltage-dividers:
    description: |
      Select which dividers to use for VDD Overvoltage detection. Note that
      when the internal dividers are used the threshold is referenced to VDD.
      The percentages in the datasheet are misleading since the actual values
      to look for are in the "Absolute Maximum Ratings" table in the
      "Comparator Inputs" section. In there there's a line for each of the 5%,
      10% and 15% settings with the actual min, typical and max tolerances.
    $ref: /schemas/types.yaml#/definitions/string
    enum: [external, vdd_5_percent, vdd_10_percent, vdd_15_percent]
    default: 0

  adi,undervoltage-dividers:
    description: |
      Select which dividers to use for VDD Overvoltage detection. Note that
      when the internal dividers are used the threshold is referenced to VDD.
      The percentages in the datasheet are misleading since the actual values
      to look for are in the "Absolute Maximum Ratings" table in the
      "Comparator Inputs" section. In there there's a line for each of the 5%,
      10% and 15% settings with the actual min, typical and max tolerances.
    $ref: /schemas/types.yaml#/definitions/string
    enum: [external, vdd_5_percent, vdd_10_percent, vdd_15_percent]
    default: 0

  adi,current-limit-sense-microvolt:
    description:
      The current limit sense voltage of the chip is adjustable between
      12.5mV and 34.4mV in 3.1mV steps. This effectively limits the current
      on the load.
    enum: [12500, 15625, 18750, 21875, 25000, 28125, 31250, 34375]
    default: 25000

  adi,overcurrent-retry:
    description:
      If set, enables the chip to auto-retry 256 timer cycles after an
      Overcurrent fault.
    type: boolean

  adi,overvoltage-retry-disable:
    description:
      If set, disables the chip to auto-retry 50ms after an Overvoltage fault.
      It's enabled by default.
    type: boolean

  adi,undervoltage-retry-disable:
    description:
      If set, disables the chip to auto-retry 50ms after an Undervoltage fault.
      It's enabled by default.
    type: boolean

  adi,fault-log-enable:
    description:
      If set, enables the FAULT_LOG and ADC_ALERT_LOG registers to be written
      to the EEPROM when a fault bit transitions high and hence, will be
      available after a power cycle (the chip loads the contents of
      the EE_FAULT_LOG register - the one in EEPROM - into FAULT_LOG at boot).
    type: boolean

  adi,gpio-alert:
    description: Use the ALERT pin as a GPIO.
    type: boolean

  adi,gpio1-mode:
    description: Defines the function of the Pin.
    $ref: /schemas/types.yaml#/definitions/string
    enum: [gpio, power_bad, power_good]

  adi,gpio2-mode:
    description: Defines the function of the Pin.
          0 - GPIO Mode.
          1 - Acts as an input pin and it is feeded into the ADC.
          2 - Pulls Low when the MOSFET is dissipating power (stress).
    $ref: /schemas/types.yaml#/definitions/string
    enum: [gpio, adc_input, stress_fet]

  adi,gpio3-mode:
    description: Defines the function of the Pin.
          0 - GPIO Mode.
          1 - Acts as an input pin and it is feeded into the ADC.
    $ref: /schemas/types.yaml#/definitions/string
    enum: [gpio, adc_input]

  gpio-controller:
    description:
      This property applies if some of the pins are used as GPIOs.

  '#gpio-cells':
    const: 2

required:
  - compatible
  - reg
  - adi,rsense-nano-ohms

dependencies:
  adi,alert-as-gpio: [gpio-controller, '#gpio-cells']

allOf:
  - if:
      required:
        - adi,gpio1-mode
    then:
      allOf:
        - if:
            properties:
              adi,gpio1-mode:
                const: gpio
          then:
            dependencies:
              adi,gpio1-mode: [gpio-controller, '#gpio-cells']
  - if:
      required:
        - adi,gpio2-mode
    then:
      allOf:
        - if:
            properties:
              adi,gpio2-mode:
                const: gpio
          then:
            dependencies:
              adi,gpio2-mode: [gpio-controller, '#gpio-cells']
  - if:
      required:
        - adi,gpio3-mode
    then:
      allOf:
        - if:
            properties:
              adi,gpio3-mode:
                const: gpio
          then:
            dependencies:
              adi,gpio3-mode: [gpio-controller, '#gpio-cells']

additionalProperties: false

examples:
  - |
    i2c {
        #address-cells = <1>;
        #size-cells = <0>;

        hwmon@50 {
            compatible = "adi,ltc4282";
            reg = <0x50>;
            adi,rsense-nano-ohms = <500>;

            gpio-controller;
            #gpio-cells = <2>;

            adi,gpio1-mode = "power_good";
            adi,gpio2-mode = "gpio";
        };
    };
...
```

## Documentation/devicetree/bindings/hwmon/adi,ltc4283.yaml
```yaml
# SPDX-License-Identifier: (GPL-2.0 OR BSD-2-Clause)
%YAML 1.2
---
$id: http://devicetree.org/schemas/hwmon/adi,ltc4283.yaml#
$schema: http://devicetree.org/meta-schemas/core.yaml#

title: HWMON LTC4283 Negative Voltage Hot Swap Controller

maintainers:
  - Nuno Sá <nuno.sa@analog.com>

description: |
  This module is part of the LTC4283 MFD device.
  See Documentation/devicetree/bindings/mfd/adi,ltc4283.yaml
  This implements the HWMON bindings for the LTC4283 negative voltage hot swap
  controller.

properties:
  compatible:
    enum:
      - adi,ltc4283-hwmon

  adi,rsense-nano-ohms:
    description: Value of the sense resistor.

  adi,current-limit-sense-microvolt:
    description:
      The current limit sense voltage of the chip is adjustable between
      15mV and 30mV in 1mV steps. This effectively limits the current
      on the load.
    minimum: 15000
    maximum: 30000
    default: 15000

  adi,current-limit-foldback-factor:
    description:
      Specifies the foldback factor for the current limit. The current limit
      can be reduced (folded back) to one of four preset levels. The value
      represents the percentage of the current limit sense voltage to use
      during foldback. A value of 100 means no foldback.
    $ref: /schemas/types.yaml#/definitions/uint32
    enum: [10, 20, 50, 100]
    default: 100

  adi,cooling-delay-ms:
    description:
      Cooling time to apply after an overcurrent fault, FET bad or
      external fault.
    enum: [512, 1002, 2005, 4100, 8190, 16400, 32800, 65600]
    default: 512

  adi,fet-bad-timer-delay-ms:
    description:
      FET bad timer delay. After a FET bad status condition is detected,
      this timer is started. If the condition persists for the
      specified time, the FET is turned off and a fault is logged.
    enum: [256, 512, 1002, 2005]
    default: 256

  adi,power-good-reset-on-fet:
    description:
      If set, resets the power good status when the MOSFET is turned off.
      Otherwise, it resets when a low output voltage is detected.
    type: boolean

  adi,fet-turn-off-disable:
    description:
      If set, the MOSFET is turned off immediately when a FET fault is detected.
    type: boolean

  adi,tmr-pull-down-disable:
    description: Disables 2uA pull-down current on the TMR pin.
    type: boolean

  adi,dvdt-inrush-control-disable:
    description:
      Enables dV/dt inrush control during startup. In dV/dt mode, the inrush
      current is limited by controlling a constant output voltage ramp rate.
      If not set, the inrush control mechanism is active current limiting.
    type: boolean

  adi,fault-log-enable:
    description:
      If set, enables logging fault registers and ADC data into EEPROM upon a
      fault.
    type: boolean

  adi,vpower-drns-enable:
    description:
      If set, enables the attenuated MOSFET drain voltage to be monitored. This
      effectively means that the MOSFET power is monitored. If not set, the
      attenuated input voltage (and hence input power) is monitored.
    type: boolean

  adi,external-fault-fet-off-enable:
    description: Turns MOSFET off following an external fault.
    type: boolean

  adi,undervoltage-retry-disable:
    description: Do not retry to turn on the MOSFET after an undervoltage fault.
    type: boolean

  adi,overvoltage-retry-disable:
    description: Do not retry to turn on the MOSFET after an overvoltage fault.
    type: boolean

  adi,external-fault-retry-enable:
    description: Retry to turn on the MOSFET retry after an external fault.
    type: boolean

  adi,overcurrent-retries:
    description: Configures auto-retry following an Overcurrent fault.
    $ref: /schemas/types.yaml#/definitions/string
    enum: [latch-off, "1", "7", unlimited]
    default: latch-off

  adi,fet-bad-retries:
    description:
      Configures auto-retry following a FET bad fault and a consequent MOSFET
      turn off.
    $ref: /schemas/types.yaml#/definitions/string
    enum: [latch-off, "1", "7", unlimited]
    default: latch-off

  adi,pgio1-func:
    description: Configures the function of the PGIO1 pin.
    $ref: /schemas/types.yaml#/definitions/string
    enum: [inverted_power_good, power_good]
    default: inverted_power_good

  adi,pgio2-func:
    description: Configures the function of the PGIO2 pin.
    $ref: /schemas/types.yaml#/definitions/string
    enum: [inverted_power_good, power_good, active_current_limiting]
    default: inverted_power_good

  adi,pgio3-func:
    description: Configures the function of the PGIO3 pin.
    $ref: /schemas/types.yaml#/definitions/string
    enum: [inverted_power_good_input, power_good_input]
    default: inverted_power_good_input

  adi,pgio4-func:
    description: Configures the function of the PGIO4 pin.
    $ref: /schemas/types.yaml#/definitions/string
    enum: [inverted_external_fault, external_fault]
    default: inverted_external_fault

dependencies:
  adi,external-fault-retry-enable:
    - adi,pgio4-func
  adi,external-fault-fet-off-enable:
    - adi,pgio4-func

required:
  - compatible
  - adi,rsense-nano-ohms

additionalProperties: false
```
