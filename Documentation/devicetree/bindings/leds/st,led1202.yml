## Documentation/devicetree/bindings/leds/st,led1202.yml
```yaml
# SPDX-License-Identifier: GPL-2.0-only OR BSD-2-Clause
%YAML 1.2
---
$id: http://devicetree.org/schemas/leds/st,led1202.yaml#
$schema: http://devicetree.org/meta-schemas/core.yaml#

title: ST LED1202 LED controllers

maintainers:
  - Vicentiu Galanopulo <vicentiu.galanopulo@remote-tech.co.uk>

description:
  The LED1202 is a 12-channel low quiescent current LED controller
  programmable via I2C; The output current can be adjusted separately
  for each channel by 8-bit analog and 12-bit digital dimming control.

  Datasheet available at
  https://www.st.com/en/power-management/led1202.html

properties:
  compatible:
    enum:
      - st,led1202

  reg:
    maxItems: 1

  "#address-cells":
    const: 1

  "#size-cells":
    const: 0

patternProperties:
  "^led@[0-9a-f]+$":
    type: object
    $ref: common.yaml#
    unevaluatedProperties: false

    properties:
      reg:
        minimum: 0
        maximum: 11

    required:
      - reg

additionalProperties: true

examples:
  - |
    #include <dt-bindings/leds/common.h>

    i2c {
        #address-cells = <1>;
        #size-cells = <0>;

        led-controller@58 {
            compatible = "st,led1202";
            reg = <0x58>;
            address-cells = <1>;
            size-cells = <0>;

            led@0 {
                reg = <0>;
                label = "led1_r";
                active = <1>;
            };

            led@1 {
                reg = <1>;
                label = "led1_g";
                active = <1>;
            };

            led@2 {
                reg = <2>;
                label = "led1_b";
                active = <1>;
            };

            led@3 {
                reg = <3>;
                label = "led2_r";
                active = <1>;
            };

            led@4 {
                reg = <4>;
                label = "led2_g";
                active = <1>;
            };

            led@5 {
                reg = <5>;
                label = "led2_b";
                active = <1>;
            };

            led@6 {
                reg = <6>;
                label = "led3_r";
                active = <1>;
            };

            led@7 {
                reg = <7>;
                label = "led3_g";
                active = <1>;
            };

            led@8 {
                reg = <8>;
                label = "led3_b";
                active = <1>;
            };

            led@9 {
                reg = <9>;
                active = <0>;
            };

            led@a {
                reg = <10>;
                active = <0>;
            };

            led@b {
                reg = <11>;
                active = <0>;
            };
        };
    };

...
```

## Documentation/devicetree/bindings/leds/ti,lm3532.yaml
```yaml
# SPDX-License-Identifier: (GPL-2.0 OR BSD-2-Clause)
%YAML 1.2
---
$id: http://devicetree.org/schemas/leds/ti,lm3532.yaml#
$schema: http://devicetree.org/meta-schemas/core.yaml#

title: Texas Instruments - lm3532 White LED driver with
  ambient light sensing capability.

description: |
  The LM3532 provides the 3 high-voltage,
  low-side current sinks. The device is programmable over an
  I2C-compatible interface and has independent current
  control for all three channels. The adaptive current
  regulation method allows for different LED currents in
  each current sink thus allowing for a wide variety of
  backlight and keypad applications.

  The main features of the LM3532 include dual ambient light
  sensor inputs each with 32 internal voltage setting
  resistors, 8-bit logarithmic and linear brightness
  control, dual external PWM brightness control inputs,
  and up to 1000:1 dimming ratio with programmable fade in
  and fade out settings.

  For more product information please see the link below:
  https://www.ti.com/product/LM3532

maintainers:
  - Dan Murphy <dmurphy@ti.com>

properties:
  compatible:
    const: ti,lm3532

  reg:
    maxItems: 1

  '#address-cells':
    const: 1

  '#size-cells':
    const: 0

  enable-gpios:
    description: GPIO pin to enable (active high)/disable
      the device.
    maxItems: 1

  ti,als-avrg-time-us:
    description: Determines the length of time the device
      needs to average the two ALS inputs.  This is only
      used if the input mode is LM3532_ALS_INPUT_AVRG.
    minimum: 17920
    maximum: 2293760

  ti,als-input-mode:
    $ref: /schemas/types.yaml#/definitions/uint32
    description: Determines how the device uses the attached
      ALS devices.
      0x00 - ALS1 and ALS2 input average
      0x01 - ALS1 Input
      0x02 - ALS2 Input
      0x03 - Max of ALS1 and ALS2
    minimum: 0
    maximum: 3

patternProperties:
  "^ramp-(up|down)-us$":
    description: The Run time ramp rates/step are from one
      current set-point to another after the device has
      reached its initial target set point from turn-on
    minimum: 8
    maximum: 65536

  "^ti,als-v(min|max)$":
    $ref: /schemas/types.yaml#/definitions/uint32
    description: Min/max ALS voltage in Volts.
    minimum: 0
    maximum: 2

  "^ti,als(1|2)-imp-sel$":
    $ref: /schemas/types.yaml#/definitions/uint32
    description: ALS impedance resistor selection in Ohms.
      Values above 37kohms will be set to the "High
      Impedance" setting
    minimum: 1190
    maximum: 37000

  "^led@[0,1]?([0-9]|[a-z])$":
    $ref: common.yaml#
    type: object
    properties:
      reg:
        description: Indicates control bank the LED string
          is controlled by

      ti,led-mode:
        $ref: /schemas/types.yaml#/definitions/uint32
        description: Defines if the LED strings are manually
            controlled or if the LED strings are controlled
            by the ALS.
            0x00 - LED strings are I2C controlled via full
                  scale brightness control register
            0x01 - LED strings are ALS controlled
        minimum: 0
        maximum: 1

      led-max-microamp:
        minimum: 5000
        maximum: 29800
        multipleOf: 800

    required:
      - reg
      - led-sources
      - ti,led-mode

    unevaluatedProperties: true

required:
  - compatible
  - reg
  - '#address-cells'
  - '#size-cells'

additionalProperties: false

examples:
  - |
    #include <dt-bindings/gpio/gpio.h>
    #include <dt-bindings/leds/common.h>

    i2c {
        #address-cells = <1>;
        #size-cells = <0>;

        led-controller@38 {
            compatible = "ti,lm3532";
            #address-cells = <1>;
            #size-cells = <0>;
            reg = <0x38>;

            enable-gpios = <&gpio6 12 GPIO_ACTIVE_HIGH>;
            ramp-up-us = <1024>;
            ramp-down-us = <65536>;

            ti,als-vmin = <0>;
            ti,als-vmax = <2>;
            ti,als1-imp-sel = <4110>;
            ti,als2-imp-sel = <2180>;
            ti,als-avrg-time-us = <17920>;
            ti,als-input-mode = <0x00>;

            led@0 {
                reg = <0>;
                led-sources = <2>;
                ti,led-mode = <1>;
                led-max-microamp = <21600>;
                label = ":backlight";
                linux,default-trigger = "backlight";
            };

            led@1 {
                reg = <1>;
                led-sources = <1>;
                ti,led-mode = <0>;
                label = ":kbd_backlight";
            };
        };
    };
...
```

## Documentation/devicetree/bindings/leds/ti,lm3560.yaml
```yaml
# SPDX-License-Identifier: (GPL-2.0-only OR BSD-2-Clause)
%YAML 1.2
---
$id: http://devicetree.org/schemas/leds/ti,lm3560.yaml#
$schema: http://devicetree.org/meta-schemas/core.yaml#

title: TI LM3560 Synchronous Boost Flash Driver

maintainers:
  - Svyatoslav Ryhel <clamor95@gmail.com>

description:
  The LM3560 is a 2-MHz fixed frequency synchronous boost converter with two
  1000-mA constant current drivers for high-current white LEDs. The dual high-
  side current sources allow for grounded cathode LED operation and can be
  tied together for providing flash currents at up to 2 A through a single LED.
  An adaptive regulation method ensures the current for each LED remains in
  regulation and maximizes efficiency.

allOf:
  - $ref: /schemas/leds/common.yaml

properties:
  compatible:
    enum:
      - ti,lm3559
      - ti,lm3560

  reg:
    maxItems: 1

  '#address-cells':
    const: 1

  '#size-cells':
    const: 0

  enable-gpios:
    description: GPIO connected to the HWEN pin.
    maxItems: 1

  vin-supply:
    description: Supply connected to the IN line.

  flash-max-timeout-us:
    minimum: 32000
    maximum: 1024000
    default: 32000

  ti,peak-current-microamp:
    description:
      The LM3560 features 4 selectable current limits 1.6A, 2.3A, 3A, and 3.6A.
      When the current limit is reached, the LM3560 stops switching for the
      remainder of the switching cycle.
    enum: [16000000, 23000000, 30000000, 36000000]
    default: 16000000

patternProperties:
  '^led@[01]$':
    description: LED control bank nodes.
    $ref: /schemas/leds/common.yaml#
    unevaluatedProperties: false

    properties:
      reg:
        description: Control bank selection (0 = bank A, 1 = bank B).
        maximum: 1

      flash-max-microamp:
        minimum: 62500
        maximum: 1000000

      led-max-microamp:
        minimum: 31250
        maximum: 250000

    required:
      - reg
      - flash-max-microamp
      - led-max-microamp

required:
  - compatible
  - reg
  - '#address-cells'
  - '#size-cells'

additionalProperties: false

examples:
  - |
    #include <dt-bindings/gpio/gpio.h>

    i2c {
        #address-cells = <1>;
        #size-cells = <0>;

        led-controller@53 {
            compatible = "ti,lm3560";
            reg = <0x53>;

            enable-gpios = <&gpio 28 GPIO_ACTIVE_HIGH>;
            vin-supply = <&vdd_3v3_sys>;

            flash-max-timeout-us = <1024000>;
            ti,peak-current-microamp = <16000000>;

            #address-cells = <1>;
            #size-cells = <0>;

            led@0 {
                reg = <0>;

                label = "white::flash";
                linux,default-trigger = "flash";

                flash-max-microamp = <562500>;
                led-max-microamp = <156250>;
            };

            led@1 {
                reg = <1>;

                label = "yellow::flash";
                linux,default-trigger = "flash";

                flash-max-microamp = <562500>;
                led-max-microamp = <156250>;
            };
        };
    };
```

## Documentation/devicetree/bindings/leds/ti,lm3601x.yaml
```yaml
# SPDX-License-Identifier: (GPL-2.0 OR BSD-2-Clause)
%YAML 1.2
---
$id: http://devicetree.org/schemas/leds/ti,lm3601x.yaml#
$schema: http://devicetree.org/meta-schemas/core.yaml#

title: Texas Instruments - lm3601x Single-LED Flash Driver

description: |
  The LM3601X are ultra-small LED flash drivers
  that provide a high level of adjustability.

  For more product information please see the links below:
  https://www.ti.com/product/LM36010
  https://www.ti.com/product/LM36011

maintainers:
  - Dan Murphy <dmurphy@ti.com>

properties:
  compatible:
    enum:
      - "ti,lm36010"
      - "ti,lm36011"

  reg:
    maxItems: 1

  '#address-cells':
    const: 1

  '#size-cells':
    const: 0

patternProperties:
  "^led@[0,1]?([0-9]|[a-z])$":
    type: object
    $ref: common.yaml#
    properties:
      reg:
        description: |
          0 - Indicates IR mode
          1 - Indicates Torch (white LED) mode
        minimum: 0
        maximum: 1

      flash-max-microamp:
        minimum: 11
        maximum: 1500000

      flash-max-timeout-us:
        minimum: 40
        maximum: 1600000

      led-max-microamp:
        minimum: 24
        maximum: 376000

    required:
      - reg
      - flash-max-microamp
      - flash-max-timeout-us
      - led-max-microamp

    unevaluatedProperties: true

required:
  - compatible
  - reg
  - '#address-cells'
  - '#size-cells'

additionalProperties: false

examples:
  - |
    #include <dt-bindings/leds/common.h>

    i2c {
        #address-cells = <1>;
        #size-cells = <0>;

        led-controller@64 {
            compatible = "ti,lm36010";
            #address-cells = <1>;
            #size-cells = <0>;
            reg = <0x64>;

            led@1 {
                reg = <1>;
                function = LED_FUNCTION_TORCH;
                color = <LED_COLOR_ID_WHITE>;
                led-max-microamp = <376000>;
                flash-max-microamp = <1500000>;
                flash-max-timeout-us = <1600000>;
            };
        };
    };
...
```

## Documentation/devicetree/bindings/leds/ti,lm3643.yaml
```yaml
# SPDX-License-Identifier: (GPL-2.0-only OR BSD-2-Clause)
%YAML 1.2
---
$id: http://devicetree.org/schemas/leds/ti,lm3643.yaml#
$schema: http://devicetree.org/meta-schemas/core.yaml#

title: Texas Instruments LM3643 1500mA dual LED Flash Driver

maintainers:
  - Rillian Grant <rillian.grant@gmail.com>

description: |
  The LM3643 is a dual LED flash driver utilizing a synchronous boost converter
  to provide power to two current sources.

  The dual high-side current sources can be tied together to provide flash
  currents up to 1.5A through a single LED.

  Datasheet: https://www.ti.com/lit/ds/symlink/lm3643.pdf

properties:
  compatible:
    enum:
      - ti,lm3643

  reg:
    maxItems: 1

  "#address-cells":
    const: 1

  "#size-cells":
    const: 0

patternProperties:
  "^led@[0-1]$":
    type: object
    $ref: common.yaml#
    unevaluatedProperties: false

    properties:
      reg:
        description: Index of the LED.
        minimum: 0
        maximum: 1

      led-sources:
        minItems: 1
        maxItems: 2
        items:
          minimum: 0
          maximum: 1

      flash-max-microamp:
        description: |
          Maximum flash current through this LED. Each high-side current source
          can provide up to 1.5A. The maximum current the boost can deliver is
          1.5A across both sources.

          Valid values for an LED connected to one source:
            10900 - 1500000, step by 11725 (rounded down)
          Valid values for an LED connected to both sources:
            21800 - 1500000, step by 23450 (rounded down)

        minimum: 10900
        maximum: 1500000

      led-max-microamp:
        description: |
          Maximum torch current through this LED. In torch mode each high-side
          current source can provide up to 179mA.

          Valid values for an LED connected to one source:
            977 - 179000, step by 1400 (rounded down)
          Valid values for an LED connected to both sources:
            1954 - 358000, step by 2800 (rounded down)

        minimum: 977
        maximum: 358000

      flash-max-timeout-us:
        description: |
          The chip supports timeouts from 10ms to 100ms in increments of 10ms
          and from 100ms to 400ms in increments of 50ms. The provided value
          will be rounded down to a supported value.

        minimum: 10000
        maximum: 400000

    required:
      - reg
      - led-sources

required:
  - compatible
  - reg
  - "#address-cells"
  - "#size-cells"

additionalProperties: false

examples:
  - |
    #include <dt-bindings/leds/common.h>

    i2c {
        #address-cells = <1>;
        #size-cells = <0>;

        flash-led-controller@63 {
            compatible = "ti,lm3643";
            reg = <0x63>;
            #address-cells = <1>;
            #size-cells = <0>;

            led@0 {
                reg = <0>;
                led-sources = <0>, <1>;
                function = LED_FUNCTION_FLASH;
                color = <LED_COLOR_ID_IR>;
                flash-max-microamp = <750000>;
                led-max-microamp = <180000>;
                flash-max-timeout-us = <150000>;
            };
        };
    };
```
