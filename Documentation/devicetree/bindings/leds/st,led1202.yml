## Documentation/devicetree/bindings/mailbox/xlnx,versal-ipi-mailbox.yaml
```yaml
# SPDX-License-Identifier: (GPL-2.0-only OR BSD-2-Clause)
%YAML 1.2
---
$id: http://devicetree.org/schemas/mailbox/xlnx,versal-ipi-mailbox.yaml#
$schema: http://devicetree.org/meta-schemas/core.yaml#

title: Xilinx IPI(Inter Processor Interrupt) mailbox controller

description: |
  The Xilinx IPI(Inter Processor Interrupt) mailbox controller is to manage
  messaging between two IPI agents. Each IPI agent owns registers used for
  notification and buffers for message.

               +-------------------------------------+
               | Xilinx IPI Controller               |
               +-------------------------------------+
    +--------------------------------------------------+
  TF-A                   |                     |
                         |                     |
                         |                     |
    +--------------------------+               |
                         |                     |
                         |                     |
    +--------------------------------------------------+
              +------------------------------------------+
              |  +----------------+   +----------------+ |
  Hardware    |  |  IPI Agent     |   |  IPI Buffers   | |
              |  |  Registers     |   |  (optional)    | |
              |  |                |   |                | |
              |  +----------------+   +----------------+ |
              |                                          |
              | Xilinx IPI Agent Block                   |
              +------------------------------------------+

maintainers:
  - Shubhrajyoti Datta <shubhrajyoti.datta@amd.com>

properties:
  compatible:
    const: xlnx,versal-ipi-mailbox

  method:
    description: |
      The method of calling the PM-API firmware layer.
      Permitted values are.
      - "smc" : SMC
      - "hvc" : HVC

    $ref: /schemas/types.yaml#/definitions/string
    enum:
      - smc
      - hvc
    default: smc

  '#address-cells':
    const: 2

  '#size-cells':
    const: 2

  reg:
    minItems: 1
    items:
      - description: Host IPI agent control registers
      - description: Host IPI agent optional message buffers

  reg-names:
    minItems: 1
    items:
      - const: ctrl
      - const: msg

  xlnx,ipi-id:
    description: |
      Remote Xilinx IPI agent ID of which the mailbox is connected to.
    $ref: /schemas/types.yaml#/definitions/uint32

  interrupts:
    maxItems: 1

  ranges: true

patternProperties:
  '^mailbox@[0-9a-f]+$':
    description: Internal ipi mailbox node
    type: object

    properties:

      compatible:
        const: xlnx,versal-ipi-dest-mailbox

      xlnx,ipi-id:
        description:
          Remote Xilinx IPI agent ID of which the mailbox is connected to.
        $ref: /schemas/types.yaml#/definitions/uint32

      '#mbox-cells':
        const: 1
        description:
          It contains tx(0) or rx(1) channel IPI id number.

      reg:
        minItems: 1
        items:
          - description: Host IPI agent control registers
          - description: Host IPI agent optional message buffers

      reg-names:
        minItems: 1
        items:
          - const: ctrl
          - const: msg

    additionalProperties: false

    required:
      - compatible
      - reg
      - reg-names
      - xlnx,ipi-id
      - "#mbox-cells"

additionalProperties: false

required:
  - compatible
  - interrupts
  - '#address-cells'
  - '#size-cells'
  - reg
  - reg-names
  - xlnx,ipi-id

examples:
  - |
    #include<dt-bindings/interrupt-controller/arm-gic.h>

    amba {
      #address-cells = <0x2>;
      #size-cells = <0x2>;
      zynqmp-mailbox@ff300000 {
        compatible = "xlnx,versal-ipi-mailbox";
        interrupts = <GIC_SPI 29 IRQ_TYPE_LEVEL_HIGH>;
        xlnx,ipi-id = <0>;
        #address-cells = <2>;
        #size-cells = <2>;
        reg = <0x0 0xff300000 0x0 0x1000>,
              <0x0 0xff990000 0x0 0x1ff>;
        reg-names = "ctrl", "msg";
        ranges;

        /* buffered IPI */
        mailbox@ff340000 {
          compatible = "xlnx,versal-ipi-dest-mailbox";
          reg = <0x0 0xff340000 0x0 0x1000>,
                <0x0 0xff990400 0x0 0x1ff>;
          reg-names = "ctrl", "msg";
          #mbox-cells = <1>;
          xlnx,ipi-id = <4>;
        };

        /* bufferless IPI */
        mailbox@ff370000 {
          compatible = "xlnx,versal-ipi-dest-mailbox";
          reg = <0x0 0xff370000 0x0 0x1000>;
          reg-names = "ctrl";
          #mbox-cells = <1>;
          xlnx,ipi-id = <7>;
        };
      };
    };

...
```

## Documentation/devicetree/bindings/media/allegro,al300-vdec.yaml
```yaml
# SPDX-License-Identifier: (GPL-2.0 OR BSD-2-Clause)
%YAML 1.2
---
$id: http://devicetree.org/schemas/media/allegro,al300-vdec.yaml#
$schema: http://devicetree.org/meta-schemas/core.yaml#

title: Allegro DVT Video IP Decoder Gen 3

maintainers:
  - Yassine OUAISSA <yassine.ouaissa@allegrodvt.com>

description:
  The al300-vdec represents the gen 3 of Allegro DVT IP video
  decoding technology, offering significant advancements over its
  predecessors. This new decoder features enhanced processing capabilities
  with improved throughput and reduced latency.

  Communication between the host driver software and the MCU is implemented
  through a specialized mailbox interface mechanism. This mailbox system
  provides a structured channel for exchanging commands, parameters, and
  status information between the host CPU and the MCU controlling the codec
  engines.

properties:
  compatible:
    const: allegro,al300-vdec

  reg:
    maxItems: 2

  reg-names:
    items:
      - const: top
      - const: apb

  interrupts:
    maxItems: 1

  clocks:
    description: MCU core clock
    maxItems: 1

  memory-region:
    maxItems: 1

  firmware-name:
    maxItems: 1

required:
  - compatible
  - reg
  - reg-names
  - interrupts
  - clocks

additionalProperties: False

examples:
  - |
    #include <dt-bindings/interrupt-controller/arm-gic.h>

    axi {
        #address-cells = <2>;
        #size-cells = <2>;

        video-decoder@a0120000 {
            compatible = "allegro,al300-vdec";
            reg = <0x00 0xa0120000 0x00 0x10000>, /*VDEC_TOP*/
                  <0x01 0x80000000 0x00 0x8000>;  /*MCU_APB*/
            reg-names = "top", "apb";
            interrupts = <GIC_SPI 96 IRQ_TYPE_LEVEL_HIGH>;
            clocks = <&mcu_core_clk>;
            memory-region = <&vdec_mem>;
            firmware-name = "al300_vdec.fw";
        };
    };
```

## Documentation/devicetree/bindings/media/allegrodvt,al300-vdec.yaml
```yaml
# SPDX-License-Identifier: (GPL-2.0 OR BSD-2-Clause)
%YAML 1.2
---
$id: http://devicetree.org/schemas/media/allegrodvt,al300-vdec.yaml#
$schema: http://devicetree.org/meta-schemas/core.yaml#

title: Allegro DVT Video IP Decoder Gen 3

maintainers:
  - Yassine OUAISSA <yassine.ouaissa@allegrodvt.com>

description:
  The al300-vdec represents the latest generation of Allegro DVT IP decoding
  technology, offering significant advancements over its predecessors.
  This new decoder features enhanced processing capabilities with improved
  throughput and reduced latency.

  Communication between the host driver software and the MCU is implemented
  through a specialized mailbox interface mechanism. This mailbox system
  provides a structured channel for exchanging commands, parameters, and
  status information between the host CPU and the MCU controlling the codec
  engines.

properties:
  compatible:
    const: allegrodvt,al300-vdec

  reg:
    items:
      - description: The registers
      - description: the MCU APB register

  reg-names:
    items:
      - const: regs
      - const: apb

  interrupts:
    maxItems: 1

  clocks:
    items:
      - description: MCU clock

  clock-names:
    items:
      - const: mcu_clk

  memory-region:
    maxItems: 1

  firmware-name:
    maxItems: 1

required:
  - compatible
  - reg
  - reg-names
  - interrupts
  - clocks
  - clock-names

additionalProperties: False

examples:
  - |
    axi {
        #address-cells = <2>;
        #size-cells = <2>;

        ald300@a0120000 {
            compatible = "allegrodvt,al300-vdec";
            reg = <0 0xa0120000 0 0x10000>,
                  <1 0x80000000 0 0x80000>;
            reg-names = "regs", "apb";
            interrupts = <0 96 4>;
            clocks = <&mcu_clock_dec>;
            clock-names = "mcu_clk";
            firmware-name = "al300_vdec.fw";
        };
    };

...
```
