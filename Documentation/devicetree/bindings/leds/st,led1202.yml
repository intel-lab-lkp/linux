## Documentation/devicetree/bindings/mailbox/qcom,ipq5424-tmel.yaml
```yaml
# SPDX-License-Identifier: (GPL-2.0-only OR BSD-2-Clause)
%YAML 1.2
---
$id: http://devicetree.org/schemas/mailbox/qcom,ipq5424-tmel.yaml#
$schema: http://devicetree.org/meta-schemas/core.yaml#

title: Qualcomm TMEL IPCC channel

maintainers:
  - Sricharan Ramabadhran <quic_srichara@quicinc.com>

description:
  TMEL SS provides different kinds of services like secureboot, remote image authentication,
  key management, crypto, OEM provisioning etc. This patch adds support for remote image
  authentication. Support for rest of the services can be added.

  The QMP mailbox is the primary means of communication between TMEL SS and other subsystem on
  the SoC. A dedicated pair of inbound and outbound mailboxes is implemented for each
  subsystem/external execution environment which needs to communicate with TMEL for security
  services. The inbound mailboxes are used to send IPC requests to TMEL, which are then processed
  by TMEL firmware and accordingly the responses are sent back via outbound mailboxes.

properties:
  compatible:
    items:
      - enum:
          - qcom,ipq5424-tmel

  reg:
    maxItems: 1

  interrupts:
    maxItems: 1

  mboxes:
    maxItems: 1

  "#mbox-cells":
    const: 1

required:
  - compatible
  - reg
  - interrupts
  - mboxes
  - "#mbox-cells"

additionalProperties: false

examples:
  - |
    #include <dt-bindings/interrupt-controller/arm-gic.h>

    mailbox@32090000 {
        compatible = "qcom,ipq5424-tmel";
        reg = <0x32090000 0x2000>;
        interrupts = <GIC_SPI 126 IRQ_TYPE_EDGE_RISING>;
        mboxes = <&apcs_glb 20>;
        #mbox-cells = <1>;
    };

...
```

## Documentation/devicetree/bindings/mailbox/qcom,tmel-qmp.yaml
```yaml
# SPDX-License-Identifier: (GPL-2.0-only OR BSD-2-Clause)
%YAML 1.2
---
$id: http://devicetree.org/schemas/mailbox/qcom,tmel-qmp.yaml#
$schema: http://devicetree.org/meta-schemas/core.yaml#

title: Qualcomm TMEL IPCC channel

maintainers:
  - Sricharan Ramabadhran <quic_srichara@quicinc.com>

description:
  TMEL SS provides different kinds of services like secureboot, remote image
  authentication, key management, crypto, OEM provisioning etc. This patch adds
  support for remote image authentication. Support for rest of the services can
  be added.

  The QMP mailbox is the primary means of communication between TMEL SS and
  other subsystem on the SoC. A dedicated pair of inbound and outbound mailboxes
  is implemented for each subsystem/external execution environment which needs to
  communicate with TMEL for security services. The inbound mailboxes are used to
  send IPC requests to TMEL, which are then processed by TMEL firmware and
  accordingly the responses are sent to the requestor via outbound mailboxes.

properties:
  compatible:
    items:
      - enum:
          - qcom,ipq5424-tmel-qmp

  reg:
    maxItems: 1

  interrupts:
    maxItems: 1

  mboxes:
    maxItems: 1

  "#mbox-cells":
    const: 2
    description:
      The first cell is the client-id, and the second cell is the signal-id.

required:
  - compatible
  - reg
  - interrupts
  - mboxes

additionalProperties: false

examples:
  - |
    #include <dt-bindings/interrupt-controller/arm-gic.h>

    tmel_qmp: mailbox@32090000 {
        compatible = "qcom,ipq5424-tmel-qmp";
        reg = <0x32090000 0x2000>;
        interrupts = <GIC_SPI 126 IRQ_TYPE_EDGE_RISING>;
        mboxes = <&apcs_glb 20>;
        #mbox-cells = <2>;
    };

...
```

## Documentation/devicetree/bindings/mailbox/qcom,tmelite-qmp.yaml
```yaml
# SPDX-License-Identifier: (GPL-2.0-only OR BSD-2-Clause)
%YAML 1.2
---
$id: http://devicetree.org/schemas/mailbox/qcom,tmelite-qmp.yaml#
$schema: http://devicetree.org/meta-schemas/core.yaml#

title: Qualcomm TMELITE IPCC channel

maintainers:
  - Sricharan Ramabadhran <quic_srichara@quicinc.com>

description:
  This binding describes the component responsible for communication
  between the TME-L server based subsystems (Q6) and the TME-L client
  (APPSS/BTSS/AUDIOSS), used for security services like secure image
  authentication, enable/disable efuses, crypto services. Each client
  in the   SoC has its own block of message RAM and IRQ for communication
  with the TME-L SS. The protocol used to communicate in the message RAM
  is known as Qualcomm Messaging Protocol (QMP).

properties:
  compatible:
    items:
      - enum:
          - qcom,ipq5424-tmelite-qmp
      - const: qcom,tmelite-qmp

  reg:
    maxItems: 1
    description:
      The base address and size of the message RAM for this client's
      communication with the TMELITE core

  interrupts:
    maxItems: 1
    description:
      Should specify the TMELITE message IRQ for this client

  mboxes:
    maxItems: 1
    description:
      Reference to the mailbox representing the outgoing doorbell in APCS for
      this client, as described in mailbox/mailbox.txt

  "#mbox-cells":
    const: 2
    description:
      The first cell is the client-id, and the second cell is the signal-id.

required:
  - compatible
  - reg
  - interrupts
  - mboxes

additionalProperties: false

examples:
  - |
    #include <dt-bindings/interrupt-controller/arm-gic.h>

    tmel_qmp: qmp@32090000 {
           compatible = "qcom,ipq5424-tmelite-qmp", "qcom,tmelite-qmp";
           reg = <0x32090000 0x2000>;
           interrupts = <GIC_SPI 126 IRQ_TYPE_EDGE_RISING>;
           mboxes = <&apcs_glb 20>;
           #mbox-cells = <2>;
    };

...
```

## Documentation/devicetree/bindings/mailbox/rcar,mfis-mailbox.yaml
```yaml
# SPDX-License-Identifier: (GPL-2.0 OR BSD-2-Clause)
%YAML 1.2
---
$id: http://devicetree.org/schemas/mailbox/rcar,mfis-mailbox.yaml#
$schema: http://devicetree.org/meta-schemas/core.yaml#

title: Renesas MFIS (Multifunctional Inferface) Mailbox controller

maintainers:
  - Kuninori Morimoto <kuninori.morimoto.gx@renesas.com>

description:
  The R-Car multifunctional interface (MFIS) provides an interface between
  the different CPU Cores, such as AP System Core domain and the Realtime
  Core domain, SCP Core domain and AP System Core domain or Realtime Core
  domain and AP System Core domain or Realtime Core domain.
  The MFIS supports the issuing of interrupts for each CPU core domain.

properties:
  compatible:
    items:
      - enum:
          - rcar,mfis-mailbox-r8a78000   # R-Car X5H
      - const: rcar,mfis-mailbox-gen5    # R-Car Gen5

  reg:
    maxItems: 1

  interrupts:
    maxItems: 1

  "#mbox-cells":
    const: 1

required:
  - compatible
  - reg
  - interrupts
  - "#mbox-cells"

additionalProperties: false

examples:
  - |
    #include <dt-bindings/interrupt-controller/arm-gic.h>
    mailbox@18842000  {
        compatible = "rcar,mfis-mailbox-r8a78000", "rcar,mfis-mailbox-gen5";
        reg = <0x18842000 0x8>;
        interrupts = <GIC_SPI 4362 IRQ_TYPE_LEVEL_HIGH>;
        #mbox-cells = <1>;
    };
```

## Documentation/devicetree/bindings/mailbox/renesas,mfis-mailbox.yaml
```yaml
# SPDX-License-Identifier: (GPL-2.0 OR BSD-2-Clause)
%YAML 1.2
---
$id: http://devicetree.org/schemas/mailbox/renesas,mfis-mailbox.yaml#
$schema: http://devicetree.org/meta-schemas/core.yaml#

title: Renesas MFIS (Multifunctional Interface) Mailbox Driver

maintainers:
  - Kuninori Morimoto <kuninori.morimoto.gx@renesas.com>

description: |
    The R-Car multifunctional interface (MFIS) provides an interface between
    the different CPU Cores, such as AP System Core domain and the Realtime
    Core domain, SCP Core domain and AP System Core domain or Realtime Core
    domain and AP System Core domain or Realtime Core domain.
    The MFIS supports the issuing of interrupts for each CPU core domain.

properties:
  compatible:
    const: renesas,mfis-mbox

  reg:
    maxItems: 1

  interrupts:
    description: the irq line
    maxItems: 1

  "#mbox-cells":
    const: 1

required:
  - compatible
  - reg
  - interrupts
  - "#mbox-cells"

additionalProperties: false

examples:
  - |
    #include <dt-bindings/interrupt-controller/arm-gic.h>
    mailbox: mfis_mbox@18842000  {
        compatible = "renesas,mfis-mbox";
        reg = <0x18842000 0x8>;
        interrupts = <GIC_SPI 4362 IRQ_TYPE_LEVEL_HIGH>;
        #mbox-cells = <1>;
    };
```

## Documentation/devicetree/bindings/mailbox/starfive-meu.yaml
```yaml
# SPDX-License-Identifier: (GPL-2.0-only OR BSD-2-Clause)
%YAML 1.2
---
$id: http://devicetree.org/schemas/mailbox/starfive-meu.yaml#
$schema: http://devicetree.org/meta-schemas/core.yaml#

title: StarFive MEU Mailbox Controller

maintainers:
  - Jee Heng Sia <jeeheng.sia@starfivetech.com>
  - Joshua Yeong <joshua.yeong@starfivetech.com>

description: |
  StarFive's Message-Exchange-Unit (MEU) is a mailbox controller that has 62
  independent doorbells. Each MEU channel consist of 31 doorbells and consist of
  a pair of Tx/Rx links that shall communicates with remote processor. The
  sender set the bit in the SET register to indicate data readiness for the
  receiver. An interrupt will be raised whenever receiving notification doorbell
  from remote processor. The receiver will clear the bit in the CLR register
  upon handling the doorbell notification. The sender should poll the STAT
  register before starting any transaction to ensure all on-going doorbells are
  processed.

properties:
  compatible:
    enum:
      - starfive,jh8100-meu

  reg:
    maxItems: 1

  interrupts:
    items:
      - description: mailbox0
      - description: mailbox1

  '#mbox-cells':
    description: represents index of the mailbox/doorbell paired channel
      channel  0 - 30 for mailbox0 doorbell
      channel 31 - 61 for mailbox1 doorbell
    const: 1

required:
  - compatible
  - reg
  - interrupts
  - '#mbox-cells'

additionalProperties: false

examples:
  - |
    soc {
        #address-cells = <2>;
        #size-cells = <2>;

        meu: mailbox@1f370000 {
            compatible = "starfive,jh8100-meu";
            reg = <0x0 0x1f370000 0 0x8000>;
            interrupts = <170>, /* Mailbox0 */
                         <171>; /* Mailbox1 */
            #mbox-cells = <1>;
        };
    };

...
```

## Documentation/devicetree/bindings/mailbox/thead,th1520-mbox.yaml
```yaml
# SPDX-License-Identifier: (GPL-2.0-only OR BSD-2-Clause)
%YAML 1.2
---
$id: http://devicetree.org/schemas/mailbox/thead,th1520-mbox.yaml#
$schema: http://devicetree.org/meta-schemas/core.yaml#

title: T-head TH1520 Mailbox Controller

description:
  The T-head mailbox controller enables communication and coordination between
  cores within the SoC by passing messages (e.g., data, status, and control)
  through mailbox channels. It also allows one core to signal another processor
  using interrupts via the Interrupt Controller Unit (ICU).

  The SoC is divided to two worlds, REE and TEE, although it's currently unknown
  how to enable the seperation between worlds so the seperation does not exist
  yet. However each mailbox is assigned to a certain world, and register windows
  for mailboxes are assigned to different worlds too. In a certain world's
  register windows for mailboxes, only mailboxes assigned to this world will
  have the local ICU part mapped (in addition to the remote ICU part of the
  other same-world mailbox), and mailboxes assigned to the other world have
  only the coressponding remote ICU part mapped to this world. Two mailboxes
  (C910T and E902) are assigned to the TEE world and two mailboxes (C906 and
  C910R) are assigned to the REE world.

maintainers:
  - Michal Wilczynski <m.wilczynski@samsung.com>

properties:
  compatible:
    const: thead,th1520-mbox

  clocks:
    items:
      - description: Clock for the local mailbox
      - description: Clock for the other mailbox in the same world
      - description: Clock for the first mailbox in the other world
      - description: Clock for the second mailbox in the other world

  clock-names:
    items:
      - const: clk-local
      - const: clk-remote-icu0
      - const: clk-remote-icu1
      - const: clk-remote-icu2

  reg:
    items:
      - description: Base address of this specific mailbox
      - description: Base address of the other mailbox in the same world
      - description:
          Base address of the register window in this world corresponding to the
          first other-world mailbox.
      - description:
          Base address of the register window in this world corresponding to the
          second other-world mailbox.

  reg-names:
    items:
      - const: local
      - const: remote-icu0
      - const: remote-icu1
      - const: remote-icu2

  interrupts:
    maxItems: 1

  thead,mbox-id:
    $ref: /schemas/types.yaml#/definitions/uint32
    description:
      The ID of this specific mailbox that this device tree node describes. For
      compatibility with old device trees, if missing, the ID is default to 0,
      the C910T mailbox.

  '#mbox-cells':
    const: 1
    description:
      The one and only cell describes destination mailbox ID.

required:
  - compatible
  - clocks
  - clock-names
  - reg
  - reg-names
  - interrupts
  - '#mbox-cells'

additionalProperties: false

examples:
  - |
    #include <dt-bindings/clock/thead,th1520-clk-ap.h>
    soc {
      #address-cells = <2>;
      #size-cells = <2>;
      mbox_c910t: mailbox@ffffc38000 {
        compatible = "thead,th1520-mbox";
        reg = <0xff 0xffc38000 0x0 0x6000>,
              <0xff 0xffc44000 0x0 0x6000>,
              <0xff 0xffc4c000 0x0 0x2000>,
              <0xff 0xffc54000 0x0 0x2000>;
        reg-names = "local", "remote-icu0", "remote-icu1", "remote-icu2";
        clocks = <&clk CLK_MBOX0>, <&clk CLK_MBOX1>, <&clk CLK_MBOX2>,
                 <&clk CLK_MBOX3>;
        clock-names = "clk-local", "clk-remote-icu0", "clk-remote-icu1",
                      "clk-remote-icu2";
        interrupts = <28>;
        #mbox-cells = <1>;
        thead,mbox-id = <0>;
      };
    };
```
