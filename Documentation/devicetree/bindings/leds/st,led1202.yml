## Documentation/devicetree/bindings/leds/ti,lp5812.yaml
```yaml
# SPDX-License-Identifier: (GPL-2.0-only OR BSD-2-Clause)
%YAML 1.2
---
$id: http://devicetree.org/schemas/leds/ti,lp5812.yaml#
$schema: http://devicetree.org/meta-schemas/core.yaml#

title: TI LP5812 4x3 Matrix RGB LED Driver with Autonomous Control

maintainers:
  - Nam Tran <trannamatk@gmail.com>

description: |
  The LP5812 is a 4x3 matrix RGB LED driver with I2C interface
  and autonomous animation engine control.
  For more product information please see the link below:
  https://www.ti.com/product/LP5812#tech-docs

properties:
  compatible:
    const: ti,lp5812

  reg:
    maxItems: 1

  ti,operation-mode:
    description: |
      Selects the LED operation mode of the LP5812. The device supports
      three modes:
        - Direct-drive mode ("direct_mode") drives up to 4 LEDs directly
        by internal current sinks (LED0-LED3).
        - TCM-drive mode ("tcmscan:<n>:<order...>") drives up to 12 LEDs
        (4 RGB) using 1-4 scan multiplexing. The <n> specifies the number
        of scans (1-4), and <order...> defines the scan order of the outputs.
        - Mix-drive mode ("mixscan:<n>:<direct>:<order...>") combines
        direct-drive and TCM-drive outputs. The <n> specifies the number
        of scans, <direct> selects the direct-drive outputs, and <order...>
        defines the scan order.
    $ref: /schemas/types.yaml#/definitions/string
    enum:
      - direct_mode
      - tcmscan:1:0
      - tcmscan:1:1
      - tcmscan:1:2
      - tcmscan:1:3
      - tcmscan:2:0:1
      - tcmscan:2:0:2
      - tcmscan:2:0:3
      - tcmscan:2:1:2
      - tcmscan:2:1:3
      - tcmscan:2:2:3
      - tcmscan:3:0:1:2
      - tcmscan:3:0:1:3
      - tcmscan:3:0:2:3
      - tcmscan:4:0:1:2:3
      - mixscan:1:0:1
      - mixscan:1:0:2
      - mixscan:1:0:3
      - mixscan:1:1:0
      - mixscan:1:1:2
      - mixscan:1:1:3
      - mixscan:1:2:0
      - mixscan:1:2:1
      - mixscan:1:2:3
      - mixscan:1:3:0
      - mixscan:1:3:1
      - mixscan:1:3:2
      - mixscan:2:0:1:2
      - mixscan:2:0:1:3
      - mixscan:2:0:2:3
      - mixscan:2:1:0:2
      - mixscan:2:1:0:3
      - mixscan:2:1:2:3
      - mixscan:2:2:0:1
      - mixscan:2:2:0:3
      - mixscan:2:2:1:3
      - mixscan:2:3:0:1
      - mixscan:2:3:0:2
      - mixscan:2:3:1:2
      - mixscan:3:0:1:2:3
      - mixscan:3:1:0:2:3
      - mixscan:3:2:0:1:3
      - mixscan:3:3:0:1:2

  vcc-supply:
    description: Regulator providing power to the 'VCC' pin.

  "#address-cells":
    const: 1

  "#size-cells":
    const: 0

patternProperties:
  "^led@[0-3]$":
    type: object
    $ref: common.yaml#
    unevaluatedProperties: false

    properties:
      reg:
        minimum: 0
        maximum: 3

    required:
      - reg

  "^multi-led@[4-7]$":
    type: object
    $ref: leds-class-multicolor.yaml#
    unevaluatedProperties: false

    properties:
      reg:
        minimum: 4
        maximum: 7

      "#address-cells":
        const: 1

      "#size-cells":
        const: 0

    patternProperties:
      "^led@[4-9a-f]$":
        type: object
        $ref: common.yaml#
        unevaluatedProperties: false

        properties:
          reg:
            minimum: 4
            maximum: 15

        required:
          - reg

required:
  - compatible
  - reg
  - ti,operation-mode

additionalProperties: false

examples:
  - |
    #include <dt-bindings/leds/common.h>

    i2c {
        #address-cells = <1>;
        #size-cells = <0>;

        led-controller@1b {
            #address-cells = <1>;
            #size-cells = <0>;
            compatible = "ti,lp5812";
            reg = <0x1b>;
            ti,operation-mode = "tcmscan:4:0:1:2:3";
            vcc-supply = <&vdd_3v3_reg>;

            led@0 {
                reg = <0x0>;
                label = "LED0";
                led-max-microamp = <25500>;
            };

            led@1 {
                reg = <0x1>;
                label = "LED1";
                led-max-microamp = <25500>;
            };

            led@2 {
                reg = <0x2>;
                label = "LED2";
                led-max-microamp = <25500>;
            };

            led@3 {
                reg = <0x3>;
                label = "LED3";
                led-max-microamp = <25500>;
            };

            multi-led@4 {
                #address-cells = <1>;
                #size-cells = <0>;
                reg = <0x4>;
                color = <LED_COLOR_ID_RGB>;
                label = "LED_A";

                led@4 {
                    reg = <0x4>;
                    color = <LED_COLOR_ID_GREEN>;
                    led-max-microamp = <25500>;
                };

                led@5 {
                    reg = <0x5>;
                    color = <LED_COLOR_ID_RED>;
                    led-max-microamp = <25500>;
                };

                led@6 {
                    reg = <0x6>;
                    color = <LED_COLOR_ID_BLUE>;
                    led-max-microamp = <25500>;
                };
            };

            multi-led@5 {
                #address-cells = <1>;
                #size-cells = <0>;
                reg = <0x5>;
                color = <LED_COLOR_ID_RGB>;
                label = "LED_B";

                led@7 {
                    reg = <0x7>;
                    color = <LED_COLOR_ID_GREEN>;
                    led-max-microamp = <25500>;
                };

                led@8 {
                    reg = <0x8>;
                    color = <LED_COLOR_ID_RED>;
                    led-max-microamp = <25500>;
                };

                led@9 {
                    reg = <0x9>;
                    color = <LED_COLOR_ID_BLUE>;
                    led-max-microamp = <25500>;
                };
            };

            multi-led@6 {
                #address-cells = <1>;
                #size-cells = <0>;
                reg = <0x6>;
                color = <LED_COLOR_ID_RGB>;
                label = "LED_C";

                led@a {
                    reg = <0xa>;
                    color = <LED_COLOR_ID_GREEN>;
                    led-max-microamp = <25500>;
                };

                led@b {
                    reg = <0xb>;
                    color = <LED_COLOR_ID_RED>;
                    led-max-microamp = <25500>;
                };

                led@c {
                    reg = <0xc>;
                    color = <LED_COLOR_ID_BLUE>;
                    led-max-microamp = <25500>;
                };
            };

            multi-led@7 {
                #address-cells = <1>;
                #size-cells = <0>;
                reg = <0x7>;
                color = <LED_COLOR_ID_RGB>;
                label = "LED_D";

                led@d {
                    reg = <0xd>;
                    color = <LED_COLOR_ID_GREEN>;
                    led-max-microamp = <25500>;
                };

                led@e {
                    reg = <0xe>;
                    color = <LED_COLOR_ID_RED>;
                    led-max-microamp = <25500>;
                };

                led@f {
                    reg = <0xf>;
                    color = <LED_COLOR_ID_BLUE>;
                    led-max-microamp = <25500>;
                };
            };
        };
    };

...
```

## Documentation/devicetree/bindings/leds/ti,tps6131x.yaml
```yaml
# SPDX-License-Identifier: (GPL-2.0-only OR BSD-2-Clause)
%YAML 1.2
---
$id: http://devicetree.org/schemas/leds/ti,tps6131x.yaml#
$schema: http://devicetree.org/meta-schemas/core.yaml#

title: Texas Instruments TPS6131X flash LED driver

maintainers:
  - Matthias Fend <matthias.fend@emfend.at>

description: |
  The TPS61310/TPS61311 is a flash LED driver with I2C interface.
  Its power stage is capable of supplying a maximum total current of roughly 1500mA.
  The TPS6131x provides three constant-current sinks, capable of sinking
  up to 2 × 400mA (LED1 and LED3) and 800mA (LED2) in flash mode.
  In torch mode, each sink (LED1, LED2, LED3) supports currents up to 175mA.

  The data sheet can be found at:
    https://www.ti.com/lit/ds/symlink/tps61310.pdf

properties:
  compatible:
    enum:
      - ti,tps61310
      - ti,tps61311

  reg:
    maxItems: 1

  '#address-cells':
    const: 1

  '#size-cells':
    const: 0

  reset-gpios:
    maxItems: 1
    description: GPIO connected to NRESET pin

  ti,valley-current-limit:
    type: boolean
    description:
      Reduce the valley peak current limit from 1750mA to 1250mA (TPS61310) or
      from 2480mA to 1800mA (TPS61311).

  led:
    type: object
    $ref: common.yaml#
    unevaluatedProperties: false

    properties:
      led-sources:
        allOf:
          - minItems: 1
            maxItems: 3
            items:
              enum: [1, 2, 3]

      led-max-microamp:
        anyOf:
          - minimum: 25000
            maximum: 350000
            multipleOf: 50000
          - minimum: 25000
            maximum: 525000
            multipleOf: 25000

      flash-max-microamp:
        anyOf:
          - minimum: 25000
            maximum: 800000
            multipleOf: 50000
          - minimum: 25000
            maximum: 1500000
            multipleOf: 25000

      flash-max-timeout-us:
        enum: [ 5300, 10700, 16000, 21300, 26600, 32000, 37300, 68200, 71500,
                102200, 136300, 170400, 204500, 340800, 579300, 852000 ]

    required:
      - led-sources
      - led-max-microamp
      - flash-max-microamp
      - flash-max-timeout-us

required:
  - compatible
  - reg
  - '#address-cells'
  - '#size-cells'
  - led

additionalProperties: false

examples:
  - |
    #include <dt-bindings/leds/common.h>
    #include <dt-bindings/gpio/gpio.h>

    i2c {
      #address-cells = <1>;
      #size-cells = <0>;

      led-controller@33 {
        compatible = "ti,tps61310";
        reg = <0x33>;
        #address-cells = <1>;
        #size-cells = <0>;

        reset-gpios = <&gpio1 0 GPIO_ACTIVE_LOW>;

        tps61310_flash: led {
          function = LED_FUNCTION_FLASH;
          color = <LED_COLOR_ID_WHITE>;
          led-sources = <1>, <2>, <3>;
          led-max-microamp = <525000>;
          flash-max-microamp = <1500000>;
          flash-max-timeout-us = <852000>;
        };
      };
    };
```

## Documentation/devicetree/bindings/mailbox/allwinner,sun55i-a523-msgbox.yaml
```yaml
# SPDX-License-Identifier: GPL-2.0-only OR BSD-2-Clause
%YAML 1.2
---
$id: http://devicetree.org/schemas/mailbox/allwinner,sun55i-a523-msgbox.yaml#
$schema: http://devicetree.org/meta-schemas/core.yaml#

title: Allwinner sun55i 4-Port Message Box

maintainers:
  - Tim Michals <tcmichals@gmail.com>
  - Samuel Holland <samuel@sholland.org>

description: |
  The hardware message box on sun55i (A523, A527, T527) and sun60i (A733)
  SoCs is a 4-port multi-processor mailbox controller connecting the ARM
  Cortex-A55 host cluster, HiFi4 Audio DSP, Power Management Unit (CPUS),
  and XuanTie RISC-V co-processor.

  It features independent 256-byte register banks for each processor port,
  12 logical channels on the host (4 per remote processor), and 8-entry
  hardware FIFOs with level interrupts.

properties:
  compatible:
    enum:
      - allwinner,sun55i-a523-msgbox
      - allwinner,sun55i-t527-msgbox
      - allwinner,sun60i-a733-msgbox

  reg:
    minItems: 4
    maxItems: 4
    description: |
      Register banks for each of the four processor ports. Each port has
      an independent 256-byte register bank.

  reg-names:
    items:
      - const: arm
      - const: dsp
      - const: cpus
      - const: rv

  clocks:
    maxItems: 1
    description: bus clock

  resets:
    maxItems: 1
    description: bus reset

  interrupts:
    minItems: 1
    maxItems: 4
    description: |
      One interrupt per processor port. The host port interrupt is required;
      remote port interrupts are optional.

  '#mbox-cells':
    const: 1
    description: "channel number (0-11: 0-3 CPUS, 4-7 DSP, 8-11 RISC-V)"

required:
  - compatible
  - reg
  - reg-names
  - clocks
  - resets
  - interrupts
  - '#mbox-cells'

additionalProperties: false

examples:
  - |
    #include <dt-bindings/interrupt-controller/arm-gic.h>

    mailbox@3003000 {
        compatible = "allwinner,sun55i-a523-msgbox";
        reg = <0x03003000 0x1000>,
              <0x07094000 0x1000>,
              <0x07120000 0x1000>,
              <0x07136000 0x1000>;
        reg-names = "arm", "dsp", "cpus", "rv";
        clocks = <&ccu 120>;
        resets = <&ccu 45>;
        interrupts = <GIC_SPI 0 IRQ_TYPE_LEVEL_HIGH>,
                     <GIC_SPI 1 IRQ_TYPE_LEVEL_HIGH>,
                     <GIC_SPI 181 IRQ_TYPE_LEVEL_HIGH>,
                     <GIC_SPI 174 IRQ_TYPE_LEVEL_HIGH>;
        #mbox-cells = <1>;
    };
```

## Documentation/devicetree/bindings/mailbox/apple,dockchannel.yaml
```yaml
# SPDX-License-Identifier: (GPL-2.0-only OR BSD-2-Clause)
%YAML 1.2
---
$id: http://devicetree.org/schemas/mailbox/apple,dockchannel.yaml#
$schema: http://devicetree.org/meta-schemas/core.yaml#

title: Apple DockChannel FIFO Mailbox

maintainers:
  - Michael Reeves <michael.reeves077@gmail.com>

description:
  DockChannel is a hardware FIFO and interrupt block used on Apple SoCs for
  low-latency byte stream communication with co-processors.

properties:
  compatible:
    oneOf:
      - items:
          - const: apple,t8112-dockchannel
      - items:
          - enum:
              - apple,t6020-dockchannel
              - apple,t8122-dockchannel
          - const: apple,t8112-dockchannel

  reg:
    items:
      - description: Interrupt control registers
      - description: FIFO configuration registers
      - description: FIFO data registers

  reg-names:
    items:
      - const: irq
      - const: config
      - const: data

  interrupts:
    maxItems: 1

  "#mbox-cells":
    const: 0

  nonposted-mmio: true

required:
  - compatible
  - reg
  - reg-names
  - interrupts
  - "#mbox-cells"

additionalProperties: false

examples:
  - |
    #include <dt-bindings/interrupt-controller/apple-aic.h>
    #include <dt-bindings/interrupt-controller/irq.h>

    soc {
        #address-cells = <2>;
        #size-cells = <2>;

        mailbox@24eb14000 {
            compatible = "apple,t8112-dockchannel";
            reg = <0x2 0x4eb14000 0x0 0x4000>,
                  <0x2 0x4eb30000 0x0 0x4000>,
                  <0x2 0x4eb34000 0x0 0x4000>;
            reg-names = "irq", "config", "data";
            interrupt-parent = <&aic>;
            interrupts = <AIC_IRQ 850 IRQ_TYPE_LEVEL_HIGH>;
            #mbox-cells = <0>;
        };
    };
```
