## Documentation/devicetree/bindings/leds/brcm,bcm6358-leds.yaml
```yaml
# SPDX-License-Identifier: (GPL-2.0 OR BSD-2-Clause)
%YAML 1.2
---
$id: http://devicetree.org/schemas/leds/brcm,bcm6358-leds.yaml#
$schema: http://devicetree.org/meta-schemas/core.yaml#

title: LEDs connected to Broadcom BCM6358 controller

description: This controller is present on BCM6358 and
  BCM6368. In these SoCs there are Serial LEDs (LEDs
  connected to a 74x164 controller), which can either be
  controlled by software (exporting the 74x164 as spi-gpio) 
  or by hardware using this driver. See example at
  Documentation/devicetree/bindings/gpio/fairchild,74hc595.yaml.

maintainers:
  - Jonas Gorski <jonas.gorski@gmail.com>

properties:
  compatible:
    const: brcm,bcm6358-leds

  reg:
    maxItems: 1

  '#address-cells':
    const: 1

  '#size-cells':
    const: 0

  brcm,clk-div:
    description: SCK signal Divider. Default 1
    $ref: /schemas/types.yaml#/definitions/uint32
    enum: [1, 2, 4, 8]

  brcm,clk-dat-low:
    description: Makes clock and data signals active low.
      Default false.
    type: boolean

patternProperties:
  "^led@[0,1]?([0-9]|[a-z])$":
    type: object
    $ref: common.yaml
    description: Each LED is represented as a sub-node of
      this device.

    properties:
      reg:
        description: LED pin number
        maximum: 31
        minimum: 0

    required:
      - reg

required:
  - compatible
  - reg
  - "#address-cells"
  - "#size-cells"

additionalProperties: true

examples:
  - |
    #include <dt-bindings/leds/common.h>

    /* The bcm6358 SOC */
    soc {
        #address-cells = <1>;
        #size-cells = <1>;

        led-controller@fffe00d0 {
            compatible = "brcm,bcm6358-leds";
            #address-cells = <1>;
            #size-cells = <0>;
            reg = <0xfffe00d0 0x8>;

            alarm_white@0 {
                reg = <0>;
                active-low;
                label = "white:alarm";
            };
            tv_white@2 {
                reg = <2>;
                active-low;
                label = "white:tv";
            };
            tel_white@3 {
                reg = <3>;
                active-low;
                label = "white:tel";
            };
            adsl_white@4 {
                reg = <4>;
                active-low;
                label = "white:adsl";
            };
        };
    };
  - |
    /* The bcm6368 SOC */
    led-controller@100000d0 {
        compatible = "brcm,bcm6358-leds";
        #address-cells = <1>;
        #size-cells = <0>;
        reg = <0x100000d0 0x8>;

        brcm,pol-low;
        brcm,clk-div = <4>;

        power_red@0 {
            reg = <0>;
            active-low;
            label = "red:power";
        };
        power_green@1 {
            reg = <1>;
            active-low;
            label = "green:power";
            default-state = "on";
        };
        power_blue@2 {
            reg = <2>;
            label = "blue:power";
        };
        broadband_red@3 {
            reg = <3>;
            active-low;
            label = "red:broadband";
        };
        broadband_green@4 {
            reg = <4>;
            label = "green:broadband";
        };
        broadband_blue@5 {
            reg = <5>;
            active-low;
            label = "blue:broadband";
        };
        wireless_red@6 {
            reg = <6>;
            active-low;
            label = "red:wireless";
        };
        wireless_green@7 {
            reg = <7>;
            active-low;
            label = "green:wireless";
        };
        wireless_blue@8 {
            reg = <8>;
            label = "blue:wireless";
        };
        phone_red@9 {
            reg = <9>;
            active-low;
            label = "red:phone";
        };
        phone_green@10 {
            reg = <10>;
            active-low;
            label = "green:phone";
        };
        phone_blue@11 {
            reg = <11>;
            label = "blue:phone";
        };
        upgrading_red@12 {
            reg = <12>;
            active-low;
            label = "red:upgrading";
        };
        upgrading_green@13 {
            reg = <13>;
            active-low;
            label = "green:upgrading";
        };
        upgrading_blue@14 {
            reg = <14>;
            label = "blue:upgrading";
        };
    };
...
```

## Documentation/devicetree/bindings/leds/brcm,bcmbca-leds.yaml
```yaml
# SPDX-License-Identifier: GPL-2.0-only OR BSD-2-Clause
%YAML 1.2
---
$id: http://devicetree.org/schemas/leds/brcm,bcmbca-leds.yaml#
$schema: http://devicetree.org/meta-schemas/core.yaml#

title: Broadcom BCMBCA LEDs

maintainers:
  - Linus Walleij <linus.walleij@linaro.org>

description: |
  The Broadcom BCA (Broadband Access) SoCs have a LED control
  block that can support either parallel (directly connected)
  LEDs or serial (connected to 1-4 shift registers) LEDs.
  The LEDs can optionally be hardware-triggered by ethernet port
  traffic.

properties:
  compatible:
    const: brcm,bcmbca-leds

  reg:
    maxItems: 1

  "#address-cells":
    const: 1

  "#size-cells":
    const: 0

  brcm,serial-shifters:
    $ref: /schemas/types.yaml#/definitions/uint32
    description:
      This describes the number of 8-bit serial shifters
      connected to the LED controller block. If this property
      is definied, it is implicit that the driver is using
      serial LED control, if it is missing, parallel LED
      control is assumed.

patternProperties:
  "^led@[0-9a-f]+$":
    type: object
    $ref: common.yaml#
    unevaluatedProperties: false

    properties:
      reg:
        minimum: 0

    required:
      - reg

required:
  - compatible
  - reg

additionalProperties: false

examples:
  - |
    #include <dt-bindings/leds/common.h>

    soc {
        #address-cells = <1>;
        #size-cells = <1>;

        led-controller@800 {
            #address-cells = <1>;
            #size-cells = <0>;
            compatible = "brcm,bcmbca-leds";
            reg = <0x800 0xc8>;

            led@0 {
                reg = <0>;
                active-low;
                function = "ext";
                color = <LED_COLOR_ID_GREEN>;
            };

            led@1 {
                reg = <1>;
                active-low;
                function = "ext";
                color = <LED_COLOR_ID_AMBER>;
            };
        };
    };
```

## Documentation/devicetree/bindings/leds/issi,is31fl3236.yaml
```yaml
# SPDX-License-Identifier: (GPL-2.0-only OR BSD-2-Clause)
%YAML 1.2
---
$id: http://devicetree.org/schemas/leds/issi,is31fl3236.yaml#
$schema: http://devicetree.org/meta-schemas/core.yaml#

title: is31fl32xx and Si-En SN32xx IC LED driver

maintainers:
  - Pavel Machek <pavel@ucw.cz>
  - Lee Jones <lee@kernel.org>

description: |
  The is31fl32xx/SN32xx family of LED drivers are I2C devices with multiple
  constant-current channels, each with independent 256-level PWM control.
  Each LED is represented as a sub-node of the device.

  For more product information please see the links below:
    https://www.lumissil.com/assets/pdf/core/IS31FL3216_DS.pdf
    https://www.lumissil.com/assets/pdf/core/IS31FL3218_DS.pdf
    https://www.lumissil.com/assets/pdf/core/IS31FL3235_DS.pdf
    https://www.lumissil.com/assets/pdf/core/IS31FL3236_DS.pdf

properties:
  compatible:
    enum:
      - issi,is31fl3216
      - issi,is31fl3218
      - issi,is31fl3235
      - issi,is31fl3236
      - si-en,sn3216
      - si-en,sn3218

  reg:
    maxItems: 1

  "#address-cells":
    const: 1

  "#size-cells":
    const: 0

patternProperties:
  "^led@([1-9a-f]|1[0-9a-f]|2[0-4])$":
    type: object
    $ref: common.yaml#
    unevaluatedProperties: false

    properties:
      reg:
        description:
          LED channel number (1..N)
        minimum: 1
        maximum: 36

    required:
      - reg

required:
  - compatible
  - reg
  - "#size-cells"
  - "#address-cells"

additionalProperties: false

examples:
  - |
    #include <dt-bindings/leds/common.h>

    i2c {
        #address-cells = <1>;
        #size-cells = <0>;

        led-controller@3c {
            compatible = "issi,is31fl3236";
            reg = <0x3c>;
            #address-cells = <1>;
            #size-cells = <0>;

            led@1 {
                reg = <1>;
                label = "led1:red";
            };
            led@2 {
                reg = <2>;
                label = "led1:green";
            };
            led@3 {
                reg = <3>;
                label = "led1:blue";
            };
        };
    };
...
```

## Documentation/devicetree/bindings/leds/issi,is31fl32xx.yaml
```yaml
# SPDX-License-Identifier: (GPL-2.0-only OR BSD-2-Clause)
%YAML 1.2
---
$id: http://devicetree.org/schemas/leds/issi,is31fl32xx.yaml#
$schema: http://devicetree.org/meta-schemas/core.yaml#

title: IS31FL32xx and Si-En SN32xx LED controller

maintainers:
  - Lucca Fachinetti <luccafachinetti@gmail.com>
  - Pavel Machek <pavel@ucw.cz>
  - Jun Yan <jerrysteve1101@gmail.com>

description: |
  The IS31FL32xx/SN32xx family of LED drivers are I2C devices with multiple
  constant-current channels, each with independent 256-level PWM control.
  Each LED is represented as a sub-node of the device.

  For more product information please see the links below:
    https://www.lumissil.com/assets/pdf/core/IS31FL3216_DS.pdf
    https://www.lumissil.com/assets/pdf/core/IS31FL3218_DS.pdf
    https://www.lumissil.com/assets/pdf/core/IS31FL3235_DS.pdf
    https://www.lumissil.com/assets/pdf/core/IS31FL3236_DS.pdf
    https://www.lumissil.com/assets/pdf/core/IS31FL3236A_DS.pdf
    https://www.lumissil.com/assets/pdf/core/IS31FL3293_DS.pdf

properties:
  compatible:
    enum:
      - issi,is31fl3216
      - issi,is31fl3218
      - issi,is31fl3235
      - issi,is31fl3236
      - issi,is31fl3236a
      - issi,is31fl3293
      - si-en,sn3216
      - si-en,sn3218

  reg:
    maxItems: 1

  issi,22khz-pwm:
    type: boolean
    description:
      When present, the chip's PWM will operate at ~22kHz as opposed
      to ~3kHz to move the operating frequency out of the audible range.

  "#address-cells":
    const: 1

  "#size-cells":
    const: 0

patternProperties:
  "^led@([1-9a-f]|1[0-9a-f]|2[0-4])$":
    type: object
    $ref: common.yaml#
    unevaluatedProperties: false

    properties:
      reg:
        description:
          LED channel number (1..N)
        minimum: 1
        maximum: 36

    required:
      - reg

allOf:
  - if:
      properties:
        compatible:
          contains:
            enum:
              - issi,is31fl3216
              - issi,is31fl3218
              - issi,is31fl3235
              - issi,is31fl3236
              - issi,is31fl3293
              - si-en,sn3216
              - si-en,sn3218
    then:
      properties:
        issi,22khz-pwm: false

  - if:
      properties:
        compatible:
          contains:
            enum:
              - issi,is31fl3293
    then:
      patternProperties:
        "^led@":
          properties:
            reg:
              maximum: 3
  - if:
      properties:
        compatible:
          contains:
            enum:
              - issi,is31fl3216
              - si-en,sn3216
    then:
      patternProperties:
        "^led@":
          properties:
            reg:
              maximum: 16
  - if:
      properties:
        compatible:
          contains:
            enum:
              - issi,is31fl3218
              - si-en,sn3218
    then:
      patternProperties:
        "^led@":
          properties:
            reg:
              maximum: 18
  - if:
      properties:
        compatible:
          contains:
            enum:
              - issi,is31fl3235
    then:
      patternProperties:
        "^led@":
          properties:
            reg:
              maximum: 28

required:
  - compatible
  - reg
  - "#address-cells"
  - "#size-cells"

additionalProperties: false

examples:
  - |
    #include <dt-bindings/leds/common.h>

    i2c {
        #address-cells = <1>;
        #size-cells = <0>;

        led-controller@3c {
            compatible = "issi,is31fl3236";
            reg = <0x3c>;
            #address-cells = <1>;
            #size-cells = <0>;

            led@1 {
                reg = <1>;
                color = <LED_COLOR_ID_RED>;
                function = LED_FUNCTION_STATUS;
            };

            led@5 {
                reg = <5>;
                color = <LED_COLOR_ID_GREEN>;
                function = LED_FUNCTION_POWER;
                linux,default-trigger = "default-on";
            };
        };
    };
...
```
