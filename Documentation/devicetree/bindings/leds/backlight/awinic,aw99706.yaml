## Documentation/devicetree/bindings/leds/leds-class-virtualcolor.yaml
```yaml
# SPDX-License-Identifier: (GPL-2.0-only OR BSD-2-Clause)
%YAML 1.2
---
$id: http://devicetree.org/schemas/leds/leds-class-virtualcolor.yaml#
$schema: http://devicetree.org/meta-schemas/core.yaml#

title: Virtual LED class device with priority-based arbitration

maintainers:
  - Jonathan Brophy <professor_jonny@hotmail.com>

description: |
  Represents a single virtual LED that combines one or more physical monochromatic
  LEDs. Multiple virtual LEDs can share the same physical LEDs, with priority-based
  arbitration determining which virtual LED's state is displayed.

  The driver implements winner-takes-all arbitration:
  - Only virtual LEDs with brightness > 0 participate in arbitration
  - Highest priority wins (ties broken by sequence number - most recent wins)
  - Winner controls ALL physical LEDs
  - Physical LEDs not used by winner are turned off

  Two operating modes are supported:

  1. Multicolor mode (default):
     - Full multicolor LED ABI support
     - Exposes multi_intensity, multi_index, multi_multipliers in sysfs
     - Per-channel intensity control (0-255)
     - Channel multipliers for color temperature adjustment
     - Master brightness scales all channels proportionally

  2. Standard mode:
     - Fixed color ratios via mc-channel-multipliers
     - Only brightness control available (no intensity changes)
     - Useful for fixed-color LEDs (e.g., warm white, amber)

  Sysfs interface (multicolor mode):
  - /sys/class/leds/<led>/brightness - Master brightness (0-max_brightness)
  - /sys/class/leds/<led>/mc/multi_intensity - Per-channel intensities (space-separated)
  - /sys/class/leds/<led>/mc/multi_index - Color IDs per channel (read-only)
  - /sys/class/leds/<led>/mc/multi_multipliers - Channel multipliers (read-only)

properties:
  $nodename:
    pattern: "^virtual-led(@[0-9a-f])?$"

  reg:
    maxItems: 1
    description: |
      Unique index of this virtual LED within the controller. Used for node addressing.

  function:
    description: |
      LED function identifier. recommended to use: LED_FUNCTION_VIRTUAL_STATUS,
      See include/dt-bindings/leds/common.h

  priority:
    $ref: /schemas/types.yaml#/definitions/uint32
    default: 0
    minimum: 0
    maximum: 2147483647
    description: |
      Arbitration priority for this virtual LED (signed 32-bit integer).
      When multiple virtual LEDs sharing physical LEDs are active (brightness > 0),
      only the highest-priority LED's state is displayed.

      Tie-breaking: If priorities are equal, the most recently updated virtual LED wins.

      Suggested priority ranges:
        0-99:   Normal operation indicators
        100-499: System state indicators (boot, shutdown)
        500-999: Warning/error indicators
        1000+:   Critical alerts and emergency overrides

  led-mode:
    $ref: /schemas/types.yaml#/definitions/string
    enum: [multicolor, standard]
    default: multicolor
    description: |
      Operating mode for this virtual LED:

      - "multicolor": (default) Full multicolor ABI with dynamic intensity control
        * Exposes multi_intensity sysfs attribute for per-channel control
        * Channels can be adjusted independently at runtime
        * Suitable for RGB LEDs, color-changing indicators

      - "standard": Fixed color ratios, brightness-only control
        * Channel intensities fixed by mc-channel-multipliers
        * Only brightness sysfs attribute available (no multi_intensity)
        * Suitable for warm white, amber, or other fixed-color LEDs

  leds:
    $ref: /schemas/types.yaml#/definitions/phandle-array
    minItems: 1
    maxItems: 255
    description: |
      Array of phandles to physical LED devices that compose this virtual LED.
      LEDs are automatically grouped by their 'color' property into channels.

      Channel ordering: Channels are ordered by ascending LED_COLOR_ID value.
      Only colors present in the LED list are included (no sparse indices).

      Color ID values (from include/dt-bindings/leds/common.h):
        LED_COLOR_ID_WHITE = 0
        LED_COLOR_ID_RED = 1
        LED_COLOR_ID_GREEN = 2
        LED_COLOR_ID_BLUE = 3
        LED_COLOR_ID_AMBER = 4
        LED_COLOR_ID_VIOLET = 5
        LED_COLOR_ID_YELLOW = 6
        LED_COLOR_ID_IR = 7
        ... (see header for complete list)

      The /sys/class/leds/<led>/mc/multi_index file reports the color ID for
      each channel, allowing userspace to verify the ordering.

      Supported LED types:
      - GPIO LEDs (gpio-leds compatible)
      - PWM LEDs (pwm-leds compatible)
      - I2C/SPI LED controllers (any with brightness_set or brightness_set_blocking)

      Example 1 - RGB LED:
        leds = <&led_red>, <&led_green>, <&led_blue>;
        Results in 3 channels: [0]=red (ID 1), [1]=green (ID 2), [2]=blue (ID 3)

      Example 2 - RGBW LED:
        leds = <&led_red>, <&led_green>, <&led_blue>, <&led_white>;
        Results in 4 channels: [0]=white (ID 0), [1]=red (ID 1), [2]=green (ID 2), [3]=blue (ID 3)
        Note: White comes first because LED_COLOR_ID_WHITE = 0

      Example 3 - Non-contiguous IDs:
        leds = <&led_amber>, <&led_red>;
        Results in 2 channels: [0]=red (ID 1), [1]=amber (ID 4)

      Userspace verification:
        $ cat /sys/class/leds/status:multi/mc/multi_index
        1 2 3
        # Confirms: [0]=red, [1]=green, [2]=blue

  mc-channel-multipliers:
    $ref: /schemas/types.yaml#/definitions/uint32-array
    minItems: 1
    maxItems: 255
    description: |
      Per-channel brightness multipliers (0-255) for color temperature adjustment
      and normalization. Array must have one entry per channel.

      Channel ordering: Array indices must match the channel order, which is
      determined by ascending LED_COLOR_ID value. Only colors present in the
      'leds' property are included.

      For predictable DT configuration, list multipliers in ascending color ID order.
      The /sys/class/leds/<led>/mc/multi_index file can verify the ordering at runtime.

      In multicolor mode:
        - Scales the intensity value before applying brightness
        - Formula: final = (intensity * multiplier / 255) * brightness / max_brightness
        - Useful for: Color temperature control, vendor normalization, power limiting
        - Default: 255 (no scaling) for all channels if omitted

      In standard mode:
        - Defines the FIXED color ratios (intensity changes not allowed)
        - Formula: final = multiplier * brightness / max_brightness
        - Useful for: Fixed-color LEDs (warm white, amber)
        - REQUIRED in standard mode

      Example 1 - RGB with equal scaling:
        leds = <&red>, <&green>, <&blue>;
        mc-channel-multipliers = <255 255 255>;
        # Channels: [0]=red, [1]=green, [2]=blue - all at full scale

      Example 2 - RGBW warm white (standard mode):
        leds = <&red>, <&green>, <&blue>, <&white>;
        mc-channel-multipliers = <180 255 200 100>;
        # Channels: [0]=white:180, [1]=red:255, [2]=green:200, [3]=blue:100
        # Note: White (ID=0) comes first, then red (ID=1), green (ID=2), blue (ID=3)

      Example 3 - Color temperature adjustment:
        leds = <&red>, <&green>, <&blue>;
        mc-channel-multipliers = <255 180 100>;
        # Creates warm white by reducing green/blue relative to red

required:
  - reg
  - leds

allOf:
  - $ref: common.yaml#
  - if:
      properties:
        led-mode:
          const: standard
    then:
      required:
        - mc-channel-multipliers

unevaluatedProperties: false
```

## Documentation/devicetree/bindings/leds/leds-consumer.yaml
```yaml
# SPDX-License-Identifier: (GPL-2.0-only OR BSD-2-Clause)
%YAML 1.2
---
$id: http://devicetree.org/schemas/leds/leds-consumer.yaml#
$schema: http://devicetree.org/meta-schemas/core.yaml#

title: Common leds consumer

maintainers:
  - Aleksandrs Vinarskis <alex@vinarskis.com>

description:
  Some LED defined in DT are required by other DT consumers, for example
  v4l2 subnode may require privacy or flash LED.

  Document LED properties that its consumers may define.

properties:
  leds:
    description:
      Phandle to LED device(s) required by particular consumer.
    $ref: /schemas/types.yaml#/definitions/phandle
  led-names:
    description:
      List of device name(s). Used to map LED devices to their respective
      functions, when consumer requires more than one LED.

additionalProperties: true

examples:
  - |
    #include <dt-bindings/gpio/gpio.h>
    #include <dt-bindings/leds/common.h>

    i2c {
      #address-cells = <1>;
      #size-cells = <0>;

      camera@36 {
        compatible = "ovti,ov02c10";
        reg = <0x36>;

        reset-gpios = <&tlmm 237 GPIO_ACTIVE_LOW>;
        pinctrl-names = "default";
        pinctrl-0 = <&cam_rgb_default>;

        led-names = "privacy-led";
        leds = <&privacy_led>;

        clocks = <&ov02e10_clk>;

        assigned-clocks = <&ov02e10_clk>;
        assigned-clock-rates = <19200000>;

        avdd-supply = <&vreg_l7b_2p8>;
        dvdd-supply = <&vreg_l7b_2p8>;
        dovdd-supply = <&vreg_cam_1p8>;

        port {
          ov02e10_ep: endpoint {
            data-lanes = <1 2>;
            link-frequencies = /bits/ 64 <400000000>;
            remote-endpoint = <&csiphy4_ep>;
          };
        };
      };
    };

...
```

## Documentation/devicetree/bindings/leds/leds-group-virtualcolor.yaml
```yaml
# SPDX-License-Identifier: (GPL-2.0-only OR BSD-2-Clause)
%YAML 1.2
---
$id: http://devicetree.org/schemas/leds/leds-group-virtualcolor.yaml#
$schema: http://devicetree.org/meta-schemas/core.yaml#

title: Virtual LED Group Controller with Multicolor Support

maintainers:
  - Jonathan Brophy <professor_jonny@hotmail.com>

description: |
  The virtual LED group controller provides priority-based arbitration for
  shared physical LEDs across multiple virtual LED instances. Each virtual LED
  combines physical monochromatic LEDs into logical units with:

  - Priority-based arbitration: Higher priority virtual LEDs take precedence
    when multiple virtual LEDs compete for the same physical LEDs
  - Sequence-based tie-breaking: Among equal priorities, most recent update wins
  - Winner-takes-all: Only ONE virtual LED controls ALL physical LEDs at any time
  - Color channel grouping: Organize LEDs by color for multicolor control
  - Full multicolor ABI support: multi_intensity, multi_index, multi_multipliers
  - Two operating modes:
    * Multicolor mode: Dynamic per-channel intensity control (default)
    * Standard mode: Fixed color ratios via multipliers (brightness only)
  - Brightness scaling: Master brightness control with per-channel intensity
  - Global ownership: Physical LEDs claimed exclusively per controller instance
  - Update batching: Optional coalescing of rapid brightness changes

  Key features:
  - Supports GPIO, PWM, I2C, and SPI LED devices
  - Automatic physical LED discovery and claiming
  - Lock-free arbitration with atomic sequence numbers
  - Suspend/resume with state preservation
  - Comprehensive debugfs telemetry (when CONFIG_DEBUG_FS enabled)

  Typical use cases:
  - System status indicators with boot/update/error priority levels
  - RGB lighting with priority-based overrides
  - Multi-element LED arrays unified into single logical controls
  - LED rings or strips with coordinated color control

properties:
  compatible:
    const: leds-group-virtualcolor

  '#address-cells':
    const: 1

  '#size-cells':
    const: 0

patternProperties:
  "^virtual-led@[0-9a-f]+$":
    type: object
    $ref: leds-class-virtualcolor.yaml#

required:
  - compatible
  - '#address-cells'
  - '#size-cells'

additionalProperties: false

examples:
  - |
    #include <dt-bindings/leds/common.h>
    #include <dt-bindings/gpio/gpio.h>

    /* Physical LED definitions */
    led-controller {
        compatible = "gpio-leds";

        led_red: led-red {
            color = <LED_COLOR_ID_RED>;
            function = LED_FUNCTION_STATUS;
            gpios = <&gpio0 10 GPIO_ACTIVE_HIGH>;
            default-state = "off";
        };

        led_green: led-green {
            color = <LED_COLOR_ID_GREEN>;
            function = LED_FUNCTION_STATUS;
            gpios = <&gpio0 11 GPIO_ACTIVE_HIGH>;
            default-state = "off";
        };

        led_blue: led-blue {
            color = <LED_COLOR_ID_BLUE>;
            function = LED_FUNCTION_STATUS;
            gpios = <&gpio0 12 GPIO_ACTIVE_HIGH>;
            default-state = "off";
        };

        led_white: led-white {
            color = <LED_COLOR_ID_WHITE>;
            function = LED_FUNCTION_STATUS;
            gpios = <&gpio0 13 GPIO_ACTIVE_HIGH>;
            default-state = "off";
        };
    };

    pwm-led-controller {
        compatible = "pwm-leds";

        pwm_red: led-1 {
            color = <LED_COLOR_ID_RED>;
            function = LED_FUNCTION_STATUS;
            pwms = <&pwm 0 7812500>;
            max-brightness = <255>;
        };

        pwm_green: led-2 {
            color = <LED_COLOR_ID_GREEN>;
            function = LED_FUNCTION_STATUS;
            pwms = <&pwm 1 7812500>;
            max-brightness = <255>;
        };

        pwm_blue: led-3 {
            color = <LED_COLOR_ID_BLUE>;
            function = LED_FUNCTION_STATUS;
            pwms = <&pwm 2 7812500>;
            max-brightness = <255>;
        };
    };

    /* virtual LED definitions */
    virtual-led-controller {
        compatible = "leds-group-virtualcolor";
        #address-cells = <1>;
        #size-cells = <0>;

        /* High-priority RGB virtual LED (emergency/error indicator) */
        virtual-led@0 {
            reg = <0>;
            color = <LED_COLOR_ID_MULTI>;
            function = LED_FUNCTION_STATUS;
            priority = <1000>;
            led-mode = "multicolor";
            leds = <&led_red>, <&led_green>, <&led_blue>;
            /* Channels ordered by color ID: [0]=red, [1]=green, [2]=blue */
        };

        /* Medium-priority RGBW indicator (system state) */
        virtual-led@1 {
            reg = <1>;
            color = <LED_COLOR_ID_MULTI>;
            function = LED_FUNCTION_STATUS;
            priority = <500>;
            led-mode = "multicolor";
            leds = <&pwm_red>, <&pwm_green>, <&pwm_blue>, <&led_white>;
            /* Channels: [0]=white (ID=0), [1]=red, [2]=green, [3]=blue */
        };

        /* Low-priority warm white (fixed color ratios, standard mode) */
        virtual-led@2 {
            reg = <2>;
            color = <LED_COLOR_ID_MULTI>;
            function = LED_FUNCTION_STATUS;
            priority = <10>;
            led-mode = "standard";
            leds = <&led_red>, <&led_green>, <&led_blue>;
            /* Channels: [0]=red, [1]=green, [2]=blue */
            mc-channel-multipliers = <255 180 100>;
            /* Creates warm white: full red, 70% green, 40% blue */
        };
    };

...
```
