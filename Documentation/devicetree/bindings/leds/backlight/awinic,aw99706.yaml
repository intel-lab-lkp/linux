## Documentation/devicetree/bindings/leds/issi,is32fl3207.yaml
```yaml
# SPDX-License-Identifier: (GPL-2.0-only OR BSD-2-Clause)
%YAML 1.2
---
$id: http://devicetree.org/schemas/leds/issi,is32fl3207.yaml#
$schema: http://devicetree.org/meta-schemas/core.yaml#

title: Lumissil IS32FL3207 18-channel LED controller

maintainers:
  - Ahmad Byagowi <ahmadexp@gmail.com>

description: |
  The IS32FL3207 is an I2C LED controller with 18 individually controlled
  constant-current outputs. Each output has 8-bit current scaling. PWM
  brightness control uses the controller's default 8-bit, 62 kHz mode.
  Outputs may be exposed as individual LEDs or grouped as multicolor LEDs.

  The data sheet is available at:
    https://www.lumissil.com/assets/pdf/core/IS32FL3207_DS.pdf

properties:
  compatible:
    const: issi,is32fl3207

  reg:
    enum: [0x34, 0x35, 0x36, 0x37]

  vcc-supply:
    description: Regulator providing power to the VCC pin.

  enable-gpios:
    maxItems: 1
    description: GPIO connected to SDB, asserted to enable the controller.

  issi,riset-ohms:
    minimum: 2000
    maximum: 76500000
    description: |
      Resistance in ohms of the external RISET resistor. The resistor sets the
      full-scale output current according to IOUT(MAX) = 76.5 / RISET amperes.
      Each LED's led-max-microamp value selects a board-safe peak current no
      greater than this full scale, using the per-output scaling register.

  "#address-cells":
    const: 1

  "#size-cells":
    const: 0

patternProperties:
  "^led@[0-9a-f]+$":
    type: object
    $ref: common.yaml#
    unevaluatedProperties: false

    properties:
      reg:
        minimum: 0
        maximum: 17
        description: |
          Zero-based LED output number. Values 0 through 17 correspond to
          OUT1 through OUT18.

      led-max-microamp:
        minimum: 1
        maximum: 38250
        description: |
          Board-safe peak current for this output. The value must not exceed
          the full-scale current derived from issi,riset-ohms and must be high
          enough to produce a nonzero per-output current-scaling value for the
          configured RISET resistance.

      color:
        oneOf:
          - minimum: 0
            maximum: 7
          - minimum: 10
            maximum: 14

      max-brightness:
        minimum: 1
        maximum: 255

      default-state:
        description:
          The driver performs a software reset and clears the PWM state during
          initialization, so an existing state cannot be preserved.
        enum: ["on", "off"]

      default-brightness:
        maximum: 255
        description: |
          Brightness used when default-state is "on". This value must not
          exceed max-brightness when max-brightness is specified.

    anyOf:
      - required:
          - function
      - required:
          - color

    required:
      - reg
      - led-max-microamp

  "^multi-led(@[0-9a-f]|-[0-9]+)?$":
    type: object
    $ref: leds-class-multicolor.yaml#
    unevaluatedProperties: false

    properties:
      reg:
        minimum: 0
        maximum: 15
        description: |
          Optional zero-based lowest-numbered output used by a group named
          multi-led@N. Values 0 through 15 correspond to OUT1 through OUT16.
          For a multi-led-N group without reg, the driver derives the lowest
          output from its component nodes. This form permits groups beginning
          at channels 16 or 17 while following the common multicolor node-name
          schema.

      "#address-cells":
        const: 1

      "#size-cells":
        const: 0

      max-brightness:
        minimum: 1
        maximum: 255

      default-state:
        description:
          The driver performs a software reset and clears the PWM state during
          initialization, so an existing state cannot be preserved.
        enum: ["on", "off"]

      default-brightness:
        maximum: 255
        description: |
          Brightness used when default-state is "on". This value must not
          exceed max-brightness when max-brightness is specified.

    patternProperties:
      "^led@[0-9a-f]+$":
        type: object
        $ref: common.yaml#
        unevaluatedProperties: false

        properties:
          reg:
            minimum: 0
            maximum: 17
            description: |
              Zero-based LED output number. Values 0 through 17 correspond to
              OUT1 through OUT18.

          led-max-microamp:
            minimum: 1
            maximum: 38250
            description: |
              Board-safe peak current for this output. The value must not
              exceed the full-scale current derived from issi,riset-ohms and
              must be high enough to produce a nonzero per-output
              current-scaling value for the configured RISET resistance.

          color:
            oneOf:
              - minimum: 0
                maximum: 7
              - minimum: 10
                maximum: 14

          max-brightness: false

          default-state: false

          default-brightness: false

          retain-state-shutdown: false

        required:
          - reg
          - color
          - led-max-microamp

    anyOf:
      - required: [led@0]
      - required: [led@1]
      - required: [led@2]
      - required: [led@3]
      - required: [led@4]
      - required: [led@5]
      - required: [led@6]
      - required: [led@7]
      - required: [led@8]
      - required: [led@9]
      - required: [led@a]
      - required: [led@b]
      - required: [led@c]
      - required: [led@d]
      - required: [led@e]
      - required: [led@f]
      - required: [led@10]
      - required: [led@11]

    required:
      - "#address-cells"
      - "#size-cells"

required:
  - compatible
  - reg
  - issi,riset-ohms
  - "#address-cells"
  - "#size-cells"

additionalProperties: false

examples:
  - |
    #include <dt-bindings/gpio/gpio.h>
    #include <dt-bindings/leds/common.h>

    i2c {
        #address-cells = <1>;
        #size-cells = <0>;

        led-controller@34 {
            compatible = "issi,is32fl3207";
            reg = <0x34>;
            #address-cells = <1>;
            enable-gpios = <&gpio0 4 GPIO_ACTIVE_HIGH>;
            #size-cells = <0>;
            vcc-supply = <&led_3v3>;
            issi,riset-ohms = <4700>;

            multi-led@0 {
                reg = <0>;
                #address-cells = <1>;
                color = <LED_COLOR_ID_RGB>;
                function = LED_FUNCTION_STATUS;
                #size-cells = <0>;

                led@0 {
                    reg = <0>;
                    color = <LED_COLOR_ID_RED>;
                    led-max-microamp = <8100>;
                };

                led@1 {
                    reg = <1>;
                    color = <LED_COLOR_ID_GREEN>;
                    led-max-microamp = <8100>;
                };

                led@2 {
                    reg = <2>;
                    color = <LED_COLOR_ID_BLUE>;
                    led-max-microamp = <8100>;
                };
            };

            multi-led-1 {
                #address-cells = <1>;
                color = <LED_COLOR_ID_MULTI>;
                function = LED_FUNCTION_INDICATOR;
                #size-cells = <0>;

                led@10 {
                    reg = <16>;
                    color = <LED_COLOR_ID_AMBER>;
                    led-max-microamp = <8100>;
                };

                led@11 {
                    reg = <17>;
                    color = <LED_COLOR_ID_WHITE>;
                    led-max-microamp = <8100>;
                };
            };
        };
    };
...
```

## Documentation/devicetree/bindings/leds/lacie,netxbig-leds.yaml
```yaml
# SPDX-License-Identifier: (GPL-2.0-only OR BSD-2-Clause)
%YAML 1.2
---
$id: http://devicetree.org/schemas/leds/lacie,netxbig-leds.yaml#
$schema: http://devicetree.org/meta-schemas/core.yaml#

title: LaCie/Seagate netxbig CPLD LEDs

maintainers:
  - Simon Guinot <simon.guinot@sequanux.org>

description: |
  Binding for the CPLD LEDs (GPIO extension bus) found on some LaCie/Seagate
  boards (Example: 2Big/5Big Network v2, 2Big NAS).

properties:
  compatible:
    const: lacie,netxbig-leds

  gpio-ext:
    description: Phandle for the gpio-ext bus.
    $ref: /schemas/types.yaml#/definitions/phandle

  timers:
    description: |
      Timer array. Each timer entry is represented by three integers:
      Mode (gpio-ext bus), delay_on and delay_off.
    $ref: /schemas/types.yaml#/definitions/uint32-array

required:
  - compatible
  - gpio-ext

additionalProperties:
  description: Each child node represents a single LED
  type: object
  $ref: common.yaml#
  unevaluatedProperties: false

  properties:
    mode-addr:
      description: Mode register address on gpio-ext bus.
      $ref: /schemas/types.yaml#/definitions/uint32

    mode-val:
      description: |
        Mode to value mapping. Each entry is represented by two integers: a mode and
        the corresponding value on the gpio-ext bus.
      $ref: /schemas/types.yaml#/definitions/uint32-array

    bright-addr:
      description: Brightness register address on gpio-ext bus.
      $ref: /schemas/types.yaml#/definitions/uint32

    max-brightness:
      description: Maximum brightness value.
      $ref: /schemas/types.yaml#/definitions/uint32

  required:
    - mode-addr
    - mode-val
    - bright-addr
    - max-brightness

examples:
  - |
    #include <dt-bindings/leds/leds-netxbig.h>

    netxbig-leds {
        compatible = "lacie,netxbig-leds";

        gpio-ext = <&netxbig_gpio_ext>;

        timers = <NETXBIG_LED_TIMER1 500 500
                  NETXBIG_LED_TIMER2 500 1000>;

        blue-power {
            label = "netxbig:blue:power";
            mode-addr = <0>;
            mode-val = <NETXBIG_LED_OFF 0
                        NETXBIG_LED_ON 1
                        NETXBIG_LED_TIMER1 3
                        NETXBIG_LED_TIMER2 7>;
            bright-addr = <1>;
            max-brightness = <7>;
        };
        red-power {
            label = "netxbig:red:power";
            mode-addr = <0>;
            mode-val = <NETXBIG_LED_OFF 0
                        NETXBIG_LED_ON 2
                        NETXBIG_LED_TIMER1 4>;
            bright-addr = <1>;
            max-brightness = <7>;
        };
        blue-sata0 {
            label = "netxbig:blue:sata0";
            mode-addr = <3>;
            mode-val = <NETXBIG_LED_OFF 0
                        NETXBIG_LED_ON 7
                        NETXBIG_LED_SATA 1
                        NETXBIG_LED_TIMER1 3>;
            bright-addr = <2>;
            max-brightness = <7>;
        };
        red-sata0 {
            label = "netxbig:red:sata0";
            mode-addr = <3>;
            mode-val = <NETXBIG_LED_OFF 0
                        NETXBIG_LED_ON 2
                        NETXBIG_LED_TIMER1 4>;
            bright-addr = <2>;
            max-brightness = <7>;
        };
        blue-sata1 {
            label = "netxbig:blue:sata1";
            mode-addr = <4>;
            mode-val = <NETXBIG_LED_OFF 0
                        NETXBIG_LED_ON 7
                        NETXBIG_LED_SATA 1
                        NETXBIG_LED_TIMER1 3>;
            bright-addr = <2>;
            max-brightness = <7>;
        };
        red-sata1 {
            label = "netxbig:red:sata1";
            mode-addr = <4>;
            mode-val = <NETXBIG_LED_OFF 0
                        NETXBIG_LED_ON 2
                        NETXBIG_LED_TIMER1 4>;
            bright-addr = <2>;
            max-brightness = <7>;
        };
    };
```
