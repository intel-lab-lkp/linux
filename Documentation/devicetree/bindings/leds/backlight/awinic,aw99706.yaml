## Documentation/devicetree/bindings/leds/mps,mp3326.yaml
```yaml
# SPDX-License-Identifier: (GPL-2.0-only OR BSD-2-Clause)
%YAML 1.2
---
$id: http://devicetree.org/schemas/leds/mps,mp3326.yaml#
$schema: http://devicetree.org/meta-schemas/core.yaml#

title: MPS MP3326 RGB/White LED Driver

maintainers:
  - Yuxi Wang <Yuxi.Wang@monolithicpower.com>

description: |
  The MP3326 is a RGB/White LED driver with I2C interface.

  For more product information please see the link below:
  https://www.monolithicpower.com/en/products/mp3326.html

properties:
  compatible:
    const: mps,mp3326

  "#address-cells":
    const: 1

  "#size-cells":
    const: 0

  reg:
    maxItems: 1

patternProperties:
  '^multi-led@[0-4]$':
    type: object
    $ref: leds-class-multicolor.yaml#
    unevaluatedProperties: false

    properties:
      "#address-cells":
        const: 1

      "#size-cells":
        const: 0
      reg:
        minimum: 0
        maximum: 4
        description: Index of the RGB module.

    patternProperties:
      "^led@[0-9a-f]+$":
        type: object
        $ref: common.yaml#
        unevaluatedProperties: false

        properties:
          reg:
            description: Index of the LED.
            minimum: 0
            maximum: 15

        required:
          - reg
          - color

    required:
      - "#address-cells"
      - "#size-cells"
      - reg

  "^led@[0-9a-f]+$":
    type: object
    $ref: common.yaml#
    unevaluatedProperties: false

    properties:
      reg:
        description: Index of the LED.
        minimum: 0
        maximum: 15

    required:
      - reg

required:
  - compatible
  - reg
  - "#address-cells"
  - "#size-cells"

additionalProperties: false

examples:
  - |
    #include <dt-bindings/leds/common.h>

    i2c {
        #address-cells = <1>;
        #size-cells = <0>;

        led-controller@30 {
            #address-cells = <1>;
            #size-cells = <0>;
            compatible = "mps,mp3326";
            reg = <0x30>;
            multi-led@0 {
                #address-cells = <1>;
                #size-cells = <0>;
                color = <LED_COLOR_ID_RGB>;
                reg = <0>;
                label = "multi-led1";
                led@0 {
                    reg  = <0>;
                    color = <LED_COLOR_ID_RED>;
                };

                led@1 {
                    reg = <1>;
                    color = <LED_COLOR_ID_GREEN>;
                };

                led@2 {
                    reg = <2>;
                    color = <LED_COLOR_ID_BLUE>;
                };
            };
        };
    };

  - |
    #include <dt-bindings/leds/common.h>

    i2c {
        #address-cells = <1>;
        #size-cells = <0>;
        led-controller@30 {
            compatible = "mps,mp3326";
            reg = <0x30>;
            #address-cells = <1>;
            #size-cells = <0>;

            led@0 {
                label = "red0";
                reg= <0>;
                color = <LED_COLOR_ID_WHITE>;
            };
        };
    };
```

## Documentation/devicetree/bindings/leds/samsung,s2mu005-rgb.yaml
```yaml
# SPDX-License-Identifier: (GPL-2.0-only OR BSD-2-Clause)
%YAML 1.2
---
$id: http://devicetree.org/schemas/leds/samsung,s2mu005-rgb.yaml#
$schema: http://devicetree.org/meta-schemas/core.yaml#

title: RGB LED Controller for Samsung S2M series PMICs

maintainers:
  - Kaustabh Chakraborty <kauschluss@disroot.org>

description: |
  The Samsung S2M series PMIC RGB LED is a three-channel LED device with
  8-bit brightness control for each channel, typically used as status
  indicators in mobile phones.

  This is a part of device tree bindings for S2M and S5M family of Power
  Management IC (PMIC).

  See also Documentation/devicetree/bindings/mfd/samsung,s2mps11.yaml for
  additional information and example.

allOf:
  - $ref: common.yaml#

properties:
  compatible:
    enum:
      - samsung,s2mu005-rgb

required:
  - compatible

unevaluatedProperties: false
```

## Documentation/devicetree/bindings/leds/skyworks,aat2870.yaml
```yaml
# SPDX-License-Identifier: (GPL-2.0 OR BSD-2-Clause)
%YAML 1.2
---
$id: http://devicetree.org/schemas/leds/skyworks,aat2870.yaml#
$schema: http://devicetree.org/meta-schemas/core.yaml#

title: AAT2870 LED Backlight Driver and Multiple LDO Lighting Management Unit

maintainers:
  - Svyatoslav Ryhel <clamor95@gmail.com>

properties:
  compatible:
    const: skyworks,aat2870

  reg:
    maxItems: 1

  enable-gpios:
    description: GPIO connected to EN pin.
    maxItems: 1

  vin-supply:
    description: Regulator providing power to the "IN" pin.

  backlight:
    $ref: /schemas/leds/backlight/common.yaml#
    unevaluatedProperties: false

    properties:
      compatible:
        const: skyworks,aat2870-backlight

      led-max-microamp:
        minimum: 450000
        maximum: 27900000
        default: 450000

      max-brightness:
        default: 255

      skyworks,channels:
        description: layout of active channels, where each bit represents
          one of 8 channels.
        $ref: /schemas/types.yaml#/definitions/uint8
        default: 0xff

    required:
      - compatible

  regulators:
    type: object
    additionalProperties: false

    properties:
      compatible:
        const: skyworks,aat2870-regulator

      in-ldo-supply:
        description: Phandle to parent supply of regulators populated under
          regulators node. They all share same parent.

    patternProperties:
      "^(ldo-(a|b|c|d))$":
        $ref: /schemas/regulator/regulator.yaml#
        unevaluatedProperties: false

    required:
      - compatible

required:
  - compatible
  - reg

additionalProperties: false

examples:
  - |
    #include <dt-bindings/gpio/gpio.h>

    i2c {
        #address-cells = <1>;
        #size-cells = <0>;

        led-controller@60 {
            compatible = "skyworks,aat2870";
            reg = <0x60>;

            enable-gpios = <&gpio 139 GPIO_ACTIVE_HIGH>;
            vin-supply = <&vdd_3v3_vbat>;

            backlight {
                compatible = "skyworks,aat2870-backlight";

                skyworks,channels = /bits/ 8 <0xff>;
                led-max-microamp = <27900000>;
            };

            regulators {
                compatible = "skyworks,aat2870-regulator";

                in-ldo-supply = <&vdd_3v3_vbat>;

                ldo-a {
                    regulator-min-microvolt = <1200000>;
                    regulator-max-microvolt = <1200000>;
                };

                ldo-b {
                    regulator-min-microvolt = <3300000>;
                    regulator-max-microvolt = <3300000>;
                    regulator-always-on;
                };

                ldo-c {
                    regulator-min-microvolt = <1800000>;
                    regulator-max-microvolt = <3300000>;
                    regulator-boot-on;
                };

                ldo-d {
                    regulator-min-microvolt = <2700000>;
                    regulator-max-microvolt = <2800000>;
                };
            };
        };
    };
```
