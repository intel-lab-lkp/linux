## Documentation/devicetree/bindings/leds/leds-is31fl3236.yaml
```yaml
# SPDX-License-Identifier: (GPL-2.0-only OR BSD-2-Clause)
%YAML 1.2
---
$id: http://devicetree.org/schemas/leds/leds-is31fl3236.yaml#
$schema: http://devicetree.org/meta-schemas/core.yaml#

title: is31fl32xx and Si-En SN32xx IC LED driver

maintainers:
  - Pavel Machek <pavel@ucw.cz>
  - Lee Jones <lee@kernel.org>

description: |
  The is31fl32xx/SN32xx family of LED drivers are I2C devices with multiple
  constant-current channels, each with independent 256-level PWM control.
  Each LED is represented as a sub-node of the device.

  For more product information please see the links below:
    https://www.lumissil.com/assets/pdf/core/IS31FL3236_DS.pdf
    https://www.lumissil.com/assets/pdf/core/IS31FL3236A_DS.pdf
    https://www.lumissil.com/assets/pdf/core/IS31FL3235_DS.pdf
    https://www.lumissil.com/assets/pdf/core/IS31FL3218_DS.pdf
    https://www.lumissil.com/assets/pdf/core/IS31FL3216_DS.pdf

properties:
  compatible:
    enum:
      - issi,is31fl3236
      - issi,is31fl3236a
      - issi,is31fl3235
      - issi,is31fl3218
      - issi,is31fl3216
      - si-en,sn3218
      - si-en,sn3216

  reg:
    maxItems: 1

  '#address-cells':
    const: 1

  "#size-cells":
    const: 0

  issi,22kHz-pwm:
    type: boolean
    description:
      When present, the chip's PWM will operate at ~22kHz as opposed
      to ~3kHz to move the operating frequency out of the audible range.

patternProperties:
  "^led@[1-9][0-9]*$":
    type: object
    $ref: common.yaml#
    additionalProperties: false

    properties:
      reg:
        minItems: 1
        description:
          LED channel number (1..N)

      label: true

      linux,default-trigger: true

    required:
      - reg

required:
  - compatible
  - reg
  - "#size-cells"
  - "#address-cells"

additionalProperties: false

examples:
  - |
    #include <dt-bindings/leds/common.h>

    i2c {
        #address-cells = <1>;
        #size-cells = <0>;

        s31fl3236: led-controller@3c {
          compatible = "issi,is31fl3236";
          reg = <0x3c>;
          #address-cells = <1>;
          #size-cells = <0>;

          led@1 {
            reg = <1>;
            label = "EB:blue:usr0";
          };
          led@2 {
            reg = <2>;
            label = "EB:blue:usr1";
          };
          led@3 {
            reg = <3>;
            label = "EB:blue:usr35";
          };
        };
    };
...
```

## Documentation/devicetree/bindings/leds/leds-lm36274.yaml
```yaml
%YAML 1.2
---
$id: http://devicetree.org/schemas/leds/leds-lm36274.yaml#
$schema: http://devicetree.org/meta-schemas/core.yaml#
title: Texas Instruments LM36274 4-Channel LCD Backlight Driver w/Integrated Bias
maintainers: [Erick Setubal Bacurau <erick.setubal@gmx.de>]
description:
  The LM36274 is an integrated four-channel WLED driver and LCD bias supply.
  The backlight boost provides the power to bias four parallel LED strings with
  up to 29V total output voltage. The 11-bit LED current is programmable via
  the I2C bus and/or controlled via a logic level PWM input from 60 uA to 30 mA.
  For more product information please see the link https://www.ti.com/lit/ds/symlink/lm36274.pdf

properties:
  compatible:
    const: ti,lm36274-backlight
  reg:
    maxItems: 1
    description: I2C address of the device.
 
  '#address-cells':
    const: 1

  '#size-cells':
    const: 0

  label:
    $ref: /schemas/leds/common.yaml#/properties/label

  linux,default-trigger:
    $ref: /schemas/leds/common.yaml#/properties/linux,default-trigger

required:
  - compatible
  - reg

additionalProperties: false

patternProperties:
  '^led@[0-3]$':
    type: object
    properties:
      reg:
        description: LED channel index (0..3)
        minimum: 0
        maximum: 3

      led-sources:
        description: Indicates which LED strings will be enabled (0..3).
        allOf:
          - $ref: /schemas/leds/common.yaml#/properties/led-sources
          - type: array
            items:
              $ref: /schemas/types.yaml#/definitions/uint32
              minimum: 0
              maximum: 3
            maxItems: 4
            uniqueItems: true

examples:
  - |
    i2c {
        #address-cells = <1>;
        #size-cells = <0>;

        backlight@11 {
            #address-cells = <1>;
            #size-cells = <0>;
            reg = <0x11>;
            compatible = "ti,lm36274-backlight";

            led@0 {
                reg = <0>;
                led-sources = <0 2>;
                label = "white:backlight_cluster";
                linux,default-trigger = "backlight";
            };
        };
    };

 
```

## Documentation/devicetree/bindings/leds/leds-lp5812.yaml
```yaml
# SPDX-License-Identifier: (GPL-2.0-only OR BSD-2-Clause)
%YAML 1.2

title: LED driver for LP5812 LED from Texas Instruments.

maintainers:

description: |
  The LP5812 is an I2C LED Driver that can support LED matrix 4x3.

properties:
  compatible:
    const: ti,lp5812

  reg:
    description: I2C slave address
    maxItems: 1

required:
  - compatible
  - reg

additionalProperties: false

examples:
  - |
    i2c1 {
      lp5812@1b {
        compatible = "ti,lp5812";
        reg = <0x1b>;
      };
    };

...
```

## Documentation/devicetree/bindings/leds/leds-ltc3220.yaml
```yaml
# SPDX-License-Identifier: (GPL-2.0-only OR BSD-2-Clause)
%YAML 1.2
---
$id: http://devicetree.org/schemas/leds/leds-ltc3220.yaml#
$schema: http://devicetree.org/meta-schemas/core.yaml#

title: Analog Devices LTC3220 LED Driver

maintainers:
  - Edelweise Escala <edelweise.escala@analog.com>

description:
  The LTC3220 is a multi-display LED driver, which contains a high-efficiency,
  low-noise charge pump to provide power to up to 18 LED current sources.
  The LEDs are individually configurable to 64-step linear brightness control,
  blinking and gradation control via 2-wire I2C interface.

  For more product information please see the link below
    https://www.analog.com/en/products/ltc3220.html

properties:
  compatible:
    const: adi,ltc3220

  reg:
    maxItems: 1

  '#address-cells':
    const: 1

  '#size-cells':
    const: 0

  reset-gpios:
    maxItems: 1

  adi,quick-write:
    type: boolean
    description:
      Enables the hardware quick-write feature where a write to the LED 1
      output register simultaneously updates all 18 LED output registers
      to the same value. Only applicable when LED 1 output is physically
      present and defined in the device tree.

patternProperties:
  '^led@([1-9]|1[0-8])$':
    type: object
    $ref: /schemas/leds/common.yaml#
    unevaluatedProperties: false
    properties:
      reg:
        description: Output channel for the LED (1-18 maps to LED outputs D1-D18).
        minimum: 1
        maximum: 18

    required:
      - reg

required:
  - compatible
  - reg

additionalProperties: false

examples:
  - |
    #include <dt-bindings/gpio/gpio.h>
    #include <dt-bindings/leds/common.h>

    i2c {
       #address-cells = <1>;
       #size-cells = <0>;

       led-controller@1c {
             compatible = "adi,ltc3220";
             reg = <0x1c>;
             #address-cells = <1>;
             #size-cells = <0>;
             reset-gpios = <&gpio 17 GPIO_ACTIVE_LOW>;
             adi,quick-write;

             led@1 {
                 reg = <1>;
                 function = LED_FUNCTION_INDICATOR;
                 function-enumerator = <1>;
             };

             led@2 {
                 reg = <2>;
                 function = LED_FUNCTION_INDICATOR;
                 function-enumerator = <2>;
             };

             led@3 {
                 reg = <3>;
                 function = LED_FUNCTION_INDICATOR;
                 function-enumerator = <3>;
             };

             led@4 {
                 reg = <4>;
                 function = LED_FUNCTION_INDICATOR;
                 function-enumerator = <4>;
             };

             led@5 {
                 reg = <5>;
                 function = LED_FUNCTION_INDICATOR;
                 function-enumerator = <5>;
             };

             led@6 {
                 reg = <6>;
                 function = LED_FUNCTION_INDICATOR;
                 function-enumerator = <6>;
             };
        };
    };

...
```

## Documentation/devicetree/bindings/leds/leds-mp3326.yaml
```yaml
# SPDX-License-Identifier: (GPL-2.0-only OR BSD-2-Clause)
%YAML 1.2
---
$id: http://devicetree.org/schemas/leds-mp3326.yaml#
$schema: http://devicetree.org/meta-schemas/core.yaml#

title: LED driver for MP3326 from Monolithic Power Systems

maintainers:
  - Yuxi Wang <Yuxi.Wang@monolithicpower.com>

description: |
  Monolithic Power Systems MP3326 LED Drivers

  For more product information please see the link below:
  https://www.monolithicpower.com/en/products/mp3326.html

properties:
  compatible:
    - const: mps,mp3326

  "#address-cells":
    const: 1

  "#size-cells":
    const: 0

  reg:
    maxItems: 1

  mps,led-protect:
    description: |
      LED short protection threshold.
    enum: [0, 1, 2, 3]

  multi-led:
    type: object

    properties:
      "#address-cells":
        const: 1
      "#size-cells":
        const: 0

      color:
        description: RGB module
        const: LED_COLOR_ID_RGB

      led_r:
        type: object

        properties:
          "#address-cells":
            const: 1
          "#size-cells":
            const: 0
          reg:
            description: Index of the LED.
            minimum: 1
            maximum: 16
          color:
            description: Red.
            const: LED_COLOR_ID_RED
          required:
            - reg
            - color

      led_g:
        type: object

        properties:
          "#address-cells":
            const: 1
          "#size-cells":
            const: 0
        reg:
          description: Index of the LED.
          minimum: 1
          maximum: 16
        color:
          description: Green.
          const: LED_COLOR_ID_GREEN
        required:
          - reg
          - color

      led_b:
        type: object

        properties:
          "#address-cells":
            const: 1
          "#size-cells":
            const: 0
        reg:
          description: Index of the LED.
          minimum: 1
          maximum: 16
        color:
          description: Blue.
          const: LED_COLOR_ID_BLUE
        required:
          - reg
          - color

  patternProperties:
    "^led@[0-3]$":
      type: object

      properties:
        reg:
          description: Index of the LED.
          minimum: 1
          maximum: 16

        required:
          - reg
          - color

examples:
  - |
    #include <dt-bindings/leds/common.h>

    i2c {
        #address-cells = <1>;
        #size-cells = <0>;

        mp3326@30 {
            compatible = "mps,mp3326";
            reg = <0x30>;
            led-protect =<3>;
            #address-cells = <1>;
            #size-cells = <0>;

            multi-led {
              color = <LED_COLOR_ID_RGB>;
              #address-cells = <1>;
              #size-cells = <0>;

              rgb_r@1 {
                  #address-cells = <1>;
                  #size-cells = <0>;
                  reg  = <1>;
                  color = <LED_COLOR_ID_RED>;
              };
              rgb_g@2 {
                  #address-cells = <1>;
                  #size-cells = <0>;
                  reg = <2>;
                  color = <LED_COLOR_ID_GREEN>;
              };
              rgb_b@3 {
                  #address-cells = <1>;
                  #size-cells = <0>;
                  reg = <3>;
                  color = <LED_COLOR_ID_BLUE>;
              };
            };
        };
    };

  - |
    #include <dt-bindings/leds/common.h>

    i2c {
        #address-cells = <1>;
        #size-cells = <0>;

        mp3326@30 {
            compatible = "mps,mp3326";
            reg = <0x30>;
            led-protect =<3>;
            #address-cells = <1>;
            #size-cells = <0>;
            led0@0 {
                #address-cells = <1>;
                #size-cells = <0>;
                reg= <5>;
                color = <LED_COLOR_ID_WHITE>;
            };
        };
    };

...
```

## Documentation/devicetree/bindings/leds/leds-wl-icled.yaml
```yaml
# SPDX-License-Identifier: (GPL-2.0-only OR BSD-2-Clause)
%YAML 1.2
---
$id: http://devicetree.org/schemas/leds/leds-wl-icled.yaml#
$schema: http://devicetree.org/meta-schemas/core.yaml#

title: LED driver for WL-ICLEDs from Wurth Elektronik.

maintainers:
  - Ante Knezic <ante.knezic@helmholz.de>

description: |
  The WL-ICLEDs are RGB LEDs with integrated controller that can be
  daisy-chained to arbitrary number of LEDs. Communication with LEDs is
  via SPI interface and can be single or two wire, depending on the model.
  For more product information please see the link below:
  https://www.we-online.com/en/components/products/WL-ICLED

properties:
  compatible:
    enum:
      - we,1315x246
      - we,1315x002
      - we,131x000
      - we,131161x
      - we,131212x

  '#address-cells':
    const: 1

  '#size-cells':
    const: 0

patternProperties:
  '^led@[0-9a-f]$':
    type: object
    $ref: leds-class-multicolor.yaml#
    unevaluatedProperties: false

    properties:
      reg:
        maxItems: 1
        description:
          This property denotes the LED position in the daisy chain
          series. It is a zero based LED identifier.

required:
  - compatible
  - reg

additionalProperties: false

examples:
  - |
    #include <dt-bindings/gpio/gpio.h>
    #include <dt-bindings/leds/common.h>

    spi {
        #address-cells = <1>;
        #size-cells = <0>;

        icled@1 {
            compatible = "we,131x000";
            #address-cells = <1>;
            #size-cells = <0>;
            reg = <1>;
            cs-gpios = <&gpio 1 GPIO_ACTIVE_HIGH>;

            led@0 {
                reg = <0>;
                color = <LED_COLOR_ID_RGB>;
                function = "error";
            };

            led@1 {
                reg = <1>;
                color = <LED_COLOR_ID_RGB>;
                function = "warning";
            };

            led@2 {
                reg = <2>;
                color = <LED_COLOR_ID_RGB>;
                function = "running";
            };
        };
    };
...
```
