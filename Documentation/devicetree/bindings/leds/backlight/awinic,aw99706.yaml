## Documentation/devicetree/bindings/leds/backlight/awinic,aw99706.yaml
```yaml
# SPDX-License-Identifier: (GPL-2.0 OR BSD-2-Clause)
%YAML 1.2
---
$id: http://devicetree.org/schemas/leds/backlight/awinic,aw99706.yaml#
$schema: http://devicetree.org/meta-schemas/core.yaml#

title: Awinic AW99706 6-channel WLED Backlight Driver

maintainers:
  - Junjie Cao <caojunjie650@gmail.com>

allOf:
  - $ref: common.yaml#

properties:
  compatible:
    const: awinic,aw99706

  reg:
    maxItems: 1

  enable-gpios:
    description: GPIO to use to enable/disable the backlight (HWEN pin).
    maxItems: 1

  awinic,dim-mode:
    $ref: /schemas/types.yaml#/definitions/uint32
    description: >
      Select dimming mode of the device.
        0 = Bypass mode.
        1 = DC mode.
        2 = MIX mode.
        3 = MIX-26k.
    enum: [0, 1, 2, 3]
    default: 1

  awinic,sw-freq:
    $ref: /schemas/types.yaml#/definitions/uint32
    description: Boost switching frequency in kHz.
    enum: [300, 400, 500, 600, 660, 750, 850, 1000, 1200, 1330, 1500, 1700]
    default: 750

  awinic,sw-ilmt:
    $ref: /schemas/types.yaml#/definitions/uint32
    description: Switching current limitation in mA.
    enum: [1500, 2000, 2500, 3000]
    default: 3000

  awinic,iled-max:
    $ref: /schemas/types.yaml#/definitions/uint32
    description: Maximum LED current setting in uA.
    minimum: 5000
    maximum: 50000
    multipleOf: 500
    default: 20000

  awinic,uvlo-thres:
    $ref: /schemas/types.yaml#/definitions/uint32
    description: UVLO(Under Voltage Lock Out) in mV.
    enum: [2200, 5000]
    default: 2200

  awinic,fade-time:
    $ref: /schemas/types.yaml#/definitions/uint32
    description: Fade In/Out Time(per step) in us.
    enum: [8, 16, 32, 64, 128, 256, 512, 1024]
    default: 16

  awinic,slope-time:
    $ref: /schemas/types.yaml#/definitions/uint32
    description: Slope time in ms.
    enum: [8, 24, 48, 96, 200, 300, 400, 500]
    default: 300

  awinic,ramp-ctl:
    $ref: /schemas/types.yaml#/definitions/uint32
    description: >
      Select ramp control and filter of the device.
        0 = Fade in/fade out.
        1 = Light filter.
        2 = Medium filter.
        3 = Heavy filter.
    enum: [0, 1, 2, 3]
    default: 2

  awinic,brt-mode:
    $ref: /schemas/types.yaml#/definitions/uint32
    description: >
      Select brightness control of the device.
        0 = PWM.
        1 = IIC.
        2 = IIC x PWM.
        3 = IIC x PWM(P-ramp).
    enum: [0, 1, 2, 3]
    default: 1

  awinic,onoff-time:
    $ref: /schemas/types.yaml#/definitions/uint32
    description: Turn on/off time(per step) in ns.
    enum: [250, 500, 1000, 2000, 4000, 8000, 16000]
    default: 2000

required:
  - compatible
  - reg
  - enable-gpios

unevaluatedProperties: false

examples:
  - |
    #include <dt-bindings/gpio/gpio.h>

    i2c {
        #address-cells = <1>;
        #size-cells = <0>;

        aw99706@76 {
            compatible = "awinic,aw99706";
            reg = <0x76>;
            enable-gpios = <&tlmm 88 GPIO_ACTIVE_HIGH>;
            awinic,dim-mode = <1>;
            awinic,sw-ilmt = <3000>;
            awinic,sw-freq = <750>;
            awinic,uvlo-thres = <2200>;
            awinic,iled-max = <23500>;
            awinic,ramp-ctl = <2>;
            awinic,slope-time = <96>;
            awinic,fade-time = <16>;
            awinic,brt-mode = <1>;
            awinic,onoff-time = <2000>;
        };
    };

...
```

## Documentation/devicetree/bindings/leds/backlight/maxim,max25014.yaml
```yaml
# SPDX-License-Identifier: (GPL-2.0 OR BSD-2-Clause)
%YAML 1.2
---
$id: http://devicetree.org/schemas/leds/backlight/maxim,max25014.yaml#
$schema: http://devicetree.org/meta-schemas/core.yaml#

title: Maxim max25014 backlight controller

maintainers:
  - Maud Spierings <maudspierings@gocontroll.com>

properties:
  compatible:
    enum:
      - maxim,max25014

  reg:
    maxItems: 1

  "#address-cells":
    const: 1

  "#size-cells":
    const: 0

  enable-gpios:
    maxItems: 1

  interrupts:
    maxItems: 1

  power-supply:
    description: Regulator which controls the boost converter input rail.

  pwms:
    maxItems: 1

  maxim,iset:
    $ref: /schemas/types.yaml#/definitions/uint32
    maximum: 15
    default: 11
    description:
      Value of the ISET field in the ISET register. This controls the current
      scale of the outputs, a higher number means more current.

  led@0:
    type: object
    description: Properties for a string of connected LEDs.
    $ref: common.yaml#

    properties:
      reg:
        const: 0

      led-sources:
        allOf:
          - minItems: 1
            maxItems: 4
            items:
              minimum: 0
              maximum: 3
            default: [0, 1, 2, 3]

      default-brightness:
        minimum: 0
        maximum: 100
        default: 50

    required:
      - reg

    additionalProperties: false

required:
  - compatible
  - reg

additionalProperties: false

examples:
  - |
    #include <dt-bindings/gpio/gpio.h>
    #include <dt-bindings/interrupt-controller/irq.h>

    i2c {
        #address-cells = <1>;
        #size-cells = <0>;

        backlight@6f {
            compatible = "maxim,max25014";
            reg = <0x6f>;
            #address-cells = <1>;
            #size-cells = <0>;
            enable-gpios = <&gpio1 4 GPIO_ACTIVE_HIGH>;
            interrupt-parent = <&gpio1>;
            interrupts = <2 IRQ_TYPE_EDGE_FALLING>;
            power-supply = <&reg_backlight>;
            pwms = <&pwm1>;
            maxim,iset = <7>;

            led@0 {
                reg = <0>;
                led-sources = <0 1 2 3>;
                default-brightness = <50>;
            };
        };
    };
```

## Documentation/devicetree/bindings/leds/backlight/mps,mp3309c.yaml
```yaml
# SPDX-License-Identifier: (GPL-2.0 OR BSD-2-Clause)
%YAML 1.2
---
$id: http://devicetree.org/schemas/leds/backlight/mps,mp3309c.yaml#
$schema: http://devicetree.org/meta-schemas/core.yaml#

title: MPS MP3309C backlight

maintainers:
  - Flavio Suligoi <f.suligoi@asem.it>

description: |
  The Monolithic Power (MPS) MP3309C is a WLED step-up converter, featuring a
  programmable switching frequency to optimize efficiency.
  It supports two different dimming modes:

  - analog mode, via I2C commands, as default mode (32 dimming levels)
  - PWM controlled mode (optional)

  The datasheet is available at:
  https://www.monolithicpower.com/en/mp3309c.html

properties:
  compatible:
    const: mps,mp3309c

  reg:
    maxItems: 1

  pwms:
    description: if present, the backlight is controlled in PWM mode.
    maxItems: 1

  enable-gpios:
    description: GPIO used to enable the backlight in "analog-i2c" dimming mode.
    maxItems: 1

  brightness-levels:
    description:
      Array of distinct brightness levels, in PWM dimming mode.
      Typically these are in the range from 0 to 255, but any range starting
      at 0 will do.
      The 0 value means a 0% duty cycle (darkest/off), while the last value in
      the array represents a 100% duty cycle (brightest).
    $ref: /schemas/types.yaml#/definitions/uint32-array

  default-brightness:
    description:
      The default brightness (index into the levels array).
    $ref: /schemas/types.yaml#/definitions/uint32

  mps,overvoltage-protection-microvolt:
    description: Overvoltage protection (13.5V, 24V or 35.5V).
    enum: [ 13500000, 24000000, 35500000 ]
    default: 35500000

  mps,no-sync-mode:
    description: disable synchronous rectification mode
    type: boolean

required:
  - compatible
  - reg

unevaluatedProperties: false

examples:
  - |
    i2c {
        #address-cells = <1>;
        #size-cells = <0>;

        /* Backlight with PWM control */
        backlight_pwm: backlight@17 {
            compatible = "mps,mp3309c";
            reg = <0x17>;
            pwms = <&pwm1 0 3333333 0>; /* 300 Hz --> (1/f) * 1*10^9 */
            brightness-levels = <0 1 2 3 4 5 6 7 8 9 10>;
            default-brightness = <8>;
            mps,overvoltage-protection-microvolt = <24000000>;
        };
    };
```

## Documentation/devicetree/bindings/leds/backlight/ocs,ocp8178.yaml
```yaml
# SPDX-License-Identifier: (GPL-2.0-only OR BSD-2-Clause)
%YAML 1.2
---
$id: http://devicetree.org/schemas/leds/backlight/ocs,ocp8178.yaml#
$schema: http://devicetree.org/meta-schemas/core.yaml#

title: Orient Chip OCP8178 backlight

maintainers:
  - Wim de With <wf@dewith.io>

description:
  The Orient Chip OCP8178 is a white LED backlight driver controlled by a single
  GPIO line with a vendor-specific onewire protocol.

allOf:
  - $ref: common.yaml#

properties:
  compatible:
    const: ocs,ocp8178

  enable-gpios:
    description: GPIO to use to enable/disable and dim the backlight.
    maxItems: 1

  default-brightness:
    maximum: 31

  max-brightness:
    maximum: 31

required:
  - compatible
  - enable-gpios

additionalProperties: false

examples:
  - |
    #include <dt-bindings/gpio/gpio.h>
    backlight {
        compatible = "ocs,ocp8178";
        enable-gpios = <&gpio2 5 GPIO_ACTIVE_HIGH>;
        default-brightness = <13>;
        max-brightness = <31>;
    };
```

## Documentation/devicetree/bindings/leds/backlight/silergy,sy7758.yaml
```yaml
# SPDX-License-Identifier: (GPL-2.0 OR BSD-2-Clause)
%YAML 1.2
---
$id: http://devicetree.org/schemas/leds/backlight/silergy,sy7758.yaml#
$schema: http://devicetree.org/meta-schemas/core.yaml#

title: Silergy SY7758 I2C LED backlight controller

maintainers:
  - Alexandre Hamamdjian <azkali.limited@gmail.com>
  - Philippe Simons <simons.philippe@gmail.com>

description:
  The Silergy SY7758 is an I2C-controlled multi-channel LED backlight
  driver typically used to drive the edge-lit LED strings of LCD panels
  in handheld and embedded devices. Brightness is programmed as a 12-bit
  linear value through two 8-bit registers.

allOf:
  - $ref: common.yaml#

properties:
  compatible:
    const: silergy,sy7758

  reg:
    maxItems: 1

required:
  - compatible
  - reg

unevaluatedProperties: false

examples:
  - |
    i2c {
        #address-cells = <1>;
        #size-cells = <0>;

        backlight@36 {
            compatible = "silergy,sy7758";
            reg = <0x36>;
            max-brightness = <4080>;
            default-brightness = <1500>;
        };
    };
```

## Documentation/devicetree/bindings/leds/backlight/ti,lp8860.yaml
```yaml
# SPDX-License-Identifier: (GPL-2.0 OR BSD-2-Clause)
%YAML 1.2
---
$id: http://devicetree.org/schemas/leds/backlight/ti,lp8860.yaml#
$schema: http://devicetree.org/meta-schemas/core.yaml#

title: Texas Instruments - LP886x 4/6-Channel LED Driver family

maintainers:
  - Andrew Davis <afd@ti.com>
  - Alexander Sverdlin <alexander.sverdlin@siemens.com>

description: |
  The LP8860-Q1 is an high-efficiency LED driver with boost controller.
  It has 4 high-precision current sinks that can be controlled by a PWM input
  signal, a SPI/I2C master, or both.

  LP8866-Q1, LP8866S-Q1, LP8864-Q1, LP8864S-Q1 are newer products offering
  similar functionality with 4/6 channels.

  For more product information please see the links below:
    https://www.ti.com/product/lp8860-q1
    https://www.ti.com/product/LP8864-Q1
    https://www.ti.com/product/LP8864S-Q1
    https://www.ti.com/product/LP8866-Q1
    https://www.ti.com/product/LP8866S-Q1

properties:
  compatible:
    enum:
      - ti,lp8860
      - ti,lp8864

  reg:
    maxItems: 1
    description: I2C slave address

  enable-gpios:
    maxItems: 1
    description: GPIO pin to enable (active high) / disable the device

  vled-supply:
    description: LED supply

  led:
    type: object
    $ref: common.yaml#
    properties:
      function: true
      color: true
      label: true
      linux,default-trigger: true

    additionalProperties: false

required:
  - compatible
  - reg
  - led

additionalProperties: false

examples:
  - |
    #include <dt-bindings/gpio/gpio.h>
    #include <dt-bindings/leds/common.h>

    i2c {
        #address-cells = <1>;
        #size-cells = <0>;

        led-controller@2d {
            compatible = "ti,lp8860";
            reg = <0x2d>;
            enable-gpios = <&gpio1 28 GPIO_ACTIVE_HIGH>;
            vled-supply = <&vbatt>;

            led {
                function = LED_FUNCTION_BACKLIGHT;
                color = <LED_COLOR_ID_WHITE>;
                linux,default-trigger = "backlight";
            };
        };
    };

...
```

## Documentation/devicetree/bindings/leds/backlight/ti,tps65217.yaml
```yaml
# SPDX-License-Identifier: (GPL-2.0-only OR BSD-2-Clause)
%YAML 1.2
---
$id: http://devicetree.org/schemas/leds/backlight/ti,tps65217.yaml#
$schema: http://devicetree.org/meta-schemas/core.yaml#

title: TPS65217 family of regulators

maintainers:
  - Eduard Bostina <egbostina@gmail.com>

description:
  The TPS65217 chip contains a boost converter and current sinks which can be
  used to drive LEDs for use as backlights.

properties:
  compatible:
    const: ti,tps65217

  reg:
    maxItems: 1
    description: I2C slave address

  interrupts:
    maxItems: 1

  interrupt-controller: true

  "#interrupt-cells":
    const: 1

  ti,pmic-shutdown-controller:
    type: boolean
    description:
      Set the PMIC to shutdown on PWR_EN toggle.

  backlight:
    type: object
    additionalProperties: false
    description:
      Node for specifying WLED1 and WLED2 lines in TPS65217.

    properties:
      isel:
        $ref: /schemas/types.yaml#/definitions/uint32
        enum: [1, 2]
        description: |
          Selection bit. Valid values:
            1 - ISEL1 (low-level)
            2 - ISEL2 (high-level)

      fdim:
        $ref: /schemas/types.yaml#/definitions/uint32
        enum: [100, 200, 500, 1000]
        description:
          PWM dimming frequency in Hz.

      default-brightness:
        $ref: /schemas/types.yaml#/definitions/uint32
        minimum: 0
        maximum: 100

    required:
      - isel
      - fdim
      - default-brightness

  regulators:
    type: object
    additionalProperties: false
    description:
      List of child nodes that specify the regulator initialization data.
      Not all regulators for the given device need to be present.

    properties:
      "#address-cells":
        const: 1

      "#size-cells":
        const: 0

    patternProperties:
      "^regulator@[0-6]$":
        type: object
        $ref: /schemas/regulator/regulator.yaml#
        unevaluatedProperties: false

        properties:
          reg:
            maxItems: 1

          regulator-compatible:
            $ref: /schemas/types.yaml#/definitions/string

  charger:
    $ref: /schemas/power/supply/tps65217-charger.yaml#

  pwrbutton:
    $ref: /schemas/input/ti,tps65217-pwrbutton.yaml#

required:
  - compatible
  - reg

additionalProperties: false

examples:
  - |
    i2c {
        #address-cells = <1>;
        #size-cells = <0>;

        tps@24 {
            reg = <0x24>;
            compatible = "ti,tps65217";

            backlight {
                isel = <1>;   /* 1 - ISET1, 2 ISET2 */
                fdim = <100>; /* TPS65217_BL_FDIM_100HZ */
                default-brightness = <50>;
            };
        };
    };
```
