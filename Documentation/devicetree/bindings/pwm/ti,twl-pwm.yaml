## Documentation/devicetree/bindings/pwm/ti,twl-pwm.yaml
```yaml
# SPDX-License-Identifier: (GPL-2.0-only OR BSD-2-Clause)
%YAML 1.2
---
$id: http://devicetree.org/schemas/pwm/ti,twl-pwm.yaml#
$schema: http://devicetree.org/meta-schemas/core.yaml#

title: Texas Instruments TWL4030/TWL6030 family PWM controller

maintainers:
  - Peter Ujfalusi <peter.ujfalusi@gmail.com>

description: |
  Bindings for the following PWM controllers :
    TWL4030 series: PWMA and PWMB (connected to LEDA and LEDB terminals)
    TWL6030 series: LED PWM (mainly used as charging indicator LED)

allOf:
  - $ref: /schemas/pwm/pwm.yaml#

properties:
  compatible:
    enum:
      - ti,twl4030-pwm
      - ti,twl6030-pwm

  '#pwm-cells':
    const: 2

required:
  - compatible
  - '#pwm-cells'

unevaluatedProperties: false

examples:
  - |
    pwm {
        compatible = "ti,twl4030-pwm";
        #pwm-cells = <2>;
    };

  - |
    pwm {
        compatible = "ti,twl6030-pwm";
        #pwm-cells = <2>;
    };
```

## Documentation/devicetree/bindings/pwm/ti,twl-pwmled.yaml
```yaml
# SPDX-License-Identifier: (GPL-2.0-only OR BSD-2-Clause)
%YAML 1.2
---
$id: http://devicetree.org/schemas/pwm/ti,twl-pwmled.yaml#
$schema: http://devicetree.org/meta-schemas/core.yaml#

title: Texas Instruments TWL4030/TWL6030 family PWM LED controller

maintainers:
  - Peter Ujfalusi <peter.ujfalusi@gmail.com>

description: |
  Bindings for the following PWM controllers :
    TWL4030 series: PWMA and PWMB (connected to LEDA and LEDB terminals)
    TWL6030 series: LED PWM (mainly used as charging indicator LED)

allOf:
  - $ref: /schemas/pwm/pwm.yaml#

properties:
  compatible:
    enum:
      - ti,twl4030-pwmled
      - ti,twl6030-pwmled

  '#pwm-cells':
    const: 2

required:
  - compatible
  - '#pwm-cells'

unevaluatedProperties: false

examples:
  - |
    pwm {
        compatible = "ti,twl4030-pwmled";
        #pwm-cells = <2>;
    };

  - |
    pwm {
        compatible = "ti,twl6030-pwmled";
        #pwm-cells = <2>;
    };
```

## Documentation/devicetree/bindings/ras/arm,ras-ffh.yaml
```yaml
# SPDX-License-Identifier: (GPL-2.0-only OR BSD-2-Clause)
%YAML 1.2
---
$id: http://devicetree.org/schemas/ras/arm,ras-ffh.yaml#
$schema: http://devicetree.org/meta-schemas/core.yaml#

title: Arm Firmware-First Handler (FFH) CPER provider

maintainers:
  - Ahmed Tiba <ahmed.tiba@arm.com>

description: |
  Some Arm platforms describe a firmware-first error handler that exposes a
  Common Platform Error Record (CPER) buffer directly via DeviceTree. The OS
  maps the buffer to consume the error records, and firmware signals that a new
  record is ready either by asserting an interrupt or by relying on a periodic
  poll. This binding describes the buffer and the associated notification
  signal. If firmware delivers the error via Synchronous External Abort (SEA),
  the optional sea-notify flag marks the source accordingly.

properties:
  compatible:
    const: arm,ras-ffh

  reg:
    minItems: 1
    items:
      - description: CPER status block exposed by firmware
      - description:
          Optional 32- or 64-bit acknowledgment register. Firmware watches this
          register and expects bit 0 to be written to 1 once the OS consumes the
          status buffer so it can reuse the record.

  reg-names:
    items:
      - const: status
      - const: ack

  interrupts:
    maxItems: 1
    description:
      Optional interrupt used to signal that a new status record is ready. If
      omitted, the OS relies on the polling interval property.

  poll-interval:
    $ref: /schemas/types.yaml#/definitions/uint32
    minimum: 1
    description:
      Optional polling interval, in milliseconds, for platforms that cannot
      route an interrupt.

  arm,sea-notify:
    type: boolean
    description:
      Set if the platform delivers these errors as Synchronous External Aborts.

required:
  - compatible
  - reg

allOf:
  - if:
      properties:
        poll-interval: false
    then:
      required:
        - interrupts
  - if:
      properties:
        interrupts: false
    then:
      required:
        - poll-interval
  - if:
      properties:
        reg:
          minItems: 2
    then:
      required:
        - reg-names

unevaluatedProperties: false

examples:
  - |
    #include <dt-bindings/interrupt-controller/arm-gic.h>

    ras-ffh@fe800000 {
        compatible = "arm,ras-ffh";
        reg = <0xfe800000 0x1000>,
              <0xfe810000 0x4>;
        reg-names = "status", "ack";
        interrupts = <0 32 IRQ_TYPE_LEVEL_HIGH>;
    };
...
```

## Documentation/devicetree/bindings/regmap/common.yaml
```yaml
# SPDX-License-Identifier: (GPL-2.0-only OR BSD-2-Clause)
%YAML 1.2
---
$id: http://devicetree.org/schemas/regmap/common.yaml#
$schema: http://devicetree.org/meta-schemas/core.yaml#

title: Common register access constraints

maintainers:
  - TBD

description:
  Common properties describing register access constraints.

properties:
  no-sequential-read:
    type: boolean
    description:
      Indicates that this device instance does not support sequential
      register reads.

      Reads may start at a given register address, but reading multiple
      consecutive registers in a single operation is not reliable.
      Software must instead read registers individually.

additionalProperties: true
```

## Documentation/devicetree/bindings/regset/register-settings.yaml
```yaml
# SPDX-License-Identifier: (GPL-2.0 OR BSD-2-Clause)
%YAML 1.2
---
$id: http://devicetree.org/schemas/regset/register-settings.yaml#
$schema: http://devicetree.org/meta-schemas/core.yaml#

title: Register Settings

maintainers:
  - Thierry Reding <thierry.reding@gmail.com>
  - Krishna Yarlagadda <kyarlagadda@nvidia.com>
  - Rajesh Gumasta <rgumasta@nvidia.com>
  - Jon Hunter <jonathanh@nvidia.com>

description: |
  Register Settings provides a generic way to specify register configurations
  for any hardware controllers. Settings are specified under a "reg-settings"
  sub-node under the controller device tree node. It allows defining both
  default and operating mode specific register settings in the device tree.

properties:
  reg-settings:
    type: object
    description: |
      Container node for register settings configurations. Each child node
      represents a specific configuration mode or operating condition.

    additionalProperties:
      type: object

additionalProperties: true
```

## Documentation/devicetree/bindings/regulator/dlg,da9211.yaml
```yaml
# SPDX-License-Identifier: (GPL-2.0 OR BSD-2-Clause)
%YAML 1.2
---
$id: http://devicetree.org/schemas/regulator/dlg,da9211.yaml#
$schema: http://devicetree.org/meta-schemas/core.yaml#

title: |
  Dialog Semiconductor DA9211/DA9212/DA9213/DA9223/DA9214/DA9224/DA9215/DA9225
  Voltage Regulator

maintainers:
  - Ariel D'Alessandro <ariel.dalessandro@collabora.com>

properties:
  compatible:
    enum:
      - "dlg,da9211"
      - "dlg,da9212"
      - "dlg,da9213"
      - "dlg,da9223"
      - "dlg,da9214"
      - "dlg,da9224"
      - "dlg,da9215"
      - "dlg,da9225"

  reg:
    maxItems: 1

  interrupts:
    maxItems: 1

  regulators:
    type: object
    additionalProperties: false
    description: |
      List of regulators provided by the device

    patternProperties:
      "^BUCK([A-B])$":
        type: object
        $ref: regulator.yaml#
        description: |
          Properties for a single BUCK regulator

        properties:
          regulator-initial-mode:
            items:
              enum: [ 1, 2, 3 ]
            description: Defined in include/dt-bindings/regulator/dlg,da9211-regulator.h

          regulator-allowed-modes:
            items:
              enum: [ 1, 2, 3 ]
            description: Defined in include/dt-bindings/regulator/dlg,da9211-regulator.h

          enable-gpios:
            maxItems: 1
            description: Specify a valid GPIO for platform control of the regulator

        unevaluatedProperties: false

required:
  - compatible
  - reg
  - interrupts
  - regulators

additionalProperties: false

examples:
  - |
    #include <dt-bindings/regulator/dlg,da9211-regulator.h>

    i2c1 {
        #address-cells = <1>;
        #size-cells = <0>;

        da9212: da9212@68 {
            compatible = "dlg,da9212";
            reg = <0x68>;
            interrupts = <3 27>;

            regulators {
                BUCKA {
                    regulator-name = "VBUCKA";
                    regulator-min-microvolt = < 300000>;
                    regulator-max-microvolt = <1570000>;
                    regulator-min-microamp = <2000000>;
                    regulator-max-microamp = <5000000>;
                    enable-gpios = <&gpio 27 0>;
                };
                BUCKB {
                    regulator-name = "VBUCKB";
                    regulator-min-microvolt = < 300000>;
                    regulator-max-microvolt = <1570000>;
                    regulator-min-microamp = <2000000>;
                    regulator-max-microamp = <5000000>;
                    enable-gpios = <&gpio 17 0>;
                };
            };
        };
    };

...
```

## Documentation/devicetree/bindings/regulator/fiti,fp9931.yaml
```yaml
# SPDX-License-Identifier: GPL-2.0-only OR BSD-2-Clause
%YAML 1.2
---
$id: http://devicetree.org/schemas/regulator/fiti,fp9931.yaml#
$schema: http://devicetree.org/meta-schemas/core.yaml#

title: FitiPower FP9931/JD9930 Power Management Integrated Circuit

maintainers:
  - Andreas Kemnade <andreas@kemnade.info>

description:
  FP9931 is a Power Management IC to provide Power for EPDs with one 3.3V
  switch, 2 symmetric LDOs behind 2 DC/DC converters, and one unsymmetric
  regulator for a compensation voltage.
  JD9930 has in addition some kind of night mode.

properties:
  compatible:
    oneOf:
      - const: fiti,fp9931

      - items:
          - const: fiti,jd9930
          - const: fiti,fp9931

  reg:
    maxItems: 1

  '#thermal-sensor-cells':
    const: 0

  enable-gpios:
    maxItems: 1

  pg-gpios:
    maxItems: 1

  ts-en-gpios:
    maxItems: 1

  xon-gpios:
    maxItems: 1

  vin-supply:
    description:
      Supply for the whole chip. Some vendor kernels and devicetrees
      declare this as a non-existing GPIO named "pwrall".

  fiti,tdly:
    $ref: /schemas/types.yaml#/definitions/uint32-array
    description:
      Power up soft start delay settings tDLY1-4 bitfields in the
      POWERON_DELAY register

    minItems: 4
    maxItems: 4

  VCOM:
    type: object
    $ref: /schemas/regulator/regulator.yaml#
    unevaluatedProperties: false
    description:
      The regulator for the compenstation voltage.
    properties:
      regulator-name:
        const: VCOM

  VPOSNEG:
    type: object
    $ref: /schemas/regulator/regulator.yaml#
    unevaluatedProperties: false
    description:
      The pair of symmetric LDOs
    properties:
      regulator-name:
        const: VPOSNEG

  V3P3:
    type: object
    $ref: /schemas/regulator/regulator.yaml#
    unevaluatedProperties: false
    description:
      The pair of symmetric LDOs
    properties:
      regulator-name:
        const: V3P3

required:
  - compatible
  - reg
  - '#thermal-sensor-cells'
  - pg-gpios
  - enable-gpios

additionalProperties: false

examples:
  - |
    #include <dt-bindings/gpio/gpio.h>
    i2c {
        #address-cells = <1>;
        #size-cells = <0>;

        fp9931: pmic@18 {
          compatible = "fiti,fp9931";
          reg = <0x18>;
          pinctrl-names = "default";
          pinctrl-0 = <&pinctrl_fp9931_gpio>;
          #thermal-sensor-cells = <0>;
          vin-supply = <&epd_pmic_supply>;
          pg-gpios = <&gpio2 7 GPIO_ACTIVE_HIGH>;
          ts-en-gpios = <&gpio2 9 GPIO_ACTIVE_HIGH>;
          enable-gpios = <&gpio2 8 GPIO_ACTIVE_HIGH>;
          fiti,tdly = <2 2 3 3>;

          vcom_reg: VCOM {
            regulator-name = "VCOM";
            regulator-min-microvolt = <2352840>;
            regulator-max-microvolt = <2352840>;
          };

          vposneg_reg: VPOSNEG {
            regulator-name = "VPOSNEG";
            regulator-min-microvolt = <15060000>;
            regulator-max-microvolt = <15060000>;
          };

          v3p3_reg: V3P3 {
            regulator-name = "V3P3";
          };
        };
    };
```

## Documentation/devicetree/bindings/regulator/hisilicon,histb-volt.yaml
```yaml
# SPDX-License-Identifier: (GPL-2.0-only OR BSD-2-Clause)
%YAML 1.2
---
$id: http://devicetree.org/schemas/regulator/hisilicon,histb-volt.yaml#
$schema: http://devicetree.org/meta-schemas/core.yaml#

title: HiSilicon STB voltage regulator

maintainers:
  - David Yang <mmyangfl@gmail.com>

description: |
  HiSilicon STB SoCs provide PWM outputs in the PMOC block which drive an
  external converter. The signal is filtered into a DC level between 0 V and
  3.3 V which is summed into the feedback input of the converter, so a rail
  follows the average level of the PWM signal and its voltage is set by the duty
  cycle.

  Where the duty cycle maps to in volts is a property of the board, not of the
  SoC: the endpoints come from the resistors of the filter and from the
  reference voltage of the converter. The datasheets therefore tabulate a
  different pair of endpoints for each converter of their reference designs
  (0.65 V to 1.15 V for the Hi3798cv200, 0.7 V to 1.25 V for the Hi3798mv200),
  and a board built to its own schematic has to describe its own.
  regulator-min-microvolt and regulator-max-microvolt are those endpoints of
  the linear range, and the regulator has no other source of calibration.

properties:
  compatible:
    enum:
      - hisilicon,hi3798cv200-volt
      - hisilicon,hi3798mv100-volt
      - hisilicon,hi3798mv200-volt

  reg:
    maxItems: 1

required:
  - compatible
  - reg
  - regulator-min-microvolt
  - regulator-max-microvolt

allOf:
  - $ref: regulator.yaml#

unevaluatedProperties: false

examples:
  - |
    vddcpu: regulator@8a23018 {
        compatible = "hisilicon,hi3798mv200-volt";
        reg = <0x8a23018 0x4>;
        regulator-name = "vdd-cpu";
        regulator-min-microvolt = <700000>;
        regulator-max-microvolt = <1250000>;
        regulator-always-on;
    };
```
