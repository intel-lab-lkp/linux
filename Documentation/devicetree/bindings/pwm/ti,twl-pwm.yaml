## Documentation/devicetree/bindings/regulator/mediatek,mt6373-regulator.yaml
```yaml
# SPDX-License-Identifier: (GPL-2.0 OR BSD-2-Clause)
%YAML 1.2
---
$id: http://devicetree.org/schemas/regulator/mediatek,mt6373-regulator.yaml#
$schema: http://devicetree.org/meta-schemas/core.yaml#

title: MediaTek MT6373 PMIC Regulators

maintainers:
  - AngeloGioacchino Del Regno <angelogioacchino.delregno@collabora.com>

description:
  The MT6373 SPMI PMIC provides 10 BUCK and 23 LDO (Low DropOut) regulators
  and can optionally provide overcurrent warnings with one ocp interrupt
  for each voltage regulator.

properties:
  compatible:
    const: mediatek,mt6373-regulator

  reg:
    maxItems: 1

  vsys-vbuck0-supply:
    description: Input supply for vbuck0

  vsys-vbuck1-supply:
    description: Input supply for vbuck1

  vsys-vbuck2-supply:
    description: Input supply for vbuck2

  vsys-vbuck3-supply:
    description: Input supply for vbuck3

  vsys-vbuck4-supply:
    description: Input supply for vbuck4

  vsys-vbuck5-supply:
    description: Input supply for vbuck5

  vsys-vbuck6-supply:
    description: Input supply for vbuck6

  vsys-vbuck7-supply:
    description: Input supply for vbuck7

  vsys-vbuck8-supply:
    description: Input supply for vbuck8

  vsys-vbuck9-supply:
    description: Input supply for vbuck9

  vs1-ldo1-supply:
    description: Input supply for vant18, vaud18, vcn18io

  vs2-ldo1-supply:
    description: Input supply for vrf12-aif, vrf13-aif

  vs3-ldo1-supply:
    description: Input supply for vrf09-aif, vsram-digrf-aif

  vsys-ldo1-supply:
    description: Input supply for vcn33-1, vcn33-2, vmc

  vsys-ldo2-supply:
    description:
      Input supply for vaux18, vcn33-3, vefuse, vfp, vibr, vio28, vtp, vusb

  vsys-ldo3-supply:
    description: Input supply for vmch, vmch-eint-high/low

patternProperties:
  "^v(ant|aud|aux)18$":
    $ref: "#/$defs/ldo-common"

  "^vbuck[0-9]$":
    type: object
    $ref: regulator.yaml#
    properties:
      regulator-allowed-modes:
        description: |
          Allowed Buck regulator operating modes allowed. Valid values below.
            0 - Normal mode with automatic power saving, reducing the switching
                frequency when light load conditions are detected
            1 - Forced Continuous Conduction mode (FCCM) for improved voltage
                regulation accuracy with constant switching frequency but lower
                regulator efficiency
            2 - Forced Low Power mode for improved regulator efficiency, used
                when no heavy load is expected, does not limit the maximum out
                current but unless only a light load is applied, there will be
                regulation accuracy and efficiency losses.
            3 - Forced Ultra Low Power mode for ultra low load, this greatly
                reduces the maximum output power, makes the regulator to be
                efficient only for ultra light load, and greatly reduces the
                quiescent current (Iq) of the buck.
        maxItems: 3
        items:
          enum: [ 0, 1, 2, 3 ]
    unevaluatedProperties: false

  "^v(cn18io|cn33-[123]|efuse|fp|tp|ibr|io28|sram-digrf-aif|usb)$":
    $ref: "#/$defs/ldo-common"

  "^vmc(h)?$":
    $ref: "#/$defs/ldo-common"

  "^vmch-eint-(low|high)$":
    $ref: "#/$defs/ldo-common"

  "^vrf(09|12|13|18|io18)-aif$":
    $ref: "#/$defs/ldo-common"

$defs:
  ldo-common:
    type: object
    $ref: regulator.yaml#
    unevaluatedProperties: false
    properties:
      regulator-allowed-modes:
        description: |
          Allowed LDO regulator operating modes allowed. Valid values below.
            0 - Normal mode with automatic power saving, reducing the switching
                frequency when light load conditions are detected
            2 - Forced Low Power mode for improved regulator efficiency, used
                when no heavy load is expected, does not limit the maximum out
                current but unless only a light load is applied, there will be
                regulation accuracy and efficiency losses.
        maxItems: 2
        items:
          enum: [ 0, 2 ]

required:
  - compatible
  - reg

additionalProperties: false
```

## Documentation/devicetree/bindings/regulator/mediatek,mt6392-regulator.yaml
```yaml
# SPDX-License-Identifier: (GPL-2.0 OR BSD-2-Clause)
%YAML 1.2
---
$id: http://devicetree.org/schemas/regulator/mediatek,mt6392-regulator.yaml#
$schema: http://devicetree.org/meta-schemas/core.yaml#

title: MediaTek MT6392 regulator

maintainers:
  - Luca Leonardo Scorcia <l.scorcia@gmail.com>

description:
  MT6392 is a power management system chip containing three buck converters and
  23 LDOs. All voltage regulators provided by the PMIC are described as
  sub-nodes of this node.

properties:
  compatible:
    items:
      - const: mediatek,mt6392-regulator

  vproc-supply:
    description: Supply for buck regulator vproc
  vcore-supply:
    description: Supply for buck regulator vcore
  vsys-supply:
    description: Supply for buck regulator vsys
  avddldo-supply:
    description:
      Supply for AVDD LDOs (vm, vio18, vcn18, vcamd, vcamio). According to the data sheet
      this is an internal supply derived from vsys.
  ldo1-supply:
    description: Supply for LDOs group 1 (vaud28, vxo22, vaud22, vadc18, vcama, vrtc)
  ldo2-supply:
    description: Supply for LDOs group 2 (vcn35, vio28, vmc, vmch, vefuse, vdig18)
  ldo3-supply:
    description: Supply for LDOs group 3 (vusb, vemc3v3, vcamaf, vgp1, vgp2, vm25)

patternProperties:
  "^v(core|proc|sys)$":
    description: Buck regulators
    type: object
    $ref: regulator.yaml#
    unevaluatedProperties: false
    properties:
      regulator-allowed-modes:
        description:
          BUCK regulators can set regulator-allowed-modes to values specified in
          dt-bindings/regulator/mediatek,mt6392-regulator.h
        items:
          enum: [0, 1]
        minItems: 1
        maxItems: 2
      regulator-initial-mode:
        description:
          BUCK regulators can set regulator-initial-mode to values specified in
          dt-bindings/regulator/mediatek,mt6392-regulator.h
        enum: [0, 1]

  "^v(adc18|camio|cn18|io18|xo22|m25|aud28|io28|usb)$":
    description: LDOs with fixed output and mode setting
    type: object
    $ref: regulator.yaml#
    unevaluatedProperties: false
    properties:
      regulator-allowed-modes:
        description:
          LDO regulators can set regulator-allowed-modes to values specified in
          dt-bindings/regulator/mediatek,mt6392-regulator.h
        items:
          enum: [0, 2]
        minItems: 1
        maxItems: 2
      regulator-initial-mode:
        description:
          LDO regulators can set regulator-initial-mode to values specified in
          dt-bindings/regulator/mediatek,mt6392-regulator.h
        enum: [0, 2]

  "^v(cama|dig18|rtc)$":
    description: LDOs with fixed output without mode setting
    type: object
    $ref: regulator.yaml#
    unevaluatedProperties: false
    properties:
      regulator-allowed-modes: false
      regulator-initial-mode: false

  "^v(aud22|camaf|camd|cn35|efuse|emc3v3|gp1|gp2|m|mc|mch)$":
    description: LDOs with adjustable output and mode setting
    type: object
    $ref: regulator.yaml#
    unevaluatedProperties: false
    properties:
      regulator-allowed-modes:
        description:
          LDO regulators can set regulator-allowed-modes to values specified in
          dt-bindings/regulator/mediatek,mt6392-regulator.h
        items:
          enum: [0, 2]
        minItems: 1
        maxItems: 2
      regulator-initial-mode:
        description:
          LDO regulators can set regulator-initial-mode to values specified in
          dt-bindings/regulator/mediatek,mt6392-regulator.h
        enum: [0, 2]

required:
  - compatible

additionalProperties: false
```

## Documentation/devicetree/bindings/regulator/mediatek,mt6397-regulator.yaml
```yaml
# SPDX-License-Identifier: (GPL-2.0 OR BSD-2-Clause)
%YAML 1.2
---
$id: http://devicetree.org/schemas/regulator/mediatek,mt6397-regulator.yaml#
$schema: http://devicetree.org/meta-schemas/core.yaml#

title: MediaTek MT6397 Regulator

maintainers:
  - Sen Chu <sen.chu@mediatek.com>
  - Macpaul Lin <macpaul.lin@mediatek.com>

description:
  Regulator node of the PMIC. This node should under the PMIC's device node.
  All voltage regulators provided by the PMIC are described as sub-nodes of
  this node.

properties:
  compatible:
    items:
      - const: mediatek,mt6397-regulator

patternProperties:
  "^(buck_)?v(core|drm|gpu|io18|pca(7|15)|sramca(7|15))$":
    description: Buck regulators
    type: object
    $ref: regulator.yaml#
    properties:
      regulator-allowed-modes:
        description: |
          BUCK regulators can set regulator-initial-mode and regulator-allowed-modes to
          values specified in dt-bindings/regulator/mediatek,mt6397-regulator.h
        items:
          enum: [0, 1]
    unevaluatedProperties: false

  "^(ldo_)?v(tcxo|(a|io)28)$":
    description: LDOs with fixed 2.8V output and 0~100/10mV tuning
    type: object
    $ref: regulator.yaml#
    properties:
      regulator-allowed-modes: false
    unevaluatedProperties: false

  "^(ldo_)?vusb$":
    description: LDOs with fixed 3.0V output and 0~100/10mV tuning
    type: object
    $ref: regulator.yaml#
    properties:
      regulator-allowed-modes: false
    unevaluatedProperties: false

  "^(ldo_)?v(cama|emc3v3|gp[123456]|ibr|mc|mch)$":
    description: LDOs with variable output and 0~100/10mV tuning
    type: object
    $ref: regulator.yaml#
    properties:
      regulator-allowed-modes: false
    unevaluatedProperties: false

required:
  - compatible

additionalProperties: false
```

## Documentation/devicetree/bindings/regulator/mediatek,mt8196-vmm-regulator.yaml
```yaml
# SPDX-License-Identifier: (GPL-2.0 OR BSD-2-Clause)
%YAML 1.2
---
$id: "http://devicetree.org/schemas/regulator/mediatek,mt8196-vmm-regulator.yaml#"
$schema: http://devicetree.org/meta-schemas/core.yaml#

title: MediaTek MT8196 VMM (Vcore for MultiMedia) Regulator Controller

maintainers:
  - Nancy Lin <nancy.lin@mediatek.com>

description: |
  The MediaTek MT8196 VMM (Vcore for Multi Media) controller acts as the
  main power supplier for multimedia power domains, such as those used by
  display, video encode and decode subsystems. The VMM hardware block
  provides virtual regulators that serve as the power sources (suppliers)
  for various multimedia IPs. It coordinates with the MediaTek hardware
  common clock framework (HWCCF) and the Video Companion Processor (VCP)
  to manage the power domains of these multimedia components.

  Each child node under the VMM node represents a virtual regulator
  (e.g., vdisp, vdec-vcore) and must specify a 'regulator-name'.

properties:
  compatible:
    const: "mediatek,mt8196-vmm"

  mediatek,hw-ccf:
    $ref: /schemas/types.yaml#/definitions/phandle
    description: Phandle to the hardware common clock framework syscon controller.

  mediatek,vcp:
    $ref: /schemas/types.yaml#/definitions/phandle
    description: Phandle to the Video Co-Processor (VCP) node.

patternProperties:
  "^(vdisp|vdec-vcore)$":
    type: object
    description: |
      Virtual regulator for a specific multimedia domain.
      The node name should match the supported regulator (e.g., vdisp, vdec-vcore).
    properties:
      regulator-name:
        type: string
        description: The name of the virtual regulator.
    required:
      - regulator-name
    additionalProperties: false

required:
  - compatible
  - mediatek,hw-ccf
  - mediatek,vcp

additionalProperties: false

examples:
  - |
    vmm: vmm {
      compatible = "mediatek,mt8196-vmm";
      mediatek,hw-ccf = <&mm_hwv>;
      mediatek,vcp = <&vcp>;

      vdisp: vdisp {
        regulator-name = "vdisp";
      };
      vdec_vcore: vdec-vcore {
        regulator-name = "vdec-vcore";
      };
    };
```

## Documentation/devicetree/bindings/regulator/motorola,cpcap-regulator.yaml
```yaml
# SPDX-License-Identifier: (GPL-2.0 OR BSD-2-Clause)
%YAML 1.2
---
$id: http://devicetree.org/schemas/regulator/motorola,cpcap-regulator.yaml#
$schema: http://devicetree.org/meta-schemas/core.yaml#

title: Motorola CPCAP PMIC regulators

maintainers:
  - Svyatoslav Ryhel <clamor95@gmail.com>

description:
  This module is part of the Motorola CPCAP MFD device. For more details
  see Documentation/devicetree/bindings/mfd/motorola,cpcap.yaml. The
  regulator controller is represented as a sub-node of the PMIC node
  on the device tree.

properties:
  compatible:
    enum:
      - motorola,cpcap-regulator
      - motorola,mapphone-cpcap-regulator
      - motorola,xoom-cpcap-regulator

  regulators:
    type: object

    patternProperties:
      "$[A-Z0-9]+^":
        $ref: /schemas/regulator/regulator.yaml#
        type: object
        description:
          Valid regulator names are SW1, SW2, SW3, SW4, SW5, VCAM, VCSI,
          VDAC, VDIG, VFUSE, VHVIO, VSDIO, VPLL, VRF1, VRF2, VRFREF, VWLAN1,
          VWLAN2, VSIM, VSIMCARD, VVIB, VUSB, VAUDIO

        required:
          - regulator-name
          - regulator-enable-ramp-delay
          - regulator-min-microvolt
          - regulator-max-microvolt

        unevaluatedProperties: false

required:
  - compatible

additionalProperties: false

...
```

## Documentation/devicetree/bindings/regulator/mps,mp8899.yaml
```yaml
# SPDX-License-Identifier: GPL-2.0-only OR BSD-2-Clause
%YAML 1.2
---
$id: http://devicetree.org/schemas/regulator/mps,mp8899.yaml#
$schema: http://devicetree.org/meta-schemas/core.yaml#

title: Monolithic Power System MP8899 PMIC

maintainers:
  - Vignesh Viswanathan <vignesh.viswanathan@oss.qualcomm.com>

properties:
  $nodename:
    pattern: "^pmic@[0-9a-f]{1,2}$"
  compatible:
    enum:
      - mps,mp8899

  reg:
    maxItems: 1

  regulators:
    type: object

    description: |
      list of regulators provided by this controller, must be named
      after their hardware counterparts BUCK[1-4]

    patternProperties:
      "^buck[1-4]$":
        type: object
        $ref: regulator.yaml#

        unevaluatedProperties: false

    additionalProperties: false

required:
  - compatible
  - reg
  - regulators

additionalProperties: false

examples:
  - |
    i2c {
        #address-cells = <1>;
        #size-cells = <0>;

        pmic@68 {
            compatible = "mps,mp8899";
            reg = <0x68>;

            regulators {
                buck1 {
                    regulator-name = "buck1";
                    regulator-min-microvolt = <550000>;
                    regulator-max-microvolt = <960000>;
                    regulator-always-on;
                    regulator-boot-on;
                };
            };
        };
    };
...
```
