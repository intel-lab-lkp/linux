## Documentation/devicetree/bindings/regulator/maxim,max20339.yaml
```yaml
# SPDX-License-Identifier: (GPL-2.0 OR BSD-2-Clause)
%YAML 1.2
---
$id: http://devicetree.org/schemas/regulator/maxim,max20339.yaml#
$schema: http://devicetree.org/meta-schemas/core.yaml#

title: Maxim Integrated MAX20339 overvoltage protector with load switches

maintainers:
  - André Draszik <andre.draszik@linaro.org>

description: |
  The MAX20339 is an overvoltage protection (OVP) device with integrated load
  switches and ESD Protection for USB Type-C applications. It protects low
  voltage systems against voltage faults and surges. It also integrates two
  load switches with current limiting, configurable by hard- and software.

properties:
  compatible:
    enum:
      - maxim,max20339

  dig-supply:
    description:
      Input supply for the device itself (DIG pin, 1.7V to 1.9V). In absence of
      Vdig, the IN pin will power the device.

  gpio:
    type: object

    properties:
      "#gpio-cells":
        const: 2

      gpio-controller: true

      gpio-line-names:
        description: Strings describing the names of each gpio line.
        maxItems: 1

    required:
      - "#gpio-cells"
      - gpio-controller

    additionalProperties: false

  insw-supply:
    description:
      Input supply for the outputs (IN pin, 3.9V to 28.0V). Also used as supply
      for the device itself in case dig-supply is not wired up.

  interrupts:
    maxItems: 1

  lsw1-supply:
    description: Input supply for the outputs (LSW1IN pin, 4.0V to 10.0V)

  lsw2-supply:
    description: Input supply for the outputs (LSW2IN pin, 4.0V to 10.0V)

  reg:
    maxItems: 1

  regulators:
    type: object

    properties:
      insw:
        type: object
        $ref: regulator.yaml#
        description: Represents the switch connecting IN to OUT, INSW.

        properties:
          regulator-ov-protection-microvolt:
            enum: [5850000, 9700000, 14500000]

        unevaluatedProperties: false

    patternProperties:
      "^lsw[12]$":
        type: object
        $ref: regulator.yaml#
        description: Represents the load switches LSW1 and LSW2.

        properties:
          regulator-ov-protection-microvolt:
            enum: [0, 1]

          shunt-resistor-micro-ohms:
            description:
              Value in micro Ohm of the resistor connected between the SETx
              pin and GND. This value is required to be able to calculate and
              program the current limiting threshold register.

        required:
          - shunt-resistor-micro-ohms

        unevaluatedProperties: false

    required:
      - lsw1
      - lsw2

    additionalProperties: false

anyOf:
  - oneOf:
      - required:
          - dig-supply
      - required:
          - insw-supply
  - required:
      - dig-supply
      - insw-supply

required:
  - compatible
  - reg
  - regulators

additionalProperties: false

examples:
  - |
    #include <dt-bindings/gpio/gpio.h>
    #include <dt-bindings/interrupt-controller/irq.h>

    i2c {
        #address-cells = <1>;
        #size-cells = <0>;

        ovp@35 {
            compatible = "maxim,max20339";
            reg = <0x35>;

            dig-supply = <&reg_1v8>;
            insw-supply = <&reg_5v3>;
            lsw1-supply = <&reg_5v3>;
            lsw2-supply = <&reg_5v3>;

            interrupts-extended = <&gpa8 1 IRQ_TYPE_LEVEL_LOW>;

            gpio {
                gpio-controller;
                #gpio-cells = <2>;
            };

            regulators {
                insw {
                    regulator-name = "PPVAR_VBUS_OVP";
                    regulator-active-discharge = <0>;
                    regulator-min-microvolt = <5850000>;
                    regulator-max-microvolt = <14500000>;
                    regulator-ov-protection-microvolt = <14500000>;
                };
                lsw1 {
                    regulator-name = "PPVAR_VBUS_OVP_LSW1";
                    regulator-oc-protection-microamp = <1460000>;
                    regulator-ov-protection-microvolt = <1>;
                    shunt-resistor-micro-ohms = <120000000>;
                };
                lsw2 {
                    regulator-name = "PPVAR_QI_VOUT_TX";
                    regulator-oc-protection-microamp = <1230000>;
                    regulator-ov-protection-microvolt = <1>;
                    shunt-resistor-micro-ohms = <147000000>;
                };
            };
        };
    };
...
```

## Documentation/devicetree/bindings/regulator/maxim,max8907.yaml
```yaml
# SPDX-License-Identifier: (GPL-2.0-only OR BSD-2-Clause)
%YAML 1.2
---
$id: http://devicetree.org/schemas/regulator/maxim,max8907.yaml#
$schema: http://devicetree.org/meta-schemas/core.yaml#

title: Maxim Integrated MAX8907 PMIC

maintainers:
  - Svyatoslav Ryhel <clamor95@gmail.com>

properties:
  compatible:
    const: maxim,max8907

  reg:
    maxItems: 1

  interrupts:
    maxItems: 1

  maxim,system-power-controller:
    type: boolean
    deprecated: true
    description:
      Telling whether or not this PMIC is controlling the system power.

  system-power-controller: true

  mbatt-supply:
    description:
      The input supply for MBATT, BBAT, SDBY, VRTC.

  regulators:
    type: object
    additionalProperties: false

    patternProperties:
      "^(sd[1-3]|ldo([1-9]|1[0-9]|20)|bbat|mbatt|out(5v|33v)|sdby|vrtc)$":
        allOf:
          - $ref: /schemas/regulator/regulator.yaml#
          - $ref: /schemas/regulator/nvidia,tegra-regulators-coupling.yaml#
        unevaluatedProperties: false

patternProperties:
  "^in-v[1-3]-supply$":
    $ref: /schemas/types.yaml#/definitions/phandle
    description:
      The input supply for SD1, SD2 and SD3.

  "^in([1-9]|1[0-9]|20)-supply$":
    $ref: /schemas/types.yaml#/definitions/phandle
    description:
      The input supply for LDO1 - LDO20.

required:
  - compatible
  - reg
  - interrupts
  - regulators

additionalProperties: false

examples:
  - |
    i2c {
        #address-cells = <1>;
        #size-cells = <0>;

        pmic@3c {
            compatible = "maxim,max8907";
            reg = <0x3c>;
            interrupts = <0 86 0x4>;

            system-power-controller;

            mbatt-supply = <&vdd_5v0_sys>;
            in-v1-supply = <&vdd_3v3_vbat>;
            in-v2-supply = <&vdd_3v3_vbat>;
            in-v3-supply = <&vdd_3v3_vbat>;
            in1-supply = <&vdd_3v3_vbat>;
            in2-supply = <&vdd_1v8_vio>;
            in3-supply = <&vdd_3v3_vbat>;
            in4-supply = <&vdd_3v3_vbat>;
            in5-supply = <&vdd_3v3_vbat>;
            in6-supply = <&vdd_3v3_vbat>;
            in7-supply = <&vdd_3v3_vbat>;
            in8-supply = <&vdd_3v3_vbat>;
            in9-supply = <&vdd_3v3_vbat>;
            in10-supply = <&vdd_3v3_vbat>;
            in11-supply = <&vdd_3v3_vbat>;
            in12-supply = <&vdd_3v3_vbat>;
            in13-supply = <&vdd_3v3_vbat>;
            in14-supply = <&vdd_3v3_vbat>;
            in15-supply = <&vdd_3v3_vbat>;
            in16-supply = <&vdd_3v3_vbat>;
            in17-supply = <&vdd_1v8_vio>;
            in18-supply = <&vdd_3v3_vbat>;
            in19-supply = <&vdd_3v3_vbat>;
            in20-supply = <&vdd_3v3_vbat>;

            regulators {
                vdd_3v3_vbat: mbatt {
                    regulator-name = "v_powerrail";
                    regulator-always-on;
                };

                sd1 {
                    regulator-name = "vcc_1v2_ddrio";
                    regulator-min-microvolt = <1200000>;
                    regulator-max-microvolt = <1200000>;
                    regulator-always-on;
                    regulator-boot-on;
                };

                vdd_core: sd2 {
                    regulator-name = "vdd_core";
                    regulator-min-microvolt = <950000>;
                    regulator-max-microvolt = <1300000>;
                    regulator-always-on;
                    regulator-boot-on;
                };

                vdd_1v8_vio: sd3 {
                    regulator-name = "vcc_1v8_io";
                    regulator-min-microvolt = <1800000>;
                    regulator-max-microvolt = <1800000>;
                    regulator-always-on;
                    regulator-boot-on;
                };

                ldo1 {
                    regulator-name = "vcc_3v3_ddr";
                    regulator-min-microvolt = <3300000>;
                    regulator-max-microvolt = <3300000>;
                    regulator-always-on;
                    regulator-boot-on;
                };

                ldo2 {
                    regulator-name = "vcc_1v1_pll";
                    regulator-min-microvolt = <1100000>;
                    regulator-max-microvolt = <1100000>;
                    regulator-always-on;
                    regulator-boot-on;
                };

                iovcc_1v8_lcd: ldo3 {
                    regulator-name = "vcc_1v8_lcd";
                    regulator-min-microvolt = <1800000>;
                    regulator-max-microvolt = <1800000>;
                    regulator-boot-on;
                };

                avdd_3v3_usb: ldo4 {
                    regulator-name = "avdd_3v3_usb";
                    regulator-min-microvolt = <3300000>;
                    regulator-max-microvolt = <3300000>;
                    regulator-always-on;
                    regulator-boot-on;
                };

                vcore_emmc: ldo5 {
                    regulator-name = "vcc_2v8_emmc";
                    regulator-min-microvolt = <2800000>;
                    regulator-max-microvolt = <2800000>;
                    regulator-boot-on;
                };

                vcc_hdmi_pll: ldo6 {
                    regulator-name = "vcc_hdmi_pll";
                    regulator-min-microvolt = <1800000>;
                    regulator-max-microvolt = <1800000>;
                };

                vcc_3v0_sensor: ldo7 {
                    regulator-name = "vcc_3v0_sensor";
                    regulator-min-microvolt = <3000000>;
                    regulator-max-microvolt = <3000000>;
                    regulator-boot-on;
                };

                vcc_1v8_sensor: ldo8 {
                    regulator-name = "vcc_1v8_sensor";
                    regulator-min-microvolt = <1800000>;
                    regulator-max-microvolt = <1800000>;
                    regulator-boot-on;
                };

                ldo9 {
                    regulator-name = "vcc_3v3_fuse";
                    regulator-min-microvolt = <3300000>;
                    regulator-max-microvolt = <3300000>;
                };

                vcc_3v1_touch: ldo10 {
                    regulator-name = "vcc_3v1_touch";
                    regulator-min-microvolt = <3100000>;
                    regulator-max-microvolt = <3100000>;
                    regulator-boot-on;
                };

                vdd_3v3_hdmi: ldo11 {
                    regulator-name = "vdd_3v3_hdmi";
                    regulator-min-microvolt = <3300000>;
                    regulator-max-microvolt = <3300000>;
                };

                vdd_usd: ldo12 {
                    regulator-name = "vcc_2v8_sdio";
                    regulator-min-microvolt = <2800000>;
                    regulator-max-microvolt = <2800000>;
                    regulator-boot-on;
                };

                vcc_3v0_motor: ldo13 {
                    regulator-name = "vcc_3v0_motor";
                    regulator-min-microvolt = <3000000>;
                    regulator-max-microvolt = <3000000>;
                };

                vcc_2v8_lcd: ldo14 {
                    regulator-name = "vcc_2v8_lcd";
                    regulator-min-microvolt = <2800000>;
                    regulator-max-microvolt = <2800000>;
                    regulator-boot-on;
                };

                vcc_3v3_temp: ldo15 {
                    regulator-name = "vcc_3v3_temp";
                    regulator-min-microvolt = <3300000>;
                    regulator-max-microvolt = <3300000>;
                    regulator-boot-on;
                };

                /* LDO16 is not used */

                avdd_dsi_csi: ldo17 {
                    regulator-name = "vcc_1v2_mipi";
                    regulator-min-microvolt = <1200000>;
                    regulator-max-microvolt = <1200000>;
                };

                ldo18 {
                    regulator-name = "vcc_1v8_vi";
                    regulator-min-microvolt = <1800000>;
                    regulator-max-microvolt = <1800000>;
                };

                vcc_1v8_touch: ldo19 {
                    regulator-name = "vcc_1v8_touch";
                    regulator-min-microvolt = <1800000>;
                    regulator-max-microvolt = <1800000>;
                    regulator-boot-on;
                };

                /* LDO20 is not used */

                out5v {
                    regulator-name = "usb0_vbus_reg";
                    regulator-min-microvolt = <5000000>;
                    regulator-max-microvolt = <5000000>;
                };

                /* OUT33V is not used */

                bbat {
                    regulator-name = "vcc_bbat";
                };

                vdd_rtc: sdby {
                    regulator-name = "vcc_rtc";
                    regulator-min-microvolt = <950000>;
                    regulator-max-microvolt = <1300000>;
                    regulator-always-on;
                    regulator-boot-on;
                };

                vrtc {
                    regulator-name = "vrtc";
                };
            };
        };
    };
...
```

## Documentation/devicetree/bindings/regulator/mediatek,mt6316-regulator.yaml
```yaml
# SPDX-License-Identifier: (GPL-2.0 OR BSD-2-Clause)
%YAML 1.2
---
$id: http://devicetree.org/schemas/regulator/mediatek,mt6316-regulator.yaml#
$schema: http://devicetree.org/meta-schemas/core.yaml#

title: MediaTek MT6316 SPMI PMIC Regulators

maintainers:
  - AngeloGioacchino Del Regno <angelogioacchino.delregno@collabora.com>

description: |
  The MediaTek MT6316 PMIC is fully controlled by SPMI interface; it features
  four step-down DC/DC (buck) converters and has multiple variants, providing
  different phase configurations. In particular:
  MT6316BP/VP:    2+2 Phase (buck 1+2, buck 3+4)
  MT6316CP/HP/KP: 3+1 Phase (buck 1+2+4, buck 3)
  MT6316DP/TP:    4+0 Phase (buck 1+2+3+4)

properties:
  compatible:
    enum:
      - mediatek,mt6316b-regulator
      - mediatek,mt6316c-regulator
      - mediatek,mt6316d-regulator

  vbuck1234:
    type: object
    $ref: regulator.yaml#
    unevaluatedProperties: false

additionalProperties: false

allOf:
  - if:
      properties:
        compatible:
          const: mediatek,mt6316b-regulator
    then:
      patternProperties:
        "^vbuck(12|34)$":
          type: object
          $ref: regulator.yaml#
          unevaluatedProperties: false

  - if:
      properties:
        compatible:
          const: mediatek,mt6316c-regulator
    then:
      patternProperties:
        "^vbuck(124|3)$":
          type: object
          $ref: regulator.yaml#
          unevaluatedProperties: false

  - if:
      properties:
        compatible:
          const: mediatek,mt6316d-regulator
    then:
      properties:
        vbuck1234: true
    else:
      properties:
        vbuck1234: false

examples:
  - |
    pmic {
      regulators {
        compatible = "mediatek,mt6316d-regulator";

        vbuck1234 {
          regulator-min-microvolt = <400000>;
          regulator-max-microvolt = <1277500>;
          regulator-always-on;
        };
      };
    };
...
```
