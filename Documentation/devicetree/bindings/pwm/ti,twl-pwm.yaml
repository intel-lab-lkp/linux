## Documentation/devicetree/bindings/regulator/mps,mpq2286.yaml
```yaml
# SPDX-License-Identifier: GPL-2.0-only OR BSD-2-Clause
%YAML 1.2
---
$id: http://devicetree.org/schemas/regulator/mps,mpq2286.yaml#
$schema: http://devicetree.org/meta-schemas/core.yaml#

title: Monolithic Power System MPQ2286 PMIC

maintainers:
  - Saravanan Sekar <saravanan@linumiz.com>

properties:
  compatible:
    enum:
      - mps,mpq2286

  reg:
    maxItems: 1

  regulators:
    type: object

    properties:
      buck0:
        type: object
        $ref: regulator.yaml#

        unevaluatedProperties: false

    additionalProperties: false

required:
  - compatible
  - reg
  - regulators

additionalProperties: false

examples:
  - |
    i2c {
        #address-cells = <1>;
        #size-cells = <0>;

        pmic@3 {
            compatible = "mps,mpq2286";
            reg = <0x3>;

            regulators {
                buck0 {
                    regulator-name = "buck0";
                    regulator-min-microvolt = <1600000>;
                    regulator-max-microvolt = <1800000>;
                    regulator-boot-on;
                };
            };
        };
    };
...
```

## Documentation/devicetree/bindings/regulator/nvidia,tegra-regulators-coupling.yaml
```yaml
# SPDX-License-Identifier: GPL-2.0-only OR BSD-2-Clause
%YAML 1.2
---
$id: http://devicetree.org/schemas/regulator/nvidia,tegra-regulators-coupling.yaml#
$schema: http://devicetree.org/meta-schemas/core.yaml#

title: NVIDIA Tegra Regulators Coupling

description:
  NVIDIA Tegra SoC's have a mandatory voltage-coupling between regulators. Thus
  on Tegra20 there are 3 coupled regulators and on NVIDIA Tegra30 there are 2.

  Tegra20 voltage coupling On Tegra20 SoC's - there are 3 coupled
  regulators:CORE, RTC and CPU. The CORE and RTC voltages shall be in a range
  of 170mV from each other and they both shall be higher than the CPU voltage
  by at least 120mV.

  Tegra30 voltage coupling On Tegra30 SoC's - there are 2 coupled
  regulators:CORE and CPU. The CORE and CPU voltages shall be in a range of
  300mV from each other and CORE voltage shall be higher than the CPU by N mV,
  where N depends on the CPU voltage.

maintainers:
  - Dmitry Osipenko <digetx@gmail.com>
  - Thierry Reding <treding@nvidia.com>

properties:
  nvidia,tegra-core-regulator:
    description: designates regulator as the "Core domain" voltage regulator.
    type: boolean

  nvidia,tegra-rtc-regulator:
    description: designates regulator as the "RTC domain" voltage regulator.
    type: boolean

  nvidia,tegra-cpu-regulator:
    description: designates regulator as the "CPU domain" voltage regulator.
    type: boolean

additionalProperties: true

examples:
  - |
    pmic {
        regulators {
            core_vdd_reg: core {
                regulator-name = "vdd_core";
                regulator-min-microvolt = <950000>;
                regulator-max-microvolt = <1300000>;
                regulator-coupled-with = <&rtc_vdd_reg &cpu_vdd_reg>;
                regulator-coupled-max-spread = <170000 550000>;

                nvidia,tegra-core-regulator;
            };

            rtc_vdd_reg: rtc {
                regulator-name = "vdd_rtc";
                regulator-min-microvolt = <950000>;
                regulator-max-microvolt = <1300000>;
                regulator-coupled-with = <&core_vdd_reg &cpu_vdd_reg>;
                regulator-coupled-max-spread = <170000 550000>;

                nvidia,tegra-rtc-regulator;
           };

           cpu_vdd_reg: cpu {
                regulator-name = "vdd_cpu";
                regulator-min-microvolt = <750000>;
                regulator-max-microvolt = <1125000>;
                regulator-coupled-with = <&core_vdd_reg &rtc_vdd_reg>;
                regulator-coupled-max-spread = <550000 550000>;

                nvidia,tegra-cpu-regulator;
            };
        };
    };
```

## Documentation/devicetree/bindings/regulator/nxp,pf0900-regulator.yaml
```yaml
# SPDX-License-Identifier: GPL-2.0-only OR BSD-2-Clause
%YAML 1.2
---
$id: http://devicetree.org/schemas/regulator/nxp,pf0900-regulator.yaml#
$schema: http://devicetree.org/meta-schemas/core.yaml#

title: NXP PF0900 Power Management Integrated Circuit regulators

maintainers:
  - Joy Zou <joy.zou@nxp.com>

description:
  The PF0900 is a power management integrated circuit (PMIC) optimized
  for high performance i.MX9x based applications. It features five high
  efficiency buck converters, three linear and one vaon regulators. It
  provides low quiescent current in Standby and low power off Modes.

properties:
  compatible:
    enum:
      - nxp,pf0900

  reg:
    maxItems: 1

  interrupts:
    maxItems: 1

  regulators:
    type: object

    properties:
      "VAON":
       type: object
       $ref: regulator.yaml#

       unevaluatedProperties: false

    patternProperties:
      "^LDO[1-3]$":
        type: object
        $ref: regulator.yaml#
        description:
          Properties for single LDO regulator.

        unevaluatedProperties: false

      "^SW[1-5]$":
        type: object
        $ref: regulator.yaml#
        description:
          Properties for single SW regulator.

        properties:
          nxp,dvs-run-microvolt:
            minimum: 300000
            maximum: 1350000
            description:
              PMIC default "RUN" state voltage in uV. SW1~5 have such
              dvs(dynamic voltage scaling) property.

          nxp,dvs-standby-microvolt:
            minimum: 300000
            maximum: 1350000
            description:
              PMIC default "STANDBY" state voltage in uV. SW1~5 have such
              dvs(dynamic voltage scaling) property.

        unevaluatedProperties: false

    additionalProperties: false

  nxp,i2c-crc-enable:
    type: boolean
    description: If the PMIC OTP_I2C_CRC_EN is enable, you need to add this property.

required:
  - compatible
  - reg
  - interrupts
  - regulators

additionalProperties: false

examples:
  - |
    #include <dt-bindings/interrupt-controller/irq.h>

    i2c {
        #address-cells = <1>;
        #size-cells = <0>;

        pmic@8 {
            compatible = "nxp,pf0900";
            reg = <0x08>;
            interrupt-parent = <&pcal6524>;
            interrupts = <89 IRQ_TYPE_LEVEL_LOW>;
            nxp,i2c-crc-enable;

            regulators {
                VAON {
                    regulator-name = "VAON";
                    regulator-min-microvolt = <1800000>;
                    regulator-max-microvolt = <3300000>;
                    regulator-boot-on;
                    regulator-always-on;
                };

                SW1 {
                    regulator-name = "SW1";
                    regulator-min-microvolt = <500000>;
                    regulator-max-microvolt = <3300000>;
                    regulator-boot-on;
                    regulator-always-on;
                    regulator-ramp-delay = <1950>;
                };

                SW2 {
                    regulator-name = "SW2";
                    regulator-min-microvolt = <300000>;
                    regulator-max-microvolt = <3300000>;
                    regulator-boot-on;
                    regulator-always-on;
                    regulator-ramp-delay = <1950>;
                };

                SW3 {
                    regulator-name = "SW3";
                    regulator-min-microvolt = <300000>;
                    regulator-max-microvolt = <3300000>;
                    regulator-boot-on;
                    regulator-always-on;
                    regulator-ramp-delay = <1950>;
                };

                SW4 {
                    regulator-name = "SW4";
                    regulator-min-microvolt = <300000>;
                    regulator-max-microvolt = <3300000>;
                    regulator-boot-on;
                    regulator-always-on;
                    regulator-ramp-delay = <1950>;
                };

                SW5 {
                    regulator-name = "SW5";
                    regulator-min-microvolt = <300000>;
                    regulator-max-microvolt = <3300000>;
                    regulator-boot-on;
                    regulator-always-on;
                    regulator-ramp-delay = <1950>;
                };

                LDO1 {
                    regulator-name = "LDO1";
                    regulator-min-microvolt = <750000>;
                    regulator-max-microvolt = <3300000>;
                    regulator-boot-on;
                    regulator-always-on;
                };

                LDO2 {
                    regulator-name = "LDO2";
                    regulator-min-microvolt = <650000>;
                    regulator-max-microvolt = <3300000>;
                    regulator-boot-on;
                    regulator-always-on;
                };

                LDO3 {
                    regulator-name = "LDO3";
                    regulator-min-microvolt = <650000>;
                    regulator-max-microvolt = <3300000>;
                    regulator-boot-on;
                    regulator-always-on;
                };
            };
        };
     };
```
