## Documentation/devicetree/bindings/regulator/mediatek,mt6316b-regulator.yaml
```yaml
# SPDX-License-Identifier: (GPL-2.0 OR BSD-2-Clause)
%YAML 1.2
---
$id: http://devicetree.org/schemas/regulator/mediatek,mt6316b-regulator.yaml#
$schema: http://devicetree.org/meta-schemas/core.yaml#

title: MediaTek MT6316 BP/VP SPMI PMIC Regulators

maintainers:
  - AngeloGioacchino Del Regno <angelogioacchino.delregno@collabora.com>

description:
  The MediaTek MT6316BP/VP PMICs are fully controlled by SPMI interface, both
  feature four step-down DC/DC (buck) converters, and provides 2+2 Phases,
  joining Buck 1+2 for the first phase, and Buck 3+4 for the second phase.

properties:
  compatible:
    const: mediatek,mt6316b-regulator

  vbuck12:
    type: object
    $ref: regulator.yaml#
    unevaluatedProperties: false

  vbuck34:
    type: object
    $ref: regulator.yaml#
    unevaluatedProperties: false

additionalProperties: false

examples:
  - |
    pmic {
      regulators {
        compatible = "mediatek,mt6316b-regulator";

        vbuck12 {
          regulator-min-microvolt = <450000>;
          regulator-max-microvolt = <965000>;
          regulator-always-on;
        };
      };
    };
...
```

## Documentation/devicetree/bindings/regulator/mediatek,mt6316c-regulator.yaml
```yaml
# SPDX-License-Identifier: (GPL-2.0 OR BSD-2-Clause)
%YAML 1.2
---
$id: http://devicetree.org/schemas/regulator/mediatek,mt6316c-regulator.yaml#
$schema: http://devicetree.org/meta-schemas/core.yaml#

title: MediaTek MT6316 CP/HP/KP SPMI PMIC Regulators

maintainers:
  - AngeloGioacchino Del Regno <angelogioacchino.delregno@collabora.com>

description:
  The MediaTek MT6316CP/HP/KP PMICs are fully controlled by SPMI interface,
  features four step-down DC/DC (buck) converters, and provides 3+1 Phases,
  joining Buck 1+2+4 for the first phase, and uses Buck 3 for the second.

properties:
  compatible:
    const: mediatek,mt6316c-regulator

  vbuck124:
    type: object
    $ref: regulator.yaml#
    unevaluatedProperties: false

  vbuck3:
    type: object
    $ref: regulator.yaml#
    unevaluatedProperties: false

additionalProperties: false

examples:
  - |
    pmic {
      regulators {
        compatible = "mediatek,mt6316c-regulator";

        vbuck124 {
          regulator-min-microvolt = <450000>;
          regulator-max-microvolt = <1277500>;
          regulator-always-on;
        };
      };
    };
...
```

## Documentation/devicetree/bindings/regulator/mediatek,mt6316d-regulator.yaml
```yaml
# SPDX-License-Identifier: (GPL-2.0 OR BSD-2-Clause)
%YAML 1.2
---
$id: http://devicetree.org/schemas/regulator/mediatek,mt6316d-regulator.yaml#
$schema: http://devicetree.org/meta-schemas/core.yaml#

title: MediaTek MT6316 DP/TP SPMI PMIC Regulators

maintainers:
  - AngeloGioacchino Del Regno <angelogioacchino.delregno@collabora.com>

description:
  The MediaTek MT6316DP/TP PMICs are fully controlled by SPMI interface, both
  feature four step-down DC/DC (buck) converters, and provides a single Phase,
  joining Buck 1+2+3+4.

properties:
  compatible:
    const: mediatek,mt6316d-regulator

  vbuck1234:
    type: object
    $ref: regulator.yaml#
    unevaluatedProperties: false

additionalProperties: false

examples:
  - |
    pmic {
      regulators {
        compatible = "mediatek,mt6316d-regulator";

        vbuck1234 {
          regulator-min-microvolt = <400000>;
          regulator-max-microvolt = <1277500>;
          regulator-always-on;
        };
      };
    };
...
```

## Documentation/devicetree/bindings/regulator/mediatek,mt6323-regulator.yaml
```yaml
# SPDX-License-Identifier: (GPL-2.0 OR BSD-2-Clause)
%YAML 1.2
---
$id: http://devicetree.org/schemas/regulator/mediatek,mt6323-regulator.yaml#
$schema: http://devicetree.org/meta-schemas/core.yaml#

title: MediaTek MT6323 Regulator

maintainers:
  - John Crispin <john@phrozen.org>
  - Sen Chu <sen.chu@mediatek.com>
  - Macpaul Lin <macpaul.lin@mediatek.com>

description: |
  Regulator node of the PMIC. This node should under the PMIC's device node.
  All voltage regulators provided by the PMIC are described as sub-nodes of
  this node.

properties:
  compatible:
    items:
      - const: mediatek,mt6323-regulator

patternProperties:
  "^buck_v(pa|proc|sys)$":
    description: Buck regulators
    type: object
    $ref: regulator.yaml#

    properties:
      regulator-allowed-modes: false

    unevaluatedProperties: false

    required:
      - regulator-name

  "^ldo_v(camio|cn18)$":
    description: LDO with fixed 1.8V output and 0~100/10mV tuning
    type: object
    $ref: regulator.yaml#

    properties:
      regulator-allowed-modes: false

    unevaluatedProperties: false

    required:
      - regulator-name

  "^ldo_v((io|rf)18)$":
    description: LDOs with fixed 1.825V output and 0~100/10mV tuning
    type: object
    $ref: regulator.yaml#

    properties:
      regulator-allowed-modes: false

    unevaluatedProperties: false

    required:
      - regulator-name

  "^ldo_v(a|rtc|tcxo|(cn|io)28)$":
    description: LDOs with fixed 2.8V output and 0~100/10mV tuning
    type: object
    $ref: regulator.yaml#

    properties:
      regulator-allowed-modes: false

    unevaluatedProperties: false

    required:
      - regulator-name

  "^ldo_v(usb)$":
    description: LDOs with fixed 3.3V output and 0~100/10mV tuning
    type: object
    $ref: regulator.yaml#

    properties:
      regulator-allowed-modes: false

    unevaluatedProperties: false

    required:
      - regulator-name

  "^ldo_v(cn33_(bt|wifi))$":
    description: LDOs with variable 3.3V output and 0~100/10mV tuning
    type: object
    $ref: regulator.yaml#

    properties:
      regulator-allowed-modes: false

    unevaluatedProperties: false

    required:
      - regulator-name

  "^ldo_v(cama|camaf|camd|emc3v3|gp[123]|ibr|m|mc|mch|sim[12])$":
    description: LDOs with variable output and 0~100/10mV tuning
    type: object
    $ref: regulator.yaml#

    properties:
      regulator-allowed-modes: false

    unevaluatedProperties: false

    required:
      - regulator-name

required:
  - compatible

additionalProperties: false
```

## Documentation/devicetree/bindings/regulator/mediatek,mt6363-regulator.yaml
```yaml
# SPDX-License-Identifier: (GPL-2.0 OR BSD-2-Clause)
%YAML 1.2
---
$id: http://devicetree.org/schemas/regulator/mediatek,mt6363-regulator.yaml#
$schema: http://devicetree.org/meta-schemas/core.yaml#

title: MediaTek MT6363 PMIC Regulators

maintainers:
  - AngeloGioacchino Del Regno <angelogioacchino.delregno@collabora.com>

description:
  The MT6363 SPMI PMIC provides 10 BUCK and 25 LDO (Low DropOut) regulators
  and can optionally provide overcurrent warnings with one ocp interrupt
  for each voltage regulator.

properties:
  compatible:
    const: mediatek,mt6363-regulator

  reg:
    maxItems: 1

  vsys-vbuck1-supply:
    description: Input supply for vbuck1
  vsys-vbuck2-supply:
    description: Input supply for vbuck2
  vsys-vbuck3-supply:
    description: Input supply for vbuck3
  vsys-vbuck4-supply:
    description: Input supply for vbuck4
  vsys-vbuck5-supply:
    description: Input supply for vbuck5
  vsys-vbuck6-supply:
    description: Input supply for vbuck6
  vsys-vbuck7-supply:
    description: Input supply for vbuck7
  vsys-vs1-supply:
    description: Input supply for vs1
  vsys-vs2-supply:
    description: Input supply for vs2
  vsys-vs3-supply:
    description: Input supply for vs3
  vs1-ldo1-supply:
    description: Input supply for va15, vio0p75, vm18, vrf18, vrf-io18
  vs1-ldo2-supply:
    description: Input supply for vcn15, vio18, vufs18
  vs2-ldo1-supply:
    description: Input supply for vsram-cpub, vsram-cpum, vrf12, vrf13, vufs12
  vs2-ldo2-supply:
    description: Input supply for va12-1, va12-2, vcn13, vsram-cpul
  vs3-ldo1-supply:
    description: Input supply for vsram-apu, vsram-digrf, vsram-mdfe
  vs3-ldo2-supply:
    description: Input supply for vsram-modem, vrf0p9
  vsys-ldo1-supply:
    description: Input supply for vaux18, vemc, vtref18

patternProperties:
  "^v(buck[1-7]|s[1-3])$":
    description: Buck regulators
    type: object
    $ref: regulator.yaml#
    properties:
      regulator-allowed-modes:
        description: |
          Allowed Buck regulator operating modes allowed. Valid values below.
            0 - Normal mode with automatic power saving, reducing the switching
                frequency when light load conditions are detected
            1 - Forced Continuous Conduction mode (FCCM) for improved voltage
                regulation accuracy with constant switching frequency but lower
                regulator efficiency
            2 - Forced Low Power mode for improved regulator efficiency, used
                when no heavy load is expected, does not limit the maximum out
                current but unless only a light load is applied, there will be
                regulation accuracy and efficiency losses.
            3 - Forced Ultra Low Power mode for ultra low load, this greatly
                reduces the maximum output power, makes the regulator to be
                efficient only for ultra light load, and greatly reduces the
                quiescent current (Iq) of the buck.
        maxItems: 3
        items:
          enum: [ 0, 1, 2, 3 ]
    unevaluatedProperties: false

  "^va(12-1|12-2|15)$":
    type: object
    $ref: regulator.yaml#
    properties:
      regulator-allowed-modes:
        description: |
          Allowed LDO regulator operating modes allowed. Valid values below.
            0 - Normal mode with automatic power saving, reducing the switching
                frequency when light load conditions are detected
            2 - Forced Low Power mode for improved regulator efficiency, used
                when no heavy load is expected, does not limit the maximum out
                current but unless only a light load is applied, there will be
                regulation accuracy and efficiency losses.
        maxItems: 2
        items:
          enum: [ 0, 2 ]
    unevaluatedProperties: false

  "^v(aux|m|rf-io|tref)18$":
    type: object
    $ref: regulator.yaml#
    properties:
      regulator-allowed-modes:
        maxItems: 2
        items:
          enum: [ 0, 2 ]
    unevaluatedProperties: false

  "^v(cn13|cn15|emc)$":
    type: object
    $ref: regulator.yaml#
    properties:
      regulator-allowed-modes:
        maxItems: 2
        items:
          enum: [ 0, 2 ]
    unevaluatedProperties: false

  "^vio(0p75|18)$":
    type: object
    $ref: regulator.yaml#
    properties:
      regulator-allowed-modes:
        maxItems: 2
        items:
          enum: [ 0, 2 ]
    unevaluatedProperties: false

  "^vrf(0p9|12|13|18)$":
    type: object
    $ref: regulator.yaml#
    properties:
      regulator-allowed-modes:
        maxItems: 2
        items:
          enum: [ 0, 2 ]
    unevaluatedProperties: false

  "^vsram-(apu|cpub|cpum|cpul|digrf|mdfe|modem)$":
    type: object
    $ref: regulator.yaml#
    properties:
      regulator-allowed-modes:
        maxItems: 2
        items:
          enum: [ 0, 2 ]
    unevaluatedProperties: false

  "^vufs(12|18)$":
    type: object
    $ref: regulator.yaml#
    properties:
      regulator-allowed-modes:
        maxItems: 2
        items:
          enum: [ 0, 2 ]
    unevaluatedProperties: false

required:
  - compatible
  - reg

additionalProperties: false

examples:
  - |
    #include <dt-bindings/interrupt-controller/irq.h>

    pmic {
      interrupt-controller;
      #address-cells = <1>;
      #interrupt-cells = <3>;

      regulators@30 {
        compatible = "mediatek,mt6363-regulator";
        reg = <0x

        vio18 {
          regulator-name = "pp1800-vio18-s3";
          regulator-min-microvolt = <1800000>;
          regulator-max-microvolt = <1800000>;
          regulator-allowed-modes = <0 2>;
          regulator-allow-set-load;
          regulator-over-current-protection;
        };
      };
    };
...
```
