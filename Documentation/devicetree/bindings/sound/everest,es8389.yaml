## Documentation/devicetree/bindings/sound/mt2701-afe-pcm.yaml
```yaml
# SPDX-License-Identifier: (GPL-2.0-only OR BSD-2-Clause)
%YAML 1.2
---
$id: http://devicetree.org/schemas/sound/mt2701-afe-pcm.yaml#
$schema: http://devicetree.org/meta-schemas/core.yaml#

title: MediaTek Audio Front End (AFE) PCM controller for mt2701

description:
  The AFE PCM node must be a subnode of the MediaTek audsys device tree node.
  #$ref: /schemas/arm/mediatek/mediatek,audsys.yaml#

maintainers:
  - Eugen Hristev <eugen.hristev@collabora.com>

properties:
  compatible:
    enum:
      - mediatek,mt2701-audio
      - mediatek,mt7622-audio

  interrupts:
    items:
      - description: AFE interrupt
      - description: ASYS interrupt

  interrupt-names:
    items:
      - const: afe
      - const: asys

  power-domains:
    maxItems: 1

  clocks:
    items:
      - description: audio infra sys clock
      - description: top audio mux 1
      - description: top audio mux 2
      - description: top audio sys a1 clock
      - description: top audio sys a2 clock
      - description: i2s0 source selection
      - description: i2s1 source selection
      - description: i2s2 source selection
      - description: i2s3 source selection
      - description: i2s0 source divider
      - description: i2s1 source divider
      - description: i2s2 source divider
      - description: i2s3 source divider
      - description: i2s0 master clock
      - description: i2s1 master clock
      - description: i2s2 master clock
      - description: i2s3 master clock
      - description: i2so0 hopping clock
      - description: i2so1 hopping clock
      - description: i2so2 hopping clock
      - description: i2so3 hopping clock
      - description: i2si0 hopping clock
      - description: i2si1 hopping clock
      - description: i2si2 hopping clock
      - description: i2si3 hopping clock
      - description: asrc0 output clock
      - description: asrc1 output clock
      - description: asrc2 output clock
      - description: asrc3 output clock
      - description: audio front end pd clock
      - description: audio front end conn pd clock
      - description: top audio a1 sys pd
      - description: top audio a2 sys pd
      - description: audio merge interface pd

  clock-names:
    items:
      - const: infra_sys_audio_clk
      - const: top_audio_mux1_sel
      - const: top_audio_mux2_sel
      - const: top_audio_a1sys_hp
      - const: top_audio_a2sys_hp
      - const: i2s0_src_sel
      - const: i2s1_src_sel
      - const: i2s2_src_sel
      - const: i2s3_src_sel
      - const: i2s0_src_div
      - const: i2s1_src_div
      - const: i2s2_src_div
      - const: i2s3_src_div
      - const: i2s0_mclk_en
      - const: i2s1_mclk_en
      - const: i2s2_mclk_en
      - const: i2s3_mclk_en
      - const: i2so0_hop_ck
      - const: i2so1_hop_ck
      - const: i2so2_hop_ck
      - const: i2so3_hop_ck
      - const: i2si0_hop_ck
      - const: i2si1_hop_ck
      - const: i2si2_hop_ck
      - const: i2si3_hop_ck
      - const: asrc0_out_ck
      - const: asrc1_out_ck
      - const: asrc2_out_ck
      - const: asrc3_out_ck
      - const: audio_afe_pd
      - const: audio_afe_conn_pd
      - const: audio_a1sys_pd
      - const: audio_a2sys_pd
      - const: audio_mrgif_pd

  assigned-clock-parents: true
  assigned-clock-rates: true
  assigned-clocks: true

required:
  - compatible
  - interrupts
  - interrupt-names
  - power-domains
  - clocks
  - clock-names
  - assigned-clocks
  - assigned-clock-parents
  - assigned-clock-rates

additionalProperties: false

examples:
  - |
    #include <dt-bindings/interrupt-controller/arm-gic.h>
    #include <dt-bindings/interrupt-controller/irq.h>
    #include <dt-bindings/power/mt2701-power.h>
    #include <dt-bindings/clock/mt2701-clk.h>
    soc {
        #address-cells = <2>;
        #size-cells = <2>;

        audsys: audio-subsystem@11220000 {
            compatible = "mediatek,mt2701-audsys", "syscon";
            reg = <0 0x11220000 0 0x2000>;
            #clock-cells = <1>;

            afe: audio-controller {
                compatible = "mediatek,mt2701-audio";
                interrupts = <GIC_SPI 104 IRQ_TYPE_LEVEL_LOW>,
                             <GIC_SPI 132 IRQ_TYPE_LEVEL_LOW>;
                interrupt-names = "afe", "asys";
                power-domains = <&scpsys MT2701_POWER_DOMAIN_IFR_MSC>;

                clocks = <&infracfg CLK_INFRA_AUDIO>,
                         <&topckgen CLK_TOP_AUD_MUX1_SEL>,
                         <&topckgen CLK_TOP_AUD_MUX2_SEL>,
                         <&topckgen CLK_TOP_AUD_48K_TIMING>,
                         <&topckgen CLK_TOP_AUD_44K_TIMING>,
                         <&topckgen CLK_TOP_AUD_K1_SRC_SEL>,
                         <&topckgen CLK_TOP_AUD_K2_SRC_SEL>,
                         <&topckgen CLK_TOP_AUD_K3_SRC_SEL>,
                         <&topckgen CLK_TOP_AUD_K4_SRC_SEL>,
                         <&topckgen CLK_TOP_AUD_K1_SRC_DIV>,
                         <&topckgen CLK_TOP_AUD_K2_SRC_DIV>,
                         <&topckgen CLK_TOP_AUD_K3_SRC_DIV>,
                         <&topckgen CLK_TOP_AUD_K4_SRC_DIV>,
                         <&topckgen CLK_TOP_AUD_I2S1_MCLK>,
                         <&topckgen CLK_TOP_AUD_I2S2_MCLK>,
                         <&topckgen CLK_TOP_AUD_I2S3_MCLK>,
                         <&topckgen CLK_TOP_AUD_I2S4_MCLK>,
                         <&audsys CLK_AUD_I2SO1>,
                         <&audsys CLK_AUD_I2SO2>,
                         <&audsys CLK_AUD_I2SO3>,
                         <&audsys CLK_AUD_I2SO4>,
                         <&audsys CLK_AUD_I2SIN1>,
                         <&audsys CLK_AUD_I2SIN2>,
                         <&audsys CLK_AUD_I2SIN3>,
                         <&audsys CLK_AUD_I2SIN4>,
                         <&audsys CLK_AUD_ASRCO1>,
                         <&audsys CLK_AUD_ASRCO2>,
                         <&audsys CLK_AUD_ASRCO3>,
                         <&audsys CLK_AUD_ASRCO4>,
                         <&audsys CLK_AUD_AFE>,
                         <&audsys CLK_AUD_AFE_CONN>,
                         <&audsys CLK_AUD_A1SYS>,
                         <&audsys CLK_AUD_A2SYS>,
                         <&audsys CLK_AUD_AFE_MRGIF>;

                clock-names = "infra_sys_audio_clk",
                              "top_audio_mux1_sel",
                              "top_audio_mux2_sel",
                              "top_audio_a1sys_hp",
                              "top_audio_a2sys_hp",
                              "i2s0_src_sel",
                              "i2s1_src_sel",
                              "i2s2_src_sel",
                              "i2s3_src_sel",
                              "i2s0_src_div",
                              "i2s1_src_div",
                              "i2s2_src_div",
                              "i2s3_src_div",
                              "i2s0_mclk_en",
                              "i2s1_mclk_en",
                              "i2s2_mclk_en",
                              "i2s3_mclk_en",
                              "i2so0_hop_ck",
                              "i2so1_hop_ck",
                              "i2so2_hop_ck",
                              "i2so3_hop_ck",
                              "i2si0_hop_ck",
                              "i2si1_hop_ck",
                              "i2si2_hop_ck",
                              "i2si3_hop_ck",
                              "asrc0_out_ck",
                              "asrc1_out_ck",
                              "asrc2_out_ck",
                              "asrc3_out_ck",
                              "audio_afe_pd",
                              "audio_afe_conn_pd",
                              "audio_a1sys_pd",
                              "audio_a2sys_pd",
                              "audio_mrgif_pd";

                assigned-clocks = <&topckgen CLK_TOP_AUD_MUX1_SEL>,
                                  <&topckgen CLK_TOP_AUD_MUX2_SEL>,
                                  <&topckgen CLK_TOP_AUD_MUX1_DIV>,
                                  <&topckgen CLK_TOP_AUD_MUX2_DIV>;
                assigned-clock-parents = <&topckgen CLK_TOP_AUD1PLL_98M>,
                                         <&topckgen CLK_TOP_AUD2PLL_90M>;
                assigned-clock-rates = <0>, <0>, <49152000>, <45158400>;
            };
        };
    };

...
```

## Documentation/devicetree/bindings/sound/mt6358.yaml
```yaml
# SPDX-License-Identifier: (GPL-2.0-only OR BSD-2-Clause)
%YAML 1.2
---
$id: http://devicetree.org/schemas/sound/mt6358.yaml#
$schema: http://devicetree.org/meta-schemas/core.yaml#

title: Mediatek MT6358 Audio Codec

maintainers:
  - Jiaxin Yu <jiaxin.yu@mediatek.com>
  - Macpaul Lin <macpaul.lin@mediatek.com>

description: |
  The communication between MT6358 and SoC is through Mediatek PMIC wrapper.
  For more detail, please visit Mediatek PMIC wrapper documentation.
  Must be a child node of PMIC wrapper.

properties:
  compatible:
    enum:
      - mediatek,mt6366-sound
      - mediatek,mt6358-sound
    const: mediatek,mt6358-sound

  Avdd-supply:
    description: Power source of AVDD

  mediatek,dmic-mode:
    $ref: /schemas/types.yaml#/definitions/uint32
    description: |
      Indicates how many data pins are used to transmit two channels of PDM
      signal. 0 means two wires, 1 means one wire. Default value is 0.
    enum:
      - 0 # two wires
      - 1 # one wire

required:
  - compatible
  - Avdd-supply

additionalProperties: false
```

## Documentation/devicetree/bindings/sound/neofidelity,ntp8918.yaml
```yaml
# SPDX-License-Identifier: (GPL-2.0-only OR BSD-2-Clause)
%YAML 1.2
---
$id: http://devicetree.org/schemas/sound/neofidelity,ntp8918.yaml#
$schema: http://devicetree.org/meta-schemas/core.yaml#

title: NeoFidelity NTP8918 Amplifier

maintainers:
  - Igor Prusov <ivprusov@salutedevices.com>

description: |
  The NTP8918 is a single chip full digital audio amplifier
  including power stage for stereo amplifier system.
  The NTP8918 is integrated with versatile digital audio signal
  processing functions, high-performance, high-fidelity fully
  digital PWM modulator and two high-power full-bridge MOSFET
  power stages.

allOf:
  - $ref: dai-common.yaml#

properties:
  compatible:
    enum:
      - neofidelity,ntp8918

  reg:
    maxItems: 1
    enum:
      - 0x2a
      - 0x2b
      - 0x2c
      - 0x2d
    description: |
      I2C address of the device.

  reset-gpios:
    maxItems: 1
    description: GPIO used to control the state of the device.

  '#sound-dai-cells':
    enum: [0]

required:
  - compatible
  - reg

unevaluatedProperties: false

examples:
  - |
   #include <dt-bindings/gpio/gpio.h>
   i2c {
     #address-cells = <1>;
     #size-cells = <0>;
     ntp8918@54 {
       compatible = "neofidelity,ntp8918";
       #sound-dai-cells = <0>;
       reg = <0x54>;
       reset-gpios = <&gpio 5 GPIO_ACTIVE_LOW>;
    };
   };
```

## Documentation/devicetree/bindings/sound/nuvoton,nau8325.yaml
```yaml
# SPDX-License-Identifier: (GPL-2.0-only OR BSD-2-Clause)
%YAML 1.2
---
$id: http://devicetree.org/schemas/sound/nuvoton,nau8325.yaml#
$schema: http://devicetree.org/meta-schemas/core.yaml#

title: NAU8325 audio Amplifier

maintainers:
  - Seven Lee <WTLI@nuvoton.com>

allOf:
  - $ref: dai-common.yaml#

properties:
  compatible:
    const: nuvoton,nau8325

  reg:
    maxItems: 1

  nuvoton,vref-impedance:
    $ref: /schemas/types.yaml#/definitions/uint32
    description:
      The vref impedance to be used in kohms. Middle of voltage enables
      Tie-Off selection options. Due to the high impedance of the VREF
      pin, it is important to use a low-leakage capacitor. Possible
      values are 0, 1, 2, and 3 as per the below,

      0 = Disable tie off resistance
      1 = 25 kohms
      2 = 125 kohms
      3 = 2.5 kohms
    enum: [ 0, 1, 2, 3 ]

  nuvoton,dac-vref:
    $ref: /schemas/types.yaml#/definitions/uint32
    description:
      The dac vref to be used in voltage. DAC reference voltage setting. Can
      be used for minor tuning of the output level. Possible values are 0, 1,
      2, and 3 as per the below,

      0 = VDDA
      1 = VDDA * 1.5
      2 = VDDA * 1.6
      3 = VDDA * 1.7
    enum: [ 0, 1, 2, 3 ]

  nuvoton,alc-enable:
    description:
      Enable digital automatic level control (ALC) function.
    type: boolean

  nuvoton,clock-detection-disable:
    description:
      When clock detection is enabled, it will detect whether MCLK
      and FS are within the range. MCLK range is from 2.048MHz to 24.576MHz.
      FS range is from 8kHz to 96kHz. And also needs to detect the ratio
      MCLK_SRC/LRCK of 256, 400 or 500, and needs to detect the BCLK
      to make sure data is present. There needs to be at least 8 BCLK
      cycles per Frame Sync.
    type: boolean

  nuvoton,clock-det-data:
    description:
      Request clock detection to require 2048 non-zero samples before enabling
      the audio paths. If set then non-zero samples is required, otherwise it
      doesn't matter.
    type: boolean

required:
  - compatible
  - reg

unevaluatedProperties: false

examples:
  - |
    i2c {
        #address-cells = <1>;
        #size-cells = <0>;
        codec@21 {
            compatible = "nuvoton,nau8325";
            reg = <0x21>;
            nuvoton,vref-impedance = <2>;
            nuvoton,dac-vref = <2>;
            nuvoton,alc-enable;
            nuvoton,clock-det-data;
        };
    };
```

## Documentation/devicetree/bindings/sound/nuvoton,nau8360.yaml
```yaml
# SPDX-License-Identifier: GPL-2.0-only OR BSD-2-Clause
%YAML 1.2
---
$id: http://devicetree.org/schemas/sound/nuvoton,nau8360.yaml#
$schema: http://devicetree.org/meta-schemas/core.yaml#

title: Nuvoton NAU83G60 Stereo Class-D Amplifier with DSP

description:
  Stereo Class-D Amplifier with DSP and I/V-sense.
  This device supports I2C.

maintainers:
  - Neo Chang <YLCHANG2@nuvoton.com>

properties:
  compatible:
    enum:
      - nuvoton,nau8360

  reg:
    maxItems: 1
    description:
      The I2C address of the device. The address is determined by the external
      hardware configuration of GPIO1 and GPIO2 pins.
       - 0x1a (GPIO2=Low, GPIO1=Low)
       - 0x1b (GPIO2=Low, GPIO1=High)
       - 0x4a (GPIO2=High, GPIO1=Low)
       - 0x4b (GPIO2=High, GPIO1=High)

  "#sound-dai-cells":
    const: 0

  clocks:
    maxItems: 1

  clock-names:
    const: mclk

  firmware-name:
    minItems: 2
    maxItems: 2
    description:
      Assign firmware filenames for Left and Right DSP cores.
      The first firmware is for the Left channel,
      and the second is for the Right channel.
      In PBTL mode, the Left firmware is ignored and only the Right is applied.

  nuvoton,pbtl-enable:
    type: boolean
    description:
      NAU83G60 supports PBTL mode for mono output.

  nuvoton,dac-cur-enable:
    type: boolean
    description:
      Adjust DAC output current to match speaker impedance and prevent
      hardware damage. +3.2dB when present, 0dB by default.

required:
  - compatible
  - reg

allOf:
  - $ref: dai-common.yaml#

unevaluatedProperties: false

examples:
  - |
    i2c {
        #address-cells = <1>;
        #size-cells = <0>;

        codec@1a {
            compatible = "nuvoton,nau8360";
            reg = <0x1a>;
            #sound-dai-cells = <0>;
            firmware-name = "NAU83G60.kcs.bin.l", "NAU83G60.kcs.bin.r";
            nuvoton,dac-cur-enable;
            nuvoton,pbtl-enable;
        };
    };
```
