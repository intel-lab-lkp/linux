## Documentation/devicetree/bindings/sound/mediatek,mt6359-accdet.yaml
```yaml
# SPDX-License-Identifier: (GPL-2.0-only OR BSD-2-Clause)
%YAML 1.2
---
$id: http://devicetree.org/schemas/sound/mediatek,mt6359-accdet.yaml#
$schema: http://devicetree.org/meta-schemas/core.yaml#

title: MT6359 Accessory Detection

maintainers:
  - Nícolas F. R. A. Prado <nfraprado@collabora.com>

description: |
  The MT6359 Accessory Detection block is part of the MT6359 PMIC and allows
  detecting audio jack insertion and removal, as well as identifying the type of
  events connected to the jack.

properties:
  compatible:
    const: mediatek,mt6359-accdet

  mediatek,hp-eint-high:
    type: boolean
    description:
      By default, the HP_EINT pin is assumed to be pulled high and connected to
      a normally open 3.5mm jack. Plug insertion is detected when the pin is
      brought low in that case. Add this property if the behavior should be
      inverted, for example if a normally closed 3.5mm jack is used, or if the
      line is pulled low on open.

required:
  - compatible

additionalProperties: false

examples:
  - |
    #include <dt-bindings/interrupt-controller/irq.h>

    accdet: accdet {
        compatible = "mediatek,mt6359-accdet";
        mediatek,hp-eint-high;
    };
```

## Documentation/devicetree/bindings/sound/mediatek,mt8196-afe.yaml
```yaml
# SPDX-License-Identifier: (GPL-2.0-only OR BSD-2-Clause)
%YAML 1.2
---
$id: http://devicetree.org/schemas/sound/mediatek,mt8196-afe.yaml#
$schema: http://devicetree.org/meta-schemas/core.yaml#

title: MediaTek Audio Front End PCM controller for MT8196

maintainers:
  - Darren Ye <darren.ye@mediatek.com>

properties:
  compatible:
    const: mediatek,mt8196-afe

  reg:
    maxItems: 1

  interrupts:
    maxItems: 1

  memory-region:
    maxItems: 1

  mediatek,vlpcksys:
    $ref: /schemas/types.yaml#/definitions/phandle
    description: To set up the apll12 tuner

  power-domains:
    maxItems: 1

  clocks:
    items:
      - description: mux for audio intbus
      - description: mux for audio engen1
      - description: mux for audio engen2
      - description: mux for audio h
      - description: vlp 26m clock
      - description: audio apll1 clock
      - description: audio apll2 clock
      - description: audio apll1 divide4
      - description: audio apll2 divide4
      - description: audio apll12 divide for i2sin0
      - description: audio apll12 divide for i2sin1
      - description: audio apll12 divide for fmi2s
      - description: audio apll12 divide for tdmout mck
      - description: audio apll12 divide for tdmout bck
      - description: mux for audio apll1
      - description: mux for audio apll2
      - description: mux for i2sin0 mck
      - description: mux for i2sin1 mck
      - description: mux for fmi2s mck
      - description: mux for tdmout mck
      - description: mux for adsp clock
      - description: 26m clock

  clock-names:
    items:
      - const: top_aud_intbus
      - const: top_aud_eng1
      - const: top_aud_eng2
      - const: top_aud_h
      - const: vlp_clk26m
      - const: apll1
      - const: apll2
      - const: apll1_d4
      - const: apll2_d4
      - const: apll12_div_i2sin0
      - const: apll12_div_i2sin1
      - const: apll12_div_fmi2s
      - const: apll12_div_tdmout_m
      - const: apll12_div_tdmout_b
      - const: top_apll1
      - const: top_apll2
      - const: top_i2sin0
      - const: top_i2sin1
      - const: top_fmi2s
      - const: top_tdmout
      - const: top_adsp
      - const: clk26m

required:
  - compatible
  - reg
  - interrupts
  - mediatek,vlpcksys
  - power-domains
  - memory-region
  - clocks
  - clock-names

additionalProperties: false

examples:
  - |
    #include <dt-bindings/interrupt-controller/arm-gic.h>
    #include <dt-bindings/interrupt-controller/irq.h>

    soc {
        #address-cells = <2>;
        #size-cells = <2>;

        afe@1a110000 {
            compatible = "mediatek,mt8196-afe";
            reg = <0 0x1a110000 0 0x9000>;
            interrupts = <GIC_SPI 351 IRQ_TYPE_LEVEL_HIGH 0>;
            memory-region = <&afe_dma_mem_reserved>;
            mediatek,vlpcksys = <&vlp_cksys_clk>;
            power-domains = <&scpsys 14>; //MT8196_POWER_DOMAIN_AUDIO
            clocks = <&vlp_cksys_clk 40>, //CLK_VLP_CK_AUD_INTBUS_SEL
                     <&vlp_cksys_clk 38>, //CLK_VLP_CK_AUD_ENGEN1_SEL
                     <&vlp_cksys_clk 39>, //CLK_VLP_CK_AUD_ENGEN2_SEL
                     <&vlp_cksys_clk 37>, //CLK_VLP_CK_AUDIO_H_SEL
                     <&vlp_cksys_clk 45>, //CLK_VLP_CK_CLKSQ
                     <&cksys_clk 129>, //CLK_CK_APLL1
                     <&cksys_clk 132>, //CLK_CK_APLL2
                     <&cksys_clk 130>, //CLK_CK_APLL1_D4
                     <&cksys_clk 133>, //CLK_CK_APLL2_D4
                     <&cksys_clk 80>, //CLK_CK_APLL12_CK_DIV_I2SIN0
                     <&cksys_clk 81>, //CLK_CK_APLL12_CK_DIV_I2SIN1
                     <&cksys_clk 92>, //CLK_CK_APLL12_CK_DIV_FMI2S
                     <&cksys_clk 93>, //CLK_CK_APLL12_CK_DIV_TDMOUT_M
                     <&cksys_clk 94>, //CLK_CK_APLL12_CK_DIV_TDMOUT_B
                     <&cksys_clk 43>, //CLK_CK_AUD_1_SEL
                     <&cksys_clk 44>, //CLK_CK_AUD_2_SEL
                     <&cksys_clk 66>, //CLK_CK_APLL_I2SIN0_MCK_SEL
                     <&cksys_clk 67>, //CLK_CK_APLL_I2SIN1_MCK_SEL
                     <&cksys_clk 78>, //CLK_CK_APLL_FMI2S_MCK_SEL
                     <&cksys_clk 79>, //CLK_CK_APLL_TDMOUT_MCK_SEL
                     <&cksys_clk 45>, //CLK_CK_ADSP_SEL
                     <&cksys_clk 140>; //CLK_CK_TCK_26M_MX9
            clock-names = "top_aud_intbus",
                          "top_aud_eng1",
                          "top_aud_eng2",
                          "top_aud_h",
                          "vlp_clk26m",
                          "apll1",
                          "apll2",
                          "apll1_d4",
                          "apll2_d4",
                          "apll12_div_i2sin0",
                          "apll12_div_i2sin1",
                          "apll12_div_fmi2s",
                          "apll12_div_tdmout_m",
                          "apll12_div_tdmout_b",
                          "top_apll1",
                          "top_apll2",
                          "top_i2sin0",
                          "top_i2sin1",
                          "top_fmi2s",
                          "top_tdmout",
                          "top_adsp",
                          "clk26m";
        };
    };
```

## Documentation/devicetree/bindings/sound/mediatek,mt8196-dsp.yaml
```yaml
# SPDX-License-Identifier: (GPL-2.0 OR BSD-2-Clause)
%YAML 1.2
---
$id: http://devicetree.org/schemas/sound/mediatek,mt8196-dsp.yaml#
$schema: http://devicetree.org/meta-schemas/core.yaml#

title: MediaTek mt8196 DSP core

maintainers:
  - Hailong Fan <hailong.fan@mediatek.com>

description: The MediaTek mt8196 SoC mt8196 contain a DSP core used for advanced
  pre- and post- audio processing.

properties:
  compatible:
    const: mediatek,mt8196-dsp

  reg:
    items:
      - description: DSP configuration registers
      - description: DSP SRAM
      - description: DSP secure registers
      - description: DSP bus registers

  reg-names:
    items:
      - const: cfg
      - const: sram
      - const: sec
      - const: bus

  clocks:
    items:
      - description: mux for dsp clock
      - description: 26M clock
      - description: ADSP PLL clock

  clock-names:
    items:
      - const: adsp_sel
      - const: clk26m
      - const: adsppll

  power-domains:
    maxItems: 1

  mboxes:
    items:
      - description: mailbox for receiving audio DSP requests.
      - description: mailbox for transmitting requests to audio DSP.

  mbox-names:
    items:
      - const: rx
      - const: tx

  memory-region:
    items:
      - description: dma buffer between host and DSP.
      - description: DSP system memory.

required:
  - compatible
  - reg
  - reg-names
  - clocks
  - clock-names
  - power-domains
  - mboxes
  - mbox-names

additionalProperties: false

examples:
  - |
    #include <dt-bindings/clock/mt8196-clk.h>
    #include <dt-bindings/power/mt8196-power.h>
    adsp@1a000000 {
        compatible = "mediatek,mt8196-dsp";
        reg = <0x1a000000 0x5000>,
              <0x1a210000 0x80000>,
              <0x1a345000 0x300>,
              <0x1a00f000 0x1000>;
        reg-names = "cfg", "sram", "sec", "bus";
        clocks = <&cksys_clk CLK_CK_ADSP_SEL>,
                 <&cksys_clk CLK_CK_TCK_26M_MX9>,
                 <&cksys_clk CLK_CK_ADSPPLL>;
        clock-names = "adsp_sel",
                      "clk26m",
                      "adsppll";
        power-domains = <&scpsys MT8196_POWER_DOMAIN_ADSP_TOP_DORMANT>;
        mboxes = <&adsp_mailbox0>, <&adsp_mailbox1>;
        mbox-names = "rx", "tx";
    };
```

## Documentation/devicetree/bindings/sound/mediatek,mt8196-mt6681.yaml
```yaml
# SPDX-License-Identifier: (GPL-2.0-only OR BSD-2-Clause)
%YAML 1.2
---
$id: http://devicetree.org/schemas/sound/mediatek,mt8196-mt6681.yaml#
$schema: http://devicetree.org/meta-schemas/core.yaml#

title: MediaTek MT8196 ASoC sound card

maintainers:
  - Darren Ye <darren.ye@mediatek.com>

allOf:
  - $ref: sound-card-common.yaml#

properties:
  compatible:
    oneOf:
      - enum:
          - mediatek,mt8196-mt6681-sound
          - mediatek,mt8196-nau8825-sound
          - mediatek,mt8196-rt5682s-sound
          - mediatek,mt8196-rt5650-sound
      - items:
          - const: mediatek,mt8196-mt6681-sound
          - const: mediatek,mt8196-nau8825-sound

  audio-routing:
    description:
      Valid names could be the input or output widgets of audio components,
      power supplies, MicBias of codec and the software switch.

  mediatek,platform:
    $ref: /schemas/types.yaml#/definitions/phandle
    description: The phandle of MT8188 ASoC platform.

  mediatek,adsp:
    $ref: /schemas/types.yaml#/definitions/phandle
    description:
      The phandle of the MT8188 ADSP platform, which is the optional Audio DSP
      hardware that provides additional audio functionalities if present.
      The AFE will link to ADSP when the phandle is provided.

patternProperties:
  "^dai-link-[0-9]+$":
    type: object
    description:
      Container for dai-link level properties and CODEC sub-nodes.

    properties:
      link-name:
        description:
          This property corresponds to the name of the BE dai-link to which
          we are going to update parameters in this node.
        items:
          enum:
            - TDM_DPTX_BE
            - I2SOUT6_BE
            - I2SIN6_BE
            - I2SOUT4_BE
            - I2SOUT3_BE

      codec:
        description: Holds subnode which indicates codec dai.
        type: object
        additionalProperties: false
        properties:
          sound-dai:
            minItems: 1
            maxItems: 2
        required:
          - sound-dai

      dai-format:
        description: audio format.
        items:
          enum:
            - i2s
            - right_j
            - left_j
            - dsp_a
            - dsp_b

      mediatek,clk-provider:
        $ref: /schemas/types.yaml#/definitions/string
        description: Indicates dai-link clock master.
        items:
          enum:
            - cpu
            - codec

    additionalProperties: false

    required:
      - link-name

unevaluatedProperties: false

required:
  - compatible
  - mediatek,platform

examples:
  - |
    sound {
        compatible = "mediatek,mt8196-mt6681-sound";
        model = "mt8196-mt6681";
        mediatek,platform = <&afe>;
        audio-routing = "I2SOUT4", "I2SIN4_GPIO",
                        "I2SOUT4", "I2OUT4_GPIO",
                        "I2SOUT6", "I2SIN6_GPIO",
                        "I2SOUT6", "I2SOUT6_GPIO";

        dai-link-0 {
            link-name = "I2SOUT6_BE";
            dai-format = "i2s";
            mediatek,clk-provider = "cpu";
            codec {
                sound-dai = <&nau8825>;
            };
        };
    };
```

## Documentation/devicetree/bindings/sound/mediatek,mtk-btcvsd-snd.yaml
```yaml
# SPDX-License-Identifier: (GPL-2.0-only OR BSD-2-Clause)
%YAML 1.2
---
$id: http://devicetree.org/schemas/sound/mediatek,mtk-btcvsd-snd.yaml#
$schema: http://devicetree.org/meta-schemas/core.yaml#

title: Mediatek ALSA BT SCO CVSD/MSBC Driver

maintainers:
  - Luca Leonardo Scorcia <l.scorcia@gmail.com>

properties:
  compatible:
    const: mediatek,mtk-btcvsd-snd

  reg:
    minItems: 2
    maxItems: 2

  reg-names:
    items:
      - const: pkv
      - const: sram-bank2

  interrupts:
    items:
      - description: BT-SCO interrupt

  mediatek,infracfg:
    $ref: /schemas/types.yaml#/definitions/phandle
    description: The phandle of the infracfg controller

  mediatek,offset:
    $ref: /schemas/types.yaml#/definitions/uint32-array
    description: Array of register offsets and masks
    items:
      - description: infra_misc_offset
      - description: infra_conn_bt_cvsd_mask
      - description: cvsd_mcu_read_offset
      - description: cvsd_mcu_write_offset
      - description: cvsd_packet_indicator_offset

required:
  - compatible
  - reg
  - reg-names
  - interrupts
  - mediatek,infracfg
  - mediatek,offset

additionalProperties: false

examples:
  - |
    #include <dt-bindings/interrupt-controller/arm-gic.h>
    #include <dt-bindings/interrupt-controller/irq.h>

    mtk-btcvsd-snd@18000000 {
      compatible = "mediatek,mtk-btcvsd-snd";
      reg = <0x18000000 0x1000>,
            <0x18080000 0x8000>;
      reg-names = "pkv", "sram-bank2";
      interrupts = <GIC_SPI 286 IRQ_TYPE_LEVEL_LOW>;
      mediatek,infracfg = <&infrasys>;
      mediatek,offset = <0xf00 0x800 0xfd0 0xfd4 0xfd8>;
    };
```
