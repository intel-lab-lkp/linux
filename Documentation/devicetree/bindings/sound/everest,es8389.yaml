## Documentation/devicetree/bindings/sound/everest,es8389.yaml
```yaml
# SPDX-License-Identifier: (GPL-2.0-only OR BSD-2-Clause)
%YAML 1.2
---
$id: http://devicetree.org/schemas/sound/everest,es8389.yaml#
$schema: http://devicetree.org/meta-schemas/core.yaml#

title: Everest ES8389 audio CODEC

maintainers:
  - Michael Zhang <zhangyi@everest-semi.com>

allOf:
  - $ref: dai-common.yaml#

properties:
  compatible:
    const: everest,es8389

  reg:
    maxItems: 1

  clocks:
    items:
      - description: clock for master clock (MCLK)

  clock-names:
    items:
      - const: mclk

  "#sound-dai-cells":
    const: 0

  vdda-supply:
    description:
      Analogue power supply.

  vddd-supply:
    description:
      Interface power supply.

  everest,hpfl:
    $ref: /schemas/types.yaml#/definitions/uint8
    description:
      the HPF value of ADCL.
    minimum: 0x00
    maximum: 0x0f
    default: 0x0a

  everest,hpfr:
    $ref: /schemas/types.yaml#/definitions/uint8
    description:
      the HPF value of ADCR.
    minimum: 0x00
    maximum: 0x0f
    default: 0x0a

required:
  - compatible
  - reg
  - "#sound-dai-cells"
  - vddd-supply
  - vdda-supply

additionalProperties: false

examples:
  - |
    i2c {
      #address-cells = <1>;
      #size-cells = <0>;
      es8389: codec@10 {
        compatible = "everest,es8389";
        reg = <0x10>;
        #sound-dai-cells = <0>;
        vddd-supply = <&vdd3v3>;
        vdda-supply = <&vdd3v3>;
        everest,hpfl = [0a];
        everest,hpfr = [0a];
      };
    };
```

## Documentation/devicetree/bindings/sound/foursemi,fs210x.yaml
```yaml
# SPDX-License-Identifier: GPL-2.0-only
%YAML 1.2
---
$id: http://devicetree.org/schemas/sound/foursemi,fs210x.yaml#
$schema: http://devicetree.org/meta-schemas/core.yaml#

title: FourSemi FS2104/5S Digital Audio Amplifier

maintainers:
  - Nick <nick.li@foursemi.com>

description: |
    The FS2104 is a 15W Inductor-Less, Stereo, Closed-Loop,
    Digital Input Class-D Power Amplifier with Enhanced Signal Processing.
    The FS2105S is a 30W Inductor-Less, Stereo, Closed-Loop,
    Digital Input Class-D Power Amplifier with Enhanced Signal Processing.

properties:
  compatible:
    enum:
      - foursemi,fs2104
      - foursemi,fs2105s

  reg:
    maxItems: 1
    description: |
      I2C address of the amplifier. Refer to datasheet for possible values:
      0x68/0x69/0x6A/0x6B

  clocks:
    items:
      - description: The clock of I2S BCLK

  clock-names:
    items:
      - const: bclk

  '#sound-dai-cells':
    const: 0

  pvdd-supply:
    description: |
      Regulator for power supply(PVDD in datasheet).

  dvdd-supply:
    description: |
      Regulator for digital supply(DVDD in datasheet).

  sdz-gpios:
    maxItems: 1
    description: |
      SDZ(Shut Down) pin is active low, it will power down the chip,
      and then reset the chip to shut down state.

  fs,fwm-name:
    description: |
      The name of firmware that should be loaded for this
      instance. The firmware is gernerated by FourSemi's tuning tool.
    $ref: /schemas/types.yaml#/definitions/string

  fs,dai-name:
    description: |
      The name of FS210x DAI, it can be set different name when
      there are multiple FS210x devices in the system.
    $ref: /schemas/types.yaml#/definitions/string

required:
  - compatible
  - reg
  - sdz-gpios
  - fs,fwm-name
  - '#sound-dai-cells'

additionalProperties: false

examples:
  - |
    #include <dt-bindings/gpio/gpio.h>
    i2c {
        #address-cells = <1>;
        #size-cells = <0>;
        audio-codec@68 {
            compatible = "foursemi,fs2105s";
            reg = <0x68>;
            pvdd-supply = <&pvdd_supply>;
            dvdd-supply = <&dvdd_supply>;
            sdz-gpios = <&gpio 18 GPIO_ACTIVE_LOW>;
            pinctrl-names = "default";
            pinctrl-0 = <&fs210x_pins_default>;
            fs,fwm-name = "fs2105s-btl-2p0-0s.bin";
            clocks = <&clocks 18>;
            clock-names = "bclk";
            #sound-dai-cells = <0>;
        };
    };
```

## Documentation/devicetree/bindings/sound/fsl,imx-audio-es8316.yaml
```yaml
# SPDX-License-Identifier: (GPL-2.0 OR BSD-2-Clause)
$id: http://devicetree.org/schemas/sound/fsl,imx-audio-es8316.yaml#
$schema: http://devicetree.org/meta-schemas/core.yaml#

title: NXP i.MX Audio Interface with ES8316 Codec

maintainers:
  - WangErQian <wangerqiany@icloud.com>

description: |
  Binding for NXP i.MX platforms using the Everest ES8316 audio codec.
  Defines the connections between CPU DAI (SAI), codec, and audio routing.

properties:
  compatible:
    const: fsl,imx-audio-es8316

  model:
    type: string
    description: Descriptive name of the audio setup (e.g., board-specific)
    default: "imx-audio-es8316"

  audio-cpu:
    type: phandle
    description: Phandle to the CPU audio interface (e.g., SAI node)
    maxItems: 1

  audio-codec:
    type: phandle
    description: Phandle to the audio codec (ES8316 node)
    maxItems: 1

  format:
    type: string
    description: Audio data format (e.g., i2s, left-justified)
    enum: ["i2s", "right-justified", "left-justified", "dsp-a", "dsp-b"]
    default: "i2s"

  hp-det-gpio:
    type: phandle-array
    description: GPIO for headphone detection (active high)
    maxItems: 1
    items:
      - description: GPIO specifier (controller + pin + flags)

  audio-routing:
    type: string-array
    description: Connection mapping between codec pins and audio components
    items:
      minItems: 2
      maxItems: 2
      items:
        - description: Source endpoint (e.g., "Mic Jack")
        - description: Sink endpoint (e.g., "MIC2")

required:
  - compatible
  - audio-cpu
  - audio-codec
  - audio-routing

additionalProperties: false

examples:
  - |
    #include <dt-bindings/gpio/gpio.h>
    sai3: sai@40031000 {
        compatible = "fsl,imx8mp-sai";
        reg = <0x40031000 0x1000>;
    };

    codec: es8316@11 {
        compatible = "everest,es8316";
        reg = <0x11>;
    };

    sound {
        compatible = "fsl,imx-audio-es8316";
        model = "imx-audio-es8316";
        audio-cpu = <&sai3>;
        audio-codec = <&codec>;
        format = "i2s";
        hp-det-gpio = <&gpio4 29 GPIO_ACTIVE_HIGH>;
        audio-routing =
            "Mic Jack", "MIC2",
            "Headphone Jack", "HPOL",
            "Headphone Jack", "HPOR";
    };
```

## Documentation/devicetree/bindings/sound/fsl,imx-audio-sgtl5000.yaml
```yaml
# SPDX-License-Identifier: (GPL-2.0-only OR BSD-2-Clause)
%YAML 1.2
---
$id: http://devicetree.org/schemas/sound/fsl,imx-audio-sgtl5000.yaml#
$schema: http://devicetree.org/meta-schemas/core.yaml#

title: Freescale i.MX audio complex with SGTL5000 codec

maintainers:
  - Animesh Agarwal <animeshagarwal28@gmail.com>

properties:
  compatible:
    oneOf:
      - items:
          - enum:
              - fsl,imx25-pdk-sgtl5000
              - fsl,imx51-babbage-sgtl5000
              - fsl,imx53-m53evk-sgtl5000
              - tq,imx53-mba53-sgtl5000
              - fsl,imx53-cpuvo-sgtl5000
              - fsl,imx53-qsb-sgtl5000
              - karo,tx53-audio-sgtl5000
              - fsl,imx53-voipac-sgtl5000
              - fsl,imx6q-ba16-sgtl5000
              - fsl,imx6q-ventana-sgtl5000
              - fsl,imx-sgtl5000
              - fsl,imx6-armadeus-sgtl5000
              - fsl,imx6dl-nit6xlite-sgtl5000
              - fsl,imx6q-nitrogen6_max-sgtl5000
              - fsl,imx6q-nitrogen6_som2-sgtl5000
              - fsl,imx6q-nitrogen6x-sgtl5000
              - fsl,imx6-rex-sgtl5000
              - fsl,imx6q-sabrelite-sgtl5000
              - fsl,imx6-wandboard-sgtl5000
          - const: fsl,imx-audio-sgtl5000
      - const: fsl,imx-audio-sgtl5000

  model:
    $ref: /schemas/types.yaml#/definitions/string
    description: The user-visible name of this sound complex.

  audio-cpu:
    $ref: /schemas/types.yaml#/definitions/phandle
    description: The phandle of an CPU DAI controller

  ssi-controller:
    $ref: /schemas/types.yaml#/definitions/phandle
    description: The phandle of the i.MX SSI controller.

  audio-codec:
    $ref: /schemas/types.yaml#/definitions/phandle
    description: The phandle of the SGTL5000 audio codec.

  audio-routing:
    $ref: /schemas/types.yaml#/definitions/non-unique-string-array
    description: |
      A list of the connections between audio components. Each entry is a pair
      of strings, the first being the connection's sink, the second being the
      connection's source. Valid names could be:

      Power supplies:
        * Mic Bias

      SGTL5000 pins:
        * MIC_IN
        * LINE_IN
        * HP_OUT
        * LINE_OUT

      Board connectors:
        * Mic Jack
        * Line In Jack
        * Headphone Jack
        * Line Out Jack
        * Ext Spk

  mux-int-port:
    $ref: /schemas/types.yaml#/definitions/uint32
    description: The internal port of the i.MX audio muxer (AUDMUX).
    enum: [1, 2]

  mux-ext-port:
    $ref: /schemas/types.yaml#/definitions/uint32
    description: The external port of the i.MX audio muxer.
    enum: [3, 4, 5, 6]

required:
  - compatible
  - model

additionalProperties: false

examples:
  - |
    sound {
        compatible = "fsl,imx51-babbage-sgtl5000",
            "fsl,imx-audio-sgtl5000";
        model = "imx51-babbage-sgtl5000";
        ssi-controller = <&ssi1>;
        audio-codec = <&sgtl5000>;
        audio-routing =
            "MIC_IN", "Mic Jack",
            "Mic Jack", "Mic Bias",
            "Headphone Jack", "HP_OUT";
        mux-int-port = <1>;
        mux-ext-port = <3>;
    };
```

## Documentation/devicetree/bindings/sound/fsl,imx95-cm7-sof.yaml
```yaml
# SPDX-License-Identifier: (GPL-2.0 OR BSD-2-Clause)
%YAML 1.2
---
$id: http://devicetree.org/schemas/sound/fsl,imx95-cm7-sof.yaml#
$schema: http://devicetree.org/meta-schemas/core.yaml#

title: NXP imx95 CM7 core

maintainers:
  - Daniel Baluta <daniel.baluta@nxp.com>

description: NXP imx95 CM7 core used for audio processing

allOf:
  - $ref: fsl,sof-cpu.yaml#

properties:
  compatible:
    const: fsl,imx95-cm7-sof

  port:
    description: SAI3 port
    $ref: audio-graph-port.yaml#
    unevaluatedProperties: false

required:
  - compatible
  - port

unevaluatedProperties: false

examples:
  - |
    cm7-cpu@80000000 {
      compatible = "fsl,imx95-cm7-sof";
      reg = <0x80000000 0x6100000>;
      mboxes = <&mu7 2 0>, <&mu7 2 1>, <&mu7 3 0>, <&mu7 3 1>;
      mbox-names = "txdb0", "txdb1", "rxdb0", "rxdb1";
      memory-region = <&adma_res>;
      cpu: port {
        /* SAI3-WM8962 link */
        cpu_ep: endpoint { remote-endpoint = <&wm8962_ep>; };
      };
    };
```

## Documentation/devicetree/bindings/sound/fsl,saif.yaml
```yaml
# SPDX-License-Identifier: (GPL-2.0-only OR BSD-2-Clause)
%YAML 1.2
---
$id: http://devicetree.org/schemas/sound/fsl,saif.yaml#
$schema: http://devicetree.org/meta-schemas/core.yaml#

title: Freescale MXS Serial Audio Interface (SAIF)

maintainers:
  - Lukasz Majewski <lukma@denx.de>

description: |
  The SAIF is based on I2S module that is used to communicate with audio codecs,
  but only with half-duplex manner (i.e. it can either transmit or receive PCM
  audio).

properties:
  compatible:
    const: fsl,imx28-saif

  reg:
    maxItems: 1

  "#sound-dai-cells":
    const: 0

  assigned-clock-parents: true
  assigned-clock-rates: true
  assigned-clocks: true

  interrupts:
    maxItems: 1

  dmas:
    maxItems: 1

  dma-names:
    const: rx-tx

  clocks:
    maxItems: 1

  fsl,saif-master:
    description: Indicate that saif is a slave and its phandle points to master
    $ref: /schemas/types.yaml#/definitions/phandle

required:
  - compatible
  - reg
  - interrupts
  - clocks
  - dmas
  - dma-names
  - "#sound-dai-cells"

unevaluatedProperties: false

examples:
  - |
    saif0: saif@80042000 {
        #sound-dai-cells = <0>;
        compatible = "fsl,imx28-saif";
        reg = <0x80042000 2000>;
        interrupts = <59>;
        clocks = <&clks 53>;
        dmas = <&dma_apbx 4>;
        dma-names = "rx-tx";
    };
  - |
    saif1: saif@80046000 {
        #sound-dai-cells = <0>;
        compatible = "fsl,imx28-saif";
        reg = <0x80046000 2000>;
        interrupts = <58>;
        clocks = <&clks 53>;
        dmas = <&dma_apbx 5>;
        dma-names = "rx-tx";
        fsl,saif-master = <&saif0>;
    };
```

## Documentation/devicetree/bindings/sound/fsl,sof-cpu.yaml
```yaml
# SPDX-License-Identifier: (GPL-2.0-only OR BSD-2-Clause)
%YAML 1.2
---
$id: http://devicetree.org/schemas/sound/fsl,sof-cpu.yaml#
$schema: http://devicetree.org/meta-schemas/core.yaml#

title: NXP audio CPU common properties

maintainers:
  - Daniel Baluta <daniel.baluta@nxp.com>

properties:
  reg:
    maxItems: 1

  mboxes:
    maxItems: 4

  mbox-names:
    items:
      - const: txdb0
      - const: txdb1
      - const: rxdb0
      - const: rxdb1

  memory-region:
    maxItems: 1

required:
  - reg
  - mboxes
  - mbox-names
  - memory-region

additionalProperties: true
```

## Documentation/devicetree/bindings/sound/irondevice,sma1307.yaml
```yaml
# SPDX-License-Identifier: (GPL-2.0-only OR BSD-2-Clause)
%YAML 1.2
---
$id: http://devicetree.org/schemas/sound/irondevice,sma1307.yaml#
$schema: http://devicetree.org/meta-schemas/core.yaml#

title: Iron Device SMA1307 Audio Amplifier

maintainers:
  - Kiseok Jo <kiseok.jo@irondevice.com>

description:
  SMA1307 boosted digital speaker amplifier
  with feedback-loop.

allOf:
  - $ref: dai-common.yaml#

properties:
  compatible:
    enum:
      - irondevice,sma1307a-w
      - irondevice,sma1307a-f
      - irondevice,sma1307aq-f
    description:
      It is divided according to the package.
      The WLCSP packages are denoted with 'w', and the QFN packages are denoted
      with 'f'. If a 'q' is added, it indicated the product is AEC-Q100
      qualified for automotive applications.

  reg:
    maxItems: 1

  interrupts:
    maxItems: 1
    description:
      only in sma1307

  '#sound-dai-cells':
    const: 1

  use-binary:
    type: boolean
    description:
      whether to use binary files for device settings.

required:
  - compatible
  - reg
  - '#sound-dai-cells'

additionalProperties: false

examples:
  - |
    i2c {
        #address-cells = <1>;
        #size-cells = <0>;

        amplifier@1e {
            compatible = "irondevice,sma1307a-w";
            reg = <0x1e>;
            #sound-dai-cells = <1>;
            interrupt-parent = <&gpio>;
            interrupts = <4 0>;
        };
    };
```

## Documentation/devicetree/bindings/sound/linux,spdif-dir.yaml
```yaml
# SPDX-License-Identifier: GPL-2.0-only OR BSD-2-Clause
%YAML 1.2
---
$id: http://devicetree.org/schemas/sound/linux,spdif-dir.yaml#
$schema: http://devicetree.org/meta-schemas/core.yaml#

title: Dummy SPDIF receiver

maintainers:
  - Liam Girdwood <lgirdwood@gmail.com>
  - Mark Brown <broonie@kernel.org>

allOf:
  - $ref: dai-common.yaml#

properties:
  compatible:
    const: linux,spdif-dir

  "#sound-dai-cells":
    const: 0

required:
  - compatible
  - "#sound-dai-cells"

unevaluatedProperties: false

examples:
  - |
    spdif-in {
      compatible = "linux,spdif-dir";
      #sound-dai-cells = <0>;
    };
```
