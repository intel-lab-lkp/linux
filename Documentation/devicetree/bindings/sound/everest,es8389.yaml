## Documentation/devicetree/bindings/sound/nvidia,tegra30-ahub.yaml
```yaml
# SPDX-License-Identifier: (GPL-2.0-only OR BSD-2-Clause)
%YAML 1.2
---
$id: http://devicetree.org/schemas/sound/nvidia,tegra30-ahub.yaml#
$schema: http://devicetree.org/meta-schemas/core.yaml#

title: NVIDIA Tegra Audio Hub (AHUB)

maintainers:
  - Jonathan Hunter <jonathanh@nvidia.com>

description:
  The NVIDIA Tegra AHUB (Audio Hub) is an audio interconnect block used to
  route data between various audio clients such as I2S, DAM, SPDIF, and
  APBIF. It exposes multiple register regions and supports different
  configurations depending on the Tegra SoC generation. The AHUB also
  provides a configlink bus for child audio components, which use CIF
  (Client Interface) IDs to identify their data paths. The number of DMA
  channels, reset lines, and additional modules varies across Tegra30,
  Tegra114, and Tegra124 platforms.

properties:
  compatible:
    oneOf:
      - enum:
          - nvidia,tegra114-ahub
          - nvidia,tegra124-ahub
          - nvidia,tegra30-ahub
      - items:
          - const: nvidia,tegra132-ahub
          - const: nvidia,tegra124-ahub

  reg:
    minItems: 2
    maxItems: 3

  interrupts:
    maxItems: 1

  clocks:
    items:
      - description: Clock for the D_AUDIO domain
      - description: Clock for the APBIF interface

  clock-names:
    items:
      - const: d_audio
      - const: apbif

  resets:
    minItems: 11
    maxItems: 21

  reset-names:
    minItems: 11
    maxItems: 21

  dmas:
    minItems: 8
    maxItems: 20

  dma-names:
    minItems: 8
    items:
      - const: rx0
      - const: tx0
      - const: rx1
      - const: tx1
      - const: rx2
      - const: tx2
      - const: rx3
      - const: tx3
      - const: rx4
      - const: tx4
      - const: rx5
      - const: tx5
      - const: rx6
      - const: tx6
      - const: rx7
      - const: tx7
      - const: rx8
      - const: tx8
      - const: rx9
      - const: tx9

  "#address-cells":
    enum: [1, 2]

  "#size-cells":
    enum: [1, 2]

  ranges: true

patternProperties:
  "^i2s@[0-9a-f]+$":
    $ref: /schemas/sound/nvidia,tegra30-i2s.yaml#
    unevaluatedProperties: false

allOf:
  - if:
      properties:
        compatible:
          contains:
            const: nvidia,tegra30-ahub
    then:
      properties:
        reg:
          minItems: 2
          maxItems: 2

        resets:
          minItems: 11
          maxItems: 11

        reset-names:
          items:
            - const: d_audio
            - const: apbif
            - const: i2s0
            - const: i2s1
            - const: i2s2
            - const: i2s3
            - const: i2s4
            - const: dam0
            - const: dam1
            - const: dam2
            - const: spdif

        dmas:
          minItems: 8
          maxItems: 8

        dma-names:
          minItems: 8
          maxItems: 8

        "#address-cells":
          const: 1

        "#size-cells":
          const: 1

  - if:
      properties:
        compatible:
          contains:
            const: nvidia,tegra114-ahub
    then:
      properties:
        reg:
          minItems: 3
          maxItems: 3

        resets:
          minItems: 13
          maxItems: 13

        reset-names:
          items:
            - const: d_audio
            - const: apbif
            - const: i2s0
            - const: i2s1
            - const: i2s2
            - const: i2s3
            - const: i2s4
            - const: dam0
            - const: dam1
            - const: dam2
            - const: spdif
            - const: amx
            - const: adx

        dmas:
          minItems: 20
          maxItems: 20

        dma-names:
          minItems: 20
          maxItems: 20

        "#address-cells":
          const: 1

        "#size-cells":
          const: 1

  - if:
      properties:
        compatible:
          contains:
            const: nvidia,tegra124-ahub
    then:
      properties:
        reg:
          minItems: 3
          maxItems: 3

        resets:
          minItems: 21
          maxItems: 21

        reset-names:
          items:
            - const: d_audio
            - const: apbif
            - const: i2s0
            - const: i2s1
            - const: i2s2
            - const: i2s3
            - const: i2s4
            - const: dam0
            - const: dam1
            - const: dam2
            - const: spdif
            - const: amx
            - const: amx1
            - const: adx
            - const: adx1
            - const: afc0
            - const: afc1
            - const: afc2
            - const: afc3
            - const: afc4
            - const: afc5

        dmas:
          minItems: 20
          maxItems: 20

        dma-names:
          minItems: 20
          maxItems: 20

        "#address-cells":
          const: 2

        "#size-cells":
          const: 2

required:
  - reg
  - compatible
  - interrupts
  - clocks
  - clock-names
  - resets
  - reset-names
  - dmas
  - dma-names
  - "#address-cells"
  - "#size-cells"
  - ranges

additionalProperties: false

examples:
  - |
    #include <dt-bindings/interrupt-controller/arm-gic.h>
    #include <dt-bindings/clock/tegra30-car.h>
    ahub@70080000 {
        compatible = "nvidia,tegra30-ahub";
        reg = <0x70080000 0x200>, <0x70080200 0x100>;
        interrupts = <GIC_SPI 103 IRQ_TYPE_LEVEL_HIGH>;
        clocks = <&tegra_car TEGRA30_CLK_D_AUDIO>,
                 <&tegra_car TEGRA30_CLK_APBIF>;
        clock-names = "d_audio", "apbif";
        resets = <&tegra_car 106>, <&tegra_car 107>,
                 <&tegra_car 30>, <&tegra_car 11>,
                 <&tegra_car 18>, <&tegra_car 101>,
                 <&tegra_car 102>, <&tegra_car 108>,
                 <&tegra_car 109>, <&tegra_car 110>,
                 <&tegra_car 10>;
        reset-names = "d_audio", "apbif",
                      "i2s0", "i2s1", "i2s2", "i2s3", "i2s4",
                      "dam0", "dam1", "dam2",
                      "spdif";
        dmas = <&apbdma 1>, <&apbdma 1>,
               <&apbdma 2>, <&apbdma 2>,
               <&apbdma 3>, <&apbdma 3>,
               <&apbdma 4>, <&apbdma 4>;
        dma-names = "rx0", "tx0", "rx1", "tx1",
                    "rx2", "tx2", "rx3", "tx3";
        ranges;
        #address-cells = <1>;
        #size-cells = <1>;

        i2s@70080300 {
            compatible = "nvidia,tegra30-i2s";
            reg = <0x70080300 0x100>;
            nvidia,ahub-cif-ids = <4 4>;
            clocks = <&tegra_car TEGRA30_CLK_I2S0>;
            resets = <&tegra_car 30>;
            reset-names = "i2s";
        };
    };
...
```

## Documentation/devicetree/bindings/sound/pcm3060.yaml
```yaml
# SPDX-License-Identifier: GPL-2.0-only OR BSD-2-Clause
%YAML 1.2
---
$id: http://devicetree.org/schemas/sound/pcm3060.yaml#
$schema: http://devicetree.org/meta-schemas/core.yaml#

title: PCM3060 audio CODEC

maintainers:
  - Kirill Marinushkin <k.marinushkin@gmail.com>

properties:
  compatible:
    const: ti,pcm3060

  reg:
    maxItems: 1
    description: |
      The I2C address of the device
      or SPI chip select number.

  ti,out-single-ended:
    type: boolean
    description: |
      If present, the output is single-ended.
      If absent, the output is differential.

required:
  - compatible
  - reg

additionalProperties: false

examples:
  - |
    i2c {
      #address-cells = <1>;
      #size-cells = <0>;

      pcm3060: audio-codec@46 {
        compatible = "ti,pcm3060";
        reg = <0x46>;
        ti,out-single-ended;
      };
    };
```

## Documentation/devicetree/bindings/sound/qcom,lpass-va-csr.yaml
```yaml
# SPDX-License-Identifier: (GPL-2.0-only OR BSD-2-Clause)
%YAML 1.2
---
$id: http://devicetree.org/schemas/sound/qcom,lpass-va-csr.yaml#
$schema: http://devicetree.org/meta-schemas/core.yaml#

title: Qualcomm LPASS VA CSR heartbeat pulse clock provider

maintainers:
  - Srinivas Kandagatla <srinivas.kandagatla@oss.qualcomm.com>
  - Sarath Ganapathiraju <sarath.ganapathiraju@oss.qualcomm.com>

description:
  The LPASS VA CSR block contains the rate generator hardware which
  produces the heartbeatpulse consumed by the Bolero codec macros
  (rx, tx, wsa, va). It is modelled as a clock provider
  so consumers can reference it by name in their clocks list.

properties:
  compatible:
    enum:
      - qcom,hawi-lpass-va-csr

  reg:
    maxItems: 1
    description: Must cover the full VA CSR block (base 0x7EE0000, size 0xE000).

  "#clock-cells":
    const: 0
    description:
      Single clock output "lpass_heartbeat_pulse". Consumers reference
      it by clock-name "heartbeatpulse" in their clocks list.

required:
  - compatible
  - reg
  - "#clock-cells"

unevaluatedProperties: false

examples:
  - |
    va-csr@7ee0000 {
      compatible = "qcom,hawi-lpass-va-csr";
      reg = <0x0 0x07ee0000 0x0 0xe000>;
      #clock-cells = <0>;
    };
```

## Documentation/devicetree/bindings/sound/qcom,q6apm-lpass-dais.yaml
```yaml
# SPDX-License-Identifier: GPL-2.0 OR BSD-2-Clause
%YAML 1.2
---
$id: http://devicetree.org/schemas/sound/qcom,q6apm-lpass-dais.yaml#
$schema: http://devicetree.org/meta-schemas/core.yaml#

title: Qualcomm DSP LPASS (Low Power Audio SubSystem) Audio Ports

maintainers:
  - Krzysztof Kozlowski <krzk@kernel.org>
  - Srinivas Kandagatla <srinivas.kandagatla@linaro.org>

allOf:
  - $ref: dai-common.yaml#

properties:
  compatible:
    enum:
      - qcom,q6apm-lpass-dais

  '#sound-dai-cells':
    const: 1

  '#address-cells':
    const: 1

  '#size-cells':
    const: 0

# Digital Audio Interfaces
patternProperties:
  '^dai@[0-9a-f]+$':
    type: object
    description:
      Q6DSP Digital Audio Interfaces.

    properties:
      reg:
        maxItems: 1
        description:
          Digital Audio Interface ID

      clocks:
        minItems: 1
        maxItems: 2
        description: MI2S clocks (mclk, bclk and/or eclk).

      clock-names:
        minItems: 1
        maxItems: 2

    allOf:
      - oneOf:
          - properties:
              reg: true
              clocks: true
              clock-names:
                items:
                  - const: mclk
            additionalProperties: false
          - properties:
              reg: true
              clocks: true
              clock-names:
                items:
                  - const: bclk
            additionalProperties: false
          - properties:
              reg: true
              clocks: true
              clock-names:
                items:
                  - const: eclk
            additionalProperties: false
          - properties:
              reg: true
              clocks: true
              clock-names:
                items:
                  - const: mclk
                  - const: bclk
            additionalProperties: false
          - properties:
              reg: true
              clocks: true
              clock-names:
                items:
                  - const: mclk
                  - const: eclk
            additionalProperties: false

    dependencies:
      clocks: [clock-names]

    required:
      - reg

    additionalProperties: false

required:
  - compatible
  - '#sound-dai-cells'

unevaluatedProperties: false

examples:
  - |
    #include <dt-bindings/sound/qcom,q6afe.h>

    dais {
        compatible = "qcom,q6apm-lpass-dais";
        #sound-dai-cells = <1>;
        #address-cells = <1>;
        #size-cells = <0>;

        dai@10 {
           reg = <PRIMARY_MI2S_RX>;
           clocks = <&q6prmcc LPASS_CLK_ID_MCLK_1
                              LPASS_CLK_ATTRIBUTE_COUPLE_NO>,
                    <&q6prmcc LPASS_CLK_ID_PRI_MI2S_IBIT
                              LPASS_CLK_ATTRIBUTE_COUPLE_NO>;
           clock-names = "mclk", "bclk";
        };
    };
```

## Documentation/devicetree/bindings/sound/qcom,wcd9378-codec.yaml
```yaml
# SPDX-License-Identifier: (GPL-2.0-only OR BSD-2-Clause)
%YAML 1.2
---
$id: http://devicetree.org/schemas/sound/qcom,wcd9378-codec.yaml#
$schema: http://devicetree.org/meta-schemas/core.yaml#

title: Qualcomm WCD9378 Audio Codec

maintainers:
  - Jorijn van der Graaf <jorijnvdgraaf@catcrafts.net>

description:
  The Qualcomm WCD9378 is a standalone Hi-Fi audio codec IC with three
  ADCs, three mic bias supplies, headphone/earpiece/line outputs and
  MBHC. This node describes the mobile presentation, where the codec
  appears as two SoundWire slaves on separate masters and this node owns
  the resources they share; the control registers live in the SDCA control
  address space reached through the TX slave. In SDCA mode the codec is a
  single aggregated slave with no node of its own, see
  qcom,wcd9378-sdw.yaml.

allOf:
  - $ref: dai-common.yaml#
  - $ref: qcom,wcd93xx-common.yaml#

properties:
  compatible:
    const: qcom,wcd9378-codec

  qcom,micbias4-microvolt: false

required:
  - compatible

unevaluatedProperties: false

examples:
  - |
    #include <dt-bindings/gpio/gpio.h>
    audio-codec {
        compatible = "qcom,wcd9378-codec";
        reset-gpios = <&tlmm 162 GPIO_ACTIVE_LOW>;
        vdd-buck-supply = <&vreg_l8b>;
        vdd-rxtx-supply = <&vreg_l7b>;
        vdd-io-supply = <&vreg_l7b>;
        vdd-mic-bias-supply = <&vreg_bob>;
        qcom,micbias1-microvolt = <1800000>;
        qcom,micbias2-microvolt = <1800000>;
        qcom,micbias3-microvolt = <1800000>;
        qcom,rx-device = <&wcd9378_rx>;
        qcom,tx-device = <&wcd9378_tx>;
        #sound-dai-cells = <1>;
    };
...
```
