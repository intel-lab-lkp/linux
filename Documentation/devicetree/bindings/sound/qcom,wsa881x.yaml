## Documentation/devicetree/bindings/sound/sophgo,cv1800b-sound-dac.yaml
```yaml
# SPDX-License-Identifier: (GPL-2.0-only OR BSD-2-Clause)
%YAML 1.2
---
$id: http://devicetree.org/schemas/sound/sophgo,cv1800b-sound-dac.yaml#
$schema: http://devicetree.org/meta-schemas/core.yaml#

title: Sophgo CV1800B internal DAC audio codec

maintainers:
  - Anton D. Stavinskii <stavinsky@gmail.com>

allOf:
  - $ref: dai-common.yaml#

description: Internal DAC audio codec integrated in the Sophgo CV1800B SoC.
  The codec exposes a single playback DAI and is intended to be connected to an
  I2S/TDM controller via an ASoC machine driver.

properties:
  compatible:
    const: sophgo,cv1800b-sound-dac

  reg:
    maxItems: 1

  "#sound-dai-cells":
    const: 0

required:
  - compatible
  - reg
  - "#sound-dai-cells"

unevaluatedProperties: false

examples:
  - |
    audio-codec@300A000  {
      compatible = "sophgo,cv1800b-sound-dac";
      #sound-dai-cells = <0>;
      reg = <0x0300A000 0x100>;
    };
...
```

## Documentation/devicetree/bindings/sound/starfive,jh8100-pdm.yaml
```yaml
# SPDX-License-Identifier: (GPL-2.0 OR BSD-2-Clause)
%YAML 1.2
---
$id: http://devicetree.org/schemas/sound/starfive,jh8100-pdm.yaml#
$schema: http://devicetree.org/meta-schemas/core.yaml#

title: StarFive JH8100 PDM controller

description: |
  The Pulse Density Modulation (PDM) controller is a digital PDM out
  microphone interface controller and decoder that supports both
  mono/stereo PDM format, and an Inter-IC Sound (I2S) transmitter that
  outputs standard stereo audio data to another device. The I2S transmitter
  can be configured to operate either a master or a slave (default mode).
  The PDM controller includes two PDM modules, each PDM module can drive
  one bitstream sampling clock and two bitstream coming data with sampling
  clock rising and falling edge.

maintainers:
  - Xingyu Wu <xingyu.wu@starfivetech.com>
  - Walker Chen <walker.chen@starfivetech.com>

properties:
  compatible:
    const: starfive,jh8100-pdm

  reg:
    maxItems: 1

  clocks:
    items:
      - description: DMIC output clock
      - description: Main ICG clock

  clock-names:
    items:
      - const: dmic
      - const: icg

  resets:
    maxItems: 1

  starfive,syscon:
    $ref: /schemas/types.yaml#/definitions/phandle-array
    items:
      - items:
          - description: phandle to System Register Controller sys_syscon_ne node.
          - description: PDM source enabled control offset of SYS_SYSCON_NE register.
          - description: PDM source enabled control mask
    description:
      The phandle to System Register Controller syscon node and the PDM source
      from I2S enabled control offset and mask of SYS_SYSCON_NE register.

  starfive,pdm-modulex:
    $ref: /schemas/types.yaml#/definitions/uint32
    enum: [0, 1]
    description:
      The module x will be using in PDM controller. Default use module 0.

  "#sound-dai-cells":
    const: 0

required:
  - compatible
  - reg
  - clocks
  - clock-names
  - resets
  - starfive,syscon

unevaluatedProperties: false

examples:
  - |
    pdm@12250000 {
      compatible = "starfive,jh8100-pdm";
      reg = <0x12250000 0x1000>;
      clocks = <&syscrg_ne 142>,
               <&syscrg_ne 171>;
      clock-names = "dmic", "icg";
      resets = <&syscrg_ne 44>;
      starfive,syscon = <&sys_syscon_ne 0xC 0xFF>;
      #sound-dai-cells = <0>;
    };
```

## Documentation/devicetree/bindings/sound/ti,omap2-mcbsp.yaml
```yaml
# SPDX-License-Identifier: (GPL-2.0-only OR BSD-2-Clause)
%YAML 1.2
---
$id: http://devicetree.org/schemas/sound/ti,omap2-mcbsp.yaml#
$schema: http://devicetree.org/meta-schemas/core.yaml#

title: Texas Instruments OMAP2+ McBSP

maintainers:
  - Eduard Bostina <egbostina@gmail.com>

properties:
  compatible:
    enum:
      - ti,omap2420-mcbsp
      - ti,omap2430-mcbsp
      - ti,omap3-mcbsp
      - ti,omap4-mcbsp

  reg:
    minItems: 1
    maxItems: 2
    description: |
      Register location and size. For OMAP4+ it may be an array containing:
      - MPU access base address
      - L3 interconnect address (or sidetone)

  reg-names:
    minItems: 1
    maxItems: 2
    items:
      enum: [mpu, sidetone, dma]

  interrupts:
    minItems: 1
    maxItems: 4

  interrupt-names:
    minItems: 1
    maxItems: 4
    items:
      enum: [common, tx, rx, sidetone]

  ti,buffer-size:
    $ref: /schemas/types.yaml#/definitions/uint32
    description: Size of the FIFO on the port (OMAP2430 and newer SoCs).

  ti,hwmods:
    $ref: /schemas/types.yaml#/definitions/string-array
    minItems: 1
    maxItems: 2
    description: Name of the hwmod(s) associated with the McBSP port.

  clocks:
    minItems: 1
    maxItems: 2

  clock-names:
    minItems: 1
    maxItems: 2

  dmas:
    minItems: 1
    maxItems: 2

  dma-names:
    minItems: 1
    maxItems: 2

  "#sound-dai-cells":
    const: 0

  port:
    $ref: /schemas/sound/audio-graph-port.yaml#
    unevaluatedProperties: false

required:
  - compatible
  - reg
  - reg-names
  - interrupts
  - interrupt-names

additionalProperties: false

examples:
  - |
    mcbsp@49022000 {
        compatible = "ti,omap3-mcbsp";
        reg = <0x49022000 0xff>,
              <0x49028000 0xff>;
        reg-names = "mpu", "sidetone";
        interrupts = <0 17 0x4>, /* OCP compliant */
                     <0 62 0x4>, /* TX */
                     <0 63 0x4>, /* RX */
                     <0 4 0x4>;  /* Sidetone */
        interrupt-names = "common", "tx", "rx", "sidetone";
        interrupt-parent = <&intc>;
        ti,buffer-size = <1280>;
        ti,hwmods = "mcbsp2";
    };
```

## Documentation/devicetree/bindings/sound/ti,omap4-dmic.yaml
```yaml
# SPDX-License-Identifier: GPL-2.0-only OR BSD-2-Clause
%YAML 1.2
---
$id: http://devicetree.org/schemas/sound/ti,omap4-dmic.yaml#
$schema: http://devicetree.org/meta-schemas/core.yaml#

title: Texas Instruments OMAP4+ Digital Microphone Module

maintainers:
  - Peter Ujfalusi <peter.ujfalusi@ti.com>

description:
  The OMAP4+ Digital Microphone (DMIC) controller captures audio from
  up to three stereo digital microphone pairs over an I2S-like
  interface and transfers the resulting PCM data to memory via DMA.
  The controller exposes two register regions, one for MPU-private
  control and status access and one for the L3 interconnect side
  used for data transfer, and is found on OMAP4, OMAP5 and DRA7xx
  family SoCs.

properties:
  compatible:
    const: ti,omap4-dmic

  reg:
    maxItems: 2

  reg-names:
    items:
      - const: mpu
      - const: dma

  interrupts:
    maxItems: 1

  ti,hwmods:
    description: Name of the hwmod associated with OMAP DMIC IP.
    const: dmic

  dmas:
    maxItems: 1

  dma-names:
    const: up_link

required:
  - reg
  - compatible
  - reg-names
  - interrupts
  - dmas
  - dma-names

additionalProperties: false

examples:
  - |
    #include <dt-bindings/interrupt-controller/arm-gic.h>
    dmic@4012e000 {
        compatible = "ti,omap4-dmic";
        reg = <0x4012e000 0x7f>, /* MPU private access */
              <0x4902e000 0x7f>; /* L3 Interconnect */
        reg-names = "mpu", "dma";
        interrupts = <GIC_SPI 114 IRQ_TYPE_LEVEL_HIGH>;
        dmas = <&sdma 67>;
        dma-names = "up_link";
        ti,hwmods = "dmic";
    };
```

## Documentation/devicetree/bindings/sound/ti,omap4-mcpdm.yaml
```yaml
# SPDX-License-Identifier: GPL-2.0-only OR BSD-2-Clause
%YAML 1.2
---
$id: http://devicetree.org/schemas/sound/ti,omap4-mcpdm.yaml#
$schema: http://devicetree.org/meta-schemas/core.yaml#

title: OMAP McPDM

maintainers:
  - Misael Lopez Cruz <misael.lopez@ti.com>

description:
  OMAP ALSA SoC DAI driver using McPDM port used by TWL6040

properties:
  compatible:
    const: ti,omap4-mcpdm

  reg:
    items:
      - description: MPU access base address
      - description: L3 interconnect address

  interrupts:
    maxItems: 1

  ti,hwmods:
    $ref: /schemas/types.yaml#/definitions/string
    enum: [mcpdm]

  clocks:
    maxItems: 1

  clock-names:
    items:
      - const: pdmclk

required:
  - compatible
  - reg
  - interrupts
  - ti,hwmods
  - clocks
  - clock-names

additionalProperties: false

examples:
  - |
    pdm@40132000 {
      compatible = "ti,omap4-mcpdm";
      reg = <0x40132000 0x7f>, /* MPU private access */
            <0x49032000 0x7f>; /* L3 Interconnect */
      interrupts = <GIC_SPI 112 IRQ_TYPE_LEVEL_HIGH>;
      interrupt-parent = <&gic>;
      ti,hwmods = "mcpdm";
      clocks = <&twl6040>;
      clock-names = "pdmclk";
    };
```

## Documentation/devicetree/bindings/sound/ti,tac5x1x.yaml
```yaml
# SPDX-License-Identifier: GPL-2.0-only OR BSD-2-Clause
%YAML 1.2
---
$id: http://devicetree.org/schemas/sound/ti,tac5x1x.yaml#
$schema: http://devicetree.org/meta-schemas/core.yaml#

title: TI TAC5x1x Audio Codec

maintainers:
  - Niranjan H Y <niranjan.hy@ti.com>

description: |
  The TAC5x1x codec provides audio playback and capture functionality
  with support for various audio formats and sample rates.

  This binding describes the codec functionality of the TAC5x1x device,
  which is instantiated as a child device of the main TAC5x1x MFD described
  in Documentation/devicetree/bindings/mfd/ti,tac5x1x.yaml

properties:
  compatible:
    const: ti,tac5x1x-codec

  '#sound-dai-cells':
    const: 0

  clocks:
    maxItems: 1
    description: Master clock for audio processing

  clock-names:
    items:
      - const: mclk

required:
  - compatible
  - '#sound-dai-cells'

additionalProperties: false

examples:
  - |
    codec {
        compatible = "ti,tac5x1x-codec";
        #sound-dai-cells = <0>;
        clocks = <&audio_mclk>;
        clock-names = "mclk";
    };
```

## Documentation/devicetree/bindings/sound/toshiba,apb-dummy-codec.yaml
```yaml
# SPDX-License-Identifier: (GPL-2.0-only OR BSD-2-Clause)
%YAML 1.2
---
$id: http://devicetree.org/schemas/sound/toshiba,apb-dummy-codec.yaml#
$schema: http://devicetree.org/meta-schemas/core.yaml#

title: Toshiba APBridge Dummy ALSA SoC Codec

maintainers:
  - Vaibhav Agarwal <vaibhav.agarwal@linaro.org>

description:
  The APBridge dummy codec is part of the Greybus audio framework,
  used in Project Ara modular phone hardware. It provides a dummy
  ALSA SoC codec driver for the APBridge audio interface, enabling
  audio streaming between Greybus modules and the host processor
  via the APBridge protocol.

properties:
  compatible:
    const: toshiba,apb-dummy-codec

required:
  - compatible

additionalProperties: false

examples:
  - |
    codec {
        compatible = "toshiba,apb-dummy-codec";
    };
...
```

## Documentation/devicetree/bindings/sound/trivial-codec.yaml
```yaml
# SPDX-License-Identifier: (GPL-2.0 OR BSD-2-Clause)
%YAML 1.2
---
$id: http://devicetree.org/schemas/sound/trivial-codec.yaml#
$schema: http://devicetree.org/meta-schemas/core.yaml#

title: collect trivial audio codec

maintainers:
  - patches@opensource.cirrus.com

allOf:
  - $ref: dai-common.yaml#

properties:
  compatible:
    enum:
      - adi,ssm3515
      - dlg,da9055-codec
      # Nuvoton Technology Corporation NAU85L40 Audio CODEC
      - nuvoton,nau8540
      - nuvoton,nau8810
      - nuvoton,nau8812
      - nuvoton,nau8814
      # NXP TFA9879 class-D audio amplifier
      - nxp,tfa9879
      - nxp,uda1342
      - sdw3019f836300
      - wlf,wm8510
      - wlf,wm8523
      - wlf,wm8580
      - wlf,wm8581
      - wlf,wm8711
      - wlf,wm8728
      - wlf,wm8737
      - wlf,wm8750
      - wlf,wm8753
      - wlf,wm8770
      - wlf,wm8776
      - wlf,wm8961
      - wlf,wm8974
      - wlf,wm8987

  reg:
    maxItems: 1

  "#sound-dai-cells":
    const: 0

required:
  - compatible
  - reg

unevaluatedProperties: false

examples:
  - |
    i2c {
        #address-cells = <1>;
        #size-cells = <0>;
        codec@1a {
            compatible = "wlf,wm8523";
            reg = <0x1a>;
        };
    };
```
