## Documentation/devicetree/bindings/sound/renesas,rsnd.yaml
```yaml
# SPDX-License-Identifier: (GPL-2.0-only OR BSD-2-Clause)
%YAML 1.2
---
$id: http://devicetree.org/schemas/sound/renesas,rsnd.yaml#
$schema: http://devicetree.org/meta-schemas/core.yaml#

title: Renesas R-Car Sound Driver

maintainers:
  - Kuninori Morimoto <kuninori.morimoto.gx@renesas.com>

description:
  Binding for Renesas R-Car Gen1/Gen2/Gen3/Gen4 and RZ/G1/G2 sound
  controllers using the standard RSND layout.

properties:
  compatible:
    oneOf:
      # for Gen1 SoC
      - items:
          - enum:
              - renesas,rcar_sound-r8a7778   # R-Car M1A
              - renesas,rcar_sound-r8a7779   # R-Car H1
          - const: renesas,rcar_sound-gen1
      # for Gen2 SoC
      - items:
          - enum:
              - renesas,rcar_sound-r8a7742   # RZ/G1H
              - renesas,rcar_sound-r8a7743   # RZ/G1M
              - renesas,rcar_sound-r8a7744   # RZ/G1N
              - renesas,rcar_sound-r8a7745   # RZ/G1E
              - renesas,rcar_sound-r8a77470  # RZ/G1C
              - renesas,rcar_sound-r8a7790   # R-Car H2
              - renesas,rcar_sound-r8a7791   # R-Car M2-W
              - renesas,rcar_sound-r8a7793   # R-Car M2-N
              - renesas,rcar_sound-r8a7794   # R-Car E2
          - const: renesas,rcar_sound-gen2
      # for Gen3 SoC
      - items:
          - enum:
              - renesas,rcar_sound-r8a774a1  # RZ/G2M
              - renesas,rcar_sound-r8a774b1  # RZ/G2N
              - renesas,rcar_sound-r8a774c0  # RZ/G2E
              - renesas,rcar_sound-r8a774e1  # RZ/G2H
              - renesas,rcar_sound-r8a7795   # R-Car H3
              - renesas,rcar_sound-r8a7796   # R-Car M3-W
              - renesas,rcar_sound-r8a77961  # R-Car M3-W+
              - renesas,rcar_sound-r8a77965  # R-Car M3-N
              - renesas,rcar_sound-r8a77990  # R-Car E3
              - renesas,rcar_sound-r8a77995  # R-Car D3
          - const: renesas,rcar_sound-gen3
      # for Gen4 SoC
      - items:
          - enum:
              - renesas,rcar_sound-r8a779g0  # R-Car V4H
              - renesas,rcar_sound-r8a779h0  # R-Car V4M
          - const: renesas,rcar_sound-gen4
      # for Generic
      - enum:
          - renesas,rcar_sound-gen1
          - renesas,rcar_sound-gen2
          - renesas,rcar_sound-gen3
          - renesas,rcar_sound-gen4

  reg:
    minItems: 1
    maxItems: 5

  reg-names:
    minItems: 1
    maxItems: 5

  resets:
    minItems: 1
    maxItems: 11

  reset-names:
    minItems: 1
    maxItems: 11

  clocks:
    description: References to SSI/SRC/MIX/CTU/DVC/AUDIO_CLK clocks.
    minItems: 1
    maxItems: 31

  clock-names:
    description: List of clock names.
    minItems: 1
    maxItems: 31

  "#sound-dai-cells": true

  "#clock-cells": true

  "#address-cells": true

  "#size-cells": true

  clock-frequency: true

  clkout-lr-asynchronous: true

  power-domains: true

  port: true

  rcar_sound,dvc: true

  rcar_sound,mix: true

  rcar_sound,ctu: true

  rcar_sound,src: true

  rcar_sound,ssiu: true

  rcar_sound,ssi: true

patternProperties:
  'rcar_sound,dai(@[0-9a-f]+)?$': true
  'ports(@[0-9a-f]+)?$': true

allOf:
  - $ref: renesas,rsnd-common.yaml#

  - if:
      properties:
        compatible:
          contains:
            const: renesas,rcar_sound-gen1
    then:
      properties:
        reg:
          maxItems: 3
        reg-names:
          items:
            - const: sru
            - const: ssi
            - const: adg

  - if:
      properties:
        compatible:
          contains:
            enum:
              - renesas,rcar_sound-gen2
              - renesas,rcar_sound-gen3
    then:
      properties:
        reg:
          maxItems: 5
        reg-names:
          items:
            - const: scu
            - const: adg
            - const: ssiu
            - const: ssi
            - const: audmapp
        resets:
          maxItems: 11
        reset-names:
          items:
            oneOf:
              - const: ssi-all
              - pattern: '^ssi\.[0-9]$'
        clocks:
          maxItems: 31
        clock-names:
          items:
            oneOf:
              - const: ssi-all
              - pattern: '^ssi\.[0-9]$'
              - pattern: '^src\.[0-9]$'
              - pattern: '^mix\.[0-1]$'
              - pattern: '^ctu\.[0-1]$'
              - pattern: '^dvc\.[0-1]$'
              - pattern: '^clk_(a|b|c|i)$'

  - if:
      properties:
        compatible:
          contains:
            const: renesas,rcar_sound-gen4
    then:
      properties:
        reg:
          maxItems: 4
        reg-names:
          items:
            enum:
              - adg
              - ssiu
              - ssi
              - sdmc
        resets:
          maxItems: 2
        reset-names:
          items:
            - const: ssiu.0
            - const: ssi.0
        clocks:
          maxItems: 3
        clock-names:
          items:
            - const: ssiu.0
            - const: ssi.0
            - const: clkin

unevaluatedProperties: false

examples:
  - |
    #include <dt-bindings/clock/r8a7790-cpg-mssr.h>
    #include <dt-bindings/interrupt-controller/arm-gic.h>
    #include <dt-bindings/power/r8a7790-sysc.h>
    rcar_sound: sound@ec500000 {
        #sound-dai-cells = <1>;
        compatible = "renesas,rcar_sound-r8a7790", "renesas,rcar_sound-gen2";
        reg = <0xec500000 0x1000>, /* SCU  */
              <0xec5a0000 0x100>,  /* ADG  */
              <0xec540000 0x1000>, /* SSIU */
              <0xec541000 0x280>,  /* SSI  */
              <0xec740000 0x200>;  /* Audio DMAC peri peri*/
        reg-names = "scu", "adg", "ssiu", "ssi", "audmapp";

        clocks = <&cpg CPG_MOD 1005>,                      /* SSI-ALL    */
                 <&cpg CPG_MOD 1006>, <&cpg CPG_MOD 1007>, /* SSI9, SSI8 */
                 <&cpg CPG_MOD 1008>, <&cpg CPG_MOD 1009>, /* SSI7, SSI6 */
                 <&cpg CPG_MOD 1010>, <&cpg CPG_MOD 1011>, /* SSI5, SSI4 */
                 <&cpg CPG_MOD 1012>, <&cpg CPG_MOD 1013>, /* SSI3, SSI2 */
                 <&cpg CPG_MOD 1014>, <&cpg CPG_MOD 1015>, /* SSI1, SSI0 */
                 <&cpg CPG_MOD 1022>, <&cpg CPG_MOD 1023>, /* SRC9, SRC8 */
                 <&cpg CPG_MOD 1024>, <&cpg CPG_MOD 1025>, /* SRC7, SRC6 */
                 <&cpg CPG_MOD 1026>, <&cpg CPG_MOD 1027>, /* SRC5, SRC4 */
                 <&cpg CPG_MOD 1028>, <&cpg CPG_MOD 1029>, /* SRC3, SRC2 */
                 <&cpg CPG_MOD 1030>, <&cpg CPG_MOD 1031>, /* SRC1, SRC0 */
                 <&cpg CPG_MOD 1020>, <&cpg CPG_MOD 1021>, /* MIX1, MIX0 */
                 <&cpg CPG_MOD 1020>, <&cpg CPG_MOD 1021>, /* CTU1, CTU0 */
                 <&cpg CPG_MOD 1019>, <&cpg CPG_MOD 1018>, /* DVC0, DVC1 */
                 <&audio_clk_a>, <&audio_clk_b>,           /* CLKA, CLKB */
                 <&audio_clk_c>, <&audio_clk_i>;           /* CLKC, CLKI */

        clock-names = "ssi-all",
                      "ssi.9", "ssi.8",
                      "ssi.7", "ssi.6",
                      "ssi.5", "ssi.4",
                      "ssi.3", "ssi.2",
                      "ssi.1", "ssi.0",
                      "src.9", "src.8",
                      "src.7", "src.6",
                      "src.5", "src.4",
                      "src.3", "src.2",
                      "src.1", "src.0",
                      "mix.1", "mix.0",
                      "ctu.1", "ctu.0",
                      "dvc.0", "dvc.1",
                      "clk_a", "clk_b",
                      "clk_c", "clk_i";

        power-domains = <&sysc R8A7790_PD_ALWAYS_ON>;

        resets = <&cpg 1005>,
                 <&cpg 1006>, <&cpg 1007>, <&cpg 1008>, <&cpg 1009>,
                 <&cpg 1010>, <&cpg 1011>, <&cpg 1012>, <&cpg 1013>,
                 <&cpg 1014>, <&cpg 1015>;
        reset-names = "ssi-all",
                      "ssi.9", "ssi.8", "ssi.7", "ssi.6",
                      "ssi.5", "ssi.4", "ssi.3", "ssi.2",
                      "ssi.1", "ssi.0";

        rcar_sound,dvc {
               dvc0: dvc-0 {
                    dmas = <&audma0 0xbc>;
                    dma-names = "tx";
               };
               dvc1: dvc-1 {
                    dmas = <&audma0 0xbe>;
                    dma-names = "tx";
               };
        };

        rcar_sound,mix {
            mix0: mix-0 { };
            mix1: mix-1 { };
        };

        rcar_sound,ctu {
            ctu00: ctu-0 { };
            ctu01: ctu-1 { };
            ctu02: ctu-2 { };
            ctu03: ctu-3 { };
            ctu10: ctu-4 { };
            ctu11: ctu-5 { };
            ctu12: ctu-6 { };
            ctu13: ctu-7 { };
        };

        rcar_sound,src {
            src0: src-0 {
                status = "disabled";
            };
            src1: src-1 {
                interrupts = <GIC_SPI 353 IRQ_TYPE_LEVEL_HIGH>;
                dmas = <&audma0 0x87>, <&audma1 0x9c>;
                dma-names = "rx", "tx";
            };
            /* skip after src-2 */
        };

        rcar_sound,ssiu {
            ssiu00: ssiu-0 {
                dmas = <&audma0 0x15>, <&audma1 0x16>;
                dma-names = "rx", "tx";
            };
            ssiu01: ssiu-1 {
                dmas = <&audma0 0x35>, <&audma1 0x36>;
                dma-names = "rx", "tx";
            };
            /* skip after ssiu-2 */
        };

        rcar_sound,ssi {
            ssi0: ssi-0 {
                interrupts = <GIC_SPI 370 IRQ_TYPE_LEVEL_HIGH>;
                dmas = <&audma0 0x01>, <&audma1 0x02>;
                dma-names = "rx", "tx";
            };
            ssi1: ssi-1 {
                interrupts = <GIC_SPI 371 IRQ_TYPE_LEVEL_HIGH>;
                dmas = <&audma0 0x03>, <&audma1 0x04>;
                dma-names = "rx", "tx";
            };
            /* skip other ssi-2 */
        };

        /* DAI base */
        rcar_sound,dai {
            dai0 {
                playback = <&ssi5>, <&src5>;
                capture = <&ssi6>;
            };
            dai1 {
                playback = <&ssi3>;
            };
            dai2 {
                capture = <&ssi4>;
            };
            dai3 {
                playback = <&ssi7>;
            };
            dai4 {
                capture = <&ssi8>;
            };
        };

        /* assume audio-graph */
        port {
            rsnd_endpoint: endpoint {
                remote-endpoint = <&codec_endpoint>;

                dai-format = "left_j";
                bitclock-master = <&rsnd_endpoint0>;
                frame-master = <&rsnd_endpoint0>;

                playback = <&ssi0>, <&src0>, <&dvc0>;
                capture = <&ssi1>, <&src1>, <&dvc1>;
            };
        };
    };

    /* assume audio-graph */
    codec {
        port {
            codec_endpoint: endpoint {
                remote-endpoint = <&rsnd_endpoint>;
            };
        };
    };
```

## Documentation/devicetree/bindings/sound/richtek,rtq9124.yaml
```yaml
# SPDX-License-Identifier: GPL-2.0-only OR BSD-2-Clause
%YAML 1.2
---
$id: http://devicetree.org/schemas/sound/richtek,rtq9124.yaml#
$schema: http://devicetree.org/meta-schemas/core.yaml#

title: Richtek RTQ9124 Automotive Audio Amplifier

maintainers:
  - ChiYuan Huang <cy_huang@richtek.com>

description:
  RTQ9124 is an ultra-low output noise, digital input, mono-channel Class-D
  power amplifier that supports a 2.1MHz switching frequency. It integrates
  both DC and AC load diagnostics, as well as real-time load monitoring to
  assess speaker condition. The device operates from 4.5V to 18V and delivers
  up to 30W output power.

allOf:
  - $ref: dai-common.yaml#

properties:
  compatible:
    enum:
      - richtek,rtq9124

  reg:
    maxItems: 1

  '#sound-dai-cells':
    const: 0

  enable-gpios:
    maxItems: 1

required:
  - compatible
  - reg
  - '#sound-dai-cells'

unevaluatedProperties: false

examples:
  - |
    #include <dt-bindings/gpio/gpio.h>

    i2c {
        #address-cells = <1>;
        #size-cells = <0>;

        amplifier@13 {
            compatible = "richtek,rtq9124";
            reg = <0x13>;
            enable-gpios = <&gpio 26 GPIO_ACTIVE_HIGH>;
            #sound-dai-cells = <0>;
        };
    };
```

## Documentation/devicetree/bindings/sound/rockchip,rk3399-gru-sound.yaml
```yaml
# SPDX-License-Identifier: (GPL-2.0-only OR BSD-2-Clause)
%YAML 1.2
---
$id: http://devicetree.org/schemas/sound/rockchip,rk3399-gru-sound.yaml#
$schema: http://devicetree.org/meta-schemas/core.yaml#

title: ROCKCHIP with MAX98357A/RT5514/DA7219 codecs on GRU boards

maintainers:
  - Heiko Stuebner <heiko@sntech.de>

properties:
  compatible:
    const: rockchip,rk3399-gru-sound

  rockchip,cpu:
    $ref: /schemas/types.yaml#/definitions/phandle-array
    description:
      The phandle of the Rockchip I2S controller that's connected to the codecs

  rockchip,codec:
    $ref: /schemas/types.yaml#/definitions/phandle-array
    description: The phandle of the audio codecs

  dmic-wakeup-delay-ms:
    description:
      specify delay time (ms) for DMIC ready.
      If this option is specified, which means it's required dmic need
      delay for DMIC to ready so that rt5514 can avoid recording before
      DMIC sends valid data

required:
  - compatible
  - rockchip,cpu
  - rockchip,codec

additionalProperties: false

examples:
  - |
    sound {
      compatible = "rockchip,rk3399-gru-sound";
      rockchip,cpu = <&i2s0>;
      rockchip,codec = <&max98357a &rt5514 &da7219>;
      dmic-wakeup-delay-ms = <20>;
    };
```

## Documentation/devicetree/bindings/sound/samsung,abox-generic.yaml
```yaml
# SPDX-License-Identifier: (GPL-2.0-only OR BSD-2-Clause)
%YAML 1.2
---
$id: "http://devicetree.org/schemas/soc/samsung/abox-generic.yaml#"
$schema: "http://devicetree.org/meta-schemas/core.yaml#"

title: Samsung Exynos Automotive Abox Generic

maintainers:
  - name: Eunwoo Kim
    email: ew.kim@samsung.com

description: |
  Samsung Exynos Automotive Abox Generic core node.

  This node represents the generic Abox controller which manages
  various Abox sub-drivers and acts as a hub connecting them to
  SoC-level audio drivers. It provides PCM playback and capture
  configuration, as well as dummy I2S backend handling, enabling
  integration between Abox IP blocks and the SoC audio subsystem.

  Typically, this node is used to initialize and configure playback,
  capture, and routing between the Abox and other SoC audio components.

properties:
  compatible:
    const: samsung,abox_generic

  samsung,num-of-pcm_playback:
    description: Number of PCM playback instances.
    $ref: /schemas/types.yaml#/definitions/uint32

  samsung,num-of-pcm_capture:
    description: Number of PCM capture instances.
    $ref: /schemas/types.yaml#/definitions/uint32

  samsung,num-of-i2s-dummy-backend:
    description: Number of dummy I2S backend instances.
    $ref: /schemas/types.yaml#/definitions/uint32

  status:
    description: Availability status.
    enum: [ "okay", "disabled" ]

  '#address-cells':
    description: Number of address cells in the node.
    const: 2

  '#size-cells':
    description: Number of size cells in the node.
    const: 1

  ranges:
    description: Standard `ranges` property for bus address mapping.
    type: object

required:
  - compatible
  - samsung,num-of-pcm_playback
  - samsung,num-of-pcm_capture
  - samsung,num-of-i2s-dummy-backend

additionalProperties: false

examples:
  - |
    abox_generic: abox_generic@generic {
      compatible = "samsung,abox_generic";
      samsung,num-of-pcm_playback = <32>;
      samsung,num-of-pcm_capture = <32>;
      samsung,num-of-i2s-dummy-backend = <5>;
      status = "disabled";
      #address-cells = <2>;
      #size-cells = <1>;
      ranges;
    };
```
