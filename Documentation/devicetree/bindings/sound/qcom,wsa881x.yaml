## Documentation/devicetree/bindings/sound/wlf,wm8904.yaml
```yaml
# SPDX-License-Identifier: GPL-2.0-only OR BSD-2-Clause
%YAML 1.2
---
$id: http://devicetree.org/schemas/sound/wlf,wm8904.yaml#
$schema: http://devicetree.org/meta-schemas/core.yaml#

title: Wolfson WM8904/WM8912 audio codecs

maintainers:
  - patches@opensource.cirrus.com

description: |
  Pins on the device (for linking into audio routes):
  IN1L, IN1R, IN2L, IN2R, IN3L, IN3R, HPOUTL, HPOUTR, LINEOUTL, LINEOUTR,
  MICBIAS

properties:
  compatible:
    enum:
      - wlf,wm8904
      - wlf,wm8912

  reg:
    maxItems: 1

  "#sound-dai-cells":
    const: 0

  clocks:
    maxItems: 1

  clock-names:
    const: mclk

  AVDD-supply: true
  CPVDD-supply: true
  DBVDD-supply: true
  DCVDD-supply: true
  MICVDD-supply: true

  wlf,in1l-as-dmicdat1:
    type: boolean
    description:
      Use IN1L/DMICDAT1 as DMICDAT1, enabling the DMIC input path.

  wlf,in1r-as-dmicdat2:
    type: boolean
    description:
      Use IN1R/DMICDAT2 as DMICDAT2, enabling the DMIC input path.

  wlf,gpio-cfg:
    $ref: /schemas/types.yaml#/definitions/uint32-array
    minItems: 4
    maxItems: 4
    description:
      Default register values for R121/122/123/124 (GPIO Control).
      If any entry has the value 0xFFFF, the related register won't be set.
    default: [0xFFFF, 0xFFFF, 0xFFFF, 0xFFFF]

  wlf,mic-cfg:
    $ref: /schemas/types.yaml#/definitions/uint32-array
    minItems: 2
    maxItems: 2
    description:
      Default register values for R6/R7 (Mic Bias Control).
    default: [0, 0]

  wlf,drc-cfg-names:
    $ref: /schemas/types.yaml#/definitions/string-array
    description:
      List of strings for the available DRC modes.
      If absent, DRC is disabled.

  wlf,drc-cfg-regs:
    $ref: /schemas/types.yaml#/definitions/uint16-array
    description:
      Default register values for R40/41/42/43 (DRC).
      The list must be 4 times the length of wlf,drc-cfg-names.
      If absent, DRC is disabled.

  wlf,retune-mobile-cfg-names:
    $ref: /schemas/types.yaml#/definitions/string-array
    description:
      List of strings for the available retune modes.
      If absent, retune is disabled.

  wlf,retune-mobile-cfg-rates:
    $ref: /schemas/types.yaml#/definitions/uint32-array
    description:
      List of rates for the available retune modes.
      The list must be the same length as wlf,retune-mobile-cfg-names.
      If absent, retune is disabled.

  wlf,retune-mobile-cfg-regs:
    $ref: /schemas/types.yaml#/definitions/uint16-array
    description:
      Default register values for R134/.../157 (EQ).
      The list must be 24 times the length of wlf,retune-mobile-cfg-names.
      If absent, retune is disabled.

dependencies:
  wlf,drc-cfg-names: [ 'wlf,drc-cfg-regs' ]
  wlf,drc-cfg-regs: [ 'wlf,drc-cfg-names' ]

  wlf,retune-mobile-cfg-names: [ 'wlf,retune-mobile-cfg-rates', 'wlf,retune-mobile-cfg-regs' ]
  wlf,retune-mobile-cfg-regs: [ 'wlf,retune-mobile-cfg-names', 'wlf,retune-mobile-cfg-rates' ]
  wlf,retune-mobile-cfg-rates: [ 'wlf,retune-mobile-cfg-names', 'wlf,retune-mobile-cfg-regs' ]

required:
  - compatible
  - reg
  - clocks
  - clock-names
  - AVDD-supply
  - CPVDD-supply
  - DBVDD-supply
  - DCVDD-supply
  - MICVDD-supply

allOf:
  - $ref: dai-common.yaml#

unevaluatedProperties: false

examples:
  - |
    i2c {
        #address-cells = <1>;
        #size-cells = <0>;

        codec@1a {
            compatible = "wlf,wm8904";
            reg = <0x1a>;
            clocks = <&pck0>;
            clock-names = "mclk";
            AVDD-supply = <&reg_1p8v>;
            CPVDD-supply = <&reg_1p8v>;
            DBVDD-supply = <&reg_1p8v>;
            DCVDD-supply = <&reg_1p8v>;
            MICVDD-supply = <&reg_1p8v>;

            wlf,drc-cfg-names = "default", "peaklimiter", "tradition", "soft", "music";
            wlf,drc-cfg-regs =
                /* coded default: KNEE_IP = KNEE_OP = 0, HI_COMP = LO_COMP = 1  */
                /bits/ 16 <0x01af 0x3248 0x0000 0x0000>,
                /* coded default: KNEE_IP = -24, KNEE_OP = -6, HI_COMP = 1/4, LO_COMP = 1 */
                /bits/ 16 <0x04af 0x324b 0x0010 0x0408>,
                /* coded default: KNEE_IP = -42, KNEE_OP = -3, HI_COMP = 0, LO_COMP = 1 */
                /bits/ 16 <0x04af 0x324b 0x0028 0x0704>,
                /* coded default: KNEE_IP = -45, KNEE_OP = -9, HI_COMP = 1/8, LO_COMP = 1 */
                /bits/ 16 <0x04af 0x324b 0x0018 0x078c>,
                /* coded default: KNEE_IP = -30, KNEE_OP = -10.5, HI_COMP = 1/4, LO_COMP = 1 */
                /bits/ 16 <0x04af 0x324b 0x0010 0x050e>;

            wlf,gpio-cfg = <
                0x0018 /* GPIO1 => DMIC_CLK */
                0xffff /* GPIO2 => don't touch */
                0xffff /* GPIO3 => don't touch */
                0xffff /* GPIO4 => don't touch */

            wlf,retune-mobile-cfg-names = "bassboost", "bassboost", "treble";
            wlf,retune-mobile-cfg-rates = <48000 44100 48000>;
            wlf,retune-mobile-cfg-regs =
                /* bassboost: EQ_ENA = 1, +6 dB @ 100 Hz, +3 dB @ 300 Hz, 0 dB @ 875, 2400, 6900 Hz */
                /bits/ 16 <0x1 0x12 0xf 0xc 0xc 0xc>,
                /* default values for ReTune Mobile registers 140-157 */
                /bits/ 16 <0x0fca 0x0400 0x00d8 0x1eb5 0xf145 0x0bd5 0x0075 0x1c58 0xf3d3 0x0a54 0x0568 0x168e 0xf829 0x07ad 0x1103 0x0564 0x0559 0x4000>,

                /* bassboost: EQ_ENA = 1, +6 dB @ 100 Hz, +3 dB @ 300 Hz, 0 dB @ 875, 2400, 6900 Hz */
                /bits/ 16 <0x1 0x12 0xf 0xc 0xc 0xc>,
                /* default values for ReTune Mobile registers 140-157 */
                /bits/ 16 <0x0fca 0x0400 0x00d8 0x1eb5 0xf145 0x0bd5 0x0075 0x1c58 0xf3d3 0x0a54 0x0568 0x168e 0xf829 0x07ad 0x1103 0x0564 0x0559 0x4000>,

                /* treble: EQ_ENA = 1, -2 dB @ 100, 300 Hz, 0 dB @ 875, 2400 Hz, +3 dB @ 6900 Hz */
                /bits/ 16 <0x1 0xa 0xa 0xc 0xc 0xf>,
                /* default values for ReTune Mobile registers 140-157 */
                /bits/ 16 <0x0fca 0x0400 0x00d8 0x1eb5 0xf145 0x0bd5 0x0075 0x1c58 0xf3d3 0x0a54 0x0568 0x168e 0xf829 0x07ad 0x1103 0x0564 0x0559 0x4000>;
            >;
        };
    };
```

## Documentation/devicetree/bindings/sound/xlnx,audio-formatter.yaml
```yaml
# SPDX-License-Identifier: (GPL-2.0-only OR BSD-2-Clause)
%YAML 1.2
---
$id: http://devicetree.org/schemas/sound/xlnx,audio-formatter.yaml#
$schema: http://devicetree.org/meta-schemas/core.yaml#

title: Xilinx PL audio formatter

description: |
  The IP core supports DMA, data formatting(AES<->PCM conversion)
  of audio samples.

maintainers:
  - Vincenzo Frascino <vincenzo.frascino@arm.com>

allOf:
  - $ref: dai-common.yaml#

properties:
  compatible:
    enum:
      - xlnx,audio-formatter-1.0

  reg:
    minItems: 1
    maxItems: 4
    description: |
      Base address and size of the IP core instance.

  interrupt-names:
    minItems: 1
    maxItems: 3
    description: |
      Names specified to list of interrupts in same order mentioned under
      "interrupts".

  interrupts:
    minItems: 1
    maxItems: 3
    description: |
      List of Interrupt numbers.

  clock-names:
    minItems: 2
    maxItems: 3
    description: |
      List of input clocks.

  clocks:
    minItems: 2
    maxItems: 3
    description: |
      Input clock specifier. Refer to common clock bindings.

required:
  - compatible
  - reg
  - interrupt-names
  - interrupts
  - clock-names
  - clocks

additionalProperties: true

examples:
  - |
    audio_ss_0_audio_formatter_0: audio_formatter@80010000 {
      compatible = "xlnx,audio-formatter-1.0";
      interrupt-names = "irq_mm2s", "irq_s2mm";
      interrupt-parent = <&gic>;
      interrupts = <0 104 4>, <0 105 4>;
      reg = <0x0 0x80010000 0x0 0x1000>;
      clock-names = "s_axi_lite_aclk", "aud_mclk";
      clocks = <&clk 71>, <&clk_wiz_1 0>;
    };
...
```

## Documentation/devicetree/bindings/sound/xlnx,i2s.yaml
```yaml
# SPDX-License-Identifier: (GPL-2.0-only OR BSD-2-Clause)
%YAML 1.2
---
$id: http://devicetree.org/schemas/sound/xlnx,i2s.yaml#
$schema: http://devicetree.org/meta-schemas/core.yaml#

title: Xilinx I2S PL block

description: |
  The IP supports I2S based playback/capture audio.

maintainers:
  - Vincenzo Frascino <vincenzo.frascino@arm.com>

allOf:
  - $ref: dai-common.yaml#

properties:
  compatible:
    enum:
      - xlnx,i2s-receiver-1.0
      - xlnx,i2s-transmitter-1.0

  reg:
    minItems: 1
    maxItems: 4
    description: |
      Base address and size of the IP core instance.

  xlnx,dwidth:
    $ref: /schemas/types.yaml#/definitions/uint32
    enum:
      - 16
      - 24
    description: |
      Sample data width. Can be any of 16, 24.

  xlnx,num-channels:
    $ref: /schemas/types.yaml#/definitions/uint32
    minimum: 1
    maximum: 4
    description: |
      Number of I2S streams.

required:
  - compatible
  - reg
  - xlnx,dwidth
  - xlnx,num-channels

additionalProperties: true

examples:
  - |
    i2s_receiver@a0080000 {
      compatible = "xlnx,i2s-receiver-1.0";
      reg = <0x0 0xa0080000 0x0 0x10000>;
      xlnx,dwidth = <0x18>;
      xlnx,num-channels = <1>;
    };
    i2s_transmitter@a0090000 {
      compatible = "xlnx,i2s-transmitter-1.0";
      reg = <0x0 0xa0090000 0x0 0x10000>;
      xlnx,dwidth = <0x18>;
      xlnx,num-channels = <1>;
    };

...
```

## Documentation/devicetree/bindings/sound/xlnx,spdif.yaml
```yaml
# SPDX-License-Identifier: (GPL-2.0-only OR BSD-2-Clause)
%YAML 1.2
---
$id: http://devicetree.org/schemas/sound/xlnx,spdif.yaml#
$schema: http://devicetree.org/meta-schemas/core.yaml#

title: Xilinx SPDIF IP

description:
  The IP supports playback and capture of SPDIF audio.

maintainers:
  - Vincenzo Frascino <vincenzo.frascino@arm.com>

allOf:
  - $ref: dai-common.yaml#

properties:
  compatible:
    enum:
      - xlnx,spdif-2.0

  reg:
    maxItems: 1

  interrupt-names:
    items:
      - const: spdif_interrupt

  interrupts:
    maxItems: 1
    description: |
      List of Interrupt numbers.

  clock-names:
    items:
      - const: aud_clk_i
      - const: s_axi_aclk
    description: |
      List of input clocks.

  clocks:
    maxItems: 2
    description: |
      Input clock specifier. Refer to common clock bindings.

  xlnx,spdif-mode:
    $ref: /schemas/types.yaml#/definitions/uint32
    enum:
      - 0
      - 1
    description: |
      0 - receiver
      1 - transmitter

  xlnx,aud_clk_i:
    $ref: /schemas/types.yaml#/definitions/uint32
    description: |
      Input audio clock value.

required:
  - compatible
  - reg
  - interrupt-names
  - interrupts
  - clock-names
  - clocks

additionalProperties: false

examples:
  - |
    spdif_0: spdif@80010000 {
      clock-names = "aud_clk_i", "s_axi_aclk";
      clocks = <&misc_clk_0>, <&clk 71>;
      compatible = "xlnx,spdif-2.0";
      interrupt-names = "spdif_interrupt";
      interrupt-parent = <&gic>;
      interrupts = <0 91 4>;
      reg = <0x80010000 0x10000>;
      xlnx,spdif-mode = <1>;
      xlnx,aud_clk_i = <49152913>;
    };

...
```

## Documentation/devicetree/bindings/sound/xmos,xvf3500.yaml
```yaml
# SPDX-License-Identifier: (GPL-2.0 OR BSD-2-Clause)
%YAML 1.2
---
$id: http://devicetree.org/schemas/sound/xmos,xvf3500.yaml#
$schema: http://devicetree.org/meta-schemas/core.yaml#

title: XMOS XVF3500 VocalFusion Voice Processor

maintainers:
  - Javier Carrasco <javier.carrasco@wolfvision.net>

description:
  The XMOS XVF3500 VocalFusion Voice Processor is a low-latency, 32-bit
  multicore controller for voice processing.
  https://www.xmos.com/xvf3500/

properties:
  compatible:
    const: usb20b1,0013

  reset-gpios:
    maxItems: 1

  vdd-supply:
    description:
      Regulator for the 1V0 supply.

  vdd2-supply:
    description:
      Regulator for the 3V3 supply.

required:
  - compatible
  - reset-gpios
  - vdd-supply
  - vdd2-supply

additionalProperties: false

examples:
  - |
    #include <dt-bindings/gpio/gpio.h>

    xvf3500 {
      compatible = "usb20b1,0013";
      reset-gpios = <&gpio 5 GPIO_ACTIVE_LOW>;
      vdd-supply = <&vcc1v0>;
      vdd2-supply = <&vcc3v3>;
    };

...
```

## Documentation/devicetree/bindings/spi/amlogic,a4-spisg.yaml
```yaml
# SPDX-License-Identifier: (GPL-2.0-only OR BSD-2-Clause)
# Copyright (C) 2025 Amlogic, Inc. All rights reserved
%YAML 1.2
---
$id: http://devicetree.org/schemas/spi/amlogic,a4-spisg.yaml#
$schema: http://devicetree.org/meta-schemas/core.yaml#

title: Amlogic SPI Scatter-Gather Controller

maintainers:
  - Xianwei Zhao <xianwei.zhao@amlogic.com>
  - Sunny Luo <sunny.luo@amlogic.com>

allOf:
  - $ref: spi-controller.yaml#

properties:
  compatible:
    const: amlogic,a4-spisg

  reg:
    maxItems: 1

  interrupts:
    maxItems: 1

  clocks:
    minItems: 2

  clock-names:
    items:
      - const: core
      - const: pclk

required:
  - compatible
  - reg
  - interrupts
  - clocks
  - clock-names

unevaluatedProperties: false

examples:
  - |
    spi@50000 {
        compatible = "amlogic,a4-spisg";
        reg = <0x50000 0x38>;
        interrupts = <0 183 4>;
        clocks = <&clkc 37>,
                 <&clkc 93>;
        clock-names = "core", "pclk";
        #address-cells = <1>;
        #size-cells = <0>;
    };
```
