## Documentation/devicetree/bindings/sound/qcom,wsa881x.yaml
```yaml
# SPDX-License-Identifier: (GPL-2.0-only OR BSD-2-Clause)
%YAML 1.2
---
$id: http://devicetree.org/schemas/sound/qcom,wsa881x.yaml#
$schema: http://devicetree.org/meta-schemas/core.yaml#

title: Qualcomm WSA8810/WSA8815 Class-D Smart Speaker Amplifier

maintainers:
  - Srinivas Kandagatla <srinivas.kandagatla@linaro.org>

description: |
  WSA8810 is a class-D smart speaker amplifier and WSA8815
  is a high-output power class-D smart speaker amplifier.
  This family of amplifiers support two operating modes:
  SoundWire digital audio interface which is a primary mode
  and analog mode when device is configured via i2c only.
  This binding describes both modes.

properties:
  compatible:
    enum:
      - qcom,wsa8810
      - qcom,wsa8815
      - sdw10217201000

  reg:
    maxItems: 1

  powerdown-gpios:
    description: GPIO spec for Powerdown/Shutdown line to use
    maxItems: 1

  '#thermal-sensor-cells':
    const: 0

  '#sound-dai-cells':
    const: 0

  clocks:
    maxItems: 1

  mclk-gpios:
    description: GPIO spec for control signal to the clock gating circuit
    maxItems: 1

required:
  - compatible
  - reg
  - powerdown-gpios
  - '#thermal-sensor-cells'
  - '#sound-dai-cells'

allOf:
  - $ref: dai-common.yaml#
  - if:
      properties:
        compatible:
          contains:
            enum:
              - qcom,wsa8810
              - qcom,wsa8815
    then:
      properties:
        reg:
          description:
            In case of analog mode this should be I2C address of the digital
            part of the device. The I2C address of analog part of an amplifier
            is expected to be located at the fixed offset.
          maxItems: 1
          items:
            minimum: 0x0e
            maximum: 0x0f
      required:
        - clocks
        - mclk-gpios

unevaluatedProperties: false

examples:
  - |
    #include <dt-bindings/gpio/gpio.h>
    #include <dt-bindings/sound/qcom,q6afe.h>

    soundwire@c2d0000 {
        #address-cells = <2>;
        #size-cells = <0>;
        reg = <0x0c2d0000 0x2000>;

        speaker@0,1 {
            compatible = "sdw10217201000";
            reg = <0 1>;
            powerdown-gpios = <&wcdpinctrl 2 0>;
            #thermal-sensor-cells = <0>;
            #sound-dai-cells = <0>;
        };

        speaker@0,2 {
            compatible = "sdw10217201000";
            reg = <0 2>;
            powerdown-gpios = <&wcdpinctrl 2 0>;
            #thermal-sensor-cells = <0>;
            #sound-dai-cells = <0>;
        };
    };

    i2c {
        #address-cells = <1>;
        #size-cells = <0>;

        amplifier@e {
            compatible = "qcom,wsa8810";
            reg = <0x0e>;
            clocks = <&q6afecc LPASS_CLK_ID_MCLK_3 LPASS_CLK_ATTRIBUTE_COUPLE_NO>;
            powerdown-gpios = <&lpass_tlmm 16 GPIO_ACTIVE_LOW>;
            mclk-gpios = <&lpass_tlmm 18 GPIO_ACTIVE_HIGH>;
            #sound-dai-cells = <0>;
            #thermal-sensor-cells = <0>;
       };
    };
...
```

## Documentation/devicetree/bindings/sound/realtek,alc5623.yaml
```yaml
# SPDX-License-Identifier: (GPL-2.0-only OR BSD-2-Clause)
%YAML 1.2
---
$id: http://devicetree.org/schemas/sound/realtek,alc5623.yaml#
$schema: http://devicetree.org/meta-schemas/core.yaml#

title: ALC5621/ALC5622/ALC5623 audio Codec

maintainers:
  - Aryabhatta Dey <aryabhattadey35@gmail.com>

properties:
  compatible:
    const: realtek,alc5623

  reg:
    maxItems: 1

  add-ctrl:
    description:
      Default register value for Reg-40h, Additional Control Register. If absent
      or has the value of 0, the register is untouched.
    type: object

  jack-det-ctrl:
    description:
      Default register value for Reg-5Ah, Jack Detect Control Register. If absent
      or has value 0, the register is untouched.
    type: object

required:
  - compatible
  - reg

additionalProperties: false

examples:
  - |
    i2c {
        #address-cells = <1>;
        #size-cells = <0>;
        codec@1a {
            compatible = "realtek,alc5632";
            reg = <0x1a>;
            add-ctrl = <0x3700>;
            jack-det-ctrl = <0x4810>;
        };
    };
```

## Documentation/devicetree/bindings/sound/realtek,rt5575.yaml
```yaml
# SPDX-License-Identifier: GPL-2.0-only OR BSD-2-Clause
%YAML 1.2
---
$id: http://devicetree.org/schemas/sound/realtek,rt5575.yaml#
$schema: http://devicetree.org/meta-schemas/core.yaml#

title: ALC5575 audio CODEC

maintainers:
  - Oder Chiou <oder_chiou@realtek.com>

description: |
  The device supports both I2C and SPI. I2C is mandatory, while SPI is optional depending on the
  hardware configuration.

allOf:
  - $ref: /schemas/spi/spi-peripheral-props.yaml#
  - $ref: dai-common.yaml#

properties:
  compatible:
    const: realtek,rt5575

  reg:
    maxItems: 1

required:
  - compatible
  - reg

unevaluatedProperties: false

examples:
  - |
    i2c {
        #address-cells = <1>;
        #size-cells = <0>;
        codec@57 {
            compatible = "realtek,rt5575";
            reg = <0x57>;
        };
    };
```

## Documentation/devicetree/bindings/sound/renesas,fsi.yaml
```yaml
# SPDX-License-Identifier: GPL-2.0
%YAML 1.2
---
$id: http://devicetree.org/schemas/sound/renesas,fsi.yaml#
$schema: http://devicetree.org/meta-schemas/core.yaml#

title: Renesas FIFO-buffered Serial Interface (FSI)

maintainers:
  - Kuninori Morimoto <kuninori.morimoto.gx@renesas.com>

properties:
  $nodename:
    pattern: "^sound@.*"

  compatible:
    oneOf:
      # for FSI2 SoC
      - items:
          - enum:
              - renesas,fsi2-sh73a0  # SH-Mobile AG5
              - renesas,fsi2-r8a7740 # R-Mobile A1
          - enum:
              - renesas,sh_fsi2
      # for Generic
      - items:
          - enum:
              - renesas,sh_fsi
              - renesas,sh_fsi2

  reg:
    maxItems: 1

  interrupts:
    maxItems: 1

  clocks:
    description: |
      Clock driving the FSI Controller. The first clock must be
      the module clock ("own").
    minItems: 1
    maxItems: 8

  clock-names:
    description: |
      Names of clocks corresponding to entries in "clocks":
      - "own": Main FSI module clock (must be first and always present)
      - "spu": SPU bus/bridge clock. On R8A7740, this clock must be
        enabled to allow register access as the FSI block is connected
        behind the SPU bus.
      - "icka" / "ickb": CPG DIV6 functional clocks for FSI port A/B
      - "diva"/"divb": Internal FSI dividers for port A/B used for
        audio clock generation
      - "xcka"/"xckb": External clock inputs for FSI port A/B
        provided by the board
    minItems: 1
    items:
      - const: own
      - &fsi_all_clks
        enum: [spu, icka, ickb, diva, divb, xcka, xckb]
      - &fsi_no_spu_clks
        enum: [icka, ickb, diva, divb, xcka, xckb]
      - *fsi_no_spu_clks
      - *fsi_no_spu_clks
      - *fsi_no_spu_clks
      - *fsi_no_spu_clks
      - *fsi_no_spu_clks

  power-domains:
    maxItems: 1

  '#sound-dai-cells':
    const: 1

patternProperties:
  "^fsi(a|b),spdif-connection$":
    $ref: /schemas/types.yaml#/definitions/flag
    description: FSI is connected by S/PDIF

  "^fsi(a|b),stream-mode-support$":
    $ref: /schemas/types.yaml#/definitions/flag
    description: FSI supports 16bit stream mode

  "^fsi(a|b),use-internal-clock$":
    $ref: /schemas/types.yaml#/definitions/flag
    description: FSI uses internal clock when master mode

required:
  - compatible
  - reg
  - interrupts
  - clocks
  - power-domains
  - '#sound-dai-cells'

unevaluatedProperties: false

allOf:
  - $ref: dai-common.yaml#
  - if:
      properties:
        compatible:
          contains:
            const: renesas,fsi2-r8a7740
    then:
      properties:
        clock-names:
          minItems: 2
          items:
            - const: own
            - const: spu
            - *fsi_no_spu_clks
            - *fsi_no_spu_clks
            - *fsi_no_spu_clks
            - *fsi_no_spu_clks
            - *fsi_no_spu_clks
            - *fsi_no_spu_clks

examples:
  - |
    #include <dt-bindings/clock/r8a7740-clock.h>
    #include <dt-bindings/interrupt-controller/arm-gic.h>
    sh_fsi2: sound@fe1f0000 {
            compatible = "renesas,fsi2-r8a7740", "renesas,sh_fsi2";
            reg = <0xfe1f0000 0x400>;
            interrupts = <GIC_SPI 9 0x4>;
            clocks = <&mstp3_clks R8A7740_CLK_FSI>, <&spu_clk>,
                     <&fsia_clk>, <&fsib_clk>, <&fsidiva_clk>,
                     <&fsidivb_clk>,<&fsiack_clk>,<&fsibck_clk>;
            clock-names = "own", "spu", "icka", "ickb",
                          "diva", "divb", "xcka", "xckb";
            power-domains = <&pd_a4mp>;

            #sound-dai-cells = <1>;
            fsia,spdif-connection;
            fsia,stream-mode-support;
            fsia,use-internal-clock;
    };
```
