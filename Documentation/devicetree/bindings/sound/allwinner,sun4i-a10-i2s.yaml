## Documentation/devicetree/bindings/thermal/allwinner,sun8i-a83t-ths.yaml
```yaml
# SPDX-License-Identifier: GPL-2.0
%YAML 1.2
---
$id: http://devicetree.org/schemas/thermal/allwinner,sun8i-a83t-ths.yaml#
$schema: http://devicetree.org/meta-schemas/core.yaml#

title: Allwinner SUN8I Thermal Controller

maintainers:
  - Vasily Khoruzhick <anarsoul@gmail.com>
  - Yangtao Li <tiny.windzz@gmail.com>

$ref: thermal-sensor.yaml#

properties:
  compatible:
    enum:
      - allwinner,sun8i-a83t-ths
      - allwinner,sun8i-h3-ths
      - allwinner,sun8i-r40-ths
      - allwinner,sun20i-d1-ths
      - allwinner,sun50i-a64-ths
      - allwinner,sun50i-a100-ths
      - allwinner,sun50i-h5-ths
      - allwinner,sun50i-h6-ths
      - allwinner,sun50i-h616-ths
      - allwinner,sun55i-a523-ths0
      - allwinner,sun55i-a523-ths1

  clocks:
    minItems: 1
    items:
      - description: Bus Clock
      - description: Module Clock
      - description: GPADC Clock

  clock-names:
    minItems: 1
    maxItems: 2
    items:
      - const: bus
      - const: mod
      - const: gpadc

  reg:
    maxItems: 1

  interrupts:
    maxItems: 1

  resets:
    maxItems: 1

  nvmem-cells:
    minItems: 1
    items:
      - description: Calibration data for thermal sensors
      - description: Additional cell in case of separate calibration data

  nvmem-cell-names:
    minItems: 1
    items:
      - const: calibration
      - const: calibration-second-part

  allwinner,sram:
    maxItems: 1
    description: phandle to device controlling temperate offset SYS_CFG register

  "#thermal-sensor-cells":
    enum:
      - 0
      - 1

allOf:
  - if:
      properties:
        compatible:
          contains:
            enum:
              - allwinner,sun20i-d1-ths
              - allwinner,sun50i-a100-ths
              - allwinner,sun50i-h6-ths
              - allwinner,sun50i-h616-ths

    then:
      properties:
        clocks:
          maxItems: 1

        clock-names:
          maxItems: 1

    else:
      properties:
        clocks:
          minItems: 2

        clock-names:
          minItems: 2

  - if:
      not:
        properties:
          compatible:
            contains:
              const: allwinner,sun50i-h616-ths

    then:
      properties:
        allwinner,sram: false

  - if:
      properties:
        compatible:
          contains:
            enum:
              - allwinner,sun8i-h3-ths
              - allwinner,sun20i-d1-ths
              - allwinner,sun55i-a523-ths0

    then:
      properties:
        "#thermal-sensor-cells":
          const: 0

    else:
      properties:
        "#thermal-sensor-cells":
          const: 1

  - if:
      not:
        properties:
          compatible:
            contains:
              enum:
                - allwinner,sun8i-a83t-ths

    then:
      required:
        - clocks
        - clock-names
        - resets

  - if:
      properties:
        compatible:
          contains:
            enum:
              - allwinner,sun55i-a523-ths0
              - allwinner,sun55i-a523-ths1
    then:
      properties:
        clocks:
          minItems: 2
        clock-names:
          enum: [ bus, gpadc ]
        nvmem-cells:
          minItems: 2
        nvmem-cell-names:
          minItems: 2
    else:
      properties:
        nvmem-cells:
          maxItems: 1
        nvmem-cell-names:
          maxItems: 1
          items:
            - const: calibration

required:
  - compatible
  - reg
  - interrupts

unevaluatedProperties: false

examples:
  - |
    thermal-sensor@1f04000 {
        compatible = "allwinner,sun8i-a83t-ths";
        reg = <0x01f04000 0x100>;
        interrupts = <0 31 0>;
        nvmem-cells = <&ths_calibration>;
        nvmem-cell-names = "calibration";
        #thermal-sensor-cells = <1>;
    };

  - |
    thermal-sensor@1c25000 {
        compatible = "allwinner,sun8i-h3-ths";
        reg = <0x01c25000 0x400>;
        clocks = <&ccu 0>, <&ccu 1>;
        clock-names = "bus", "mod";
        resets = <&ccu 2>;
        interrupts = <0 31 0>;
        nvmem-cells = <&ths_calibration>;
        nvmem-cell-names = "calibration";
        #thermal-sensor-cells = <0>;
    };

  - |
    thermal-sensor@5070400 {
        compatible = "allwinner,sun50i-h6-ths";
        reg = <0x05070400 0x100>;
        clocks = <&ccu 0>;
        clock-names = "bus";
        resets = <&ccu 2>;
        interrupts = <0 15 0>;
        nvmem-cells = <&ths_calibration>;
        nvmem-cell-names = "calibration";
        #thermal-sensor-cells = <1>;
    };

  - |
    thermal-sensor@2009400 {
      compatible = "allwinner,sun55i-a523-ths1";
      reg = <0x02009400 0x400>;
      interrupts = <GIC_SPI 62 IRQ_TYPE_LEVEL_HIGH>;
      clocks = <&ccu CLK_BUS_THS>, <&ccu CLK_GPADC1>;
      clock-names = "bus", "gpadc";
      resets = <&ccu RST_BUS_THS>;
      nvmem-cells = <&ths_calibration0>, <&ths_calibration1>;
      nvmem-cell-names = "calibration",
             "calibration-second-part";
      #thermal-sensor-cells = <1>;
    };
...
```

## Documentation/devicetree/bindings/timer/mti,gcru.yaml
```yaml
# SPDX-License-Identifier: (GPL-2.0-only OR BSD-2-Clause)
%YAML 1.2
---
$id: http://devicetree.org/schemas/timer/mti,gcru.yaml#
$schema: http://devicetree.org/meta-schemas/core.yaml#

title: GCR.U timer device for RISC-V platforms

maintainers:
  - Aleksa Paunovic <aleksa.paunovic@htecgroup.com>

description:
  The GCR.U memory region contains memory mapped shadow copies of
  mtime and hrtime Global Configuration Registers,
  which software can choose to make accessible from user mode.

properties:
  compatible:
    const: mti,gcru

  reg:
    items:
      - description: Read-only shadow copy of the RISC-V mtime register.
      - description: Read-only shadow copy of the high resolution timer register.

required:
  - compatible
  - reg

additionalProperties: false

examples:
  - |
    timer@1617f000 {
        compatible = "mti,gcru";
        reg = <0x1617f050 0x8>,
              <0x1617f090 0x8>;
    };
```

## Documentation/devicetree/bindings/usb/google,cros-ec-typec.yaml
```yaml
# SPDX-License-Identifier: (GPL-2.0-only OR BSD-2-Clause)
%YAML 1.2
---
$id: http://devicetree.org/schemas/usb/google,cros-ec-typec.yaml#
$schema: http://devicetree.org/meta-schemas/core.yaml#

title: Google ChromeOS EC (Embedded Controller) USB Type-C Port Manager

maintainers:
  - Benson Leung <bleung@chromium.org>
  - Prashant Malani <pmalani@chromium.org>

description:
  Chrome OS devices have an Embedded Controller (EC) which has access to
  USB Type-C port state. This node is intended to allow the host to read and
  control the Type-C ports. The node for this device should be under a
  cros-ec node with a compatible like "google,cros-ec-spi".

properties:
  compatible:
    const: google,cros-ec-typec

  '#address-cells':
    const: 1

  '#size-cells':
    const: 0

  mux-gpios:
    description: GPIOs indicating which way the DisplayPort mux is steered
    minItems: 1
    maxItems: 3

  no-hpd:
    description: Indicates this device doesn't signal HPD for DisplayPort
    type: boolean

  ports:
    $ref: /schemas/graph.yaml#/properties/ports

    properties:
      port@0:
        $ref: /schemas/graph.yaml#/properties/port
        description:
          Port for DisplayPort (DP) data

        properties:
          endpoint@0:
            $ref: /schemas/graph.yaml#/properties/endpoint
            description: Input DP port

        patternProperties:
          '^endpoint@[1-8]$':
            $ref: /schemas/graph.yaml#/properties/endpoint
            description: Output to the usb-c connector's DP altmode

        required:
          - endpoint@0

        anyOf:
          - required:
              - endpoint@1
          - required:
              - endpoint@2
          - required:
              - endpoint@3
          - required:
              - endpoint@4
          - required:
              - endpoint@5
          - required:
              - endpoint@6
          - required:
              - endpoint@7
          - required:
              - endpoint@8

patternProperties:
  '^connector@[0-9a-f]+$':
    $ref: /schemas/connector/usb-connector.yaml#
    required:
      - reg

required:
  - compatible

allOf:
  - if:
      required:
        - no-hpd
    then:
      properties:
        ports:
          required:
            - port@0
  - if:
      required:
        - mux-gpios
    then:
      properties:
        ports:
          required:
            - port@0

additionalProperties: false

examples:
  - |+
    #include <dt-bindings/gpio/gpio.h>

    spi {
      #address-cells = <1>;
      #size-cells = <0>;

      cros_ec: ec@0 {
        compatible = "google,cros-ec-spi";
        reg = <0>;
        interrupts = <35 0>;
        #gpio-cells = <2>;
        gpio-controller;

        typec {
          compatible = "google,cros-ec-typec";

          #address-cells = <1>;
          #size-cells = <0>;

          mux-gpios = <&cros_ec 42 GPIO_ACTIVE_HIGH>, <&cros_ec 3 GPIO_ACTIVE_HIGH>;

          connector@0 {
            compatible = "usb-c-connector";
            reg = <0>;
            power-role = "dual";
            data-role = "dual";
            try-power-role = "source";

            altmodes {
              displayport {
                port {
                  usbc0_dp: endpoint {
                    remote-endpoint = <&dp_out0>;
                  };
                };
              };
            };

            ports {
              #address-cells = <1>;
              #size-cells = <0>;

              port@0 {
                reg = <0>;
                usb_c0_hs: endpoint {
                  remote-endpoint = <&usb_hub_dfp3_hs>;
                };
              };

              port@1 {
                reg = <1>;
                usb_c0_ss: endpoint {
                  remote-endpoint = <&usb_hub_dfp3_ss>;
                };
              };
            };
          };

          connector@1 {
            compatible = "usb-c-connector";
            reg = <1>;
            power-role = "dual";
            data-role = "dual";
            try-power-role = "source";

            altmodes {
              displayport {
                port {
                  usbc1_dp: endpoint {
                    remote-endpoint = <&dp_out1>;
                  };
                };
              };
            };

            ports {
              #address-cells = <1>;
              #size-cells = <0>;

              port@0 {
                reg = <0>;
                usb_c1_hs: endpoint {
                  remote-endpoint = <&usb_hub_dfp2_hs>;
                };
              };

              port@1 {
                reg = <1>;
                usb_c1_ss: endpoint {
                  remote-endpoint = <&usb_hub_dfp2_ss>;
                };
              };
            };
          };

          ports {
            #address-cells = <1>;
            #size-cells = <0>;

            port@0 {
              reg = <0>;
              #address-cells = <1>;
              #size-cells = <0>;

              dp_in: endpoint@0 {
                reg = <0>;
                remote-endpoint = <&dp_phy>;
              };

              dp_out0: endpoint@1 {
                reg = <1>;
                remote-endpoint = <&usbc0_dp>;
              };

              dp_out1: endpoint@2 {
                reg = <2>;
                remote-endpoint = <&usbc1_dp>;
              };
            };
          };
        };
      };
    };
```

## Documentation/devicetree/bindings/usb/google,usb-pogo-keyboard.yaml
```yaml
# SPDX-License-Identifier: (GPL-2.0-only OR BSD-2-Clause)
%YAML 1.2
---
$id: http://devicetree.org/schemas/usb/google,usb-pogo-keyboard.yaml#
$schema: http://devicetree.org/meta-schemas/core.yaml#

title: Google USB Pogo Pin Keyboard

maintainers:
  - Stephen Boyd <swboyd@chromium.org>

description:
  ChromeOS devices with a detachable keyboard have a set of five pogo pins that
  are the typical four pins for USB (D+/D-, VBUS, GND) and an extra pin for
  base detection. The detachable keyboard is a USB device that connects to the
  four USB pogo pins.

properties:
  compatible:
    const: google,usb-pogo-keyboard

  '#address-cells':
    const: 1

  '#size-cells':
    const: 0

  port:
    $ref: /schemas/graph.yaml#/properties/port
    description: Connection to USB2 port providing USB HS signals
    required:
      - endpoint

patternProperties:
  "^keyboard@[0-9a-f]{1,2}$":
    description: The detachable keyboard
    type: object
    $ref: /schemas/usb/usb-device.yaml
    unevaluatedProperties: false

required:
  - compatible
  - '#address-cells'
  - '#size-cells'
  - port

additionalProperties: false

examples:
  - |
    connector {
      compatible = "google,usb-pogo-keyboard";
      #address-cells = <1>;
      #size-cells = <0>;

      keyboard@2 {
        compatible = "usb18d1,504c";
        reg = <2>;
      };

      port {
        pogo_connector_in: endpoint {
          remote-endpoint = <&usb_hub_dsp3_hs>;
        };
      };
    };

...
```

## Documentation/devicetree/bindings/usb/usb-switch.yaml
```yaml
# SPDX-License-Identifier: (GPL-2.0-only OR BSD-2-Clause)
%YAML 1.2
---
$id: http://devicetree.org/schemas/usb/usb-switch.yaml#
$schema: http://devicetree.org/meta-schemas/core.yaml#

title: USB Orientation and Mode Switches Common Properties

maintainers:
  - Greg Kroah-Hartman <gregkh@linuxfoundation.org>

description:
  Common properties for devices handling USB mode and orientation switching.

properties:
  mode-switch:
    description: Possible handler of altmode switching
    type: boolean

  orientation-switch:
    description: Possible handler of orientation switching
    type: boolean

  retimer-switch:
    description: Possible handler of SuperSpeed signals retiming
    type: boolean

  port:
    $ref: /schemas/graph.yaml#/properties/port
    description:
      A port node to link the device to a TypeC controller for the purpose of
      handling altmode muxing and orientation switching.

  ports:
    $ref: /schemas/graph.yaml#/properties/ports
    properties:
      port@0:
        $ref: /schemas/graph.yaml#/$defs/port-base
        unevaluatedProperties: false

        properties:
          endpoint:
            $ref: '#/$defs/usbc-out-endpoint'

      port@1:
        $ref: /schemas/graph.yaml#/$defs/port-base
        description:
          Super Speed (SS) Input endpoint from the Super-Speed PHY
        unevaluatedProperties: false

        properties:
          endpoint:
            $ref: '#/$defs/usbc-in-endpoint'

oneOf:
  - required:
      - port
  - required:
      - ports

additionalProperties: true

$defs:
  usbc-out-endpoint:
    $ref: /schemas/graph.yaml#/$defs/endpoint-base
    description: Super Speed (SS) output endpoint to a type-c connector
    unevaluatedProperties: false

  usbc-in-endpoint:
    $ref: /schemas/graph.yaml#/$defs/endpoint-base
    description: Super Speed (SS) input endpoint from the Super Speed PHY
    unevaluatedProperties: false
    properties:
      data-lanes:
        $ref: /schemas/types.yaml#/definitions/uint32-array
        minItems: 1
        maxItems: 8
        uniqueItems: true
        items:
          maximum: 8

examples:
  # A USB orientation switch which flips the pin orientation
  # for a usb-c-connector node.
  - |
    device {
      orientation-switch;

      ports {
        #address-cells = <1>;
        #size-cells = <0>;

        port@0 {
          reg = <0>;
          #address-cells = <1>;
          #size-cells = <0>;

          endpoint {
            remote-endpoint = <&usb_c_connector>;
          };
        };

        port@1 {
          reg = <1>;
          #address-cells = <1>;
          #size-cells = <0>;

          endpoint {
            remote-endpoint = <&usb_ss_phy>;
          };
        };
      };
    };

...
```
