## Documentation/devicetree/bindings/sound/allwinner,sun4i-a10-i2s.yaml
```yaml
# SPDX-License-Identifier: (GPL-2.0+ OR BSD-2-Clause)
%YAML 1.2
---
$id: http://devicetree.org/schemas/sound/allwinner,sun4i-a10-i2s.yaml#
$schema: http://devicetree.org/meta-schemas/core.yaml#

title: Allwinner A10 I2S Controller

maintainers:
  - Chen-Yu Tsai <wens@csie.org>
  - Maxime Ripard <mripard@kernel.org>

properties:
  "#sound-dai-cells":
    const: 0

  compatible:
    oneOf:
      - const: allwinner,sun4i-a10-i2s
      - const: allwinner,sun6i-a31-i2s
      - const: allwinner,sun8i-a83t-i2s
      - const: allwinner,sun8i-h3-i2s
      - items:
          - const: allwinner,sun8i-r40-i2s
          - const: allwinner,sun8i-h3-i2s
      - items:
          - const: allwinner,sun8i-v3-i2s
          - const: allwinner,sun8i-h3-i2s
      - const: allwinner,sun50i-a64-codec-i2s
      - items:
          - const: allwinner,sun50i-a64-i2s
          - const: allwinner,sun8i-h3-i2s
      - const: allwinner,sun50i-h6-i2s
      - const: allwinner,sun50i-r329-i2s
      - items:
          - const: allwinner,sun20i-d1-i2s
          - const: allwinner,sun50i-r329-i2s

  reg:
    maxItems: 1

  interrupts:
    maxItems: 1

  clocks:
    items:
      - description: Bus Clock
      - description: Module Clock

  clock-names:
    items:
      - const: apb
      - const: mod

  channel-dins:
    $ref: /schemas/types.yaml#/definitions/uint8-array
    description:
      This is a list of DIN pin numbers, each used for a receiving I2S
      channel. Pins are mapped to channels based on array index.
      Channel 0 is the first number, then channel 1, and so on.

  channel-slots:
    $ref: /schemas/types.yaml#/definitions/uint8-array
    description:
      This is a list of channel I2S TDM slot numbers. Slots are mapped
      to channels based on array index.
      Channel 0 is the first number, then channel 1, and so on.

  # Even though it only applies to subschemas under the conditionals,
  # not listing them here will trigger a warning because of the
  # additionalsProperties set to false.
  dmas: true
  dma-names: true
  resets:
    maxItems: 1

allOf:
  - $ref: dai-common.yaml#
  - if:
      properties:
        compatible:
          contains:
            enum:
              - allwinner,sun6i-a31-i2s
              - allwinner,sun8i-a83t-i2s
              - allwinner,sun8i-h3-i2s
              - allwinner,sun50i-a64-codec-i2s
              - allwinner,sun50i-h6-i2s
              - allwinner,sun50i-r329-i2s

    then:
      required:
        - resets

  - if:
      properties:
        compatible:
          contains:
            enum:
              - allwinner,sun8i-a83t-i2s
              - allwinner,sun8i-h3-i2s

    then:
      properties:
        dmas:
          minItems: 1
          items:
            - description: RX DMA Channel
            - description: TX DMA Channel
          description:
            Some controllers cannot receive but can only transmit
            data. In such a case, the RX DMA channel is to be omitted.

        dma-names:
          oneOf:
            - items:
                - const: rx
                - const: tx
            - const: tx
          description:
            Some controllers cannot receive but can only transmit
            data. In such a case, the RX name is to be omitted.

    else:
      properties:
        dmas:
          items:
            - description: RX DMA Channel
            - description: TX DMA Channel

        dma-names:
          items:
            - const: rx
            - const: tx

required:
  - "#sound-dai-cells"
  - compatible
  - reg
  - interrupts
  - clocks
  - clock-names
  - dmas
  - dma-names

unevaluatedProperties: false

examples:
  - |
    i2s0: i2s@1c22400 {
        #sound-dai-cells = <0>;
        compatible = "allwinner,sun4i-a10-i2s";
        reg = <0x01c22400 0x400>;
        interrupts = <0 16 4>;
        clocks = <&apb0_gates 3>, <&i2s0_clk>;
        clock-names = "apb", "mod";
        dmas = <&dma 0 3>, <&dma 0 3>;
        dma-names = "rx", "tx";
    };

  - |
    i2s0_d1: i2s@2032000 {
            #sound-dai-cells = <0>;
            compatible = "allwinner,sun20i-d1-i2s",
                         "allwinner,sun50i-r329-i2s";
            reg = <0x2032000 0x1000>;
            interrupts = <0 26 0>;
            clocks = <&ccu 86>, <&ccu 82>;
            clock-names = "apb", "mod";
            resets = <&ccu 34>;
            dmas = <&dma 3>, <&dma 3>;
            dma-names = "rx", "tx";
            channel-dins = /bits/ 8 <0 0 1 1 2 2>;
            channel-slots = /bits/ 8 <0 1 0 1 0 1>;
    };

...
```

## Documentation/devicetree/bindings/sound/amlogic,s4-tdmout-pad.yaml
```yaml
# SPDX-License-Identifier: (GPL-2.0-only OR BSD-2-Clause)
# Copyright (C) 2024 Amlogic, Inc. All rights reserved
%YAML 1.2
---
$id: http://devicetree.org/schemas/sound/amlogic,s4-tdmout-pad.yaml#
$schema: http://devicetree.org/meta-schemas/core.yaml#

title: Amlogic TDM Internal PAD

maintainers:
  - Jiebing Chen <jiebing.chen@amlogic.com>

allOf:
  - $ref: dai-common.yaml#

properties:
  compatible:
    items:
      - const: amlogic,s4-tdmout-pad
  reg:
    maxItems: 1

  sound-name-prefix: true

required:
  - compatible
  - reg

additionalProperties: false

examples:
  - |
    audio-controller@e58 {
        compatible = "amlogic,s4-tdmout-pad";
        reg = <0xe58 0x28>;
    };
```

## Documentation/devicetree/bindings/sound/amlogic,s4-tocodec.yaml
```yaml
# SPDX-License-Identifier: (GPL-2.0-only OR BSD-2-Clause)
# Copyright (C) 2024 Amlogic, Inc. All rights reserved
%YAML 1.2
---
$id: http://devicetree.org/schemas/sound/amlogic,s4-tocodec.yaml#
$schema: http://devicetree.org/meta-schemas/core.yaml#

title: Amlogic S4 Audio Tocodec Control

maintainers:
  - Jiebing Chen <jiebing.chen@amlogic.com>

allOf:
  - $ref: dai-common.yaml#

properties:
  compatible:
    items:
      - const: amlogic,s4-tocodec

  reg:
    maxItems: 1

  resets:
    maxItems: 1

  sound-name-prefix: true

required:
  - compatible
  - reg
  - resets

additionalProperties: false

examples:
  - |
    #include <dt-bindings/reset/amlogic,meson-g12a-reset.h>
    audio-controller@740 {
        compatible = "amlogic,s4-tocodec";
        reg = <0x0 0x740 0x0 0x4>;
        sound-name-prefix = "TOACODEC";
        resets = <&clkc_audio AUD_RESET_TOACODEC>;
    };
```

## Documentation/devicetree/bindings/sound/loongson,ls-audio-card.yaml
```yaml
# SPDX-License-Identifier: (GPL-2.0-only OR BSD-2-Clause)
%YAML 1.2
---
$id: http://devicetree.org/schemas/sound/loongson,ls-audio-card.yaml#
$schema: http://devicetree.org/meta-schemas/core.yaml#

title: Loongson 7axxx/2kxxx ASoC audio sound card driver

maintainers:
  - Yingkun Meng <mengyingkun@loongson.cn>
  - Binbin Zhou <zhoubinbin@loongson.cn>

description:
  The binding describes the sound card present in loongson
  7axxx/2kxxx platform. The sound card is an ASoC component
  which uses Loongson I2S controller to transfer the audio data.

allOf:
  - $ref: sound-card-common.yaml#

properties:
  compatible:
    enum:
      - loongson,ls-audio-card  # Loongson-2K1000/Loongson-2K2000/LS7A
      - loongson,ls2k0300-forever-pi-audio-card # CTCISZ Forever Pi

  mclk-fs:
    $ref: simple-card.yaml#/definitions/mclk-fs

  cpu:
    description: Holds subnode which indicates cpu dai.
    type: object
    additionalProperties: false
    properties:
      sound-dai:
        maxItems: 1
    required:
      - sound-dai

  codec:
    description: Holds subnode which indicates codec dai.
    type: object
    additionalProperties: false
    properties:
      sound-dai:
        maxItems: 1
    required:
      - sound-dai

required:
  - compatible
  - mclk-fs
  - cpu
  - codec

unevaluatedProperties: false

examples:
  - |
    sound {
        compatible = "loongson,ls-audio-card";
        model = "loongson-audio";
        mclk-fs = <512>;

        cpu {
            sound-dai = <&i2s>;
        };
        codec {
             sound-dai = <&es8323>;
        };
    };
```

## Documentation/devicetree/bindings/sound/qcom,wcd937x-sdw.yaml
```yaml
# SPDX-License-Identifier: (GPL-2.0-only OR BSD-2-Clause)
%YAML 1.2
---
$id: http://devicetree.org/schemas/sound/qcom,wcd937x-sdw.yaml#
$schema: http://devicetree.org/meta-schemas/core.yaml#

title: Qualcomm SoundWire Slave devices on WCD9370

maintainers:
  - Srinivas Kandagatla <srinivas.kandagatla@linaro.org>

description: |
  Qualcomm WCD9370 Codec is a standalone Hi-Fi audio codec IC.
  It has RX and TX Soundwire slave devices. This bindings is for the
  slave devices.

properties:
  compatible:
    const: sdw20217010a00

  reg:
    maxItems: 1

  qcom,tx-port-mapping:
    description: |
      Specifies static port mapping between slave and master tx ports.
      In the order of slave port index.
    $ref: /schemas/types.yaml#/definitions/uint32-array
    minItems: 4
    maxItems: 4

  qcom,rx-port-mapping:
    description: |
      Specifies static port mapping between slave and master rx ports.
      In the order of slave port index.
    $ref: /schemas/types.yaml#/definitions/uint32-array
    minItems: 5
    maxItems: 5

required:
  - compatible
  - reg
  - qcom,port-mapping

additionalProperties: false

examples:
  - |
    soundwire@3210000 {
        #address-cells = <2>;
        #size-cells = <0>;
        reg = <0x03210000 0x2000>;
        wcd937x_rx: codec@0,4 {
            compatible = "sdw20217010a00";
            reg  = <0 4>;
            qcom,rx-port-mapping = <1 2 3 4 5>;
        };
    };

    soundwire@3230000 {
        #address-cells = <2>;
        #size-cells = <0>;
        reg = <0x03230000 0x2000>;
        wcd937x_tx: codec@0,3 {
            compatible = "sdw20217010a00";
            reg  = <0 3>;
            qcom,tx-port-mapping = <2 3 4 5>;
        };
    };

...
```

## Documentation/devicetree/bindings/sound/qcom,wcd937x.yaml
```yaml
# SPDX-License-Identifier: (GPL-2.0-only OR BSD-2-Clause)
%YAML 1.2
---
$id: http://devicetree.org/schemas/sound/qcom,wcd937x.yaml#
$schema: http://devicetree.org/meta-schemas/core.yaml#

title: Qualcomm WCD9370 Audio Codec

maintainers:
  - Srinivas Kandagatla <srinivas.kandagatla@linaro.org>

description: |
  Qualcomm WCD9370 Codec is a standalone Hi-Fi audio codec IC.
  It has RX and TX Soundwire slave devices.

properties:
  compatible:
    enum:
      - qcom,wcd9370-codec

  reset-gpios:
    description: GPIO spec for reset line to use
    maxItems: 1

  vdd-buck-supply:
    description: A reference to the 1.8V buck supply

  vdd-rxtx-supply:
    description: A reference to the 1.8V rx supply

  vdd-px-supply:
    description: A reference to the 1.8V I/O supply

  vdd-mic-bias-supply:
    description: A reference to the 3.8V mic bias supply

  qcom,tx-device:
    $ref: /schemas/types.yaml#/definitions/phandle-array
    description: A reference to Soundwire tx device phandle

  qcom,rx-device:
    $ref: /schemas/types.yaml#/definitions/phandle-array
    description: A reference to Soundwire rx device phandle

  qcom,micbias1-microvolt:
    description: micbias1 voltage
    minimum: 1800000
    maximum: 2850000

  qcom,micbias2-microvolt:
    description: micbias2 voltage
    minimum: 1800000
    maximum: 2850000

  qcom,micbias3-microvolt:
    description: micbias3 voltage
    minimum: 1800000
    maximum: 2850000

  '#sound-dai-cells':
    const: 1

required:
  - compatible
  - reset-gpios
  - qcom,tx-device
  - qcom,rx-device
  - qcom,micbias1-microvolt
  - qcom,micbias2-microvolt
  - qcom,micbias3-microvolt
  - "#sound-dai-cells"

unevaluatedProperties: false

examples:
  - |
    codec {
        compatible = "qcom,wcd9370-codec";
        pinctrl-names = "default", "sleep";
        pinctrl-0 = <&wcd_reset_n>;
        pinctrl-1 = <&wcd_reset_n_sleep>;
        reset-gpios = <&tlmm 83 0>;
        vdd-buck-supply = <&vreg_l17b_1p8>;
        vdd-rxtx-supply = <&vreg_l18b_1p8>;
        vdd-px-supply = <&vreg_l18b_1p8>;
        vdd-mic-bias-supply = <&vreg_bob>;
        qcom,micbias1-microvolt = <1800000>;
        qcom,micbias2-microvolt = <1800000>;
        qcom,micbias3-microvolt = <1800000>;
        qcom,rx-device = <&wcd937x_rx>;
        qcom,tx-device = <&wcd937x_tx>;
        #sound-dai-cells = <1>;
    };

    /* ... */

    soundwire@3210000 {
        #address-cells = <2>;
        #size-cells = <0>;
        reg = <0x03210000 0x2000>;
        wcd937x_rx: codec@0,4 {
            compatible = "sdw20217010a00";
            reg  = <0 4>;
            qcom,rx-port-mapping = <1 2 3 4 5>;
        };
    };

    soundwire@3230000 {
        #address-cells = <2>;
        #size-cells = <0>;
        reg = <0x03230000 0x2000>;
        wcd937x_tx: codec@0,3 {
            compatible = "sdw20217010a00";
            reg  = <0 3>;
            qcom,tx-port-mapping = <2 3 4 5>;
        };
    };

...
```

## Documentation/devicetree/bindings/sound/sound-card-common.yaml
```yaml
# SPDX-License-Identifier: (GPL-2.0-only OR BSD-2-Clause)
%YAML 1.2
---
$id: http://devicetree.org/schemas/sound/sound-card-common.yaml#
$schema: http://devicetree.org/meta-schemas/core.yaml#

title: Board Sound Card Common Properties

maintainers:
  - Mark Brown <broonie@kernel.org>

properties:
  audio-routing:
    $ref: /schemas/types.yaml#/definitions/non-unique-string-array
    description: |
      A list of the connections between audio components. Each entry is a
      pair of strings, the first being the connection's sink, the second
      being the connection's source.

  lpa-widgets:
    $ref: /schemas/types.yaml#/definitions/non-unique-string-array
    description: |
      A list of DAPM endpoints which mark paths between these endpoints should
      not be disabled when system enters in suspend state. LPA means low power
      audio case. For example on asymmetric multiprocessor, there are Cortex-A
      core and Cortex-M core, Linux is running on Cortex-A core, RTOS or other
      OS is running on Cortex-M core. The audio hardware devices can be
      controlled by Cortex-M. LPA can be explained as a mechanism that Cortex-A
      allocates a large buffer and fill audio data, then Cortex-A can enter
      into suspend for the purpose of power saving. Cortex-M continues to play
      the sound during suspend phase of Cortex-A. LPA requires some audio paths
      still enabled when Cortex-A enters into suspend.

  model:
    $ref: /schemas/types.yaml#/definitions/string
    description: User specified audio sound card name

required:
  - model

additionalProperties: true
```

## Documentation/devicetree/bindings/spi/nxp,sc18is602.yaml
```yaml
# SPDX-License-Identifier: (GPL-2.0-only OR BSD-2-Clause)
%YAML 1.2
---
$id: http://devicetree.org/schemas/spi/nxp,sc18is602.yaml#
$schema: http://devicetree.org/meta-schemas/core.yaml#

title: NXP SC18IS602/602B/603/606 I2C to SPI bridge

maintainers:
  - Alvin Šipraga <alsi@bang-olufsen.dk>

properties:
  compatible:
    enum:
      - nxp,sc18is602
      - nxp,sc18is602b
      - nxp,sc18is603
      - nxp,sc18is606

  reg:
    maxItems: 1

  clock-frequency:
    $ref: /schemas/types.yaml#/definitions/uint32
    description:
      External oscillator clock frequency. Only relevant if the chip has an
      external oscillator (SC18IS603).
    default: 7372000

required:
  - compatible
  - reg

allOf:
  - $ref: spi-controller.yaml#
  - if:
      not:
        properties:
          comptaible:
            contains:
              enum:
                - nxp,sc18is603
    then:
      properties:
        clock-frequency: false

unevaluatedProperties: false

examples:
  - |
    i2c {
      #address-cells = <1>;
      #size-cells = <0>;

      spi@28 {
        compatible = "nxp,sc18is603";
        reg = <0x28>;
        clock-frequency = <14744000>;
      };
    };
```
