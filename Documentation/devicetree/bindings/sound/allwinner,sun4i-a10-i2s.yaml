## arch/riscv/configs/rzfive_defconfig
```kconfig
CONFIG_SYSVIPC=y
CONFIG_POSIX_MQUEUE=y
CONFIG_NO_HZ_IDLE=y
CONFIG_HIGH_RES_TIMERS=y
CONFIG_BPF_SYSCALL=y
CONFIG_PREEMPT=y
CONFIG_IKCONFIG=y
CONFIG_IKCONFIG_PROC=y
CONFIG_CGROUPS=y
CONFIG_MEMCG=y
CONFIG_CGROUP_SCHED=y
CONFIG_CFS_BANDWIDTH=y
CONFIG_RT_GROUP_SCHED=y
CONFIG_CGROUP_PIDS=y
CONFIG_CGROUP_FREEZER=y
CONFIG_CGROUP_HUGETLB=y
CONFIG_CGROUP_DEVICE=y
CONFIG_CGROUP_CPUACCT=y
CONFIG_CGROUP_PERF=y
CONFIG_CGROUP_BPF=y
CONFIG_NAMESPACES=y
CONFIG_USER_NS=y
CONFIG_CHECKPOINT_RESTORE=y
CONFIG_BLK_DEV_INITRD=y
CONFIG_CC_OPTIMIZE_FOR_SIZE=y
CONFIG_EXPERT=y
# CONFIG_SYSFS_SYSCALL is not set
CONFIG_PROFILING=y
CONFIG_ARCH_RENESAS=y
CONFIG_ERRATA_SIFIVE=y
CONFIG_NONPORTABLE=y
# CONFIG_RISCV_ISA_SUPM is not set
# CONFIG_RISCV_ISA_SVNAPOT is not set
# CONFIG_RISCV_ISA_SVPBMT is not set
# CONFIG_RISCV_ISA_V is not set
# CONFIG_RISCV_ISA_ZAWRS is not set
# CONFIG_RISCV_ISA_ZBA is not set
# CONFIG_RISCV_ISA_ZBB is not set
# CONFIG_RISCV_ISA_ZBC is not set
# CONFIG_RISCV_ISA_ZICBOM is not set
# CONFIG_RISCV_ISA_ZICBOZ is not set
# CONFIG_RISCV_ISA_VENDOR_EXT_THEAD is not set
# CONFIG_EFI is not set
CONFIG_PM_AUTOSLEEP=y
CONFIG_CPU_IDLE=y
CONFIG_RISCV_SBI_CPUIDLE=y
CONFIG_CPU_FREQ=y
CONFIG_CPU_FREQ_STAT=y
CONFIG_CPU_FREQ_DEFAULT_GOV_USERSPACE=y
CONFIG_CPU_FREQ_GOV_PERFORMANCE=y
CONFIG_CPU_FREQ_GOV_ONDEMAND=y
CONFIG_CPUFREQ_DT=y
CONFIG_JUMP_LABEL=y
CONFIG_SLAB_FREELIST_HARDENED=y
CONFIG_NET=y
CONFIG_PACKET=y
CONFIG_IP_MULTICAST=y
CONFIG_IP_ADVANCED_ROUTER=y
CONFIG_IP_PNP=y
CONFIG_IP_PNP_DHCP=y
CONFIG_IP_PNP_BOOTP=y
CONFIG_IP_PNP_RARP=y
CONFIG_NETFILTER=y
CONFIG_NET_SCHED=y
CONFIG_NETLINK_DIAG=y
CONFIG_CGROUP_NET_PRIO=y
CONFIG_CAN=y
CONFIG_NET_9P=y
CONFIG_NET_9P_VIRTIO=y
CONFIG_PAGE_POOL_STATS=y
CONFIG_DEVTMPFS=y
CONFIG_DEVTMPFS_MOUNT=y
CONFIG_MTD=y
# CONFIG_MTD_OF_PARTS is not set
CONFIG_MTD_BLOCK=y
CONFIG_MTD_CFI=y
CONFIG_MTD_CFI_ADV_OPTIONS=y
CONFIG_MTD_SPI_NOR=y
# CONFIG_MTD_SPI_NOR_USE_4K_SECTORS is not set
CONFIG_BLK_DEV_LOOP=y
CONFIG_VIRTIO_BLK=y
CONFIG_BLK_DEV_SD=y
CONFIG_BLK_DEV_SR=y
CONFIG_SCSI_VIRTIO=y
CONFIG_ATA=y
CONFIG_SATA_AHCI_PLATFORM=y
CONFIG_MD=y
CONFIG_NETDEVICES=y
CONFIG_VIRTIO_NET=y
CONFIG_RAVB=y
CONFIG_MICREL_PHY=y
CONFIG_MICROSEMI_PHY=y
CONFIG_VITESSE_PHY=y
CONFIG_CAN_RCAR_CANFD=y
CONFIG_INPUT_MOUSEDEV=y
# CONFIG_KEYBOARD_ATKBD is not set
# CONFIG_MOUSE_PS2 is not set
CONFIG_INPUT_MISC=y
CONFIG_INPUT_DA9063_ONKEY=y
CONFIG_VT_HW_CONSOLE_BINDING=y
CONFIG_SERIAL_EARLYCON_RISCV_SBI=y
CONFIG_SERIAL_SH_SCI=y
CONFIG_HVC_RISCV_SBI=y
CONFIG_VIRTIO_CONSOLE=y
CONFIG_HW_RANDOM_VIRTIO=y
CONFIG_I2C=y
CONFIG_I2C_CHARDEV=y
CONFIG_I2C_RIIC=y
CONFIG_SPI=y
CONFIG_SPI_RPCIF=y
CONFIG_SPI_RSPI=y
# CONFIG_PTP_1588_CLOCK is not set
CONFIG_PINCTRL_DA9062=y
CONFIG_POWER_RESET=y
CONFIG_POWER_RESET_SYSCON=y
CONFIG_POWER_RESET_SYSCON_POWEROFF=y
CONFIG_POWER_SUPPLY=y
CONFIG_THERMAL=y
CONFIG_THERMAL_DEBUGFS=y
CONFIG_CPU_THERMAL=y
CONFIG_DA9062_THERMAL=y
CONFIG_RZG2L_THERMAL=y
CONFIG_WATCHDOG=y
CONFIG_DA9062_WATCHDOG=y
CONFIG_RENESAS_RZG2LWDT=y
CONFIG_MFD_DA9062=y
CONFIG_RZ_MTU3=y
CONFIG_REGULATOR=y
CONFIG_REGULATOR_FIXED_VOLTAGE=y
CONFIG_REGULATOR_GPIO=y
CONFIG_BACKLIGHT_CLASS_DEVICE=y
CONFIG_SOUND=y
CONFIG_SND=y
# CONFIG_SND_PCM_TIMER is not set
# CONFIG_SND_SUPPORT_OLD_API is not set
# CONFIG_SND_PROC_FS is not set
# CONFIG_SND_CTL_FAST_LOOKUP is not set
# CONFIG_SND_DRIVERS is not set
# CONFIG_SND_SPI is not set
# CONFIG_SND_USB is not set
CONFIG_SND_SOC=y
CONFIG_SND_SOC_RZ=y
CONFIG_SND_SOC_WM8978=y
CONFIG_SND_SIMPLE_CARD=y
CONFIG_USB=y
CONFIG_USB_OTG=y
CONFIG_USB_EHCI_HCD=y
CONFIG_USB_EHCI_HCD_PLATFORM=y
CONFIG_USB_OHCI_HCD=y
CONFIG_USB_OHCI_HCD_PLATFORM=y
CONFIG_USB_RENESAS_USBHS=y
CONFIG_USB_STORAGE=y
CONFIG_USB_UAS=y
CONFIG_USB_GADGET=y
CONFIG_USB_RENESAS_USBHS_UDC=y
CONFIG_MMC=y
CONFIG_MMC_SDHI=y
CONFIG_RTC_CLASS=y
CONFIG_RTC_DRV_DA9063=y
CONFIG_DMADEVICES=y
CONFIG_RZ_DMAC=y
CONFIG_SYNC_FILE=y
CONFIG_COMMON_CLK_VC3=y
CONFIG_RENESAS_OSTM=y
CONFIG_MAILBOX=y
# CONFIG_RISCV_IOMMU is not set
CONFIG_RPMSG_CHAR=y
CONFIG_RPMSG_CTRL=y
CONFIG_RPMSG_VIRTIO=y
CONFIG_ARCH_R9A07G043=y
CONFIG_EXTCON=y
CONFIG_MEMORY=y
CONFIG_RENESAS_RPCIF=y
CONFIG_IIO=y
CONFIG_RZG2L_ADC=y
CONFIG_RESET_RZG2L_USBPHY_CTRL=y
CONFIG_RESET_SIMPLE=y
CONFIG_PHY_RCAR_GEN3_USB2=y
CONFIG_EXT4_FS=y
CONFIG_EXT4_FS_POSIX_ACL=y
CONFIG_EXT4_FS_SECURITY=y
CONFIG_AUTOFS_FS=y
CONFIG_VFAT_FS=y
CONFIG_TMPFS=y
CONFIG_TMPFS_POSIX_ACL=y
CONFIG_HUGETLBFS=y
CONFIG_NFS_FS=y
CONFIG_NFS_V2=y
CONFIG_NFS_V4=y
CONFIG_NFS_V4_1=y
CONFIG_NFS_V4_2=y
CONFIG_ROOT_NFS=y
# CONFIG_NFS_V4_2_READ_PLUS is not set
CONFIG_9P_FS=y
CONFIG_NLS_CODEPAGE_437=y
CONFIG_NLS_ISO8859_1=y
CONFIG_SECURITY=y
CONFIG_SECURITY_SELINUX=y
CONFIG_SECURITY_APPARMOR=y
CONFIG_DEFAULT_SECURITY_DAC=y
CONFIG_CRYPTO_SHA1=y
CONFIG_CRYPTO_USER_API_HASH=y
CONFIG_CRYPTO_DEV_VIRTIO=y
CONFIG_PRINTK_TIME=y
CONFIG_MAGIC_SYSRQ=y
CONFIG_DEBUG_FS=y
CONFIG_DEBUG_PAGEALLOC=y
CONFIG_SCHED_STACK_END_CHECK=y
CONFIG_DEBUG_VM=y
CONFIG_DEBUG_VM_PGFLAGS=y
CONFIG_DEBUG_MEMORY_INIT=y
CONFIG_SOFTLOCKUP_DETECTOR=y
CONFIG_WQ_WATCHDOG=y
CONFIG_WQ_CPU_INTENSIVE_REPORT=y
# CONFIG_SCHED_DEBUG is not set
CONFIG_DEBUG_RT_MUTEXES=y
CONFIG_DEBUG_SPINLOCK=y
CONFIG_DEBUG_MUTEXES=y
CONFIG_DEBUG_RWSEMS=y
CONFIG_DEBUG_ATOMIC_SLEEP=y
CONFIG_DEBUG_LIST=y
CONFIG_DEBUG_PLIST=y
CONFIG_DEBUG_SG=y
CONFIG_RCU_EQS_DEBUG=y
# CONFIG_FTRACE is not set
CONFIG_MEMTEST=y
```

## drivers/bus/qcom/Kconfig
```kconfig
# SPDX-License-Identifier: GPL-2.0

menuconfig QCOM_SOC_BUS
	tristate "Qualcomm SoC Bus Drivers"
	depends on ARCH_QCOM || COMPILE_TEST

if QCOM_SOC_BUS

config QCOM_SOC_BUS_SC7180
	tristate "Qualcomm SC7180 SoC Bus"
	depends on ALLOW_SIMPLE_BUS_OVERRIDE
	depends on OF_SIMPLE_BUS || !OF_SIMPLE_BUS
	help
	  Support for the Qualcomm SC7180 SoC bus.

endif
```

## drivers/crypto/starfive/Kconfig
```kconfig
#
# StarFive crypto drivers configuration
#

config CRYPTO_DEV_JH7110
	tristate "StarFive JH7110 cryptographic engine driver"
	depends on (SOC_STARFIVE && AMBA_PL08X) || COMPILE_TEST
	depends on HAS_DMA && !CRYPTO_DEV_JH8100
	select CRYPTO_ENGINE
	select CRYPTO_HMAC
	select CRYPTO_SHA256
	select CRYPTO_SHA512
	select CRYPTO_SM3_GENERIC
	select CRYPTO_RSA
	select CRYPTO_AES
	select CRYPTO_CCM
	select CRYPTO_GCM
	select CRYPTO_ECB
	select CRYPTO_CBC
	select CRYPTO_CTR
	help
	  Support for StarFive JH7110 crypto hardware acceleration engine.
	  This module provides acceleration for public key algo,
	  skciphers, AEAD and hash functions.

	  If you choose 'M' here, this module will be called jh7110-crypto.

config CRYPTO_DEV_JH8100
	tristate "StarFive JH8100 cryptographic engine drivers"
	depends on (SOC_STARFIVE && DW_AXI_DMAC) || COMPILE_TEST
	depends on HAS_DMA
	select CRYPTO_ENGINE
	select CRYPTO_HMAC
	select CRYPTO_SHA256
	select CRYPTO_SHA512
	select CRYPTO_SM3_GENERIC
	select CRYPTO_SM4_GENERIC
	select CRYPTO_RSA
	select CRYPTO_AES
	select CRYPTO_CCM
	select CRYPTO_GCM
	select CRYPTO_CBC
	select CRYPTO_ECB
	select CRYPTO_CTR
	help
	  Support for StarFive JH8100 crypto hardware acceleration engine.
	  This module provides additional support for SM2 signature verification,
	  SM3 hash/hmac functions and SM4 skcipher.

	  If you choose 'M' here, this module will be called jh8100-crypto.
```

## drivers/firmware/samsung/Kconfig
```kconfig
# SPDX-License-Identifier: GPL-2.0-only

config EXYNOS_ACPM
	tristate "Exynos ACPM (Alive Clock and Power Manager) driver support"
	select MAILBOX
	help
	  ACPM is a firmware that operates on the APM (Active Power Management)
	  module that handles overall power management activities. ACPM and
	  masters regard each other as independent hardware component and
	  communicate with each other using mailbox messages and shared memory.
	  This module provides the means to communicate with the ACPM firmware.
```

## drivers/gpu/drm/nuvoton/Kconfig
```kconfig
config DRM_MA35
	tristate "Nuvoton MA35D1 LCD Display Controller"
	default ARCH_MA35
	depends on DRM
	depends on OF && (ARCH_MA35 || COMPILE_TEST)
	select DRM_KMS_HELPER
	select DRM_KMS_DMA_HELPER
	select DRM_GEM_DMA_HELPER
	select DRM_BRIDGE
	select DRM_PANEL_BRIDGE
	select VIDEOMODE_HELPERS
	select REGMAP_MMIO
	help
	  Choose this option to enable support for the Display Controller Unit (DCU)
	  found in Nuvoton MA35D1 SoCs.

	  This driver supports the DRM/KMS API for the MA35 display subsystem,
	  handling display output via hardware composition layers.

	  To compile this driver as a module, choose M here: the module
	  will be called ma35-drm.
```

## drivers/gpu/drm/verisilicon/Kconfig
```kconfig
# SPDX-License-Identifier: GPL-2.0
config DRM_VERISILICON_DC8200
	tristate "DRM Support for VeriSilicon DC8200"
	depends on DRM
	select DRM_KMS_HELPER
	select DRM_GEM_DMA_HELPER
	select DMA_CMA if HAVE_DMA_CONTIGUOUS
	select CMA if HAVE_DMA_CONTIGUOUS
	help
	  Choose this option if you have a VeriSilicon DC8200 chipset.
	  This driver provides VeriSilicon kernel mode
	  setting and buffer management. It does not
	  provide 2D or 3D acceleration.

config DRM_INNO_STARFIVE_HDMI
	bool "Starfive JH7110 specific extensions for Innosilicon HDMI"
	depends on DRM_VERISILICON_DC8200
	select DRM_INNO_HDMI
	select DRM_DISPLAY_HELPER
	select DRM_BRIDGE_CONNECTOR
	help
          This configuration option enables support for StarFive SoC
          specific extensions for the Innosilicon HDMI driver.

          Enabling this option is essential for proper functionality
          of HDMI on JH7110 based SoCs. If you are using a StarFive
          JH7110 SoC and require HDMI output functionalities,
          you should select this option to ensure that the driver is
          compiled with the necessary extensions and dependencies.

          This option may enable additional features and capabilities
          specific to StarFive's implementation of the HDMI technology.
```

## drivers/i3c/func/Kconfig
```kconfig
# SPDX-License-Identifier: GPL-2.0

config I3C_TARGET_FUNC_TTY
	tristate "I3C target tty driver"
	depends on I3C_TARGET
	help
	  I3C Target TTY Function Driver.

	  General TTY over I3C target controller function drivers.
```

## drivers/iio/imu/smi330/Kconfig
```kconfig
# SPDX-License-Identifier: GPL-2.0
#
# SMI330 IMU driver
#

config SMI330
	tristate "Bosch Sensor SMI330 Inertial Measurement Unit"
	select IIO_BUFFER
	select IIO_TRIGGERED_BUFFER
	help
	  Enable support for the Bosch SMI330 IMU.

	  The driver supports different operation modes like polling,
	  data ready or fifo mode and advanced features like no-motion,
	  no-motion, any-motion or tilt detection.

if SMI330

choice
	prompt "Select communication interface"
	help
	  Choose communication interface for the sensor.

	  Make sure the sensor is connected accordingly.
	  SPI and I2C are not supported at the same time,
	  choose either SPI or I2C to build the driver.

	config SMI330_SPI
		bool "Enable SPI connection"
		depends on SPI
		select REGMAP_SPI
		help
		  Enables SPI communication interface.

		  Make sure the sensor is connected to the SPI bus.
		  To specifiy further parameters like max frequency
		  use the device tree.

	config SMI330_I2C
		bool "Enable I2C connection"
		depends on I2C
		select REGMAP_I2C
		help
		  Enables I2C communication interface.

		  Make sure the sensor is connected to the I2C bus.
		  To specifiy further parameters like the address
		  use the device tree.
endchoice

choice
	prompt "Map data interrupt"
	default SMI330_IRQ_DATA_INT1
	help
	  Map data interrupt to INT1 or INT2.

	  NONE: data interrupt disabled
	  INT1: data interrupt mapped to INT1
	  INT2: data interrupt mapped to INT2

	config SMI330_IRQ_DATA_NONE
		bool "NONE"
		help
		  Data interrupt disabled.

		  In this mode only polling is possible.
		  To activate data ready of fifo mode choose
		  INT1 or INT2.

	config SMI330_IRQ_DATA_INT1
		bool "INT1"
		help
		  Data interrupt mapped to INT1.

		  In this mode data ready is the default mode.
		  The interrupt is triggered when new data is available.
		  When fifo watermark is set, fifo mode is activated.
		  The interrupt is triggered when fifo watermark level is reached.

	config SMI330_IRQ_DATA_INT2
		bool "INT2"
		help
		  Data interrupt mapped to INT2.

		  In this mode data ready is the default mode.
		  The interrupt is triggered when new data is available.
		  When fifo watermark is set, fifo mode is activated.
		  The interrupt is triggered when fifo watermark level is reached.
endchoice

choice
	prompt "Map advanced features interrupt"
	default SMI330_IRQ_ADV_FEAT_NONE
	help
	  Map advanced features interrupt to INT1 or INT2.

	  NONE: advanced features interrupt disabled
	  INT1: advanced features interrupt mapped to INT1
	  INT2: advanced features interrupt mapped to INT2

	config SMI330_IRQ_ADV_FEAT_NONE
		bool "NONE"
		help
		  Advanced features interrupt disabled.

		  In this mode no-motion, any-motion or tilt detection
		  is disabled.
		  To enable these features choose INT1 or INT2.

	config SMI330_IRQ_ADV_FEAT_INT1
		bool "INT1"
		help
		  Advanced features interrupt mapped to INT1.

		  In this mode no-motion, any-motion or tilt detection
		  is enabled.
		  The interrupt is triggered when the feature is detected.

	config SMI330_IRQ_ADV_FEAT_INT2
		bool "INT2"
		help
		  Advanced features interrupt mapped to INT1.

		  In this mode no-motion, any-motion or tilt detection
		  is enabled.
		  The interrupt is triggered when the feature is detected.
endchoice

endif  # SMI330
```
