## Documentation/devicetree/bindings/display/starfive/starfive,jh7110-inno-hdmi.yaml
```yaml
# SPDX-License-Identifier: (GPL-2.0-only OR BSD-2-Clause)
%YAML 1.2
---
$id: http://devicetree.org/schemas/display/starfive/starfive,jh7110-inno-hdmi.yaml#
$schema: http://devicetree.org/meta-schemas/core.yaml#

title: Starfive JH7110 Innosilicon HDMI controller

maintainers:
  - keith zhao <keith.zhao@starfivetech.com>

description: |
  Innosilicon HDMI TX IP is designed for transmitting video and audio data
  from a video source device to a display device.
  It contains a digital controller and a physical layer.

allOf:
  - $ref: ../bridge/innosilicon,inno-hdmi.yaml#

properties:
  compatible:
    const: "starfive,jh7110-inno-hdmi"

  clocks:
    items:
      - description: System clock of HDMI module.
      - description: Mclk clock of HDMI audio.
      - description: Bclk clock of HDMI audio.

  clock-names:
    items:
      - const: sysclk
      - const: mclk
      - const: bclk

  resets:
    maxItems: 1

required:
  - compatible
  - reg
  - interrupts
  - clocks
  - clock-names
  - resets
  - ports

unevaluatedProperties: false

examples:
  - |
    hdmi: hdmi@29590000 {
        compatible = "starfive,jh7110-inno-hdmi";
        reg = <0x29590000 0x4000>;
        interrupts = <99>;
        clocks = <&voutcrg 17>, <&voutcrg 15>, <&voutcrg 16>;
        clock-names = "sysclk", "mclk","bclk";
        resets = <&voutcrg 9>;

        ports {
            #address-cells = <1>;
            #size-cells = <0>;

            hdmi_in: port@0 {
                reg = <0>;
                hdmi_in_vop: endpoint {
                    remote-endpoint = <&dc_out_dpi0>;
                };
            };

            hdmi_out: port@1 {
                reg = <1>;
                hdmi_out_con: endpoint {
                    remote-endpoint = <&hdmi_con_in>;
                };
            };
        };
    };

    hdmi-out {
        compatible = "hdmi-connector";
        type = "a";

        port {
            hdmi_con_in: endpoint {
                remote-endpoint = <&hdmi_out_con>;
            };
        };
    };

...
```

## Documentation/devicetree/bindings/display/verisilicon,dc.yaml
```yaml
# SPDX-License-Identifier: (GPL-2.0 OR BSD-2-Clause)
%YAML 1.2
---
$id: http://devicetree.org/schemas/display/verisilicon,dc.yaml#
$schema: http://devicetree.org/meta-schemas/core.yaml#

title: Verisilicon DC-series display controllers

maintainers:
  - Icenowy Zheng <uwu@icenowy.me>

description:
  Verisilicon DC-series display controllers.

# Select any node whose compatible contains one of the known Verisilicon DC
# or DC-derived compatible strings, including SoC-specific glue variants.
select:
  properties:
    compatible:
      contains:
        enum:
          - verisilicon,dc
          - thead,th1520-dc8200
          - nuvoton,ma35d1-dcu
  required:
    - compatible

properties:
  $nodename:
    pattern: "^display@[0-9a-f]+$"

  compatible:
    # Enumerated in full so the schema validator can verify any compatible
    # string against this list, including those from child schemas.
    contains:
      enum:
        - verisilicon,dc
        - thead,th1520-dc8200
        - nuvoton,ma35d1-dcu

  reg:
    maxItems: 1

  interrupts:
    maxItems: 1

  clocks:
    minItems: 2
    maxItems: 5

  clock-names:
    minItems: 2
    maxItems: 5

  resets:
    minItems: 1
    maxItems: 3

  reset-names:
    minItems: 1
    maxItems: 3

  port:
    $ref: /schemas/graph.yaml#/properties/port
    description: Single video output port for single-output variants.

  ports:
    $ref: /schemas/graph.yaml#/properties/ports

    properties:
      port@0:
        $ref: /schemas/graph.yaml#/properties/port
        description: The first output channel, endpoint 0 should be
          used for DPI format output and endpoint 1 should be used
          for DP format output.

      port@1:
        $ref: /schemas/graph.yaml#/properties/port
        description: The second output channel if the DC variant
          supports. Follow the same endpoint addressing rule with
          the first port.

required:
  - compatible
  - reg
  - interrupts
  - clocks
  - clock-names

additionalProperties: true

examples:
  - |
    #include <dt-bindings/interrupt-controller/irq.h>
    #include <dt-bindings/clock/thead,th1520-clk-ap.h>
    #include <dt-bindings/reset/thead,th1520-reset.h>
    soc {
      #address-cells = <2>;
      #size-cells = <2>;

      display@ffef600000 {
        compatible = "thead,th1520-dc8200", "verisilicon,dc";
        reg = <0xff 0xef600000 0x0 0x100000>;
        interrupts = <93 IRQ_TYPE_LEVEL_HIGH>;
        clocks = <&clk_vo CLK_DPU_CCLK>,
                 <&clk_vo CLK_DPU_ACLK>,
                 <&clk_vo CLK_DPU_HCLK>,
                 <&clk_vo CLK_DPU_PIXELCLK0>,
                 <&clk_vo CLK_DPU_PIXELCLK1>;
        clock-names = "core", "axi", "ahb", "pix0", "pix1";
        resets = <&rst TH1520_RESET_ID_DPU_CORE>,
                 <&rst TH1520_RESET_ID_DPU_AXI>,
                 <&rst TH1520_RESET_ID_DPU_AHB>;
        reset-names = "core", "axi", "ahb";

        ports {
          #address-cells = <1>;
          #size-cells = <0>;

          port@1 {
            reg = <1>;
            #address-cells = <1>;
            #size-cells = <0>;

            dpu_out_dp1: endpoint@1 {
              reg = <1>;
              remote-endpoint = <&hdmi_in>;
            };
          };
        };
      };
    };
```

## Documentation/devicetree/bindings/dma/nxp,lpc3220-dmamux.yaml
```yaml
# SPDX-License-Identifier: (GPL-2.0-only OR BSD-2-Clause)
%YAML 1.2
---
$id: http://devicetree.org/schemas/dma/nxp,lpc3220-dmamux.yaml#
$schema: http://devicetree.org/meta-schemas/core.yaml#

title: DMA multiplexer for LPC32XX SoC (DMA request router)

maintainers:
  - J.M.B. Downing <jonathan.downing@nautel.com>
  - Piotr Wojtaszczyk <piotr.wojtaszczyk@timesys.com>

allOf:
  - $ref: dma-router.yaml#

properties:
  "#dma-cells":
    const: 3
    description: |
      First two cells same as for device pointed in dma-masters.
      Third cell represents mux value for the request.

  compatible:
    const: nxp,lpc3220-dmamux

  dma-masters:
    description: phandle to a dma node compatible with arm,pl080

  reg:
    maxItems: 1

required:
  - compatible
  - reg
  - dma-masters

additionalProperties: false

examples:
  - |
    syscon@40004000 {
      compatible = "nxp,lpc3220-creg", "syscon", "simple-mfd";
      reg = <0x40004000 0x114>;
      ranges = <0 0x40004000 0x114>;
      #address-cells = <1>;
      #size-cells = <1>;

      dma-router@7c {
        compatible = "nxp,lpc3220-dmamux";
        reg = <0x7c 0x8>;
        #dma-cells = <3>;
        dma-masters = <&dma>;
      };
    };

...
```

## Documentation/devicetree/bindings/dma/ti/ti,am62l-dmss-bcdma.yaml
```yaml
# SPDX-License-Identifier: (GPL-2.0-only OR BSD-2-Clause)
# Copyright (C) 2024-25 Texas Instruments Incorporated
# Author: Sai Sree Kartheek Adivi <s-adivi@ti.com>
%YAML 1.2
---
$id: http://devicetree.org/schemas/dma/ti/ti,am62l-dmss-bcdma.yaml#
$schema: http://devicetree.org/meta-schemas/core.yaml#

title: Texas Instruments K3 DMSS BCDMA V2

maintainers:
  - Sai Sree Kartheek Adivi <s-adivi@ti.com>

description:
  The BCDMA V2 is intended to perform similar functions as the TR
  mode channels of K3 UDMA-P.
  BCDMA V2 includes block copy channels and Split channels.

  Block copy channels mainly used for memory to memory transfers, but with
  optional triggers a block copy channel can service peripherals by accessing
  directly to memory mapped registers or area.

  Split channels can be used to service PSI-L based peripherals.
  The peripherals can be PSI-L native or legacy, non PSI-L native peripherals
  with PDMAs. PDMA is tasked to act as a bridge between the PSI-L fabric and the
  legacy peripheral.

allOf:
  - $ref: /schemas/dma/dma-controller.yaml#

properties:
  compatible:
    const: ti,am62l-dmss-bcdma

  reg:
    items:
      - description: BCDMA Control & Status Registers region
      - description: Block Copy Channel Realtime Registers region
      - description: Channel Realtime Registers region
      - description: Ring Realtime Registers region

  reg-names:
    items:
      - const: gcfg
      - const: bchanrt
      - const: chanrt
      - const: ringrt

  "#address-cells":
    const: 0

  "#interrupt-cells":
    const: 1

  "#dma-cells":
    const: 4
    description: |
      cell 1: Trigger type for the channel
        0 - disable / no trigger
        1 - internal channel event
        2 - external signal
        3 - timer manager event

      cell 2: parameter for the trigger:
        if cell 1 is 0 (disable / no trigger):
          Unused, ignored
        if cell 1 is 1 (internal channel event):
          channel number whose TR event should trigger the current channel.
        if cell 1 is 2 or 3 (external signal or timer manager event):
          index of global interfaces that come into the DMA.

          Please refer to the device documentation for global interface indexes.

      cell 3: Channel number for the peripheral

        Please refer to the device documentation for the channel map.

      cell 4: ASEL value for the channel

  interrupt-map-mask:
    items:
      - const: 0x7ff

  interrupt-map:
    description: |
      Maps internal BCDMA channel IDs to the parent GIC IRQ lines.

required:
  - compatible
  - reg
  - reg-names
  - "#address-cells"
  - "#interrupt-cells"
  - "#dma-cells"
  - interrupt-map-mask
  - interrupt-map

unevaluatedProperties: false

examples:
  - |
    #include <dt-bindings/interrupt-controller/arm-gic.h>
    #include <dt-bindings/interrupt-controller/irq.h>

    dma-controller@485c4000 {
        compatible = "ti,am62l-dmss-bcdma";
        reg = <0x485c4000 0x4000>,
              <0x48880000 0x10000>,
              <0x48800000 0x80000>,
              <0x47000000 0x200000>;
        reg-names = "gcfg", "bchanrt", "chanrt", "ringrt";

        #address-cells = <0>;
        #interrupt-cells = <1>;
        #dma-cells = <4>;

        interrupt-map-mask = <0x7ff>;
        interrupt-map = <49 &gic500 0 0 GIC_SPI 385 IRQ_TYPE_LEVEL_HIGH>,
                        <50 &gic500 0 0 GIC_SPI 386 IRQ_TYPE_LEVEL_HIGH>;
    };
```

## Documentation/devicetree/bindings/dma/ti/ti,am62l-dmss-pktdma.yaml
```yaml
# SPDX-License-Identifier: (GPL-2.0-only OR BSD-2-Clause)
# Copyright (C) 2024-2025 Texas Instruments Incorporated
%YAML 1.2
---
$id: http://devicetree.org/schemas/dma/ti/ti,am62l-dmss-pktdma.yaml#
$schema: http://devicetree.org/meta-schemas/core.yaml#

title: Texas Instruments K3 DMSS PKTDMA V2

maintainers:
  - Sai Sree Kartheek Adivi <s-adivi@ti.com>

description:
  The PKTDMA V2 is intended to perform similar functions as the packet mode
  channels of K3 UDMA-P. PKTDMA V2 only includes Split channels to service
  PSI-L based peripherals.

  The peripherals can be PSI-L native or legacy, non PSI-L native peripherals
  with PDMAs. PDMA is tasked to act as a bridge between the PSI-L fabric and the
  legacy peripheral.

allOf:
  - $ref: /schemas/dma/dma-controller.yaml#

properties:
  compatible:
    const: ti,am62l-dmss-pktdma

  reg:
    items:
      - description: Packet DMA Control & Status
      - description: Channel Realtime
      - description: Ring Realtime

  reg-names:
    items:
      - const: gcfg
      - const: chanrt
      - const: ringrt

  "#address-cells":
    const: 0

  "#interrupt-cells":
    const: 1

  "#dma-cells":
    const: 2
    description: |
      cell 1: Channel identification for the peripheral
        PSI-L thread ID of the remote (to PKTDMA) end.
        Valid ranges for thread ID depends on the data movement direction:
        for source thread IDs (rx): 0 - 0x7fff
        for destination thread IDs (tx): 0x8000 - 0xffff

        Please refer to the device documentation for the PSI-L thread map and
        also the PSI-L peripheral chapter for the correct thread ID.

      cell 2: ASEL value for the channel

  interrupt-map-mask:
    items:
      - const: 0x7ff

  interrupt-map:
    description: |
      Maps internal PKTDMA channel IDs to the parent GIC IRQ lines.

required:
  - compatible
  - reg
  - reg-names
  - "#address-cells"
  - "#interrupt-cells"
  - "#dma-cells"
  - interrupt-map-mask
  - interrupt-map

unevaluatedProperties: false

examples:
  - |
    #include <dt-bindings/interrupt-controller/arm-gic.h>
    #include <dt-bindings/interrupt-controller/irq.h>

    dma-controller@485c0000 {
        compatible = "ti,am62l-dmss-pktdma";
        reg = <0x485c0000 0x4000>,
              <0x48900000 0x80000>,
              <0x47200000 0x100000>;
        reg-names = "gcfg", "chanrt", "ringrt";

        #address-cells = <0>;
        #interrupt-cells = <1>;
        #dma-cells = <2>;

        interrupt-map-mask = <0x7ff>;
        interrupt-map = <64 &gic500 0 0 GIC_SPI 500 IRQ_TYPE_LEVEL_HIGH>,
                        <65 &gic500 0 0 GIC_SPI 501 IRQ_TYPE_LEVEL_HIGH>;
    };
```

## Documentation/devicetree/bindings/firmware/thead,th1520-aon.yaml
```yaml
# SPDX-License-Identifier: (GPL-2.0-only OR BSD-2-Clause)
%YAML 1.2
---
$id: http://devicetree.org/schemas/firmware/thead,th1520-aon.yaml#
$schema: http://devicetree.org/meta-schemas/core.yaml#

title: T-HEAD TH1520 AON (Always-On) Firmware

description: |
  The Always-On (AON) subsystem in the TH1520 SoC is responsible for managing
  low-power states, system wakeup events, and power management tasks. It is
  designed to operate independently in a dedicated power domain, allowing it to
  remain functional even during the SoC's deep sleep states.

  At the heart of the AON subsystem is the E902, a low-power core that executes
  firmware responsible for coordinating tasks such as power domain control,
  clock management, and system wakeup signaling. Communication between the main
  SoC and the AON subsystem is handled through a mailbox interface, which
  enables message-based interactions with the AON firmware.

maintainers:
  - Michal Wilczynski <m.wilczynski@samsung.com>

properties:
  compatible:
    const: thead,th1520-aon

  clocks:
    items:
      - description: GPU core clock
      - description: GPU sys clock

  clock-names:
    items:
      - const: gpu-core
      - const: gpu-sys

  mboxes:
    maxItems: 1

  mbox-names:
    items:
      - const: aon

  resets:
    items:
      - description: GPU reset
      - description: GPU CLKGEN reset

  reset-names:
    items:
      - const: gpu
      - const: gpu-clkgen

  "#power-domain-cells":
    const: 1

required:
  - compatible
  - clocks
  - clock-names
  - mboxes
  - mbox-names
  - resets
  - reset-names
  - "#power-domain-cells"

additionalProperties: false

examples:
  - |
    aon: aon {
        compatible = "thead,th1520-aon";
        clocks = <&clk_vo 0>, <&clk_vo 1>;
        clock-names = "gpu-core", "gpu-sys";
        mboxes = <&mbox_910t 1>;
        mbox-names = "aon";
        resets = <&rst 0>, <&rst 1>;
        reset-names = "gpu", "gpu-clkgen";
        #power-domain-cells = <1>;
    };
```
