## Documentation/devicetree/bindings/clock/sophgo/sophgo,sg2042-clkgen.yaml
```yaml
# SPDX-License-Identifier: (GPL-2.0 OR BSD-2-Clause)
%YAML 1.2
---
$id: http://devicetree.org/schemas/clock/sophgo/sophgo,sg2042-clkgen.yaml#
$schema: http://devicetree.org/meta-schemas/core.yaml#

title: Sophgo SG2042 Clock Generator

maintainers:
  - Chen Wang <unicorn_wang@outlook.com>

properties:
  compatible:
    items:
      - const: sophgo,sg2042-clkgen

  reg:
    maxItems: 1

  system-ctrl:
    $ref: /schemas/types.yaml#/definitions/phandle
    description: a phandle to SG2042 System Controller node.

  clocks:
    items:
      - description: Clock Generation IC (25 MHz)

  '#clock-cells':
    const: 1
    description:
      See <dt-bindings/clock/sophgo,sg2042-clkgen.h> for valid indices.

required:
  - compatible
  - reg
  - system-ctrl
  - clocks
  - '#clock-cells'

additionalProperties: false

examples:
  - |
    clock-controller@30012000 {
        compatible = "sophgo,sg2042-clkgen";
        reg = <0x30012000 0x1000>;
        system-ctrl = <&sys_ctrl>;
        clocks = <&cgi>;
        #clock-cells = <1>;
    };
```

## Documentation/devicetree/bindings/clock/ti/ti,autoidle.yaml
```yaml
# SPDX-License-Identifier: (GPL-2.0-only OR BSD-2-Clause)
%YAML 1.2
---
$id: http://devicetree.org/schemas/clock/ti/ti,autoidle.yaml#
$schema: http://devicetree.org/meta-schemas/core.yaml#

title: TI autoidle clock

maintainers:
  - Tero Kristo <kristo@kernel.org>
  - Sukrut Bellary <sbellary@baylibre.com>

description: |
  In TI SoC, some of the clocks support autoidle feature.
  It assumes a register mapped clock which can be put to idle automatically
  by hardware based on the usage and a configuration bit setting.
  Autoidle clock is never an individual clock, it is always a derivative
  of some basic clock like a gate, divider or fixed-factor.

properties:
  reg:
    maxItems: 1

  ti,autoidle-shift:
    $ref: /schemas/types.yaml#/definitions/uint32
    description:
      bit shift of the autoidle enable bit for the clock
    maximum: 31
    default: 0

  ti,invert-autoidle-bit:
    type: boolean
    description:
      autoidle is enabled by setting the bit to 0

additionalProperties: true

examples:
  - |
    bus {
      #address-cells = <1>;
      #size-cells = <0>;

      clock@1b4 {
        reg = <0x01b4>;
        ti,autoidle-shift = <8>;
        ti,invert-autoidle-bit;
      };
    };
```

## Documentation/devicetree/bindings/clock/ti/ti,clockdomain.yaml
```yaml
# SPDX-License-Identifier: (GPL-2.0-only OR BSD-2-Clause)
%YAML 1.2
---
$id: http://devicetree.org/schemas/clock/ti/ti,clockdomain.yaml#
$schema: http://devicetree.org/meta-schemas/core.yaml#

title: TI clock domain

maintainers:
  - Tero Kristo <kristo@kernel.org>
  - Sukrut Bellary <sbellary@baylibre.com>

description: |
  Every clock on TI SoC belongs to one clockdomain. For specific clocks, the
  parent clockdomain has to be controlled when the clock is enabled/disabled.
  This binding doesn't define a new clock binding type, it is used to group
  the existing clock nodes under hardware hierarchy.

properties:
  compatible:
    const: ti,clockdomain

  clocks:
    description:
      Clocks within this domain

required:
  - compatible
  - clocks

additionalProperties: false

examples:
  - |
    l3init_clkdm: l3init_clkdm {
        compatible = "ti,clockdomain";
        clocks = <&dpll_usb_ck>;
    };
```

## Documentation/devicetree/bindings/display/bridge/innosilicon,inno-hdmi.yaml
```yaml
# SPDX-License-Identifier: (GPL-2.0-only OR BSD-2-Clause)
%YAML 1.2
---
$id: http://devicetree.org/schemas/display/bridge/innosilicon,inno-hdmi.yaml#
$schema: http://devicetree.org/meta-schemas/core.yaml#

title: Common Properties for Innosilicon HDMI TX IP

maintainers:
  - keith zhao <keith.zhao@starfivetech.com>

description: |
  Innosilicon HDMI TX is an HDMI transmission device integrated into the zap SoC.
  This document specifies the device tree properties for the INNO HDMI IP core.
  It is intended to be referenced by platform-specific device tree bindings,
  which will determine the necessity of each property.

properties:
  reg:
    maxItems: 1

  interrupts:
    maxItems: 1

  ports:
    $ref: /schemas/graph.yaml#/properties/ports

    properties:
      port@0:
        $ref: /schemas/graph.yaml#/properties/port
        description:
          Port node with one endpoint connected to a display controller node.

      port@1:
        $ref: /schemas/graph.yaml#/properties/port
        description:
          Port node with one endpoint connected to a hdmi-connector node.

    required:
      - port@0
      - port@1

additionalProperties: true

...
```

## Documentation/devicetree/bindings/display/bridge/synopsys,dw-hdmi-qp.yaml
```yaml
# SPDX-License-Identifier: (GPL-2.0-only OR BSD-2-Clause)
%YAML 1.2
---
$id: http://devicetree.org/schemas/display/bridge/synopsys,dw-hdmi-qp.yaml#
$schema: http://devicetree.org/meta-schemas/core.yaml#

title: Common Properties for Synopsys DesignWare HDMI QP TX Controller IP

maintainers:
  - Cristian Ciocaltea <cristian.ciocaltea@collabora.com>

description: |
  This document defines device tree properties for the Synopsys DesignWare
  HDMI 2.1 Quad-Pixel (QP) TX controller IP core.
  It doesn't constitute a device tree binding specification by itself, but
  is meant to be referenced by platform-specific device tree bindings.

  When referenced from platform device tree bindings, the properties defined
  in this document are defined as follows. The platform device tree bindings
  are responsible for defining whether each property is required or optional.

properties:
  reg:
    maxItems: 1

  clocks:
    minItems: 4
    maxItems: 6
    items:
      - description: Peripheral/APB bus clock
      - description: EARC RX biphase clock
      - description: Reference clock
      - description: Audio interface clock
    additionalItems: true

  clock-names:
    minItems: 4
    maxItems: 6
    items:
      - const: pclk
      - const: earc
      - const: ref
      - const: aud
    additionalItems: true

  interrupts:
    minItems: 4
    maxItems: 5
    items:
      - description: AVP Unit interrupt
      - description: CEC interrupt
      - description: eARC RX interrupt
      - description: Main Unit interrupt
    additionalItems: true

  interrupt-names:
    minItems: 4
    maxItems: 5
    items:
      - const: avp
      - const: cec
      - const: earc
      - const: main
    additionalItems: true

additionalProperties: true
```

## Documentation/devicetree/bindings/display/mediatek/mediatek,blender.yaml
```yaml
# SPDX-License-Identifier: (GPL-2.0-only OR BSD-2-Clause)
%YAML 1.2
---
$id: http://devicetree.org/schemas/display/mediatek/mediatek,blender.yaml#
$schema: http://devicetree.org/meta-schemas/core.yaml#

title: MediaTek Display Overlap Blender

maintainers:
  - Chun-Kuang Hu <chunkuang.hu@kernel.org>
  - Philipp Zabel <p.zabel@pengutronix.de>

description:
  MediaTek display overlap blender, namely OVL_BLENDER or BLENDER,
  executes the alpha blending function for overlapping layers
  from different sources. This is the primary function of the
  overlapping system.

properties:
  compatible:
    const: mediatek,mt8196-blender

  reg:
    maxItems: 1

  clocks:
    items:
      - description: Overlap Blender Clock

required:
  - compatible
  - reg
  - clocks

additionalProperties: false

examples:
  - |
    #include <dt-bindings/clock/mt8196-clk.h>

    soc {
        #address-cells = <2>;
        #size-cells = <2>;

        disp_ovl0_blender0: blender@328d0000 {
            compatible = "mediatek,mt8196-blender";
            reg = <0 0x328d0000 0 0x1000>;
            clocks = <&ovlsys_config_clk CLK_OVL_BLENDER0_DISP>;
        };
    };
```

## Documentation/devicetree/bindings/display/nuvoton,ma35d1-dcu.yaml
```yaml
# SPDX-License-Identifier: (GPL-2.0-only OR BSD-2-Clause)
%YAML 1.2
---
$id: http://devicetree.org/schemas/display/nuvoton,ma35d1-dcu.yaml#
$schema: http://devicetree.org/meta-schemas/core.yaml#

title: Nuvoton MA35D1 DCUltra Lite display controller

maintainers:
  - Joey Lu <yclu4@nuvoton.com>

description:
  The Nuvoton MA35D1 integrates the Verisilicon DCUltra Lite display
  controller. It is a single-output display controller with a 32-bit
  RGB (DPI) interface.

select:
  properties:
    compatible:
      contains:
        enum:
          - nuvoton,ma35d1-dcu
  required:
    - compatible

allOf:
  - $ref: http://devicetree.org/schemas/display/verisilicon,dc.yaml#

properties:
  compatible:
    const: nuvoton,ma35d1-dcu

  reg:
    maxItems: 1
    description:
      Register range of the DCUltra Lite controller. The address space
      is 0x2000 bytes.

  interrupts:
    maxItems: 1

  clocks:
    items:
      - description: Bus clock that gates register access (DCU_GATE)
      - description: Pixel clock divider for display timing (DCUP_DIV)

  clock-names:
    items:
      - const: core
      - const: pix0

  resets:
    maxItems: 1
    description:
      Optional reset for the display controller. The driver does not
      assert or deassert this reset; it may be used by firmware or
      boot loaders to bring the hardware to a clean state.

  port:
    $ref: /schemas/graph.yaml#/properties/port
    description:
      Output port to the downstream display device (e.g. RGB panel).
      The DCUltra Lite supports a single parallel RGB output.

required:
  - compatible
  - reg
  - interrupts
  - clocks
  - clock-names
  - port

unevaluatedProperties: false

examples:
  - |
    #include <dt-bindings/interrupt-controller/arm-gic.h>
    #include <dt-bindings/clock/nuvoton,ma35d1-clk.h>
    #include <dt-bindings/reset/nuvoton,ma35d1-reset.h>

    display@40260000 {
        compatible = "nuvoton,ma35d1-dcu";
        reg = <0x40260000 0x2000>;
        interrupts = <GIC_SPI 20 IRQ_TYPE_LEVEL_HIGH>;
        clocks = <&clk DCU_GATE>, <&clk DCUP_DIV>;
        clock-names = "core", "pix0";
        resets = <&sys MA35D1_RESET_DISP>;

        port {
            dpi_out: endpoint {
                remote-endpoint = <&panel_in>;
            };
        };
    };
```

## Documentation/devicetree/bindings/display/panel/ilitek,ili9806e.yaml
```yaml
# SPDX-License-Identifier: (GPL-2.0-only OR BSD-2-Clause)
%YAML 1.2
---
$id: http://devicetree.org/schemas/display/panel/ilitek,ili9806e.yaml#
$schema: http://devicetree.org/meta-schemas/core.yaml#

title: Ilitek ILI9806E display panels

maintainers:
  - Luca Ceresoli <luca.ceresoli@bootlin.com>

description:
  This binding is for display panels using an Ilitek ILI9806E controller in
  SPI mode.

allOf:
  - $ref: panel-common.yaml#
  - $ref: /schemas/spi/spi-peripheral-props.yaml#

properties:
  compatible:
    items:
      - enum:
          # ShenZhen New Display Co 3.97" 480x800 RGB a-SI TFT LCD
          - newdisplay,nds040480800-v3
      - const: ilitek,ili9806e

  reg:
    maxItems: 1

required:
  - compatible
  - reg
  - port

unevaluatedProperties: false

examples:
  - |
    #include <dt-bindings/gpio/gpio.h>

    spi {
        #address-cells = <1>;
        #size-cells = <0>;

        display@0 {
            compatible = "newdisplay,nds040480800-v3", "ilitek,ili9806e";
            reg = <0>;
            spi-max-frequency = <1000000>;
            pinctrl-names = "default";
            pinctrl-0 = <&pinctrl_lcdgpios>;
            reset-gpios = <&gpio 26 GPIO_ACTIVE_LOW>;
            backlight = <&backlight>;

            port {
                ili9806e_in: endpoint {
                    remote-endpoint = <&lcdif_out>;
                };
            };
        };
    };

...
```

## Documentation/devicetree/bindings/display/sprd/sprd,sharkl3-dsi-host.yaml
```yaml
# SPDX-License-Identifier: (GPL-2.0-only OR BSD-2-Clause)
%YAML 1.2
---
$id: http://devicetree.org/schemas/display/sprd/sprd,sharkl3-dsi-host.yaml#
$schema: http://devicetree.org/meta-schemas/core.yaml#

title: Unisoc MIPI DSI Controller

maintainers:
  - Kevin Tang <kevin.tang@unisoc.com>

properties:
  compatible:
    enum:
      - sprd,sharkl3-dsi-host
      - sprd,ums9230-dsi-host

  reg:
    maxItems: 1

  interrupts:
    maxItems: 2

  clocks:
    maxItems: 1

  clock-names:
    oneOf:
      - deprecated: true
        items:
          - const: clk_src_96m
      - items:
          - const: pclk

  power-domains:
    maxItems: 1

  ports:
    type: object

    properties:
      "#address-cells":
        const: 1

      "#size-cells":
        const: 0

      port@0:
        $ref: /schemas/graph.yaml#/$defs/port-base
        unevaluatedProperties: false
        properties:
          endpoint:
            $ref: /schemas/media/video-interfaces.yaml#
            unevaluatedProperties: false
            description: The input endpoint, usually connected to the DPU

      port@1:
        $ref: /schemas/graph.yaml#/$defs/port-base
        unevaluatedProperties: false
        properties:
          endpoint:
            $ref: /schemas/media/video-interfaces.yaml#
            unevaluatedProperties: false
            description: The output endpoint, usually connected to the panel

    required:
      - "#address-cells"
      - "#size-cells"
      - port@0

    additionalProperties: false

allOf:
  - $ref: /schemas/display/dsi-controller.yaml#

required:
  - compatible
  - reg
  - interrupts
  - clocks
  - clock-names
  - ports

unevaluatedProperties: false

examples:
  - |
    #include <dt-bindings/interrupt-controller/arm-gic.h>
    #include <dt-bindings/clock/sprd,sc9860-clk.h>
    dsi: dsi@63100000 {
        compatible = "sprd,sharkl3-dsi-host";
        reg = <0x63100000 0x1000>;
        interrupts = <GIC_SPI 48 IRQ_TYPE_LEVEL_HIGH>,
          <GIC_SPI 49 IRQ_TYPE_LEVEL_HIGH>;
        clocks = <&pll CLK_TWPLL_96M>;
        clock-names = "pclk";

        ports {
            #address-cells = <1>;
            #size-cells = <0>;
            port@0 {
                reg = <0>;
                dsi_in: endpoint {
                    remote-endpoint = <&dpu_out>;
                };
            };
        };
    };
```
