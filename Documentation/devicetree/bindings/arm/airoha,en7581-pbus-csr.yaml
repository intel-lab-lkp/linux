## Documentation/devicetree/bindings/arm/airoha,en7581-pbus-csr.yaml
```yaml
# SPDX-License-Identifier: (GPL-2.0 OR BSD-2-Clause)
%YAML 1.2
---
$id: http://devicetree.org/schemas/arm/airoha,en7581-pbus-csr.yaml#
$schema: http://devicetree.org/meta-schemas/core.yaml#

title: Airoha Pbus CSR Controller for EN7581 SoC

maintainers:
  - Lorenzo Bianconi <lorenzo@kernel.org>

description:
  The airoha pbus-csr block provides a configuration interface for the PBUS
  controller used to detect if a given address is on PCIE0, PCIE1 or PCIE2.

properties:
  compatible:
    items:
      - enum:
          - airoha,en7581-pbus-csr
      - const: syscon

  reg:
    maxItems: 1

required:
  - compatible
  - reg

additionalProperties: false

examples:
  - |
    soc {
      #address-cells = <2>;
      #size-cells = <2>;
      syscon@1fbe3400 {
        compatible = "airoha,en7581-pbus-csr", "syscon";
        reg = <0x0 0x1fbe3400 0x0 0xff>;
      };
    };
```

## Documentation/devicetree/bindings/auxdisplay/titanmec,tm1637.yaml
```yaml
# SPDX-License-Identifier: (GPL-2.0-only OR BSD-2-Clause)
%YAML 1.2
---
$id: http://devicetree.org/schemas/auxdisplay/titanmec,tm1637.yaml#
$schema: http://devicetree.org/meta-schemas/core.yaml#

title: TM1637 7-segment LED display controller

maintainers:
  - Siratul Islam <email@sirat.me>

description:
  The TM1637 is a 7-segment LED display controller with a two-wire serial
  interface. It can drive up to 4 digits and includes brightness control.

properties:
  compatible:
    const: titanmec,tm1637

  clk-gpios:
    maxItems: 1
    description: GPIO for clock line

  dio-gpios:
    maxItems: 1
    description: GPIO for data input/output line

required:
  - compatible
  - clk-gpios
  - dio-gpios

additionalProperties: false

examples:
  - |
    #include <dt-bindings/gpio/gpio.h>

    display {
        compatible = "titanmec,tm1637";
        clk-gpios = <&gpio 23 GPIO_ACTIVE_HIGH>;
        dio-gpios = <&gpio 24 GPIO_ACTIVE_HIGH>;
    };
```

## Documentation/devicetree/bindings/bus/qcom,soc-sc7180.yaml
```yaml
# SPDX-License-Identifier: (GPL-2.0-only OR BSD-2-Clause)
%YAML 1.2
---
$id: http://devicetree.org/schemas/bus/qcom,soc-sc7180.yaml#
$schema: http://devicetree.org/meta-schemas/core.yaml#

title: Qualcomm SC7180 SoC

maintainers:
  - Bjorn Andersson <andersson@kernel.org>
  - Konrad Dybcio <konradybcio@kernel.org>

description:
  Qualcomm's SC7180 System on a Chip (SoC).

properties:
  compatible:
    items:
      - const: qcom,soc-sc7180
      - const: simple-bus

  '#address-cells':
    const: 2

  '#size-cells':
    const: 2

  clock-controller@100000:
    $ref: /schemas/clock/qcom,gcc-sc7180.yaml#

  watchdog@17c10000:
    $ref: /schemas/watchdog/qcom-wdt.yaml#

required:
  - compatible
  - '#address-cells'
  - '#size-cells'
  - clock-controller@100000
  - watchdog@17c10000

additionalProperties: false

examples:
  - |
    #include <dt-bindings/gpio/gpio.h>
    #include <dt-bindings/interrupt-controller/irq.h>
    #include <dt-bindings/interrupt-controller/arm-gic.h>

    soc {
        #address-cells = <2>;
        #size-cells = <2>;
        compatible = "qcom,soc-sc7180", "simple-bus";

        // TODO: Is it possible to ignore the details?
        clock-controller@100000 {
          compatible = "qcom,gcc-sc7180";
          reg = <0 0x00100000 0 0x1f0000>;
          clocks = <&rpmhcc_RPMH_CXO_CLK>,
                   <&rpmhcc_RPMH_CXO_CLK_A>,
                   <&sleep_clk>;
          clock-names = "bi_tcxo", "bi_tcxo_ao", "sleep_clk";
          #clock-cells = <1>;
          #reset-cells = <1>;
          #power-domain-cells = <1>;
          power-domains = <&rpmhpd_SC7180_CX>;
        };

        watchdog@17c10000 {
          compatible = "qcom,apss-wdt-sc7180", "qcom,kpss-wdt";
          reg = <0 0x17c10000 0 0x1000>;
          clocks = <&sleep_clk>;
          interrupts = <GIC_SPI 0 IRQ_TYPE_EDGE_RISING>;
        };
    };

...
```

## Documentation/devicetree/bindings/chrome/google,cros-ec-typec.yaml
```yaml
# SPDX-License-Identifier: (GPL-2.0-only OR BSD-2-Clause)
%YAML 1.2
---
$id: http://devicetree.org/schemas/chrome/google,cros-ec-typec.yaml#
$schema: http://devicetree.org/meta-schemas/core.yaml#

title: Google Chrome OS EC(Embedded Controller) Type C port driver.

maintainers:
  - Benson Leung <bleung@chromium.org>
  - Prashant Malani <pmalani@chromium.org>

description:
  Chrome OS devices have an Embedded Controller(EC) which has access to
  Type C port state. This node is intended to allow the host to read and
  control the Type C ports. The node for this device should be under a
  cros-ec node like google,cros-ec-spi.

properties:
  compatible:
    const: google,cros-ec-typec

  '#address-cells':
    const: 1

  '#size-cells':
    const: 0

  mux-gpios:
    description: GPIOs indicating which way the DP mux is steered
    maxItems: 1

  no-hpd:
    description: Indicates this endpoint doesn't signal HPD for DisplayPort
    type: boolean

  orientation:
    description:
      Indicates this endpoint assigns lanes based on altmode and
      type-c port orientation
    type: boolean

  ports:
    $ref: /schemas/graph.yaml#/properties/ports

    properties:
      port@0:
        $ref: /schemas/graph.yaml#/$defs/port-base
        description:
          Input port to receive DisplayPort (DP) data
        unevaluatedProperties: false

        properties:
          endpoint@0:
            $ref: /schemas/graph.yaml#/$defs/endpoint-base
            description: DisplayPort data for the type-c port(s)
            unevaluatedProperties: false
            properties:
              data-lanes:
                $ref: /schemas/types.yaml#/definitions/uint32-array
                description: |
                  An array of physical DP data lane indexes
                  - 0 is DP ML0 lane
                  - 1 is DP ML1 lane
                  - 2 is DP ML2 lane
                  - 3 is DP ML3 lane
                oneOf:
                  - items:
                      - const: 0
                      - const: 1
                  - items:
                      - const: 0
                      - const: 1
                      - const: 2
                      - const: 3

        required:
          - endpoint@0

      port@1:
        $ref: /schemas/graph.yaml#/$defs/port-base
        unevaluatedProperties: false
        description:
          Input port to receive USB SuperSpeed (SS) data
        patternProperties:
          "^endpoint@([0-8])$":
            $ref: /schemas/graph.yaml#/properties/endpoint

        anyOf:
          - required:
              - endpoint@0
          - required:
              - endpoint@1
          - required:
              - endpoint@2
          - required:
              - endpoint@3
          - required:
              - endpoint@4
          - required:
              - endpoint@5
          - required:
              - endpoint@6
          - required:
              - endpoint@7
          - required:
              - endpoint@8

      port@2:
        $ref: /schemas/graph.yaml#/$defs/port-base
        unevaluatedProperties: false
        description: Output ports for combined DP and USB SS data
        patternProperties:
          "^endpoint@([0-8])$":
            $ref: /schemas/graph.yaml#/$defs/endpoint-base
            unevaluatedProperties: false

            properties:
              data-lanes:
                $ref: /schemas/types.yaml#/definitions/uint32-array
                description: |
                  An array of physical USB Type-C data lane indexes.
                  - 0 is SSRX1 lane
                  - 1 is SSTX1 lane
                  - 2 is SSTX2 lane
                  - 3 is SSRX2 lane
                minItems: 4
                maxItems: 4
                items:
                  maximum: 3

        anyOf:
          - required:
              - endpoint@0
          - required:
              - endpoint@1
          - required:
              - endpoint@2
          - required:
              - endpoint@3
          - required:
              - endpoint@4
          - required:
              - endpoint@5
          - required:
              - endpoint@6
          - required:
              - endpoint@7
          - required:
              - endpoint@8

    required:
      - port@2
    anyOf:
      - required:
          - port@0
      - required:
          - port@1

patternProperties:
  '^connector@[0-9a-f]+$':
    $ref: /schemas/connector/usb-connector.yaml#
    required:
      - reg

required:
  - compatible

allOf:
  - if:
      properties:
        no-hpd: true
      required:
        - no-hpd
    then:
      properties:
        ports:
          required:
            - port@0
  - if:
      properties:
        mux-gpios: true
      required:
        - mux-gpios
    then:
      properties:
        ports:
          required:
            - port@0
  - if:
      properties:
        orientation: true
      required:
        - orientation
    then:
      properties:
        ports:
          required:
            - port@0

additionalProperties: false

examples:
  - |+
    spi {
      #address-cells = <1>;
      #size-cells = <0>;

      cros_ec: ec@0 {
        compatible = "google,cros-ec-spi";
        reg = <0>;
        interrupts = <35 0>;

        typec {
          compatible = "google,cros-ec-typec";

          #address-cells = <1>;
          #size-cells = <0>;

          connector@0 {
            compatible = "usb-c-connector";
            reg = <0>;
            power-role = "dual";
            data-role = "dual";
            try-power-role = "source";

            ports {
              #address-cells = <1>;
              #size-cells = <0>;

              port@0 {
                reg = <0>;
                usb_c0_hs: endpoint {
                  remote-endpoint = <&usb_hub_dfp3_hs>;
                };
              };

              port@1 {
                reg = <1>;
                usb_c0_ss: endpoint {
                  remote-endpoint = <&cros_typec_c0_ss>;
                };
              };
            };
          };

          connector@1 {
            compatible = "usb-c-connector";
            reg = <1>;
            power-role = "dual";
            data-role = "dual";
            try-power-role = "source";

            ports {
              #address-cells = <1>;
              #size-cells = <0>;

              port@0 {
                reg = <0>;
                usb_c1_hs: endpoint {
                  remote-endpoint = <&usb_hub_dfp2_hs>;
                };
              };

              port@1 {
                reg = <1>;
                usb_c1_ss: endpoint {
                  remote-endpoint = <&cros_typec_c1_ss>;
                };
              };
            };
          };

          ports {
            #address-cells = <1>;
            #size-cells = <0>;

            port@0 {
              reg = <0>;
              #address-cells = <1>;
              #size-cells = <0>;

              dp_in: endpoint@0 {
                reg = <0>;
                remote-endpoint = <&dp_phy>;
                data-lanes = <0 1>;
              };
            };

            port@1 {
              reg = <1>;
              #address-cells = <1>;
              #size-cells = <0>;

              usb_in_0: endpoint@0 {
                reg = <0>;
                remote-endpoint = <&usb_ss_0_out>;
              };

              usb_in_1: endpoint@1 {
                reg = <1>;
                remote-endpoint = <&usb_ss_1_out>;
              };
            };

            port@2 {
              reg = <2>;
              #address-cells = <1>;
              #size-cells = <0>;

              cros_typec_c0_ss: endpoint@0 {
                reg = <0>;
                remote-endpoint = <&usb_c0_ss>;
                data-lanes = <0 1 2 3>;
              };

              cros_typec_c1_ss: endpoint@1 {
                reg = <1>;
                remote-endpoint = <&usb_c1_ss>;
                data-lanes = <2 3 0 1>;
              };
            };
          };
        };
      };
    };
```

## Documentation/devicetree/bindings/chrome/google,pogo-pin-connector.yaml
```yaml
# SPDX-License-Identifier: (GPL-2.0-only OR BSD-2-Clause)
%YAML 1.2
---
$id: http://devicetree.org/schemas/chrome/google,pogo-pin-connector.yaml#
$schema: http://devicetree.org/meta-schemas/core.yaml#

title: Google Pogo Pin Connector

maintainers:
  - Stephen Boyd <swboyd@chromium.org>

description:
  ChromeOS devices with a detachable keyboard have a set of five pins called
  pogo pins that are the typical four pins for USB (D+/D-, vbus, ground) and an
  extra pin for base detection. The detachable keyboard is a USB device that
  connects to the pogo pins.

properties:
  compatible:
    const: google,pogo-pin-connector

  '#address-cells':
    const: 1

  '#size-cells':
    const: 0

  port:
    $ref: /schemas/graph.yaml#/properties/port
    description: Connection to USB2 port providing USB signals
    required:
      - endpoint

patternProperties:
  "^keyboard@[0-9a-f]{1,2}$":
    description: The detachable keyboard
    type: object
    $ref: /schemas/usb/usb-device.yaml
    unevaluatedProperties: false

required:
  - compatible
  - '#address-cells'
  - '#size-cells'
  - port

additionalProperties: false

examples:
  - |
    connector {
      compatible = "google,pogo-pin-connector";
      #address-cells = <1>;
      #size-cells = <0>;

      keyboard@2 {
        compatible = "usb18d1,504c";
        reg = <2>;
      };

      port {
        pogo_connector_in: endpoint {
          remote-endpoint = <&usb_hub_dsp3_hs>;
        };
      };
    };

...
```

## Documentation/devicetree/bindings/clock/qcom,sm7150-gcc.yaml
```yaml
# SPDX-License-Identifier: (GPL-2.0-only OR BSD-2-Clause)
%YAML 1.2
---
$id: http://devicetree.org/schemas/clock/qcom,sm7150-gcc.yaml#
$schema: http://devicetree.org/meta-schemas/core.yaml#

title: Qualcomm Global Clock & Reset Controller on SM7150

maintainers:
  - Bjorn Andersson <andersson@kernel.org>
  - Danila Tikhonov <danila@jiaxyga.com>
  - David Wronek <davidwronek@gmail.com>

description: |
  Qualcomm global clock control module provides the clocks, resets and power
  domains on SM7150

  See also:: include/dt-bindings/clock/qcom,sm7150-gcc.h

properties:
  compatible:
    const: qcom,sm7150-gcc

  clocks:
    items:
      - description: Board XO source
      - description: Board XO Active-Only source
      - description: Sleep clock source

  power-domains:
    maxItems: 1
    description:
      CX power domain.

required:
  - compatible
  - clocks
  - power-domains

allOf:
  - $ref: qcom,gcc.yaml#

unevaluatedProperties: false

examples:
  - |
    #include <dt-bindings/clock/qcom,rpmh.h>
    #include <dt-bindings/power/qcom,rpmhpd.h>
    clock-controller@100000 {
      compatible = "qcom,sm7150-gcc";
      reg = <0x00100000 0x001f0000>;
      clocks = <&rpmhcc RPMH_CXO_CLK>,
               <&rpmhcc RPMH_CXO_CLK_A>,
               <&sleep_clk>;
      power-domains = <&rpmhpd RPMHPD_CX>;
      #clock-cells = <1>;
      #reset-cells = <1>;
      #power-domain-cells = <1>;
    };
...
```
