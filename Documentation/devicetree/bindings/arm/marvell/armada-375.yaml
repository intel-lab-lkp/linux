## Documentation/devicetree/bindings/arm/marvell/armada-375.yaml
```yaml
# SPDX-License-Identifier: (GPL-2.0-only OR BSD-2-Clause)
%YAML 1.2
---
$id: http://devicetree.org/schemas/arm/marvell/armada-375.yaml#
$schema: http://devicetree.org/meta-schemas/core.yaml#

title: Marvell Armada 375 Platforms

maintainers:
  - Aryabhatta Dey <aryabhattadey35@gmail.com>

properties:
  $nodename:
    const: '/'
  compatible:
    oneOf:

      - description:
          Marvell Armada 375
        items:
          - const: marvell,armada375

additionalProperties: true
```

## Documentation/devicetree/bindings/arm/marvell/armada-380-mpcore-soc-ctrl.yaml
```yaml
# SPDX-License-Identifier: (GPL-2.0-only OR BSD-2-Clause)
%YAML 1.2
---
$id: http://devicetree.org/schemas/arm/marvell/armada-380-mpcore-soc-ctrl.yaml#
$schema: http://devicetree.org/meta-schemas/core.yaml#

title: Marvell Armada 38x CA9 MPcore SoC Controller

maintainers:
  - Andrew Lunn <andrew@lunn.ch>
  - Gregory Clement <gregory.clement@bootlin.com>
  - Sebastian Hesselbarth <sebastian.hesselbarth@gmail.com>

properties:
  compatible:
    const: marvell,armada-380-mpcore-soc-ctrl

  reg:
    maxItems: 1

required:
  - compatible
  - reg

additionalProperties: false

examples:
  - |
    mpcore-soc-ctrl@20d20 {
        compatible = "marvell,armada-380-mpcore-soc-ctrl";
        reg = <0x20d20 0x6c>;
    };
```

## Documentation/devicetree/bindings/arm/mediatek/mediatek,audsys.yaml
```yaml
# SPDX-License-Identifier: (GPL-2.0 OR BSD-2-Clause)
%YAML 1.2
---
$id: http://devicetree.org/schemas/arm/mediatek/mediatek,audsys.yaml#
$schema: http://devicetree.org/meta-schemas/core.yaml#

title: MediaTek AUDSYS controller

maintainers:
  - Eugen Hristev <eugen.hristev@collabora.com>

description:
  The MediaTek AUDSYS controller provides various clocks to the system.

properties:
  compatible:
    oneOf:
      - items:
          - enum:
              - mediatek,mt2701-audsys
              - mediatek,mt6765-audsys
              - mediatek,mt6779-audsys
              - mediatek,mt7622-audsys
              - mediatek,mt8167-audsys
              - mediatek,mt8173-audsys
              - mediatek,mt8183-audsys
              - mediatek,mt8186-audsys
              - mediatek,mt8192-audsys
              - mediatek,mt8516-audsys
          - const: syscon
      - items:
          # Special case for mt7623 for backward compatibility
          - const: mediatek,mt7623-audsys
          - const: mediatek,mt2701-audsys
          - const: syscon

  reg:
    maxItems: 1

  '#clock-cells':
    const: 1

  audio-controller:
    #  $ref: /schemas/sound/mt2701-afe-pcm.yaml#
    type: object

required:
  - compatible
  - reg

additionalProperties: false

examples:
  - |
    soc {
        #address-cells = <2>;
        #size-cells = <2>;
        audsys: clock-controller@11220000 {
            compatible = "mediatek,mt7622-audsys", "syscon";
            reg = <0 0x11220000 0 0x2000>;
            #clock-cells = <1>;

            audio-controller {
            };
        };
    };
```

## Documentation/devicetree/bindings/arm/mediatek/mediatek,mt2701-hifsys.yaml
```yaml
# SPDX-License-Identifier: GPL-2.0-only OR BSD-2-Clause
%YAML 1.2
---
$id: http://devicetree.org/schemas/arm/mediatek/mediatek,mt2701-hifsys.yaml#
$schema: http://devicetree.org/meta-schemas/core.yaml#

title: Mediatek hifsys controller

description:
  The Mediatek hifsys controller provides various clocks and reset outputs to
  the system.

maintainers:
  - Matthias Brugger <matthias.bgg@gmail.com>

properties:
  compatible:
    oneOf:
      - items:
          - const: mediatek,mt2701-hifsys
          - const: syscon
      - items:
          - enum:
              - mediatek,mt7623-hifsys
          - const: mediatek,mt2701-hifsys
          - const: syscon
      - items:
          - const: mediatek,mt7622-hifsys
          - const: syscon

  reg:
    maxItems: 1

  "#clock-cells":
    const: 1
    description: The available clocks are defined in dt-bindings/clock/mt*-clk.h

  "#reset-cells":
    const: 1

required:
  - reg
  - "#clock-cells"

additionalProperties: false

examples:
  - |
    clock-controller@1a000000 {
        compatible = "mediatek,mt2701-hifsys", "syscon";
        reg = <0x1a000000 0x1000>;
        #clock-cells = <1>;
        #reset-cells = <1>;
    };
```

## Documentation/devicetree/bindings/arm/microchip,lan969x.yaml
```yaml
# SPDX-License-Identifier: (GPL-2.0-only OR BSD-2-Clause)
%YAML 1.2
---
$id: http://devicetree.org/schemas/arm/microchip,lan969x.yaml#
$schema: http://devicetree.org/meta-schemas/core.yaml#

title: Microchip LAN969x Boards

maintainers:
  - Robert Marko <robert.marko@sartura.hr>

description: |+
   The Microchip LAN969x SoC is a ARMv8-based used in a family of
   multi-port, multi-gigabit switches.

properties:
  $nodename:
    const: '/'
  compatible:
    oneOf:
      - description: The LAN969x EVB (EV23X71A) is a 24x 1G + 4x 10G
          Ethernet development system board.
        items:
          - const: microchip,ev23x71a
          - const: microchip,lan969x

required:
  - compatible

additionalProperties: true

...
```

## Documentation/devicetree/bindings/arm/omap/ti,omap-counter32k.yaml
```yaml
# SPDX-License-Identifier: (GPL-2.0-only OR BSD-2-Clause)
%YAML 1.2
---
$id: http://devicetree.org/schemas/arm/omap/ti,omap-counter32k.yaml#
$schema: http://devicetree.org/meta-schemas/core.yaml#

title: Texas Instruments OMAP Counter-32K

maintainers:
  - Eduard Bostina <egbostina@gmail.com>

properties:
  compatible:
    oneOf:
      - const: ti,omap-counter32k
      - items:
          - const: ti,am4372-counter32k
          - const: ti,omap-counter32k

  reg:
    maxItems: 1

  ti,hwmods:
    description: Name of the hwmod associated to the counter
    $ref: /schemas/types.yaml#/definitions/string-array
    items:
      - const: counter_32k

required:
  - compatible
  - reg

additionalProperties: false

examples:
  - |
    counter@4a304000 {
        compatible = "ti,omap-counter32k";
        reg = <0x4a304000 0x20>;
        ti,hwmods = "counter_32k";
    };
```

## Documentation/devicetree/bindings/arm/omap/ti,omap-l3-noc.yaml
```yaml
# SPDX-License-Identifier: (GPL-2.0-only OR BSD-2-Clause)
%YAML 1.2
---
$id: http://devicetree.org/schemas/arm/omap/ti,omap-l3-noc.yaml#
$schema: http://devicetree.org/meta-schemas/core.yaml#

title: TI OMAP L3 Network On Chip (NoC) Interconnect

maintainers:
  - Santosh Shilimkar <santosh.shilimkar@ti.com>
  - Sricharan R <r.sricharan@ti.com>

description:
  The L3 interconnect is an implementation of the generic NoC IP provided by
  Arteris. OMAP3 uses the SMX variant while OMAP4/5, DRA7, and AM4372 use the
  NoC variant.

properties:
  compatible:
    oneOf:
      - items:
          - const: ti,omap3-l3-smx
          - const: simple-bus
      - enum:
          - ti,omap4-l3-noc
          - ti,omap5-l3-noc
          - ti,dra7-l3-noc
          - ti,am4372-l3-noc

  reg:
    minItems: 1
    maxItems: 3

  interrupts:
    minItems: 2
    maxItems: 2

  ti,hwmods:
    description: hwmod names for each NoC domain.
    $ref: /schemas/types.yaml#/definitions/string-array
    deprecated: true

  "#address-cells":
    const: 1

  "#size-cells":
    const: 1

  ranges: true

patternProperties:
  "^(.*@[0-9a-fA-F]+|regulator-abb-mpu)$":
    type: object

required:
  - compatible
  - reg
  - interrupts

allOf:
  - if:
      properties:
        compatible:
          contains:
            const: ti,omap3-l3-smx
    then:
      properties:
        reg:
          maxItems: 1
        ti,hwmods:
          maxItems: 1
      required:
        - "#address-cells"
        - "#size-cells"
        - ranges

  - if:
      properties:
        compatible:
          contains:
            enum:
              - ti,omap4-l3-noc
              - ti,omap5-l3-noc
    then:
      properties:
        reg:
          minItems: 3
        "#address-cells": false
        "#size-cells": false
        ranges: false
      patternProperties:
        "^(.*@[0-9a-fA-F]+|regulator-abb-mpu)$": false

  - if:
      properties:
        compatible:
          contains:
            const: ti,dra7-l3-noc
    then:
      properties:
        reg:
          minItems: 2
          maxItems: 3
        "#address-cells": false
        "#size-cells": false
        ranges: false
      patternProperties:
        "^(.*@[0-9a-fA-F]+|regulator-abb-mpu)$": false

  - if:
      properties:
        compatible:
          contains:
            const: ti,am4372-l3-noc
    then:
      properties:
        reg:
          minItems: 2
          maxItems: 2
        "#address-cells": false
        "#size-cells": false
        ranges: false
      patternProperties:
        "^(.*@[0-9a-fA-F]+|regulator-abb-mpu)$": false

additionalProperties: false

examples:
  - |
    l3-noc@68000000 {
        compatible = "ti,omap3-l3-smx", "simple-bus";
        #address-cells = <1>;
        #size-cells = <1>;
        ranges;
        reg = <0x68000000 0x10000>;
        interrupts = <9>, <10>;
        ti,hwmods = "l3_main";
    };

  - |
    #include <dt-bindings/interrupt-controller/arm-gic.h>
    l3-noc@44000000 {
        compatible = "ti,omap4-l3-noc";
        reg = <0x44000000 0x1000>,
              <0x44800000 0x2000>,
              <0x45000000 0x1000>;
        interrupts = <GIC_SPI 9 IRQ_TYPE_LEVEL_HIGH>,
                     <GIC_SPI 10 IRQ_TYPE_LEVEL_HIGH>;
    };
```

## Documentation/devicetree/bindings/arm/omap/ti,omap3-c64.yaml
```yaml
# SPDX-License-Identifier: (GPL-2.0-only OR BSD-2-Clause)
%YAML 1.2
---
$id: http://devicetree.org/schemas/arm/omap/ti,omap3-c64.yaml#
$schema: http://devicetree.org/meta-schemas/core.yaml#

title: Texas Instruments DSP (Digital Signal Processor)

maintainers:
  - Eduard Bostina <egbostina@gmail.com>

properties:
  compatible:
    const: ti,omap3-c64

  ti,hwmods:
    description: Name of the hwmod associated to the dsp
    $ref: /schemas/types.yaml#/definitions/string-array
    items:
      - const: dsp

required:
  - compatible

additionalProperties: false

examples:
  - |
    dsp {
        compatible = "ti,omap3-c64";
        ti,hwmods = "dsp";
    };
```

## Documentation/devicetree/bindings/arm/qcom,coresight-ccu.yaml
```yaml
# SPDX-License-Identifier: (GPL-2.0-only OR BSD-2-Clause)
%YAML 1.2
---
$id: http://devicetree.org/schemas/arm/qcom,coresight-ccu.yaml#
$schema: http://devicetree.org/meta-schemas/core.yaml#

title: CoreSight Control Unit

maintainers:
  - Yuanfang Zhang <quic_yuanfang@quicinc.com>
  - Mao Jinlong <quic_jinlmao@quicinc.com>
  - Jie Gan <quic_jiegan@quicinc.com>

description:
  The Coresight Control unit controls various Coresight behaviors.
  Used to enable/disable ETR’s data filter function based on trace ID.

properties:
  compatible:
    const: qcom,coresight-ccu

  reg:
    maxItems: 1

  clocks:
    maxItems: 1

  clock-names:
    items:
      - const: apb_pclk

  reg-names:
    items:
      - const: ccu-base

  in-ports:
    $ref: /schemas/graph.yaml#/properties/ports

    unevaluatedProperties:
      patternProperties:
        '^port(@[0-7])?$':
          description: Input connections from CoreSight Trace bus
          $ref: /schemas/graph.yaml#/properties/port

          properties:
            qcom,ccu-atid-offset:
              description:
                Offset to the Coresight Control Unit component's ATID register
                that is used by specific TMC ETR. The ATID register can be programed based
                on the trace id to filter out specific trace data which gets into ETR buffer.
              $ref: /schemas/types.yaml#/definitions/uint32

required:
  - compatible
  - reg
  - in-ports

additionalProperties: false

examples:
  - |
    syscon@1001000 {
        compatible = "qcom,coresight-ccu";
        reg = <0x1001000 0x1000>;
        reg-names = "ccu-base";

        in-ports {
            #address-cells = <1>;
            #size-cells = <0>;

            port@0 {
                reg = <0>;
                ccu_in_port0: endpoint {
                    qcom,ccu-atid-offset = <0x1f>;
                    remote-endpoint = <&etr0_out_port>;
                };
            };

            port@1 {
                reg = <1>;
                ccu_in_port1: endpoint {
                    qcom,ccu-atid-offset = <0x2f>;
                    remote-endpoint = <&etr1_out_port>;
                };
            };
        };
    };
```

## Documentation/devicetree/bindings/arm/qcom,coresight-csr.yaml
```yaml
# SPDX-License-Identifier: (GPL-2.0-only OR BSD-2-Clause)
%YAML 1.2
---
$id: http://devicetree.org/schemas/arm/qcom,coresight-csr.yaml#
$schema: http://devicetree.org/meta-schemas/core.yaml#

title: CoreSight Slave Register

maintainers:
  - Yuanfang Zhang <quic_yuanfang@quicinc.com>
  - Mao Jinlong <quic_jinlmao@quicinc.com>
  - Jie Gan <quic_jiegan@quicinc.com>

description:
  The Coresight Slave Register controls various Coresight behaviors.
  Used to enable/disable ETR’s data filter function based on trace ID.

properties:
  compatible:
    const: qcom,coresight-csr

  reg:
    maxItems: 1

  clocks:
    maxItems: 1

  clock-names:
    maxItems: 1
    items:
      - const: apb_pclk

  reg-names:
    items:
      - const: csr-base

  in-ports:
    $ref: /schemas/graph.yaml#/properties/ports

    patternProperties:
      '^port(@[0-7])?$':
        description: Input connections from CoreSight Trace bus
        $ref: /schemas/graph.yaml#/properties/port

required:
  - compatible
  - reg
  - in-ports

additionalProperties: false

examples:
  - |
    syscon@10001000 {
        compatible = "qcom,coresight-csr";
        reg = <0x0 0x10001000 0x0 0x1000>;
        reg-names = "csr-base";

        in-ports {
            #address-cells = <1>;
            #size-cells = <0>;

            port@0 {
                reg = <0>;
                csr_in_port0: endpoint {
                    remote-endpoint = <&etr0_out_port>;
                };
            };

            port@1 {
                reg = <1>;
                csr_in_port1: endpoint {
                    remote-endpoint = <&etr1_out_port>;
                };
            };
        };
```

## Documentation/devicetree/bindings/arm/qcom,coresight-remote-etm.yaml
```yaml
# SPDX-License-Identifier: GPL-2.0-only OR BSD-2-Clause
%YAML 1.2
---
$id: http://devicetree.org/schemas/arm/qcom,coresight-remote-etm.yaml#
$schema: http://devicetree.org/meta-schemas/core.yaml#

title: Qualcomm Coresight Remote ETM(Embedded Trace Macrocell)

maintainers:
  - Jinlong Mao <quic_jinlmao@quicinc.com>
  - Tao Zhang <quic_taozha@quicinc.com>

description:
  Support for ETM trace collection on remote processor using coresight
  framework. Enabling this will allow turning on ETM tracing on remote
  processor like modem processor via sysfs and collecting the trace
  via coresight TMC sinks.

properties:
  compatible:
    const: qcom,coresight-remote-etm

  qcom,qmi-instance-id:
    $ref: /schemas/types.yaml#/definitions/uint32
    description:
      Each remote processor has a unique instance id to establish the
      QMI connection.

  out-ports:
    $ref: /schemas/graph.yaml#/properties/ports
    additionalProperties: false

    properties:
      port:
        description: Output connection to the CoreSight Trace bus.
        $ref: /schemas/graph.yaml#/properties/port

required:
  - compatible
  - out-ports
  - qcom,qmi-instance-id

additionalProperties: false

examples:
  - |
    etm {
        compatible = "qcom,coresight-remote-etm";

        qcom,qmi-instance-id = <2>;

        out-ports {
            port {
                modem_etm0_out_funnel_modem: endpoint {
                    remote-endpoint = <&funnel_modem_in_modem_etm0>;
                };
            };
        };
    };
...
```
