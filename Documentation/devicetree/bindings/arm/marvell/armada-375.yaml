## Documentation/devicetree/bindings/ata/eswin,eic7700-sata.yaml
```yaml
# SPDX-License-Identifier: (GPL-2.0-only OR BSD-2-Clause)
%YAML 1.2
---
$id: http://devicetree.org/schemas/ata/eswin,eic7700-sata.yaml#
$schema: http://devicetree.org/meta-schemas/core.yaml#

title: Eswin EIC7700 SoC SATA Controller

maintainers:
  - Yulin Lu <luyulin@eswincomputing.com>
  - Huan He <hehuan1@eswincomputing.com>

description: |
  This binding describes the SATA controller integrated in the Eswin EIC7700 SoC.
  The controller is compatible with the AHCI (Advanced Host Controller Interface)
  specification and supports up to 1 port.

properties:
  compatible:
    const: eswin,eic7700-ahci

  reg:
    maxItems: 1
    description: Address range of the SATA registers

  interrupt-names:
    items:
      - const: intrq
      - const: msi
      - const: pme

  interrupts:
    maxItems: 3
    description: The SATA interrupt numbers

  ports-implemented:
    maximum: 0x1

  resets:
    maxItems: 1
    description: resets to be used by the controller.

  reset-names:
    const: apb

  '#address-cells':
    const: 2

  '#size-cells':
    const: 2

  eswin,hsp_sp_csr:
    $ref: /schemas/types.yaml#/definitions/phandle-array
    description: hsp_sp_csr regs to be used by the controller.

required:
  - compatible
  - reg
  - interrupt-names
  - interrupts
  - resets
  - reset-names
  - eswin,hsp_sp_csr

additionalProperties: false

examples:
  - |
    sata: sata@50420000 {
      compatible = "eswin,eic7700-ahci";
      reg = <0x50420000 0x10000>;
      interrupt-parent = <&plic>;
      interrupt-names = "intrq", "msi", "pme";
      interrupts = <58>, <59>, <60>;
      ports-implemented = <0x1>;
      resets = <&reset 7 (1 << 27)>;
      reset-names = "apb";
      #size-cells = <2>;
      eswin,hsp_sp_csr = <&hsp_sp_csr 0x1050>;
    };
```

## Documentation/devicetree/bindings/auxdisplay/maxim,max6959.yaml
```yaml
# SPDX-License-Identifier: (GPL-2.0-only OR BSD-2-Clause)
%YAML 1.2
---
$id: http://devicetree.org/schemas/auxdisplay/maxim,max6959.yaml#
$schema: http://devicetree.org/meta-schemas/core.yaml#

title: MAX6958/6959 7-segment LED display controller with keyscan

maintainers:
  - Andy Shevchenko <andriy.shevchenko@linux.intel.com>

properties:
  compatible:
    const: maxim,max6959

  reg:
    maxItems: 1

required:
  - compatible
  - reg

additionalProperties: false

examples:
  - |
    i2c {
            #address-cells = <1>;
            #size-cells = <0>;

            max6959: max6959@38 {
                    compatible = "maxim,max6959";
                    reg = <0x38>;
            };
      };
```

## Documentation/devicetree/bindings/axis-fifo/xlnx,axi-fifo-mm-s.yaml
```yaml
# SPDX-License-Identifier: (GPL-2.0-only OR BSD-2-Clause)
%YAML 1.2
---
$id: http://devicetree.org/schemas/axis-fifo/xlnx,axi-fifo-mm-s.yaml#
$schema: http://devicetree.org/meta-schemas/core.yaml#

title: Xilinx AXI-Stream FIFO v4.1 IP core

maintainers:
  - Daniel Matyas <matyasdaniel005@gmail.com>

description: |
  This IP core has read and write AXI-Stream FIFOs, the contents of which can
  be accessed from the AXI4 memory-mapped interface. This is useful for
  transferring data from a processor into the FPGA fabric. The driver creates
  a character device that can be read/written to with standard
  open/read/write/close.

  See Xilinx PG080 document for IP details.

  Currently supports only store-forward mode with a 32-bit AXI4-Lite
  interface. DOES NOT support:
    - cut-through mode
    - AXI4 (non-lite)

properties:
  compatible:
    enum:
      - xlnx,axis-fifo-mm-s-4.1
      - xlnx,axis-fifo-mm-s-4.2
      - xlnx,axis-fifo-mm-s-4.3

  interrupt-names:
    const: interrupt

  interrupts:
    maxItems: 1

  reg:
    maxItems: 1

  xlnx,axi-str-rxd-protocol:
    $ref: /schemas/types.yaml#/definitions/string
    const: XIL_AXI_STREAM_ETH_DATA
    description: AXI4-Stream RX data protocol

  xlnx,axi-str-rxd-tdata-width:
    $ref: /schemas/types.yaml#/definitions/uint32
    const: 0x20
    description: AXI4-Stream RX data width

  xlnx,axi-str-txc-protocol:
    $ref: /schemas/types.yaml#/definitions/string
    const: XIL_AXI_STREAM_ETH_CTRL
    description: AXI4-Stream TX control protocol

  xlnx,axi-str-txc-tdata-width:
    $ref: /schemas/types.yaml#/definitions/uint32
    const: 0x20
    description: AXI4-Stream TX control data width

  xlnx,axi-str-txd-protocol:
    $ref: /schemas/types.yaml#/definitions/string
    const: XIL_AXI_STREAM_ETH_DATA
    description: AXI4-Stream TX data protocol

  xlnx,axi-str-txd-tdata-width:
    $ref: /schemas/types.yaml#/definitions/uint32
    const: 0x20
    description: AXI4-Stream TX data width

  xlnx,axis-tdest-width:
    $ref: /schemas/types.yaml#/definitions/uint32
    description: AXI-Stream TDEST width (ignored by the driver)

  xlnx,axis-tid-width:
    $ref: /schemas/types.yaml#/definitions/uint32
    description: AXI-Stream TID width (ignored by the driver)

  xlnx,axis-tuser-width:
    $ref: /schemas/types.yaml#/definitions/uint32
    description: AXI-Stream TUSER width (ignored by the driver)

  xlnx,data-interface-type:
    $ref: /schemas/types.yaml#/definitions/uint32
    const: 0x0
    description: ignored by the driver

  xlnx,has-axis-tdest:
    $ref: /schemas/types.yaml#/definitions/uint32
    const: 0x0
    description: this feature isn't supported

  xlnx,has-axis-tid:
    $ref: /schemas/types.yaml#/definitions/uint32
    const: 0x0
    description: this feature isn't supported

  xlnx,has-axis-tkeep:
    $ref: /schemas/types.yaml#/definitions/uint32
    const: 0x0
    description: this feature isn't supported

  xlnx,has-axis-tstrb:
    $ref: /schemas/types.yaml#/definitions/uint32
    const: 0x0
    description: this feature isn't supported

  xlnx,has-axis-tuser:
    $ref: /schemas/types.yaml#/definitions/uint32
    const: 0x0
    description: this feature isn't supported

  xlnx,rx-fifo-depth:
    $ref: /schemas/types.yaml#/definitions/uint32
    description: Depth of RX FIFO in words

  xlnx,rx-fifo-pe-threshold:
    $ref: /schemas/types.yaml#/definitions/uint32
    description: RX programmable empty interrupt threshold
                 (ignored by the driver)

  xlnx,rx-fifo-pf-threshold:
    $ref: /schemas/types.yaml#/definitions/uint32
    description: RX programmable full interrupt threshold
                 (ignored by the driver)

  xlnx,s-axi-id-width:
    $ref: /schemas/types.yaml#/definitions/uint32
    const: 0x4
    description: ignored by the driver

  xlnx,s-axi4-data-width:
    $ref: /schemas/types.yaml#/definitions/uint32
    const: 0x20
    description: ignored by the driver

  xlnx,select-xpm:
    $ref: /schemas/types.yaml#/definitions/uint32
    const: 0x0
    description: ignored by the driver

  xlnx,tx-fifo-depth:
    $ref: /schemas/types.yaml#/definitions/uint32
    description: Depth of TX FIFO in words

  xlnx,tx-fifo-pe-threshold:
    $ref: /schemas/types.yaml#/definitions/uint32
    description: TX programmable empty interrupt threshold
                 (ignored by the driver)

  xlnx,tx-fifo-pf-threshold:
    $ref: /schemas/types.yaml#/definitions/uint32
    description: TX programmable full interrupt threshold
                 (ignored by the driver)

  xlnx,use-rx-cut-through:
    $ref: /schemas/types.yaml#/definitions/uint32
    const: 0x0
    description: this feature isn't supported

  xlnx,use-rx-data:
    $ref: /schemas/types.yaml#/definitions/uint32
    enum: [0x0, 0x1]
    description: <0x1> if RX FIFO is enabled, <0x0> otherwise

  xlnx,use-tx-ctrl:
    $ref: /schemas/types.yaml#/definitions/uint32
    const: 0x0
    description: this feature isn't supported

  xlnx,use-tx-cut-through:
    $ref: /schemas/types.yaml#/definitions/uint32
    const: 0x0
    description: this feature isn't supported

  xlnx,use-tx-data:
    $ref: /schemas/types.yaml#/definitions/uint32
    enum: [0x0, 0x1]
    description: <0x1> if TX FIFO is enabled, <0x0> otherwise

required:
  - compatible
  - interrupt-names
  - interrupts
  - reg
  - xlnx,axi-str-rxd-protocol
  - xlnx,axi-str-rxd-tdata-width
  - xlnx,axi-str-txc-protocol
  - xlnx,axi-str-txc-tdata-width
  - xlnx,axi-str-txd-protocol
  - xlnx,axi-str-txd-tdata-width
  - xlnx,axis-tdest-width
  - xlnx,axis-tid-width
  - xlnx,axis-tuser-width
  - xlnx,data-interface-type
  - xlnx,has-axis-tdest
  - xlnx,has-axis-tid
  - xlnx,has-axis-tkeep
  - xlnx,has-axis-tstrb
  - xlnx,has-axis-tuser
  - xlnx,rx-fifo-depth
  - xlnx,rx-fifo-pe-threshold
  - xlnx,rx-fifo-pf-threshold
  - xlnx,s-axi-id-width
  - xlnx,s-axi4-data-width
  - xlnx,select-xpm
  - xlnx,tx-fifo-depth
  - xlnx,tx-fifo-pe-threshold
  - xlnx,tx-fifo-pf-threshold
  - xlnx,use-rx-cut-through
  - xlnx,use-rx-data
  - xlnx,use-tx-ctrl
  - xlnx,use-tx-cut-through
  - xlnx,use-tx-data

additionalProperties: false

examples:
  - |
    axi_fifo_mm_s_0: axi_fifo_mm_s@43c00000 {
      compatible = "xlnx,axi-fifo-mm-s-4.1";
      interrupt-names = "interrupt";
      interrupt-parent = <&intc>;
      interrupts = <0 29 4>;
      reg = <0x43c00000 0x10000>;
      xlnx,axi-str-rxd-protocol = "XIL_AXI_STREAM_ETH_DATA";
      xlnx,axi-str-rxd-tdata-width = <0x20>;
      xlnx,axi-str-txc-protocol = "XIL_AXI_STREAM_ETH_CTRL";
      xlnx,axi-str-txc-tdata-width = <0x20>;
      xlnx,axi-str-txd-protocol = "XIL_AXI_STREAM_ETH_DATA";
      xlnx,axi-str-txd-tdata-width = <0x20>;
      xlnx,axis-tdest-width = <0x4>;
      xlnx,axis-tid-width = <0x4>;
      xlnx,axis-tuser-width = <0x4>;
      xlnx,data-interface-type = <0x0>;
      xlnx,has-axis-tdest = <0x0>;
      xlnx,has-axis-tid = <0x0>;
      xlnx,has-axis-tkeep = <0x0>;
      xlnx,has-axis-tstrb = <0x0>;
      xlnx,has-axis-tuser = <0x0>;
      xlnx,rx-fifo-depth = <0x200>;
      xlnx,rx-fifo-pe-threshold = <0x2>;
      xlnx,rx-fifo-pf-threshold = <0x1fb>;
      xlnx,s-axi-id-width = <0x4>;
      xlnx,s-axi4-data-width = <0x20>;
      xlnx,select-xpm = <0x0>;
      xlnx,tx-fifo-depth = <0x8000>;
      xlnx,tx-fifo-pe-threshold = <0x200>;
      xlnx,tx-fifo-pf-threshold = <0x7ffb>;
      xlnx,use-rx-cut-through = <0x0>;
      xlnx,use-rx-data = <0x0>;
      xlnx,use-tx-ctrl = <0x0>;
      xlnx,use-tx-cut-through = <0x0>;
      xlnx,use-tx-data = <0x1>;
    };
...
```

## Documentation/devicetree/bindings/beagle/beagle,beagleconnect-freedom.yaml
```yaml
# SPDX-License-Identifier: GPL-2.0-only OR BSD-2-Clause
%YAML 1.2
---
$id: http://devicetree.org/schemas/beagle/beagle,beagleconnect-freedom.yaml#
$schema: http://devicetree.org/meta-schemas/core.yaml#

title: BeagleBoard.org BeagleConnect Freedom

description:
  The BeagleBoard.org BeagleConnect Freedom board connected over USB, UART, SPI or I2C.

maintainers:
  - Ayush Singh <ayush@beagleboard.org>

properties:
  compatible:
    const: beagle,beagleconnect-freedom

  reg:
    maxItems: 1

  vbat-supply: true

required:
  - compatible

allOf:
  - $ref: /schemas/spi/spi-peripheral-props.yaml#

unevaluatedProperties: false

examples:
  - |
    serial {
      mcu {
        compatible = "beagle,beagleconnect-freedom";
        vbat-supply = <&vbat>;
      };
    };
```

## Documentation/devicetree/bindings/bluetooth/fsl,mxc_bt_rfkill.yaml
```yaml
# SPDX-License-Identifier: (GPL-2.0 OR BSD-2-Clause)
$id: http://devicetree.org/schemas/bluetooth/fsl,mxc_bt_rfkill.yaml#
$schema: http://devicetree.org/meta-schemas/core.yaml#

title: NXP i.MX Bluetooth RFKill Controller

maintainers:
  - WangErQian <wangerqiany@icloud.com>

description: |
  Binding for NXP i.MX Bluetooth RFKill controller, managing power and wake signals via GPIOs.

properties:
  compatible:
    const: fsl,mxc_bt_rfkill

  pinctrl-names:
    maxItems: 1
    items:
      - const: default

  pinctrl-0:
    type: phandle
    description: Phandle to default pin control configuration

  bt-power-gpios:
    description: GPIO controlling Bluetooth power (active low)
    maxItems: 1

  wake-bt-gpios:
    description: GPIO for waking Bluetooth device (active low)
    maxItems: 1

  wake-host-gpios:
    description: GPIO for host wake-up signal (active low)
    maxItems: 1

  status:
    type: string
    enum: [ "okay", "disabled" ]
    default: "okay"

required:
  - compatible
  - bt-power-gpios
  - wake-bt-gpios
  - wake-host-gpios

additionalProperties: false

examples:
  - |
    #include <dt-bindings/gpio/gpio.h>
    pinctrl_bt_ctrl: bt_ctrl_grp {
        fsl,pins = <
            MX6UL_PAD_GPIO1_IO06__GPIO1_IO06 0x13059 /* BT_POWER */
            MX6UL_PAD_GPIO1_IO07__GPIO1_IO07 0x13059 /* WAKE_BT */
            MX6UL_PAD_GPIO1_IO08__GPIO1_IO08 0x13059 /* WAKE_HOST */
        >;
    };

    bt_rfkill {
        compatible = "fsl,mxc_bt_rfkill";
        pinctrl-names = "default";
        pinctrl-0 = <&pinctrl_bt_ctrl>;
        bt-power-gpios = <&gpio1 6 GPIO_ACTIVE_LOW>;
        wake-bt-gpios  = <&gpio1 7 GPIO_ACTIVE_LOW>;
        wake-host-gpios = <&gpio1 8 GPIO_ACTIVE_LOW>;
        status = "okay";
    };
```

## Documentation/devicetree/bindings/board/board-id.yaml
```yaml
# SPDX-License-Identifier: BSD-2-Clause
%YAML 1.2
---
$id: http://devicetree.org/schemas/board/board-id.yaml#
$schema: http://devicetree.org/meta-schemas/core.yaml#

title: board identifiers
description: Common property for board-id subnode

maintainers:
  - Elliot Berman <quic_eberman@quicinc.com>

properties:
  $nodename:
    const: '/'
  board-id:
    type: object
    patternProperties:
      "^.*(?!_str)$":
        $ref: /schemas/types.yaml#/definitions/uint32-matrix
      "^.*_str$":
        $ref: /schemas/types.yaml#/definitions/string-array

additionalProperties: true
```
