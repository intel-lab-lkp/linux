## Documentation/devicetree/bindings/arm/qcom,coresight-tgu.yaml
```yaml
# SPDX-License-Identifier: GPL-2.0-only OR BSD-2-Clause
# Copyright (c) 2023 Qualcomm Innovation Center, Inc. All rights reserved.
%YAML 1.2
---
$id: http://devicetree.org/schemas/arm/qcom,coresight-tgu.yaml#
$schema: http://devicetree.org/meta-schemas/core.yaml#

title: Trigger Generation Unit - TGU

description: |
  The Trigger Generation Unit (TGU) is a Data Engine which can be utilized
  to sense a plurality of signals and create a trigger into the CTI or
  generate interrupts to processors. The TGU is like the trigger circuit
  of a Logic Analyzer.The corresponding trigger logic can be realized by
  configuring the conditions for each step after sensing the signal.
  Once setup and enabled, it will observe sense inputs and based upon
  the activity of those inputs, even over clock cycles, may detect a
  preprogrammed state/sequence and then produce a trigger or interrupt.

  The primary use case of the TGU is to detect patterns or sequences on a
  given set of signals within some region of the SoC.

maintainers:
  - Mao Jinlong <quic_jinlmao@quicinc.com>
  - Sam Chai <quic_songchai@quicinc.com>

# Need a custom select here or 'arm,primecell' will match on lots of nodes
select:
  properties:
    compatible:
      contains:
        enum:
          - qcom,coresight-tgu
  required:
    - compatible

properties:
  compatible:
    items:
      - const: qcom,coresight-tgu
      - const: arm,primecell

  reg:
    maxItems: 1

  clocks:
    maxItems: 1

  clock-names:
    items:
      - const: apb_pclk

  qcom,tgu-steps:
    description:
      The trigger logic is realized by configuring each step after sensing
      the signal. The parameter here is used to describe the maximum of steps
      that could be configured in the current TGU.
    $ref: /schemas/types.yaml#/definitions/uint32
    minimum: 1
    maximum: 8

  qcom,tgu-regs:
    description:
      There are some "groups" register clusters in each step, which are used to configure the signal
      that we want to detect.Meanwhile, each group has its own priority, and the priority increases
      with number of groups.For example, group3 has a higher priority than group2 ,the signal configured
      in group3 will be sensed more preferentially than the signal which is configured in group2.
      The parameter here is used to describe the signal number that each group could be configured.
    $ref: /schemas/types.yaml#/definitions/uint32
    minimum: 1
    maximum: 18

  qcom,tgu-conditions:
    description:
      A condition sets a specific requirement for a step and defines the subsequent
      action once the requirement is met. For example, in step two, if signal A is
      detected three times, the process jumps back to step one. The parameter describes
      the register number for each functionality, whether it is setting a specific
      requirement or defining a subsequent action.
    $ref: /schemas/types.yaml#/definitions/uint32
    minimum: 1
    maximum: 4

  qcom,tgu-timer-counters:
    description:
      TGU has timer and counter which are used to set some requirement on each step.
      For example, we could use counter to create a trigger into CTI once TGU senses
      the target signal three times.This parameter is used to describe the number of
      Timers/Counters in TGU.
    $ref: /schemas/types.yaml#/definitions/uint32
    minimum: 0
    maximum: 2

  in-ports:
    $ref: /schemas/graph.yaml#/properties/ports
    additionalProperties: false

    properties:
      port:
        description: AXI Slave connected to another Coresight component
        $ref: /schemas/graph.yaml#/properties/port

required:
  - compatible
  - reg
  - clocks
  - clock-names

additionalProperties: false

examples:
  - |
    tgu@10b0e000 {
        compatible = "qcom,coresight-tgu", "arm,primecell";
        reg = <0x10b0e000 0x1000>;

        clocks = <&aoss_qmp>;
        clock-names = "apb_pclk";

        qcom,tgu-steps = <3>;
        qcom,tgu-regs = <4>;
        qcom,tgu-conditions = <4>;
        qcom,tgu-timer-counters = <1>;

        in-ports {
            port {
                tgu_in_tpdm_swao: endpoint{
                    remote-endpoint = <&tpdm_swao_out_tgu>;
                };
            };
        };
    };
...
```

## Documentation/devicetree/bindings/arm/qcom,coresight-tnoc.yaml
```yaml
# SPDX-License-Identifier: GPL-2.0-only OR BSD-2-Clause
%YAML 1.2
---
$id: http://devicetree.org/schemas/arm/qcom,coresight-tnoc.yaml#
$schema: http://devicetree.org/meta-schemas/core.yaml#

title: Qualcomm Ttrace NOC(Network On Chip)

maintainers:
  - yuanfang Zhang <quic_yuanfang@quicinc.com>

description:
  The Trace NoC is an integration hierarchy which is a replacement of Dragonlink tile configuration.
  It brings together debug component like TPDA, funnel and interconnect Trace Noc which collects trace
  from subsystems and transfers to QDSS sink.

  It sits in the different subsystem of SOC and aggregates the trace and transports it to Aggregation TNoC
  or to QDSS trace sink eventually. Trace NoC embeds bridges for all the interfaces(APB, ATB, QPMDA & NTS).

  Trace NoC can take inputs from different trace sources i.e. ATB, QPMDA.

# Need a custom select here or 'arm,primecell' will match on lots of nodes
select:
  properties:
    compatible:
      contains:
        enum:
          - qcom,coresight-tnoc
  required:
    - compatible

properties:
  $nodename:
    pattern: "^tn(@[0-9a-f]+)$"
  compatible:
    items:
      - const: qcom,coresight-tnoc
      - const: arm,primecell

  reg:
    minItems: 1
    maxItems: 2

  clocks:
    maxItems: 1

  clock-names:
    items:
      - const: apb_pclk

  in-ports:
    description: |
      Input connections from subsystem to TNoC
    $ref: /schemas/graph.yaml#/properties/ports

  out-ports:
    description: |
      Output connections from the TNoC to Aggreg TNoC or to legacy CoreSight trace bus.
    $ref: /schemas/graph.yaml#/properties/ports

    properties:
      port:
        description: |
          Output connections from the TNoC to Aggreg TNoC or to legacy CoreSight trace bus.
        $ref: /schemas/graph.yaml#/properties/port

required:
  - compatible
  - reg
  - clocks
  - clock-names
  - in-ports
  - out-ports

additionalProperties: false

examples:
  - |
    tn@109ab000  {
      compatible = "qcom,coresight-tnoc", "arm,primecell";
      reg = <0x0 0x109ab000  0x0 0x4200>;

      clocks = <&aoss_qmp>;
      clock-names = "apb_pclk";

      in-ports {
        #address-cells = <1>;
        #size-cells = <0>;

        port@0 {
          reg = <0>;

          tn_ag_in_tpdm_gcc: endpoint {
            remote-endpoint = <&tpdm_gcc_out_tn_ag>;
          };
        };
      };

      out-ports {
        port {
          tn_ag_out_funnel_in1: endpoint {
            remote-endpoint = <&funnel_in1_in_tn_ag>;
          };
        };
      };
    };
...
```

## Documentation/devicetree/bindings/arm/renesas-soc.yaml
```yaml
# SPDX-License-Identifier: GPL-2.0-only OR BSD-2-Clause
%YAML 1.2
---
$id: http://devicetree.org/schemas/arm/renesas-soc.yaml#
$schema: http://devicetree.org/meta-schemas/core.yaml#

title: Renesas SoC compatibles naming convention

maintainers:
  - Geert Uytterhoeven <geert+renesas@glider.be>
  - Niklas Söderlund <niklas.soderlund@ragnatech.se>

description: |
  Guidelines for new compatibles for SoC blocks/components.
  When adding new compatibles in new bindings, use the format::
    renesas,SoC-IP

  For example::
   renesas,r8a77965-csi2

  When adding new compatibles to existing bindings, use the format in the
  existing binding, even if it contradicts the above.

select:
  properties:
    compatible:
      pattern: "^renesas,.*$"
  required:
    - compatible

properties:
  compatible:
    oneOf:
      # Preferred naming style for compatibles of SoC components:
      - pattern: "^renesas,emev2-[a-z0-9-]+$"
      - pattern: "^renesas,r7s[0-9]+-[a-z0-9-]+$"
      - pattern: "^renesas,r8a[a-z0-9]+-[a-z0-9-]+$"
      - pattern: "^renesas,r9a[0-9]+g[0-9]+-[a-z0-9-]+$"
      - pattern: "^renesas,rzn1-[a-z0-9-]+$"
      - pattern: "^renesas,rzv2m-[a-z0-9-]+$"
      - pattern: "^renesas,sh73a0-[a-z0-9-]+$"

      # SoC agnostic compatibles - new compatibles are OK:
      - enum:
          - renesas,bsid
          - renesas,fcpf
          - renesas,fcpv
          - renesas,fdp1
          - renesas,prr
          - renesas,smp-sram
          - renesas,vsp1
          - renesas,vsp2

      # Legacy namings - variations of existing patterns/compatibles are OK,
      # but do not add completely new entries to these:
      - pattern: "^renesas,du-[a-z0-9]+$"
      - pattern: "^renesas,ether-[a-z0-9]+$"
      - pattern: "^renesas,gether-[a-z0-9]+$"
      - pattern: "^renesas,ipmmu-[a-z0-9]+$"
      - pattern: "^renesas,pfc-[a-z0-9]+$"
      - pattern: "^renesas,sata-[a-z0-9]+$"
      - pattern: "^renesas,scif-[a-z0-9]+$"
      - pattern: "^renesas,sdhi-[a-z0-9]+$"
      - pattern: "^renesas,thermal-[a-z0-9]+$"
      - pattern: "^renesas,usb2-phy-[a-z0-9]+$"
      - pattern: "^renesas,vin-[a-z0-9]+$"

      # Legacy compatibles - list cannot grow with new bindings:
      - enum:
          - renesas,dbsc-r8a73a4
          - renesas,dbsc3-r8a7740
          - renesas,em-gio
          - renesas,em-sti
          - renesas,em-uart
          - renesas,iic-emev2
          - renesas,sbsc-sh73a0
          - renesas,sdhi-mmc-r8a77470

      # None SoC related compatibles - new compatibles are OK:
      - enum:
          - renesas,5p35023
          - renesas,r2a11302ft
          - renesas,raa215300

additionalProperties: true
```

## Documentation/devicetree/bindings/arm/st,nomadik.yaml
```yaml
# SPDX-License-Identifier: (GPL-2.0-only OR BSD-2-Clause)
%YAML 1.2
---
$id: http://devicetree.org/schemas/arm/st,nomadik.yaml#
$schema: http://devicetree.org/meta-schemas/core.yaml#

title: ST Nomadik SoC based Boards

maintainers:
  - Linus Walleij <linusw@kernel.org>

description: |
  Boards using the Nomadik SoC platform

properties:
  $nodename:
    const: '/'
  compatible:
    oneOf:
      - const: st,nomadik-nhk-15
      - const: calaosystems,usb-s8815

additionalProperties: true

examples:
  - |
    usb-s8815 {
        ethernet-gpio {
            gpios = <&gpio3 19 0x1>;
            interrupts = <19 0x1>;
            interrupt-parent = <&gpio3>;
        };
        mmcsd-gpio {
            gpios = <&gpio3 16 0x1>;
        };
    };
```

## Documentation/devicetree/bindings/arm/vt8500/via,vt8500-pmc.yaml
```yaml
# SPDX-License-Identifier: (GPL-2.0-only OR BSD-2-Clause)
%YAML 1.2
---
$id: http://devicetree.org/schemas/arm/vt8500/via,vt8500-pmc.yaml#
$schema: http://devicetree.org/meta-schemas/core.yaml#

title: VIA/Wondermedia VT8500 Power Management Controller

maintainers:
  - Alexey Charkov <alchark@gmail.com>
  - Krzysztof Kozlowski <krzk@kernel.org>

description:
  The VIA/Wondermedia Power Management Controller provides register access for
  clock and power management functions on VT8500 and WM8xxx series SoCs.

properties:
  compatible:
    const: via,vt8500-pmc

  reg:
    maxItems: 1

  clocks:
    type: object
    description: Container node for VT8500/WM8xxx clock provider nodes.
    properties:
      "#address-cells":
        const: 1
      "#size-cells":
        const: 0
    required:
      - "#address-cells"
      - "#size-cells"
    additionalProperties: true

required:
  - compatible
  - reg

additionalProperties: false

examples:
  - |
    pmc@d8130000 {
        compatible = "via,vt8500-pmc";
        reg = <0xd8130000 0x1000>;

        clocks {
            #address-cells = <1>;
            #size-cells = <0>;
        };
    };
```

## Documentation/devicetree/bindings/arm/zte.yaml
```yaml
# SPDX-License-Identifier: (GPL-2.0-only OR BSD-2-Clause)
%YAML 1.2
---
$id: http://devicetree.org/schemas/arm/zte.yaml#
$schema: http://devicetree.org/meta-schemas/core.yaml#

title: ZTE zx platforms

maintainers:
  - Stefan Dösinger <stefandoesinger@gmail.com>

description: |
  ARM platforms using SoCs designed by ZTE. Currently this supports devices
  based on the zx297520v3 SoC which is found in LTE routers, and on the
  zx279128s SoC which is found in home gateways.

properties:
  $nodename:
    const: "/"
  compatible:
    oneOf:
      - items:
          - enum:
              - dlink,dwr932m
          - const: zte,zx297520v3

      - items:
          - enum:
              - zte,zxhn-h3600
          - const: zte,zx279128s

additionalProperties: true
```

## Documentation/devicetree/bindings/ata/eswin,eic7700-ahci.yaml
```yaml
# SPDX-License-Identifier: (GPL-2.0-only OR BSD-2-Clause)
%YAML 1.2
---
$id: http://devicetree.org/schemas/ata/eswin,eic7700-ahci.yaml#
$schema: http://devicetree.org/meta-schemas/core.yaml#

title: Eswin EIC7700 SoC SATA Controller

maintainers:
  - Yulin Lu <luyulin@eswincomputing.com>
  - Huan He <hehuan1@eswincomputing.com>

description:
  This document defines device tree bindings for the Synopsys DWC
  implementation of the AHCI SATA controller found in Eswin's
  Eic7700 SoC platform.

select:
  properties:
    compatible:
      const: eswin,eic7700-ahci
  required:
    - compatible

allOf:
  - $ref: snps,dwc-ahci-common.yaml#

properties:
  compatible:
    items:
      - const: eswin,eic7700-ahci
      - const: snps,dwc-ahci

  reg:
    maxItems: 1

  interrupts:
    maxItems: 1

  ports-implemented:
    const: 1

  clocks:
    minItems: 2
    maxItems: 2

  clock-names:
    items:
      - const: pclk
      - const: aclk

  resets:
    maxItems: 1

  reset-names:
    const: arst

  phys:
    maxItems: 1

  phy-names:
    const: sata-phy

required:
  - compatible
  - reg
  - interrupts
  - clocks
  - clock-names
  - resets
  - reset-names
  - phys
  - phy-names
  - ports-implemented

unevaluatedProperties: false

examples:
  - |
    sata@50420000 {
        compatible = "eswin,eic7700-ahci", "snps,dwc-ahci";
        reg = <0x50420000 0x10000>;
        interrupt-parent = <&plic>;
        interrupts = <58>;
        ports-implemented = <0x1>;
        clocks = <&gate_clk_hsp_cfgclk>, <&gate_clk_hsp_aclk>;
        clock-names = "pclk", "aclk";
        resets = <&reset 96>;
        reset-names = "arst";
        phys = <&sata_phy>;
        phy-names = "sata-phy";
    };
```
