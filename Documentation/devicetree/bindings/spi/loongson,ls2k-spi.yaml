## drivers/platform/wmi/asus/Kconfig
```kconfig
# SPDX-License-Identifier: GPL-2.0-only
#
# Asus Platform Specific Drivers
#

config ASUS_ARMOURY
	tristate "ASUS Armoury driver"
	depends on ASUS_WMI
	select FW_ATTR_CLASS
	help
	  Say Y here if you have a WMI aware Asus machine and would like to use the
	  firmware_attributes API to control various settings typically exposed in
	  the ASUS Armoury Crate application available on Windows.

	  To compile this driver as a module, choose M here: the module will
	  be called asus-armoury.

config ASUS_WMI
	tristate "ASUS WMI Driver"
	depends on ACPI_WMI
	depends on ACPI_BATTERY
	depends on INPUT
	depends on HWMON
	depends on BACKLIGHT_CLASS_DEVICE
	depends on RFKILL || RFKILL = n
	depends on HOTPLUG_PCI
	depends on ACPI_VIDEO || ACPI_VIDEO = n
	depends on SERIO_I8042 || SERIO_I8042 = n
	select INPUT_SPARSEKMAP
	select LEDS_CLASS
	select NEW_LEDS
	select ACPI_PLATFORM_PROFILE
	help
	  Say Y here if you have a WMI aware Asus laptop (like Eee PCs or new
	  Asus Notebooks).

	  To compile this driver as a module, choose M here: the module will
	  be called asus-wmi.

config ASUS_WMI_DEPRECATED_ATTRS
	bool "BIOS option support in WMI platform (DEPRECATED)"
	depends on ASUS_WMI
	default y
	help
	  Say Y to expose the configurable BIOS options through the asus-wmi
	  driver.

	  This can be used with or without the asus-armoury driver which
	  has the same attributes, but more, and better features.

config ASUS_NB_WMI
	tristate "Asus Notebook WMI Driver"
	depends on ASUS_WMI
	help
	  This is a driver for newer Asus notebooks. It adds extra features
	  like wireless radio and bluetooth control, leds, hotkeys, backlight...

	  For more information, see
	  <file:Documentation/ABI/testing/sysfs-platform-asus-wmi>

	  If you have an ACPI-WMI compatible Asus Notebook, say Y or M
	  here.
```

## kernel/trace/rv/monitors/tlob/Kconfig
```kconfig
# SPDX-License-Identifier: GPL-2.0-only
#
config RV_MON_TLOB
	bool "tlob monitor"
	depends on RV && UPROBES && HIGH_RES_TIMERS
	select HA_MON_EVENTS_ID
	select RV_UPROBE
	help
	  Enable the tlob (task latency over budget) hybrid-automaton RV
	  monitor.  tlob tracks per-task elapsed time across a
	  user-delimited code section and emits a violation when the
	  elapsed time exceeds a configurable per-invocation budget.
```
