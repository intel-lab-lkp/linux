## Documentation/devicetree/bindings/spi/loongson,ls2k-spi.yaml
```yaml
# SPDX-License-Identifier: (GPL-2.0 OR BSD-2-Clause)
%YAML 1.2
---
$id: http://devicetree.org/schemas/spi/loongson,ls2k-spi.yaml#
$schema: http://devicetree.org/meta-schemas/core.yaml#

title: Loongson SPI controller

maintainers:
  - Yinbo Zhu <zhuyinbo@loongson.cn>

allOf:
  - $ref: /schemas/spi/spi-controller.yaml#

properties:
  compatible:
    oneOf:
      - enum:
          - loongson,ls2k0300-spi-io
          - loongson,ls2k1000-spi
      - items:
          - enum:
              - loongson,ls2k0300-spi
              - loongson,ls2k0500-spi
          - const: loongson,ls2k1000-spi

  reg:
    maxItems: 1

  clocks:
    maxItems: 1

  interrupts:
    maxItems: 1

  dmas:
    maxItems: 2

  dma-names:
    items:
      - const: tx
      - const: rx

required:
  - compatible
  - reg
  - clocks

unevaluatedProperties: false

if:
  properties:
    compatible:
      contains:
        const: loongson,ls2k0300-spi-io

then:
  required:
    - dmas
    - dma-names
    - interrupts

else:
  properties:
    dmas: false
    dma-names: false

examples:
  - |
    spi0: spi@1fff0220{
        compatible = "loongson,ls2k1000-spi";
        reg = <0x1fff0220 0x10>;
        clocks = <&clk 17>;
        #address-cells = <1>;
        #size-cells = <0>;
    };

  - |
    #include <dt-bindings/interrupt-controller/irq.h>
    #include <dt-bindings/clock/loongson,ls2k-clk.h>

    spi@1610c000 {
        compatible = "loongson,ls2k0300-spi-io";
        reg = <0x1610c000 0x2000>;
        clocks = <&clk LS2K0300_CLK_DEV_GATE>;
        interrupt-parent = <&liointc0>;
        interrupts = <6 IRQ_TYPE_LEVEL_HIGH>;
        dmas = <&dma_router 14 1 0x8e>,
               <&dma_router 14 0 0x8e>;
        dma-names = "tx", "rx";
    };
```

## Documentation/devicetree/bindings/usb/rockchip,rk3572-dwc3.yaml
```yaml
# SPDX-License-Identifier: (GPL-2.0-only OR BSD-2-Clause)
%YAML 1.2
---
$id: http://devicetree.org/schemas/usb/rockchip,rk3572-dwc3.yaml#
$schema: http://devicetree.org/meta-schemas/core.yaml#

title: Rockchip RK3572 DWC3 USB controller

maintainers:
  - Heiko Stuebner <heiko@sntech.de>
  - Cunhao Lu <1579567540@qq.com>

allOf:
  - $ref: snps,dwc3-common.yaml#

properties:
  compatible:
    const: rockchip,rk3572-dwc3

  reg:
    maxItems: 1

  interrupts:
    maxItems: 1

  dma-coherent: true

  clocks:
    minItems: 3
    maxItems: 3

  clock-names:
    items:
      - const: ref_clk
      - const: suspend_clk
      - const: bus_clk

  phys:
    minItems: 1
    items:
      - description: USB2 PHY
      - description: USB3 PHY

  phy-names:
    minItems: 1
    items:
      - const: usb2-phy
      - const: usb3-phy

  power-domains:
    maxItems: 1

  resets:
    maxItems: 1

  rockchip,grf:
    $ref: /schemas/types.yaml#/definitions/phandle-array
    description:
      PHP GRF and the controller's PIPE configuration register offset.
    items:
      - items:
          - description: PHP GRF phandle
          - enum: [0x14, 0x34]

required:
  - compatible
  - reg
  - interrupts
  - clocks
  - clock-names
  - phys
  - phy-names
  - power-domains
  - resets
  - rockchip,grf

unevaluatedProperties: false

examples:
  - |
    #include <dt-bindings/clock/rockchip,rk3572-cru.h>
    #include <dt-bindings/interrupt-controller/arm-gic.h>
    #include <dt-bindings/phy/phy.h>
    #include <dt-bindings/power/rockchip,rk3572-power-controller.h>
    #include <dt-bindings/reset/rockchip,rk3572-cru.h>

    usb@24400000 {
        compatible = "rockchip,rk3572-dwc3";
        reg = <0x24400000 0x400000>;
        interrupts = <GIC_SPI 254 IRQ_TYPE_LEVEL_HIGH>;
        clocks = <&cru CLK_REF_USB3OTG1>, <&cru CLK_SUSPEND_USB3OTG1>,
                 <&cru ACLK_USB3OTG1>;
        clock-names = "ref_clk", "suspend_clk", "bus_clk";
        phys = <&u2phy1_otg>, <&combphy1 PHY_TYPE_USB3>;
        phy-names = "usb2-phy", "usb3-phy";
        power-domains = <&power RK3572_PD_PHP>;
        resets = <&cru SRST_ARESETN_USB3OTG1>;
        rockchip,grf = <&php_grf 0x34>;
        dr_mode = "host";
    };
```

## Documentation/devicetree/bindings/usb/ti,tusb1046.yaml
```yaml
# SPDX-License-Identifier: (GPL-2.0-only OR BSD-2-Clause)
%YAML 1.2
---
$id: http://devicetree.org/schemas/usb/ti,tusb1046.yaml#
$schema: http://devicetree.org/meta-schemas/core.yaml#

title: Texas Instruments TUSB1046-DCI Type-C crosspoint switch

maintainers:
  - Romain Gantois <romain.gantois@bootlin.com>

allOf:
  - $ref: usb-switch.yaml#
  - $ref: usb-switch-ports.yaml#

properties:
  compatible:
    const: ti,tusb1046

  reg:
    maxItems: 1

  ti,hpd-in-override:
    type: boolean
    description: |
      Force the HPD_IN signal high through the HPDIN_OVERRIDE bit in the
      General register while DisplayPort Alt Mode is active. This is useful
      on boards where HPD_IN is not driven by the downstream DisplayPort
      sink.

required:
  - compatible
  - reg
  - port

unevaluatedProperties: false

examples:
  - |
    i2c {
        #address-cells = <1>;
        #size-cells = <0>;

        typec-mux@44 {
            compatible = "ti,tusb1046";
            reg = <0x44>;

            mode-switch;
            orientation-switch;
            ti,hpd-in-override;

            port {
                endpoint {
                    remote-endpoint = <&typec_controller>;
                };
            };
        };
    };
...
```

## drivers/gpu/drm/nova/Kconfig
```kconfig
config DRM_NOVA
	tristate "Nova DRM driver"
	depends on 64BIT
	depends on DRM=y
	depends on PCI
	depends on RUST
	depends on !CPU_BIG_ENDIAN
	select AUXILIARY_BUS
	select NOVA_CORE
	default n
	help
	  Choose this if you want to build the Nova DRM driver for Nvidia
	  GSP-based GPUs.

	  This driver is under active upstream development and may not be
	  functional. Its uAPI is intended to be developed upstream alongside
	  the driver and is not yet stable. It may change incompatibly during
	  development.

	  Loading requires the acknowledge_unstable_uapi=1 module parameter, or
	  nova-drm.acknowledge_unstable_uapi=1 on the kernel command line when
	  built in.

	  Enabling the driver taints the kernel.

	  If M is selected, the module will be called nova-drm.
```

## drivers/gpu/nova-core/Kconfig
```kconfig
config NOVA_CORE
	tristate "Nova Core GPU driver"
	depends on 64BIT
	depends on PCI
	depends on RUST
	depends on !CPU_BIG_ENDIAN
	select AUXILIARY_BUS
	select GPU_BUDDY
	select RUST_FW_LOADER_ABSTRACTIONS
	default n
	help
	  Choose this if you want to build the Nova Core driver for Nvidia
	  GPUs based on the GPU System Processor (GSP). This is true for Turing
	  and later GPUs.

	  This driver is work in progress and may not be functional.

	  If M is selected, the module will be called nova-core.

config NOVA_CORE_SELFTESTS
	bool "Nova Core driver self-tests"
	depends on NOVA_CORE
	default n
	help
	  Build the driver self-tests and run them when the GPU is probed.

	  If the interrupt delivery test fails, the probe fails and the driver
	  does not bind to the GPU. A broken interrupt path would otherwise
	  show up later as a hang, far from its cause. Every other self-test
	  logs its failure and lets the probe continue.

	  If unsure, say N.

config NOVA_CORE_BIND_GSP
	bool "Make nova-core the default driver for GSP-capable GPUs"
	depends on NOVA_CORE
	default n
	help
	  Make nova-core bind to all NVIDIA GPUs it supports by default.

	  By default nova-core does not bind to any GPU and leaves NVIDIA
	  GPUs to other drivers, such as nouveau. Say Y here, or boot with
	  nova-core.bind_gsp=1, to make nova-core claim NVIDIA GPUs
	  instead.

	  nova-core is work in progress and may not be functional, so this
	  is intended for nova developers and testers only. When enabled,
	  nouveau must not bind to the same (GSP-capable) GPUs, i.e.
	  CONFIG_DRM_NOUVEAU_BIND_GSP=N or nouveau.bind_gsp=0 is required.
	  Otherwise both drivers compete for the same devices and
	  whichever is loaded first wins.

	  If unsure, say N.
```

## drivers/media/platform/arm/mali-c720/Kconfig
```kconfig
# SPDX-License-Identifier: GPL-2.0-only
config VIDEO_MALI_C720
	tristate "ARM Mali-C720 Image Signal Processor driver"
	depends on V4L_PLATFORM_DRIVERS
	depends on VIDEO_DEV && OF
	select CRC_CCITT
	select CRC_ITU_T
	select MEDIA_CONTROLLER
	select V4L2_FWNODE
	select V4L2_ISP
	select VIDEO_V4L2_SUBDEV_API
	select VIDEOBUF2_DMA_CONTIG
	select VIDEOBUF2_VMALLOC
	help
	  Enable this to support Arm's Mali-C720 Image Signal Processor.

	  To compile this driver as a module, choose M here: the module
	  will be called mali-c720.
```

## drivers/media/platform/arm/mali-vpu/Kconfig
```kconfig
# SPDX-License-Identifier: GPL-2.0-only
config VIDEO_MALI_VPU
	tristate "ARM Mali VPU driver"
	depends on VIDEO_DEV
	depends on !CPU_BIG_ENDIAN
	help
	  Enable this to support Arm's Mali Video hardware accelerator.
	  This is a V4L2 driver.

	  Only little-endian kernels are supported. The firmware interface
	  uses little-endian shared-memory structures.

	  To compile this driver as a module, choose M here: the module
	  will be called mali-vpu.
```

## drivers/media/platform/rockchip/iep2/Kconfig
```kconfig
# SPDX-License-Identifier: GPL-2.0-only
config VIDEO_ROCKCHIP_IEP2
	tristate "Rockchip IEP2 deinterlacer"
	depends on V4L_MEM2MEM_DRIVERS
	depends on VIDEO_DEV
	depends on ARCH_ROCKCHIP || COMPILE_TEST
	select VIDEOBUF2_DMA_CONTIG
	select V4L2_MEM2MEM_DEV
	help
	  Support for the IEP2 (image enhancement processor) found in the
	  Rockchip RK3568 and RK3588 SoCs. It is exposed as a V4L2 memory to
	  memory device that deinterlaces NV12/NV21/NV16/NV61 frames, using
	  either intra-field (bob) or motion-adaptive interpolation.

	  To compile this driver as a module, choose M here: the module
	  will be called rockchip-iep2.
```

## drivers/media/platform/rockchip/rkvenc/Kconfig
```kconfig
# SPDX-License-Identifier: GPL-2.0-only
config VIDEO_ROCKCHIP_RKVENC
	tristate "Rockchip RKVENC (vepu540/vepu541) H.264/HEVC encoder"
	depends on ARCH_ROCKCHIP || COMPILE_TEST
	depends on VIDEO_DEV
	select MEDIA_CONTROLLER
	select VIDEOBUF2_DMA_CONTIG
	select V4L2_MEM2MEM_DEV
	help
	  Support for the Rockchip RKVENC v1 hardware video encoder found
	  in the RV1109/RV1126 (vepu541) and RK3566/RK3568 (vepu540) SoCs.

	  It encodes NV12 raw frames into H.264 (AVC) or HEVC (H.265)
	  bitstreams using a stateful memory-to-memory V4L2 interface.

	  To compile this driver as a module, choose M here: the module
	  will be called rockchip-rkvenc.
```

## drivers/phy/metanoia/Kconfig
```kconfig
# SPDX-License-Identifier: GPL-2.0-only
#
# Phy drivers for Metanoia platforms
#

config PHY_METANOIA_USB2
	tristate "Metanoia USB2 PHY reset support"
	depends on OF && (ARCH_METANOIA || COMPILE_TEST)
	depends on RESET_CONTROLLER
	select GENERIC_PHY
	help
	  Enable this to support the USB2 PHY reset block that is part
	  of Metanoia SoCs.

	  This driver only toggles the reset line of the PHY needed by
	  the DWC2 USB controller.
```

## drivers/pinctrl/ti/Kconfig
```kconfig
# SPDX-License-Identifier: GPL-2.0-only
config PINCTRL_TI_IODELAY
	tristate "TI IODelay Module pinconf driver"
	depends on OF && (SOC_DRA7XX || COMPILE_TEST)
	select GENERIC_PINCTRL_GROUPS
	select GENERIC_PINMUX_FUNCTIONS
	select GENERIC_PINCONF
	select REGMAP_MMIO
	help
	  Say Y here to support Texas Instruments' IO delay pinconf driver.
	  IO delay module is used for the DRA7 SoC family.

config PINCTRL_TDA54
	tristate "TI TDA54 pinctrl driver"
	depends on OF && (ARCH_K3 || COMPILE_TEST)
	select GENERIC_PINCTRL_GROUPS
	select GENERIC_PINMUX_FUNCTIONS
	select GENERIC_PINCONF
	help
	  Say Y here to support pin multiplexing and pin configuration on the
	  Texas Instruments TDA54 SoC.
```

## drivers/platform/lenovo/Kconfig
```kconfig
# SPDX-License-Identifier: GPL-2.0-only
#
# Lenovo Platform-Specific Drivers
#

menuconfig LENOVO_PLATFORMS
	bool "Lenovo Platform-Specific Device Drivers"
	depends on ARM64 || X86 || COMPILE_TEST
	default y if ARM64 || X86
	help
	  Say Y here to get to see options for platform-specific device drivers
	  for Lenovo devices that do not depend on the CPU architecture, such
	  as the ACPI-WMI based drivers used on both x86 and arm64 laptops.
	  This option alone does not add any kernel code.

	  If you say N, all options in this submenu will be skipped and disabled.

if LENOVO_PLATFORMS

config LENOVO_WMI_HELPERS
	tristate
	depends on ACPI_WMI

config LENOVO_WMI_EVENTS
	tristate
	depends on ACPI_WMI

config LENOVO_WMI_CAPDATA
	tristate
	depends on ACPI_WMI
	depends on LENOVO_WMI_HELPERS

config LENOVO_WMI_HOTKEY_UTILITIES
	tristate "Lenovo Hotkey Utility WMI extras driver"
	depends on ACPI_WMI
	select NEW_LEDS
	select LEDS_CLASS
	imply IDEAPAD_LAPTOP
	help
	  This driver provides WMI support for Lenovo customized hotkeys function,
	  such as LED control for audio/mic mute event for Ideapad, YOGA, XiaoXin,
	  Gaming, ThinkBook and so on.

config LENOVO_WMI_FN_KEYS
	tristate "Lenovo WMI Fn keys driver"
	depends on ACPI_WMI
	depends on INPUT
	select INPUT_SPARSEKMAP
	help
	  Say Y or M here to enable the vendor specific Fn keys (microphone
	  mute, airplane mode, performance mode, star key, Fn+Esc, etc.) on
	  Lenovo laptops that deliver them as WMI events. ideapad-laptop
	  subscribes to this driver for its Fn lock LED and performance mode
	  handling.

	  To compile this driver as a module, choose M here: the module will
	  be called lenovo-wmi-fn-keys.

config LENOVO_WMI_CAMERA
	tristate "Lenovo WMI Camera Button driver"
	depends on ACPI_WMI
	depends on INPUT
	help
	  This driver provides support for Lenovo camera button. The Camera
	  button is a GPIO device. This driver receives ACPI notifications when
	  the camera button is switched on/off.

	  To compile this driver as a module, choose M here: the module
	  will be called lenovo-wmi-camera.

config LENOVO_WMI_GAMEZONE
	tristate "Lenovo GameZone WMI Driver"
	depends on ACPI_WMI
	depends on DMI
	select ACPI_PLATFORM_PROFILE
	select LENOVO_WMI_EVENTS
	select LENOVO_WMI_HELPERS
	help
	  Say Y here if you have a WMI aware Lenovo Legion device and would like to use the
	  platform-profile firmware interface to manage power usage.

	  To compile this driver as a module, choose M here: the module will
	  be called lenovo-wmi-gamezone.

config LENOVO_WMI_TUNING
	tristate "Lenovo Other Mode WMI Driver"
	depends on ACPI_WMI
	depends on ACPI_BATTERY
	select HWMON
	select FW_ATTR_CLASS
	select LENOVO_WMI_CAPDATA
	select LENOVO_WMI_EVENTS
	select LENOVO_WMI_HELPERS
	help
	  Say Y here if you have a WMI aware Lenovo Legion device and would like to use the
	  firmware_attributes API to control various tunable settings typically exposed by
	  Lenovo software in Windows.

	  To compile this driver as a module, choose M here: the module will
	  be called lenovo-wmi-other.

endif # LENOVO_PLATFORMS
```
