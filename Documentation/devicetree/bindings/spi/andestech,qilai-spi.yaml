## Documentation/devicetree/bindings/spi/andestech,qilai-spi.yaml
```yaml
# SPDX-License-Identifier: (GPL-2.0-only OR BSD-2-Clause)
%YAML 1.2
---
$id: http://devicetree.org/schemas/spi/andestech,qilai-spi.yaml#
$schema: http://devicetree.org/meta-schemas/core.yaml#

title: Andes ATCSPI200 SPI controller

maintainers:
  - CL Wang <cl634@andestech.com>

properties:
  compatible:
    enum:
      - andestech,qilai-spi
      - andestech,ae350-spi

  reg:
    maxItems: 1

  clocks:
    maxItems: 1

  num-cs:
    description: Number of chip selects supported
    maxItems: 1

  dmas:
    items:
      - description: Transmit FIFO DMA channel
      - description: Receive FIFO DMA channel

  dma-names:
    items:
      - const: tx
      - const: rx

patternProperties:
  "@[0-9a-f]+$":
    type: object
    additionalProperties: true

    properties:
      spi-rx-bus-width:
        enum: [1, 4]

      spi-tx-bus-width:
        enum: [1, 4]

allOf:
  - $ref: spi-controller.yaml#

required:
  - compatible
  - reg
  - clocks
  - dmas
  - dma-names

unevaluatedProperties: false

examples:
  - |
    soc {
      #address-cells = <2>;
      #size-cells = <2>;

      spi@f0b00000 {
        compatible = "andestech,qilai-spi";
        reg = <0x0 0xf0b00000 0x0 0x1000>;
        #address-cells = <1>;
        #size-cells = <0>;
        clocks = <&clk_spi>;
        dmas = <&dma0 0>, <&dma0 1>;
        dma-names = "tx", "rx";

        flash@0 {
          compatible = "jedec,spi-nor";
          reg = <0x0>;
          spi-tx-bus-width = <0x4>;
          spi-rx-bus-width = <0x4>;
          spi-cpol;
          spi-cpha;
        };
      };
    };
```

## Documentation/devicetree/bindings/spi/axiado,ax3000-spi.yaml
```yaml
# SPDX-License-Identifier: (GPL-2.0-only OR BSD-2-Clause)
%YAML 1.2
---
$id: http://devicetree.org/schemas/spi/axiado,ax3000-spi.yaml#
$schema: http://devicetree.org/meta-schemas/core.yaml#

title: Axiado AX3000 SoC SPI controller

maintainers:
  - Vladimir Moravcevic <vmoravcevic@axiado.com>

allOf:
  - $ref: spi-controller.yaml#

properties:
  compatible:
    enum:
      - axiado,ax3000-spi

  reg:
    maxItems: 1

  interrupts:
    maxItems: 1

  clock-names:
    items:
      - const: ref_clk
      - const: pclk

  clocks:
    maxItems: 2

required:
  - compatible
  - reg
  - interrupts
  - clock-names
  - clocks

unevaluatedProperties: false

examples:
  - |
   #include <dt-bindings/interrupt-controller/irq.h>
   #include <dt-bindings/interrupt-controller/arm-gic.h>

   soc {
      #address-cells = <2>;
      #size-cells = <2>;

      spi0: spi@80510000 {
         compatible = "axiado,ax3000-spi";
         reg = <0x00 0x80510000 0x00 0x1000>;
         clock-names = "ref_clk", "pclk";
         clocks = <&spi_clk &spi_clk>;
         interrupt-parent = <&gic500>;
         interrupts = <GIC_SPI 115 IRQ_TYPE_LEVEL_HIGH>;
         num-cs = <1>;
      };
   };
...
```

## Documentation/devicetree/bindings/spi/cdns,xspi.yaml
```yaml
# SPDX-License-Identifier: (GPL-2.0 OR BSD-2-Clause)
# Copyright 2020-21 Cadence
%YAML 1.2
---
$id: http://devicetree.org/schemas/spi/cdns,xspi.yaml#
$schema: http://devicetree.org/meta-schemas/core.yaml#

title: Cadence XSPI Controller

maintainers:
  - Parshuram Thombare <pthombar@cadence.com>

description: |
  The XSPI controller allows SPI protocol communication in
  single, dual, quad or octal wire transmission modes for
  read/write access to slaves such as SPI-NOR flash.

allOf:
  - $ref: spi-controller.yaml#

properties:
  compatible:
    oneOf:
      - description: Vanilla Cadence xSPI controller
        items:
          - const: cdns,xspi-nor
      - description: Cadence xSPI controller with v2 Marvell overlay
        items:
          - const: mrvl,xspi-nor


  reg:
    minItems: 3
    items:
      - description: address and length of the controller register set
      - description: address and length of the Slave DMA data port
      - description: address and length of the auxiliary registers
      - description: address and length of the xfer registers

  reg-names:
    minItems: 3
    items:
      - const: io
      - const: sdma
      - const: aux
      - const: xferbase

  interrupts:
    maxItems: 1

  cdns,dll-phy-control:
    description: |
      PHY config register. Valid only for cdns,mrvl-xspi-nor
    $ref: /schemas/types.yaml#/definitions/uint32
    default: 0x707

  cdns,rfile-phy-control:
    description: |
      PHY config register. Valid only for cdns,mrvl-xspi-nor
    $ref: /schemas/types.yaml#/definitions/uint32
    default: 0x40000

  cdns,rfile-phy-tsel:
    description: |
      PHY config register. Valid only for cdns,mrvl-xspi-nor
    $ref: /schemas/types.yaml#/definitions/uint32
    default: 0

  cdns,phy-dq-timing:
    description: |
      PHY config register. Valid only for cdns,mrvl-xspi-nor
    $ref: /schemas/types.yaml#/definitions/uint32
    default: 0x101

  cdns,phy-dqs-timing:
    description: |
      PHY config register. Valid only for cdns,mrvl-xspi-nor
    $ref: /schemas/types.yaml#/definitions/uint32
    default: 0x700404

  cdns,phy-gate-lpbk-ctrl:
    description: |
      PHY config register. Valid only for cdns,mrvl-xspi-nor
    $ref: /schemas/types.yaml#/definitions/uint32
    default: 0x200030

  cdns,phy-dll-master-ctrl:
    description: |
      PHY config register. Valid only for cdns,mrvl-xspi-nor
    $ref: /schemas/types.yaml#/definitions/uint32
    default: 0x00800000

  cdns,phy-dll-slave-ctrl:
    description: |
      PHY config register. Valid only for cdns,mrvl-xspi-nor
    $ref: /schemas/types.yaml#/definitions/uint32
    default: 0x0000ff01

required:
  - compatible
  - reg
  - interrupts

unevaluatedProperties: false

examples:
  - |
    #include <dt-bindings/interrupt-controller/irq.h>
    bus {
        #address-cells = <2>;
        #size-cells = <2>;

        xspi: spi@a0010000 {
            #address-cells = <1>;
            #size-cells = <0>;
            compatible = "cdns,xspi-nor";
            reg = <0x0 0xa0010000 0x0 0x1040>,
                  <0x0 0xb0000000 0x0 0x1000>,
                  <0x0 0xa0020000 0x0 0x100>;
            reg-names = "io", "sdma", "aux";
            interrupts = <0 90 IRQ_TYPE_LEVEL_HIGH>;
            interrupt-parent = <&gic>;

            flash@0 {
                compatible = "jedec,spi-nor";
                spi-max-frequency = <75000000>;
                reg = <0>;
            };

            flash@1 {
                compatible = "jedec,spi-nor";
                spi-max-frequency = <75000000>;
                reg = <1>;
            };
        };
    };
  - |
    #include <dt-bindings/interrupt-controller/irq.h>
    bus {
        #address-cells = <2>;
        #size-cells = <2>;

        mrvl_xspi: spi@d0010000 {
            #address-cells = <1>;
            #size-cells = <0>;
            compatible = "mrvl,xspi-nor";
            reg = <0x0 0xa0010000 0x0 0x1040>,
                  <0x0 0xb0000000 0x0 0x1000>,
                  <0x0 0xa0020000 0x0 0x100>,
                  <0x0 0xa0090000 0x0 0x100>;
            reg-names = "io", "sdma", "aux", "xferbase";
            interrupts = <0 90 IRQ_TYPE_LEVEL_HIGH>;
            interrupt-parent = <&gic>;

            flash@0 {
                compatible = "jedec,spi-nor";
                spi-max-frequency = <75000000>;
                reg = <0>;
            };

            flash@1 {
                compatible = "jedec,spi-nor";
                spi-max-frequency = <75000000>;
                reg = <1>;
            };
        };
    };
```

## Documentation/devicetree/bindings/spi/fsl,dspi.yaml
```yaml
# SPDX-License-Identifier: (GPL-2.0-only OR BSD-2-Clause)
%YAML 1.2
---
$id: http://devicetree.org/schemas/spi/fsl,dspi.yaml#
$schema: http://devicetree.org/meta-schemas/core.yaml#

title: ARM Freescale DSPI controller

maintainers:
  - Frank Li <Frank.Li@nxp.com>

properties:
  compatible:
    oneOf:
      - enum:
          - fsl,vf610-dspi
          - fsl,ls1021a-v1.0-dspi
          - fsl,ls1012a-dspi
          - fsl,ls1028a-dspi
          - fsl,ls1043a-dspi
          - fsl,ls1046a-dspi
          - fsl,ls1088a-dspi
          - fsl,ls2080a-dspi
          - fsl,ls2085a-dspi
          - fsl,lx2160a-dspi
      - items:
          - enum:
              - fsl,ls1012a-dspi
              - fsl,ls1028a-dspi
              - fsl,ls1043a-dspi
              - fsl,ls1046a-dspi
              - fsl,ls1088a-dspi
          - const: fsl,ls1021a-v1.0-dspi
      - items:
          - const: fsl,ls2080a-dspi
          - const: fsl,ls2085a-dspi

  reg:
    maxItems: 1

  interrupts:
    maxItems: 1

  clocks:
    maxItems: 1

  clock-names:
    items:
      - const: dspi

  pinctrl-0: true

  pinctrl-names:
    items:
      - const: default

  spi-num-chipselects:
    $ref: /schemas/types.yaml#/definitions/uint32
    description: the number of the chipselect signals.

  big-endian:
    $ref: /schemas/types.yaml#/definitions/flag
    description:
      If present the dspi device's registers are implemented
      in big endian mode.

  bus-num:
    $ref: /schemas/types.yaml#/definitions/uint32
    description: the slave chip chipselect signal number.

required:
  - compatible
  - reg
  - clocks
  - clock-names
  - interrupts
  - pinctrl-0
  - pinctrl-names
  - spi-num-chipselects

allOf:
  - $ref: spi-controller.yaml#

unevaluatedProperties: false

examples:
  - |
    #include <dt-bindings/interrupt-controller/arm-gic.h>
    #include <dt-bindings/clock/vf610-clock.h>

    spi@4002c000 {
        compatible = "fsl,vf610-dspi";
        reg = <0x4002c000 0x1000>;
        #address-cells = <1>;
        #size-cells = <0>;
        interrupts = <GIC_SPI 67 IRQ_TYPE_LEVEL_HIGH>;
        clocks = <&clks VF610_CLK_DSPI0>;
        clock-names = "dspi";
        spi-num-chipselects = <5>;
        bus-num = <0>;
        pinctrl-names = "default";
        pinctrl-0 = <&pinctrl_dspi0_1>;
        big-endian;

        flash@0 {
                compatible = "jedec,spi-nor";
                reg = <0>;
                spi-max-frequency = <16000000>;
                spi-cpol;
                spi-cpha;
                spi-cs-setup-delay-ns = <100>;
                spi-cs-hold-delay-ns = <50>;
        };
    };
```

## Documentation/devicetree/bindings/spi/ibm,p10-spi.yaml
```yaml
# SPDX-License-Identifier: (GPL-2.0 OR BSD-2-Clause)
%YAML 1.2
---
$id: http://devicetree.org/schemas/spi/ibm,p10-spi.yaml#
$schema: http://devicetree.org/meta-schemas/core.yaml#

title: IBM SPI Controller

maintainers:
  - Eddie James <eajames@linux.ibm.com>

description:
  A basic SPI controller found on IBM Power chips, accessed over FSI. This
  node will always be a child node of an ibm,fsi2spi node.

properties:
  compatible:
    enum:
      - ibm,p10-spi

  reg:
    maxItems: 1

required:
  - compatible
  - reg

allOf:
  - $ref: spi-controller.yaml#

unevaluatedProperties: false

examples:
  - |
    fsi2spi@1c00 {
        compatible = "ibm,fsi2spi";
        reg = <0x1c00 0x400>;
        #address-cells = <1>;
        #size-cells = <0>;

        spi@0 {
            compatible = "ibm,p10-spi";
            reg = <0>;
            #address-cells = <1>;
            #size-cells = <0>;

            eeprom@0 {
                compatible = "atmel,at25";
                reg = <0>;
                size = <0x80000>;
                address-width = <24>;
                pagesize = <256>;
                spi-max-frequency = <1000000>;
            };
        };
    };
```

## Documentation/devicetree/bindings/spi/mediatek,spi-mtk-nor.yaml
```yaml
# SPDX-License-Identifier: (GPL-2.0-only OR BSD-2-Clause)
%YAML 1.2
---
$id: http://devicetree.org/schemas/spi/mediatek,spi-mtk-nor.yaml#
$schema: http://devicetree.org/meta-schemas/core.yaml#

title: Serial NOR flash controller for MediaTek ARM SoCs

maintainers:
  - Bayi Cheng <bayi.cheng@mediatek.com>
  - Chuanhong Guo <gch981213@gmail.com>

description: |
  This spi controller support single, dual, or quad mode transfer for
  SPI NOR flash. There should be only one spi slave device following
  generic spi bindings. It's not recommended to use this controller
  for devices other than SPI NOR flash due to limited transfer
  capability of this controller.

properties:
  compatible:
    oneOf:
      - enum:
          - mediatek,mt8173-nor
          - mediatek,mt8186-nor
          - mediatek,mt8192-nor
      - items:
          - enum:
              - mediatek,mt2701-nor
              - mediatek,mt2712-nor
              - mediatek,mt7622-nor
              - mediatek,mt7623-nor
              - mediatek,mt7629-nor
              - mediatek,mt8195-nor
          - const: mediatek,mt8173-nor
      - items:
          - enum:
              - mediatek,mt8188-nor
              - mediatek,mt8189-nor
          - const: mediatek,mt8186-nor

  reg:
    maxItems: 1

  interrupts:
    maxItems: 1

  clocks:
    minItems: 2
    items:
      - description: clock used for spi bus
      - description: clock used for controller
      - description: clock used for nor dma bus. this depends on hardware
                     design, so this is optional.
      - description: clock used for controller axi slave bus.
                     this depends on hardware design, so it is optional.
      - description: clock used for controller axi_f, axi_h, and
                     axi_p to support the new platform.

required:
  - compatible
  - reg
  - clocks
  - clock-names

allOf:
  - $ref: /schemas/spi/spi-controller.yaml#

  - if:
      properties:
        compatible:
          contains:
            const: mediatek,mt8189-nor
    then:
      properties:
        clocks:
          minItems: 5
        clock-names:
          minItems: 5
          items:
            - const: spi
            - const: sf
            - const: axi_f
            - const: axi_h
            - const: axi_p
    else:
      properties:
        clocks:
          minItems: 2
        clock-names:
          items:
            - const: spi
            - const: sf
            - const: axi
            - const: axi_s

unevaluatedProperties: false

examples:
  - |
    #include <dt-bindings/clock/mt8173-clk.h>

    soc {
      #address-cells = <2>;
      #size-cells = <2>;

      nor_flash: spi@1100d000 {
        compatible = "mediatek,mt8173-nor";
        reg = <0 0x1100d000 0 0xe0>;
        interrupts = <1>;
        clocks = <&pericfg CLK_PERI_SPI>, <&topckgen CLK_TOP_SPINFI_IFR_SEL>,
                 <&pericfg CLK_PERI_NFI>;
        clock-names = "spi", "sf", "axi";
        #address-cells = <1>;
        #size-cells = <0>;

        flash@0 {
          compatible = "jedec,spi-nor";
          reg = <0>;
        };
      };
    };

  - |

    soc {
      #address-cells = <2>;
      #size-cells = <2>;

      nor_flash: spi@1100d000 {
        compatible = "mediatek,mt8189-nor";
        reg = <0 0x1100d000 0 0xe0>;
        interrupts = <1>;
        clocks = <&pericfg CLK_PERI_SPI>, <&topckgen CLK_TOP_SPINFI_IFR_SEL>,
                 <&pericfg CLK_PERAO_SFLASH_F>, <&topckgen CLK_PERAO_SFLASH_H>,
                 <&pericfg CLK_PERAO_SFLASH_P>;
        clock-names = "spi", "sf", "axi_f", "axi_h", "axi_p";
        #address-cells = <1>;
        #size-cells = <0>;

        flash@0 {
          compatible = "jedec,spi-nor";
          reg = <0>;
        };
      };
    };
```
