## Documentation/devicetree/bindings/spi/via,vt8500-sflash.yaml
```yaml
# SPDX-License-Identifier: (GPL-2.0-only OR BSD-2-Clause)
%YAML 1.2
---
$id: http://devicetree.org/schemas/spi/via,vt8500-sflash.yaml#
$schema: http://devicetree.org/meta-schemas/core.yaml#

title: VIA/WonderMedia serial flash controller

description:
  This controller is used on VIA/WonderMedia SoCs such as VIA VT8500,
  WonderMedia WM8850 and similar. It provides a semi-transparent interface
  for reading and writing SPI NOR chip contents via a physical memory map,
  abstracting away all SPI communication, while also providing a direct
  mechanism for issuing "programmable commands" to the underlying SPI chip

maintainers:
  - Alexey Charkov <alchark@gmail.com>

properties:
  compatible:
    enum:
      - via,vt8500-sflash
      - wm,wm8505-sflash
      - wm,wm8650-sflash
      - wm,wm8750-sflash
      - wm,wm8850-sflash

  reg:
    items:
      - description: MMIO registers region of the controller
      - description:
          Physical memory region within which the controller will map the
          flash contents of chip 0 for reading and writing. If the flash
          size is smaller than this region, it will be mapped at its end.
          Note that if this chip is used as the boot device (as is most
          often the case), the boot ROM maps it at the very end of the
          CPU address space (i.e. ending at 0xffffffff)
      - description:
          Physical memory region within which the controller will map the
          flash contents of chip 1 for reading and writing. If the flash
          size is smaller than this region, it will be mapped at its end

  reg-names:
    items:
      - const: io
      - const: chip0-mmap
      - const: chip1-mmap

  clocks:
    maxItems: 1

  "#address-cells":
    const: 1

  "#size-cells":
    const: 0

patternProperties:
  "^flash@[0-1]$":
    type: object
    additionalProperties: true

    properties:
      reg:
        minimum: 0
        maximum: 1

required:
  - compatible
  - reg
  - reg-names
  - clocks

unevaluatedProperties: false

examples:
  - |
    sflash: spi-nor-controller@d8002000 {
        compatible = "wm,wm8850-sflash";
        reg = <0xd8002000 0x400>,
              <0xff800000 0x800000>,
              <0xef800000 0x800000>;
        reg-names = "io", "chip0-mmap", "chip1-mmap";
        clocks = <&clksf>;
        #address-cells = <1>;
        #size-cells = <0>;

        flash@0 {
            compatible = "jedec,spi-nor";
            reg = <0>;

            partitions {
                compatible = "fixed-partitions";
                #address-cells = <1>;
                #size-cells = <1>;

                partition@0 {
                    label = "U-boot";
                    reg = <0 0x50000>;
                    read-only;
                };

                partition@1 {
                    label = "U-boot environment 1";
                    reg = <0x50000 0x10000>;
                };

                partition@2 {
                    label = "U-boot environment 2";
                    reg = <0x60000 0x10000>;
                };

                partition@3 {
                    label = "W-load";
                    reg = <0x70000 0x10000>;
                    read-only;
                };
            };
        };
    };

...
```

## Documentation/devicetree/bindings/spi/zte,zx279128s-spifc.yaml
```yaml
# SPDX-License-Identifier: (GPL-2.0-only OR BSD-2-Clause)
%YAML 1.2
---
$id: http://devicetree.org/schemas/spi/zte,zx279128s-spifc.yaml#
$schema: http://devicetree.org/meta-schemas/core.yaml#

title: ZTE zx279128s SPI flash controller

maintainers:
  - Navid Ghahremani <ghahramani.navid@gmail.com>

description:
  The SPI flash controller of the ZTE zx279128s runs flash operations (an
  opcode with optional address, dummy and data phases) on one chip select.
  The data phase can use one, two or four lines.

allOf:
  - $ref: spi-controller.yaml#

properties:
  compatible:
    const: zte,zx279128s-spifc

  reg:
    maxItems: 1

  interrupts:
    maxItems: 1

  clocks:
    items:
      - description: work clock, the source of the SPI clock
      - description: register (APB) clock

  clock-names:
    items:
      - const: wclk
      - const: pclk

required:
  - compatible
  - reg
  - clocks
  - clock-names

unevaluatedProperties: false

examples:
  - |
    #include <dt-bindings/clock/zte,zx279128s-crm.h>
    #include <dt-bindings/interrupt-controller/arm-gic.h>

    spi@94406000 {
        compatible = "zte,zx279128s-spifc";
        reg = <0x94406000 0x1000>;
        interrupts = <GIC_SPI 13 IRQ_TYPE_LEVEL_HIGH>;
        clocks = <&lsp0crpm ZX279128S_LSP0_SPI_WCLK>,
                 <&lsp0crpm ZX279128S_LSP0_SPI_PCLK>;
        clock-names = "wclk", "pclk";
        #address-cells = <1>;
        #size-cells = <0>;

        flash@0 {
            compatible = "spi-nand";
            reg = <0>;
            spi-max-frequency = <50000000>;
            spi-rx-bus-width = <2>;
        };
    };
```

## Documentation/devicetree/bindings/thermal/airoha,an7583-thermal.yaml
```yaml
# SPDX-License-Identifier: (GPL-2.0 OR BSD-2-Clause)
%YAML 1.2
---
$id: http://devicetree.org/schemas/thermal/airoha,an7583-thermal.yaml#
$schema: http://devicetree.org/meta-schemas/core.yaml#

title: Airoha Thermal Sensor and Monitor

maintainers:
  - Christian Marangi <ansuelsmth@gmail.com>

properties:
  compatible:
    const: airoha,an7583-thermal

  '#thermal-sensor-cells':
    const: 0

required:
  - compatible
  - '#thermal-sensor-cells'

additionalProperties: false

examples:
  - |
    thermal-sensor {
        compatible = "airoha,an7583-thermal";

        #thermal-sensor-cells = <0>;
    };
```

## Documentation/devicetree/bindings/thermal/airoha-thermal.yaml
```yaml
# SPDX-License-Identifier: (GPL-2.0 OR BSD-2-Clause)
%YAML 1.2
---
$id: http://devicetree.org/schemas/thermal/airoha-thermal.yaml#
$schema: http://devicetree.org/meta-schemas/core.yaml#

title: Airoha Thermal Sensor and Monitor

maintainers:
  - Christian Marangi <ansuelsmth@gmail.com>

properties:
  compatible:
    enum:
      - airoha,en7581-thermal
      - airoha,an7583-thermal

  reg:
    maxItems: 1

  interrupts:
    maxItems: 1

  airoha,chip-scu:
    description: phandle to the chip SCU syscon
    $ref: /schemas/types.yaml#/definitions/phandle

  '#thermal-sensor-cells':
    const: 0

required:
  - compatible
  - '#thermal-sensor-cells'

allOf:
  - if:
      properties:
        compatible:
          contains:
            const: airoha,en7581-thermal
    then:
      required:
        - reg
        - interrupts
        - airoha,chip-scu

  - if:
      properties:
        compatible:
          contains:
            const: airoha,an7583-thermal
    then:
      properties:
        reg: false
        interrupts: false
        airoha,chip-scu: false

additionalProperties: false

examples:
  - |
    #include <dt-bindings/interrupt-controller/arm-gic.h>

    thermal-sensor@1efbd800 {
        compatible = "airoha,en7581-thermal";
        reg = <0x1efbd000 0xd5c>;
        interrupts = <GIC_SPI 23 IRQ_TYPE_LEVEL_HIGH>;
        airoha,chip-scu = <&chip_scu>;

        #thermal-sensor-cells = <0>;
    };

  - |
    thermal-sensor {
        compatible = "airoha,an7583-thermal";

        #thermal-sensor-cells = <0>;
    };
```

## Documentation/devicetree/bindings/thermal/dlg,da9062-thermal.yaml
```yaml
# SPDX-License-Identifier: (GPL-2.0-only OR BSD-2-Clause)
%YAML 1.2
---
$id: http://devicetree.org/schemas/thermal/dlg,da9062-thermal.yaml#
$schema: http://devicetree.org/meta-schemas/core.yaml#

title: Dialog DA9062/61 TJUNC Thermal Module

description:
  This module is part of the DA9061/DA9062. For more details about entire
  DA9062 and DA9061 chips see Documentation/devicetree/bindings/mfd/da9062.txt

  Junction temperature thermal module uses an interrupt signal to identify
  high THERMAL_TRIP_HOT temperatures for the PMIC device.

maintainers:
  - Biju Das <biju.das.jz@bp.renesas.com>

properties:
  compatible:
    oneOf:
      - items:
          - enum:
              - dlg,da9062-thermal
      - items:
          - enum:
              - dlg,da9061-thermal
          - const: dlg,da9062-thermal # da9062-thermal fallback

  polling-delay-passive:
    description:
      Specify the polling period, measured in milliseconds, between
      thermal zone device update checks.

required:
  - compatible

additionalProperties: false

examples:
  - |
    #include <dt-bindings/interrupt-controller/irq.h>
    i2c {
      #address-cells = <1>;
      #size-cells = <0>;
      pmic@58 {
        compatible = "dlg,da9062";
        reg = <0x58>;
        interrupt-parent = <&gpio6>;
        interrupts = <11 IRQ_TYPE_LEVEL_LOW>;
        interrupt-controller;

        thermal {
          compatible = "dlg,da9062-thermal";
          polling-delay-passive = <3000>;
        };
      };
    };
```

## Documentation/devicetree/bindings/thermal/hisilicon-thermal.yaml
```yaml
# SPDX-License-Identifier: GPL-2.0-only OR BSD-2-Clause
%YAML 1.2
---
$id: http://devicetree.org/schemas/thermal/hisilicon-thermal.yaml#
$schema: http://devicetree.org/meta-schemas/core.yaml#

title: Temperature Sensor on hisilicon SoCs

maintainers:
  - Abdulrasaq Lawani <abdulrasaqolawani@gmail.com>

properties:
  compatible:
    items:
      - enum:
          - hisilicon,tsensor
          - hisilicon,hi3660-tsensor

  reg:
    description: physical base address of thermal sensor and length of memory mapped region.
    minItems: 1
    maxItems: 2

  clocks:
    maxItems: 1

  clock-names:
    items:
      - const: thermal_clk

  interrupts:
    description:
      The interrupt number to the cpu. Defines the interrupt used
      by /SOCTHERM/tsensor.
    maxItems: 1

  # See Documentation/devicetree/bindings/thermal/thermal-sensor.yaml for details
  '#thermal-sensor-cells':
    const: 1

required:
  - compatible
  - reg
  - interrupts
  - '#thermal-sensor-cells'

additionalProperties: false

examples:
  - |
    #include <dt-bindings/interrupt-controller/arm-gic.h>
    #include <dt-bindings/clock/hi6220-clock.h>

     // for Hi6220:
     tsensor: tsensor@0,f7030700 {
     compatible = "hisilicon,tsensor";
     reg = <0x0 0xf7030700 0x0 0x1000>;
     interrupts = <0 7 0x4>;
     clocks = <&sys_ctrl HI6220_TSENSOR_CLK>;
     clock-names = "thermal_clk";
     #thermal-sensor-cells = <1>;
     };

     // for Hi3660:
     tsensor1: tsensor@fff30000 {
     compatible = "hisilicon,hi3660-tsensor";
     reg = <0x0 0xfff30000 0x0 0x1000>;
     interrupts = <GIC_SPI 145 IRQ_TYPE_LEVEL_HIGH>;
     #thermal-sensor-cells = <1>;
     };
```

## Documentation/devicetree/bindings/thermal/loongson,ls2k-thermal.yaml
```yaml
# SPDX-License-Identifier: (GPL-2.0-only OR BSD-2-Clause)
%YAML 1.2
---
$id: http://devicetree.org/schemas/thermal/loongson,ls2k-thermal.yaml#
$schema: http://devicetree.org/meta-schemas/core.yaml#

title: Thermal sensors on Loongson-2 SoCs

maintainers:
  - zhanghongchen <zhanghongchen@loongson.cn>
  - Yinbo Zhu <zhuyinbo@loongson.cn>

properties:
  compatible:
    oneOf:
      - enum:
          - loongson,ls2k0300-thermal
          - loongson,ls2k1000-thermal
          - loongson,ls2k2000-thermal
      - items:
          - enum:
              - loongson,ls2k0500-thermal
          - const: loongson,ls2k1000-thermal

  reg:
    minItems: 1
    maxItems: 2

  interrupts:
    maxItems: 1

  '#thermal-sensor-cells':
    const: 1

  loongson,chipid:
    $ref: /schemas/types.yaml#/definitions/phandle
    description:
      Phandle to the syscon with the Loongson-2K0300 CHIP ID.

required:
  - compatible
  - reg
  - interrupts

allOf:
  - $ref: /schemas/thermal/thermal-sensor.yaml#

  - if:
      properties:
        compatible:
          contains:
            const: loongson,ls2k0300-thermal
    then:
      properties:
        reg:
          items:
            - description: Thermal base register region
      required:
        - loongson,chipid

  - if:
      properties:
        compatible:
          contains:
            const: loongson,ls2k1000-thermal
    then:
      properties:
        loongson,chipid: false
        reg:
          items:
            - description: Thermal base register region

  - if:
      properties:
        compatible:
          contains:
            const: loongson,ls2k2000-thermal
    then:
      properties:
        loongson,chipid: false
        reg:
          items:
            - description: Thermal base register region
            - description: Thermal data output register region

unevaluatedProperties: false

examples:
  - |
    #include <dt-bindings/interrupt-controller/irq.h>
    thermal: thermal-sensor@1fe01500 {
        compatible = "loongson,ls2k1000-thermal";
        reg = <0x1fe01500 0x30>;
        interrupt-parent = <&liointc0>;
        interrupts = <7 IRQ_TYPE_LEVEL_LOW>;
        #thermal-sensor-cells = <1>;
    };

  - |
    #include <dt-bindings/interrupt-controller/irq.h>
    thermal-sensor@16001500 {
       compatible = "loongson,ls2k0300-thermal";
       reg = <0x16001500 0x30>;
       interrupt-parent = <&liointc1>;
       interrupts = <20 IRQ_TYPE_LEVEL_HIGH>;
       loongson,chipid = <&chipid>;
       #thermal-sensor-cells = <1>;
    };
```

## Documentation/devicetree/bindings/thermal/mediatek,mt6323-thermal.yaml
```yaml
# SPDX-License-Identifier: (GPL-2.0-only OR BSD-2-Clause)
%YAML 1.2
---
$id: http://devicetree.org/schemas/thermal/mediatek,mt6323-thermal.yaml#
$schema: http://devicetree.org/meta-schemas/core.yaml#

title: MediaTek PMIC thermal

maintainers:
  - Roman Vivchar <rva333@protonmail.com>

description:
  The MediaTek PMIC thermal sensor uses an AUXADC channel to read raw
  temperature data and applies calibration data from NVMEM.

allOf:
  - $ref: thermal-sensor.yaml#

properties:
  compatible:
    const: mediatek,mt6323-thermal

  io-channels:
    description: >
      IIO channel for the AUXADC to read raw data from.
    maxItems: 1

  io-channel-names:
    const: vts

  nvmem-cells:
    description: >
      NVMEM cell with phandle to the calibration data provided by the
      NVMEM device. If unspecified default values will be used.
    maxItems: 1

  nvmem-cell-names:
    const: calibration-data

  "#thermal-sensor-cells":
    const: 1

required:
  - compatible
  - io-channels
  - io-channel-names
  - "#thermal-sensor-cells"

unevaluatedProperties: false

examples:
  - |
    #include <dt-bindings/iio/adc/mediatek,mt6323-auxadc.h>

    mt6323_thermal: thermal {
      compatible = "mediatek,mt6323-thermal";
      nvmem-cells = <&mt6323_thermal_calibration_data>;
      nvmem-cell-names = "calibration-data";

      io-channels = <&mt6323_adc MT6323_AUXADC_CHIP_TEMP>;
      io-channel-names = "vts";
      #thermal-sensor-cells = <1>;
    };
```
