## Documentation/devicetree/bindings/thermal/qcom,pm8901-temp-alarm.yaml
```yaml
# SPDX-License-Identifier: (GPL-2.0-only OR BSD-2-Clause)
%YAML 1.2
---
$id: http://devicetree.org/schemas/thermal/qcom,pm8901-temp-alarm.yaml#
$schema: http://devicetree.org/meta-schemas/core.yaml#

title: Qualcomm PM8901 PMIC Temperature Alarm

maintainers:
  - Herman van Hazendonk <github.com@herrie.org>

description: |
  PM8901 is a secondary PMIC paired with PM8058 on MSM8x60 family
  (MSM8260/MSM8660/APQ8060) platforms. It exposes an over-temperature
  alarm block at SSBI offset
  0x23 (CTRL) / 0x24 (PWM) with four selectable thresholds and three
  escalating stages. Unlike PM8058, there is no raw die-temperature
  ADC channel — the driver decodes the stage + threshold pair into a
  representative millicelsius value.

  Two PMIC-internal interrupts are exposed: a stage-transition alarm
  (TEMP_ALARM, PM8901 IRQ block 6 bit 4 == 52) and a hi-temp alarm
  (TEMP_HI_ALARM, block 6 bit 5 == 53).

  The driver registers a thermal-of sensor; board DTs declare trip
  points and a critical-trip action against it.

properties:
  compatible:
    const: qcom,pm8901-temp-alarm

  reg:
    description: SSBI offset of the temp-alarm CTRL register.
    maxItems: 1

  interrupts:
    items:
      - description: Stage-transition alarm interrupt (TEMP_ALARM).
      - description: Hi-temperature alarm interrupt (TEMP_HI_ALARM).

  interrupt-names:
    items:
      - const: alarm
      - const: hi-alarm

  "#thermal-sensor-cells":
    const: 0

required:
  - compatible
  - reg
  - interrupts
  - interrupt-names
  - "#thermal-sensor-cells"

additionalProperties: false

examples:
  - |
    #include <dt-bindings/interrupt-controller/irq.h>

    ssbi {
      pmic {
        compatible = "qcom,pm8901";
        #interrupt-cells = <2>;
        interrupt-controller;
        #address-cells = <1>;
        #size-cells = <0>;

        pm8901_temp: temp-alarm@23 {
          compatible = "qcom,pm8901-temp-alarm";
          reg = <0x23>;
          interrupts = <52 IRQ_TYPE_EDGE_RISING>,
                       <53 IRQ_TYPE_EDGE_RISING>;
          interrupt-names = "alarm", "hi-alarm";
          #thermal-sensor-cells = <0>;
        };
      };
    };
```

## Documentation/devicetree/bindings/thermal/qcom,qmi-cooling.yaml
```yaml
# SPDX-License-Identifier: (GPL-2.0 OR BSD-2-Clause)

%YAML 1.2
---
$id: http://devicetree.org/schemas/thermal/qcom,qmi-cooling.yaml#
$schema: http://devicetree.org/meta-schemas/core.yaml#

title: Qualcomm QMI based thermal mitigation (TMD) cooling devices

maintainers:
  - Gaurav Kohli <gaurav.kohli@oss.qualcomm.com>

description:
  Qualcomm QMI-based TMD cooling devices are used to mitigate thermal conditions
  across multiple remote subsystems. These devices operate based on junction
  temperature sensors (TSENS) associated with thermal zones for each subsystem.

properties:
  compatible:
    enum:
      - qcom,qmi-cooling-cdsp
      - qcom,qmi-cooling-cdsp1

patternProperties:
  "cdsp-tmd[0-9]*$":
    type: object

    description:
      Each subnode which represents qmi communication to CDSP.

    properties:
      label:
        maxItems: 1

      "#cooling-cells":
        $ref: /schemas/thermal/thermal-cooling-devices.yaml#/properties/#cooling-cells

    required:
      - label
      - "#cooling-cells"

    additionalProperties: false

required:
  - compatible

additionalProperties: false

examples:
  - |
    remoteproc-cdsp {
        cooling {
            compatible = "qcom,qmi-cooling-cdsp";

            cdsp_tmd0: cdsp-tmd0 {
              label = "cdsp_sw";
              #cooling-cells = <2>;
            };
        };
    };

  - |
    remoteproc-cdsp1 {
        cooling {
            compatible = "qcom,qmi-cooling-cdsp1";

            cdsp_tmd1: cdsp-tmd1 {
              label = "cdsp_sw";
              #cooling-cells = <2>;
            };
        };
    };
```

## Documentation/devicetree/bindings/thermal/renesas,r9a09g047-tsu.yaml
```yaml
# SPDX-License-Identifier: (GPL-2.0-only OR BSD-2-Clause)
%YAML 1.2
---
$id: http://devicetree.org/schemas/thermal/renesas,r9a09g047-tsu.yaml#
$schema: http://devicetree.org/meta-schemas/core.yaml#

title: Renesas RZ/G3E Temperature Sensor Unit (TSU)

maintainers:
  - John Madieu <john.madieu.xa@bp.renesas.com>

description: |
  The Temperature Sensor Unit (TSU) is an integrated thermal sensor that monitors
  the chip temperature on the Renesas RZ/G3E SoC. The TSU provides real-time
  temperature measurements for thermal management.

properties:
  compatible:
    const: renesas,r9a09g047-tsu

  reg:
    maxItems: 1

  clocks:
    maxItems: 1

  resets:
    maxItems: 1

  power-domains:
    maxItems: 1

  interrupts:
    description: |
      Interrupt specifiers for the TSU:
      - S12TSUADI1: Conversion complete interrupt signal (pulse)
      - S12TSUADCMPI1: Comparison result interrupt signal (level)

  interrupt-names:
    items:
      - const: S12TSUADI1
      - const: S12TSUADCMPI1

  "#thermal-sensor-cells":
    const: 0

  renesas,tsu-calibration-sys:
    $ref: /schemas/types.yaml#/definitions/phandle
    description: |
      Phandle to the system controller (sys) that contains the TSU
      calibration values used for temperature calculations.

  renesas,tsu-operating-mode:
    $ref: /schemas/types.yaml#/definitions/uint32
    enum: [0, 1]
    description: |
      TSU operating mode:
      0: Mode 0 - Conversion started by software
      1: Mode 1 - Conversion started by ELC trigger

required:
  - compatible
  - reg
  - clocks
  - resets
  - power-domains
  - interrupts
  - interrupt-names
  - "#thermal-sensor-cells"
  - renesas,tsu-operating-mode
  - renesas,tsu-calibration-sys

additionalProperties: false

examples:
  - |
    #include <dt-bindings/clock/renesas,r9a09g047-cpg.h>
    #include <dt-bindings/interrupt-controller/arm-gic.h>

    tsu: thermal@14002000 {
        compatible = "renesas,r9a09g047-tsu";
        reg = <0 0x14002000 0 0x1000>;
        clocks = <&cpg CPG_MOD 0x10a>;
        resets = <&cpg 0xf8>;
        power-domains = <&cpg>;
        interrupts = <GIC_SPI 250 IRQ_TYPE_EDGE_RISING>,
                     <GIC_SPI 251 IRQ_TYPE_LEVEL_HIGH>;
        interrupt-names = "S12TSUADI1", "S12TSUADCMPI1";
        #thermal-sensor-cells = <0>;
        renesas,tsu-operating-mode = <0>;
        renesas,tsu-calibration-sys = <&sys>;
    };

    thermal-zones {
        cpu-thermal {
            polling-delay = <1000>;
            polling-delay-passive = <250>;
            thermal-sensors = <&tsu>;

            cooling-maps {
                map0 {
                    trip = <&target>;
                    cooling-device = <&cpu0 0 3>, <&cpu1 0 3>,
                                     <&cpu2 0 3>, <&cpu3 0 3>;
                    contribution = <1024>;
                };
            };

            trips {
                target: trip-point {
                    temperature = <95000>;
                    hysteresis = <1000>;
                    type = "passive";
                };

                sensor_crit: sensor-crit {
                    temperature = <120000>;
                    hysteresis = <1000>;
                    type = "critical";
                };
            };
        };
    };
```
