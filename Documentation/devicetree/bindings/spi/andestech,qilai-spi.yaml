## Documentation/devicetree/bindings/spi/microchip,pic32mzda-sqi.yaml
```yaml
# SPDX-License-Identifier: (GPL-2.0-only OR BSD-2-Clause)
%YAML 1.2
---
$id: http://devicetree.org/schemas/spi/microchip,pic32mzda-sqi.yaml#
$schema: http://devicetree.org/meta-schemas/core.yaml#

title: Microchip PIC32MZDA Quad SPI controller

maintainers:
  - Mark Brown <broonie@kernel.org>

allOf:
  - $ref: spi-controller.yaml#

properties:
  compatible:
    const: microchip,pic32mzda-sqi

  reg:
    maxItems: 1

  interrupts:
    maxItems: 1

  clocks:
    items:
      - description: SPI source clock
      - description: SQI register interface clock

  clock-names:
    items:
      - const: spi_ck
      - const: reg_ck

required:
  - compatible
  - reg
  - interrupts
  - clocks
  - clock-names

unevaluatedProperties: false

examples:
  - |
    #include <dt-bindings/clock/microchip,pic32-clock.h>
    #include <dt-bindings/interrupt-controller/irq.h>

    spi@1f8e2000 {
        compatible = "microchip,pic32mzda-sqi";
        reg = <0x1f8e2000 0x200>;
        interrupts = <169 IRQ_TYPE_LEVEL_HIGH>;
        clocks = <&rootclk REF2CLK>, <&rootclk PB5CLK>;
        clock-names = "spi_ck", "reg_ck";
    };
```

## Documentation/devicetree/bindings/spi/nuvoton,ma35d1-qspi.yaml
```yaml
# SPDX-License-Identifier: (GPL-2.0-only OR BSD-2-Clause)
%YAML 1.2
---
$id: http://devicetree.org/schemas/spi/nuvoton,ma35d1-qspi.yaml#
$schema: http://devicetree.org/meta-schemas/core.yaml#

title: Nuvoton MA35D1 Quad SPI Controller

maintainers:
  - Chi-Wen Weng <cwweng@nuvoton.com>

allOf:
  - $ref: spi-controller.yaml#

properties:
  compatible:
    const: nuvoton,ma35d1-qspi

  reg:
    maxItems: 1

  interrupts:
    maxItems: 1

  clocks:
    maxItems: 1

required:
  - compatible
  - reg
  - clocks

unevaluatedProperties: false

examples:
  - |
    #include <dt-bindings/interrupt-controller/arm-gic.h>
    #include <dt-bindings/clock/nuvoton,ma35d1-clk.h>

    soc {
        #address-cells = <2>;
        #size-cells = <2>;

        spi@40680000 {
            compatible = "nuvoton,ma35d1-qspi";
            reg = <0x0 0x40680000 0x0 0x100>;
            interrupts = <GIC_SPI 57 IRQ_TYPE_LEVEL_HIGH>;
            clocks = <&clk QSPI0_GATE>;
            #address-cells = <1>;
            #size-cells = <0>;

            flash@0 {
                compatible = "jedec,spi-nor";
                spi-max-frequency = <30000000>;
                reg = <0>;
                spi-rx-bus-width = <4>;
                spi-tx-bus-width = <1>;
            };
        };
    };
```

## Documentation/devicetree/bindings/spi/nuvoton,ma35d1-spi.yaml
```yaml
# SPDX-License-Identifier: (GPL-2.0-only OR BSD-2-Clause)
%YAML 1.2
---
$id: http://devicetree.org/schemas/spi/nuvoton,ma35d1-spi.yaml#
$schema: http://devicetree.org/meta-schemas/core.yaml#

title: Nuvoton MA35D1 SPI Controller

description: |
  The Nuvoton MA35D1 SPI controller supports host and target operation and
  provides two native chip-select outputs. GPIO chip selects are supported
  through the generic SPI controller binding.

maintainers:
  - Chi-Wen Weng <cwweng@nuvoton.com>

allOf:
  - $ref: /schemas/spi/spi-controller.yaml#

properties:
  compatible:
    const: nuvoton,ma35d1-spi

  reg:
    maxItems: 1

  interrupts:
    maxItems: 1

  clocks:
    maxItems: 1

  resets:
    maxItems: 1

  num-cs:
    minimum: 1
    maximum: 2
    default: 2

required:
  - compatible
  - reg
  - clocks
  - resets

unevaluatedProperties: false

examples:
  - |
    #include <dt-bindings/clock/nuvoton,ma35d1-clk.h>
    #include <dt-bindings/interrupt-controller/arm-gic.h>
    #include <dt-bindings/reset/nuvoton,ma35d1-reset.h>

    soc {
        #address-cells = <2>;
        #size-cells = <2>;

        spi@40600000 {
            compatible = "nuvoton,ma35d1-spi";
            reg = <0x0 0x40600000 0x0 0x10000>;
            interrupts = <GIC_SPI 89 IRQ_TYPE_LEVEL_HIGH>;
            clocks = <&clk SPI0_GATE>;
            resets = <&sys MA35D1_RESET_SPI0>;

            #address-cells = <1>;
            #size-cells = <0>;
        };
    };
...
```

## Documentation/devicetree/bindings/spi/nuvoton,npcm-fiu.yaml
```yaml
# SPDX-License-Identifier: GPL-2.0-only OR BSD-2-Clause
%YAML 1.2
---
$id: http://devicetree.org/schemas/spi/nuvoton,npcm-fiu.yaml#
$schema: http://devicetree.org/meta-schemas/core.yaml#

title: Nuvoton NPCM Flash Interface Unit (FIU) SPI Controller

maintainers:
  - Tomer Maimon <tmaimon77@gmail.com>

allOf:
  - $ref: spi-controller.yaml#

description: |
  NPCM FIU supports single, dual and quad communication interface.

  The NPCM7XX supports three FIU modules:
    FIU0 and FIUx support two chip selects
    FIU3 supports four chip selects.

  The NPCM8XX supports four FIU modules:
    FIU0 and FIUx support two chip selects
    FIU1 and FIU3 support four chip selects.

  Alias convention:
    The '/aliases' node should define:
      For NPCM7xx:  fiu0=&fiu0; fiu1=&fiu3; fiu2=&fiux;
      For NPCM8xx:  fiu0=&fiu0; fiu1=&fiu3; fiu2=&fiux; fiu3=&fiu1;

properties:
  compatible:
    enum:
      - nuvoton,npcm750-fiu # Poleg NPCM7XX
      - nuvoton,npcm845-fiu # Arbel NPCM8XX

  reg:
    minItems: 1
    items:
      - description: FIU registers
      - description: Memory-mapped flash contents (optional)

  reg-names:
    minItems: 1
    items:
      - const: control
      - const: memory

  clocks:
    maxItems: 1

  clock-names:
    items:
      - enum:
          - clk_spi0
          - clk_spi1
          - clk_spi3
          - clk_spix

  nuvoton,spix-mode:
    type: boolean
    description: Enable SPIX mode for an expansion bus to an ASIC or CPLD.

required:
  - compatible
  - reg
  - reg-names
  - clocks

unevaluatedProperties: false

examples:
  - |
    #include <dt-bindings/clock/nuvoton,npcm7xx-clock.h>
    spi@fb000000 {
        compatible = "nuvoton,npcm750-fiu";
        #address-cells = <1>;
        #size-cells = <0>;
        reg = <0xfb000000 0x1000>, <0x80000000 0x10000000>;
        reg-names = "control", "memory";
        clocks = <&clk NPCM7XX_CLK_AHB>;
        pinctrl-names = "default";
        pinctrl-0 = <&spi3_pins>;

        flash@0 {
            compatible = "jedec,spi-nor";
            reg = <0>;
            #address-cells = <1>;
            #size-cells = <1>;
        };
    };
```

## Documentation/devicetree/bindings/spi/nvidia,lstp-spi.yaml
```yaml
# SPDX-License-Identifier: (GPL-2.0-only OR BSD-2-Clause)
# SPDX-FileCopyrightText: Copyright (c) 2026 NVIDIA CORPORATION & AFFILIATES. All rights reserved.
%YAML 1.2
---
$id: http://devicetree.org/schemas/spi/nvidia,lstp-spi.yaml#
$schema: http://devicetree.org/meta-schemas/core.yaml#

title: NVIDIA LSTP SPI Channel

maintainers:
  - Adrian Ambrozewicz <aambrozewicz@nvidia.com>
  - Donald Shannon <donalds@nvidia.com>

description: |
  SPI controller channel on an NVIDIA LSTP USB device.

  Peripherals on the bus are described as child nodes.  The number of
  chip selects and the bus speed are reported by the device firmware;
  only chip selects 0 and 1 can be addressed.

allOf:
  - $ref: /schemas/spi/spi-controller.yaml#

properties:
  compatible:
    const: nvidia,lstp-spi

  reg:
    description: Channel ID reported by the device firmware.
    maxItems: 1

patternProperties:
  "@[0-9a-f]+$":
    type: object

    properties:
      reg:
        description: Chip select.
        maximum: 1

      spi-max-frequency:
        description: Must not exceed the speed reported by the device firmware.

required:
  - compatible
  - reg

unevaluatedProperties: false

examples:
  - |
    interface {
        #address-cells = <1>;
        #size-cells = <0>;

        spi@1 {
            compatible = "nvidia,lstp-spi";
            reg = <1>;
            #address-cells = <1>;
            #size-cells = <0>;

            flash@0 {
                compatible = "jedec,spi-nor";
                reg = <0>;
                spi-max-frequency = <18750000>;
            };
        };
    };
```

## Documentation/devicetree/bindings/spi/qcom,spi-qpic-snand.yaml
```yaml
# SPDX-License-Identifier: (GPL-2.0-only OR BSD-2-Clause)
%YAML 1.2
---
$id: http://devicetree.org/schemas/spi/qcom,spi-qpic-snand.yaml#
$schema: http://devicetree.org/meta-schemas/core.yaml#

title: Qualcomm QPIC NAND controller

maintainers:
  - Md sadre Alam <quic_mdalam@quicinc.com>

properties:
  compatible:
    enum:
      - qcom,ipq9574-snand

  reg:
    maxItems: 1

  clocks:
    minItems: 2
    maxItems: 3

  clock-names:
    minItems: 2
    maxItems: 3

allOf:
  - $ref: /schemas/spi/spi-controller.yaml#
  - if:
      properties:
        compatible:
          contains:
            enum:
              - qcom,ipq9574-snand

    then:
      properties:
        dmas:
          items:
            - description: tx DMA channel
            - description: rx DMA channel
            - description: cmd DMA channel

        dma-names:
          items:
            - const: tx
            - const: rx
            - const: cmd
required:
  - compatible
  - reg
  - clocks
  - clock-names

unevaluatedProperties: false

examples:
  - |
    #include <dt-bindings/clock/qcom,ipq9574-gcc.h>
    qpic_nand: spi@79b0000 {
        compatible = "qcom,ipq9574-snand";
        reg = <0x1ac00000 0x800>;

        clocks = <&gcc GCC_QPIC_CLK>,
                 <&gcc GCC_QPIC_AHB_CLK>,
                 <&gcc GCC_QPIC_IO_MACRO_CLK>;
        clock-names = "core", "aon", "iom";

        #address-cells = <1>;
        #size-cells = <0>;

        flash@0 {
            compatible = "spi-nand";
            reg = <0>;
            #address-cells = <1>;
            #size-cells = <1>;
            nand-ecc-engine = <&qpic_nand>;
            nand-ecc-strength = <4>;
            nand-ecc-step-size = <512>;
            };
        };
```

## Documentation/devicetree/bindings/spi/spi-xilinx.yaml
```yaml
# SPDX-License-Identifier: (GPL-2.0-only OR BSD-2-Clause)
%YAML 1.2
---
$id: http://devicetree.org/schemas/spi/spi-xilinx.yaml#
$schema: http://devicetree.org/meta-schemas/core.yaml#

title: Xilinx SPI controller

maintainers:
  - Michal Simek <michal.simek@amd.com>

allOf:
  - $ref: spi-controller.yaml#

  - if:
      properties:
        compatible:
          contains:
            const: xlnx,axi-quad-spi-1.00.a
    then:
      properties:
        clock-names:
          items:
            - const: s_axi_aclk
            - const: ext_spi_clk

    else:
      properties:
        clock-names:
          items:
            - const: s_axi4_aclk
            - const: ext_spi_clk

properties:
  compatible:
    enum:
      - xlnx,xps-spi-2.00.a
      - xlnx,xps-spi-2.00.b
      - xlnx,axi-quad-spi-1.00.a

  reg:
    maxItems: 1

  interrupts:
    maxItems: 1

  clocks:
    maxItems: 2

  clock-names:
    maxItems: 2

  xlnx,num-ss-bits:
    description: Number of chip selects used.
    minimum: 1
    maximum: 32

  xlnx,num-transfer-bits:
    description: Number of bits per transfer. This will be 8 if not specified.
    enum: [8, 16, 32]
    default: 8

required:
  - compatible
  - reg
  - interrupts
  - clocks
  - clock-names

unevaluatedProperties: false

examples:
  - |
    spi0: spi@41e00000 {
      compatible = "xlnx,xps-spi-2.00.a";
      interrupt-parent = <&intc>;
      interrupts = <0 31 1>;
      reg = <0x41e00000 0x10000>;
      clocks = <&clkc 72>, <&clkc 73>;
      clock-names = "s_axi4_aclk", "ext_spi_clk";
      xlnx,num-ss-bits = <0x1>;
      xlnx,num-transfer-bits = <32>;
    };
...
```

## Documentation/devicetree/bindings/spi/ti,dm6441-spi.yaml
```yaml
# SPDX-License-Identifier: (GPL-2.0-only OR BSD-2-Clause)
%YAML 1.2
---
$id: http://devicetree.org/schemas/spi/ti,dm6441-spi.yaml#
$schema: http://devicetree.org/meta-schemas/core.yaml#

title: Davinci SPI Controller

description:
  SPI controllers on TI Davinci, OMAP-L138, and Keystone2 SoCs.

maintainers:
  - Andrew Davis <afd@ti.com>

allOf:
  - $ref: spi-controller.yaml#

properties:
  compatible:
    items:
      - enum:
          - ti,dm6441-spi # for SPI used on DM644x SoC family
          - ti,da830-spi # for SPI used on DA8xx SoC family
          - ti,keystone-spi # for SPI used on Keystone2 SoC family

  reg:
    maxItems: 1

  interrupts:
    maxItems: 1

  clock-names:
    maxItems: 1

  clocks:
    maxItems: 1

  power-domains:
    maxItems: 1

  ti,davinci-spi-intr-line:
    description:
      Interrupt line used to connect the SPI IP to the interrupt controller
        within the SoC. Possible values are 0 and 1. Manual says one of the
        two possible interrupt lines can be tied to the interrupt controller.
    $ref: /schemas/types.yaml#/definitions/uint32
    enum: [0, 1]

required:
  - compatible
  - reg
  - interrupts
  - clocks

unevaluatedProperties: false

examples:
  - |
    spi@20bf0000 {
        #address-cells = <1>;
        #size-cells = <0>;
        compatible = "ti,dm6441-spi";
        reg = <0x20bf0000 0x1000>;
        interrupts = <338>;
        clocks = <&clkspi>;

        num-cs = <4>;
        ti,davinci-spi-intr-line = <0>;

        flash@0 {
            compatible = "st,m25p32";
            spi-max-frequency = <50000000>;
            reg = <0>;
            ti,spi-wdelay = <8>;
        };
    };
```
