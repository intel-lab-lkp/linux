## Documentation/devicetree/bindings/misc/pci1de4,1.yaml
```yaml
# SPDX-License-Identifier: (GPL-2.0-only OR BSD-2-Clause)
%YAML 1.2
---
$id: http://devicetree.org/schemas/misc/pci1de4,1.yaml#
$schema: http://devicetree.org/meta-schemas/core.yaml#

title: RaspberryPi RP1 MFD PCI device

maintainers:
  - Andrea della Porta <andrea.porta@suse.com>

description:
  The RaspberryPi RP1 is a PCI multi function device containing
  peripherals ranging from Ethernet to USB controller, I2C, SPI
  and others.
  The peripherals are accessed by addressing the PCI BAR1 region.

allOf:
  - $ref: /schemas/pci/pci-ep-bus.yaml

properties:
  compatible:
    additionalItems: true
    maxItems: 3
    items:
      - const: pci1de4,1

  '#interrupt-cells':
    const: 2
    description:
      Specifies respectively the interrupt number and flags as defined
      in include/dt-bindings/interrupt-controller/irq.h.

  interrupt-controller: true

unevaluatedProperties: false

required:
  - compatible
  - '#interrupt-cells'
  - interrupt-controller
  - pci-ep-bus@1

examples:
  - |
    pci {
        #address-cells = <3>;
        #size-cells = <2>;

        rp1@0,0 {
            compatible = "pci1de4,1";
            ranges = <0x01 0x00 0x00000000
                      0x82010000 0x00 0x00
                      0x00 0x400000>;
            #address-cells = <3>;
            #size-cells = <2>;
            interrupt-controller;
            #interrupt-cells = <2>;

            pci_ep_bus: pci-ep-bus@1 {
                compatible = "simple-bus";
                ranges = <0xc0 0x40000000
                          0x01 0x00 0x00000000
                          0x00 0x00400000>;
                dma-ranges = <0x10 0x00000000
                              0x43000000 0x10 0x00000000
                              0x10 0x00000000>;
                #address-cells = <2>;
                #size-cells = <2>;

                rp1_clocks: clocks@c040018000 {
                    compatible = "raspberrypi,rp1-clocks";
                    reg = <0xc0 0x40018000 0x0 0x10038>;
                    #clock-cells = <1>;
                    clocks = <&clk_rp1_xosc>;
                    clock-names =  "xosc";
                };
            };
        };
    };
```

## Documentation/devicetree/bindings/misc/qcom,qrc.yaml
```yaml
# SPDX-License-Identifier: (GPL-2.0-only OR BSD-2-Clause)
%YAML 1.2
---
$id: http://devicetree.org/schemas/misc/qcom,qrc.yaml#
$schema: http://devicetree.org/meta-schemas/core.yaml#

title: Qualcomm Robotics Communication Driver

maintainers:
  - Srinivas Kandagatla <srinivas.kandagatla@linaro.org>

description: |
  The QRC (Qualcomm Robotics Communication) driver is used for information interaction
  between the robot control board and the main board when using a uart port connection.
  This Driver will support uart read & write and robot control board
  reset function.

properties:
  compatible:
    const: qcom,qrc-uart

required:
  - compatible

additionalProperties: false

examples:
  - |
    qrc: qcom,qrc_uart {
        compatible = "qcom,qrc-uart";
    };
```

## Documentation/devicetree/bindings/misc/qemu,pvpanic-mmio.yaml
```yaml
# SPDX-License-Identifier: (GPL-2.0-only OR BSD-2-Clause)
%YAML 1.2
---
$id: http://devicetree.org/schemas/misc/qemu,pvpanic-mmio.yaml#
$schema: http://devicetree.org/meta-schemas/core.yaml#

title: QEMU PVPANIC MMIO device

description:
  QEMU provides a pvpanic MMIO interface for guest panic notification.

maintainers:
  - Peng Hao <peng.hao2@zte.com.cn>

properties:
  compatible:
    const: qemu,pvpanic-mmio

  reg:
    maxItems: 1

required:
  - compatible
  - reg

additionalProperties: false

examples:
  - |
    pvpanic@9060000 {
      compatible = "qemu,pvpanic-mmio";
      reg = <0x0 0x9060000 0x0 0x2>;
    };
```

## Documentation/devicetree/bindings/misc/rohm,bm92txx.yaml
```yaml
# SPDX-License-Identifier: (GPL-2.0 OR BSD-2-Clause)
# Copyright (C) 2023 Emmanuel Gil Peyrot
%YAML 1.2
---
$id: http://devicetree.org/schemas/misc/rohm,bm92txx.yaml#
$schema: http://devicetree.org/meta-schemas/core.yaml#

title: BM92Txx USB-C Power Delivery Controller

maintainers:
  - Emmanuel Gil Peyrot <linkmauve@linkmauve.fr>

properties:
  compatible:
    enum:
      - rohm,bm92t10
      - rohm,bm92t20
      - rohm,bm92t30
      - rohm,bm92t36
      - rohm,bm92t50

  reg:
    maxItems: 1

  rohm,dp-signal-toggle-on-resume:
    type: boolean
    description: |
      Do a toggle on resume instead of disable in suspend and enable in resume,
      because this also disables the LED effects.

  rohm,led-static-on-suspend:
    type: boolean
    description: Dim or breathing dock LED.

  rohm,dock-power-limit-disable:
    type: boolean
    description: Disable the power limit in dock mode.

  rohm,dp-alerts-enable:
    type: boolean
    description: Enable DisplayPort alerts.

  rohm,pd-5v-current-limit-ma:
    $ref: /schemas/types.yaml#/definitions/uint32
    default: 2000
    description: Current limit in mA when voltage is 5V.

  rohm,pd-9v-current-limit-ma:
    $ref: /schemas/types.yaml#/definitions/uint32
    default: 2000
    description: Current limit in mA when voltage is 9V.

  rohm,pd-12v-current-limit-ma:
    $ref: /schemas/types.yaml#/definitions/uint32
    default: 1500
    description: Current limit in mA when voltage is 12V.

  rohm,pd-15v-current-limit-ma:
    $ref: /schemas/types.yaml#/definitions/uint32
    default: 1200
    description: Current limit in mA when voltage is 15V.

required:
  - compatible
  - reg

additionalProperties: false
```

## Documentation/devicetree/bindings/misc/silex,multipk.yaml
```yaml
# SPDX-License-Identifier: (GPL-2.0-only OR BSD-2-Clause)
%YAML 1.2
---
$id: http://devicetree.org/schemas/misc/silex,multipk.yaml#
$schema: http://devicetree.org/meta-schemas/core.yaml#

title: Silex MultiPK driver

maintainers:
  - Nipun Gupta <nipun.gupta@amd.com>
  - Praveen Jain <praveen.jain@amd.com>

description: |
  Silex Multipk device handles the Asymmetric crypto operations. The
  driver provides interface to user-space to directly interact with the
  Silex MultiPK device.

properties:
  compatible:
    const: silex,mutlipk

  interrupts:
    maxItems: 1

  reg:
    items:
      - description: PKI Queues memory region
      - description: PKI TRNG memory region
      - description: PKI reset memory region

required:
  - compatible
  - reg
  - interrupts
  - iommus

additionalProperties: false

examples:
  - |
    #include <dt-bindings/interrupt-controller/irq.h>

    multipk@20400000000 {
      compatible = "silex,multipk";
      interrupts = <0x00000000 0x0000009b IRQ_TYPE_LEVEL_HIGH>;
      reg = <0x00000204 0x00000000 0x00000000 0x00010000>,
            <0x00000204 0x00020000 0x00000000 0x00000050>,
            <0x00000000 0xEC200340 0x00000000 0x00000004>;
      iommus = <&smmu 0x25B>;
    };
```
