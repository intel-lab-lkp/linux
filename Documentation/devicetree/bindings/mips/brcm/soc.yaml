## Documentation/devicetree/bindings/mips/brcm/soc.yaml
```yaml
# SPDX-License-Identifier: (GPL-2.0-only OR BSD-2-Clause)
%YAML 1.2
---
$id: http://devicetree.org/schemas/mips/brcm/soc.yaml#
$schema: http://devicetree.org/meta-schemas/core.yaml#

title: Broadcom cable/DSL/settop platforms

maintainers:
  - Florian Fainelli <f.fainelli@gmail.com>

description: |
    Boards Broadcom cable/DSL/settop SoC shall have the following properties.
    The experimental -viper variants are for running Linux on the 3384's
    BMIPS4355 cable modem CPU instead of the BMIPS5000 application processor.

properties:
  $nodename:
    const: '/'

  compatible:
    enum:
      - brcm,bcm3368
      - brcm,bcm3384
      - brcm,bcm33843
      - brcm,bcm3384-viper
      - brcm,bcm33843-viper
      - brcm,bcm6328
      - brcm,bcm6358
      - brcm,bcm6362
      - brcm,bcm6368
      - brcm,bcm63168
      - brcm,bcm63268
      - brcm,bcm7125
      - brcm,bcm7346
      - brcm,bcm7358
      - brcm,bcm7360
      - brcm,bcm7362
      - brcm,bcm7420
      - brcm,bcm7425

  cpus:
    type: object
    additionalProperties: false
    properties:
      '#address-cells':
        const: 1

      '#size-cells':
        const: 0

      mips-hpt-frequency:
        description: MIPS counter high precision timer frequency.
         This is common to all CPUs in the system so it lives
         under the "cpus" node.
        $ref: /schemas/types.yaml#/definitions/uint32

      mips-broken-cbr-reg:
        description: Declare that the Bootloader init a broken
          CBR address in the registers and the one provided from
          DT should always be used.
        type: boolean

      mips-cbr-reg:
        description: Reference address of the CBR.
          Some SoC suffer from a BUG where read_c0_brcm_cbr() might
          return 0 if called from TP1. The CBR address is always the
          same on the SoC hence it can be provided in DT to handle
          broken case where bootloader doesn't init it or SMP where
          read_c0_brcm_cbr() returns 0 from TP1.
        $ref: /schemas/types.yaml#/definitions/uint32

    patternProperties:
      "^cpu@[0-9]$":
        type: object
        $ref: /schemas/mips/cpus.yaml#
        unevaluatedProperties: false

    required:
      - mips-hpt-frequency

dependencies:
  mips-broken-cbr-reg: [ mips-cbr-reg ]

if:
  properties:
    compatible:
      contains:
        anyOf:
          - const: brcm,bcm6358
          - const: brcm,bcm6368

then:
  properties:
    cpus:
      required:
        - mips-cbr-reg

additionalProperties: true

examples:
  - |
     / {
         compatible = "brcm,bcm3368";
         #address-cells = <1>;
         #size-cells = <1>;
         model = "Broadcom 3368";

         cpus {
           #address-cells = <1>;
           #size-cells = <0>;

           mips-hpt-frequency = <150000000>;

           cpu@0 {
             compatible = "brcm,bmips4350";
             device_type = "cpu";
             reg = <0>;
           };

           cpu@1 {
             compatible = "brcm,bmips4350";
             device_type = "cpu";
             reg = <1>;
           };
         };
       };
...
```

## Documentation/devicetree/bindings/mips/econet,en751221-chip-scu.yaml
```yaml
# SPDX-License-Identifier: (GPL-2.0 OR BSD-2-Clause)
%YAML 1.2
---
$id: http://devicetree.org/schemas/mips/econet,en751221-chip-scu.yaml#
$schema: http://devicetree.org/meta-schemas/core.yaml#

title: EcoNet Chip SCU Controller for EN751221 SoC

maintainers:
  - Caleb James DeLisle <cjd@cjdns.fr>

description:
  The EcoNet chip-scu block provides a configuration interface for clock,
  io-muxing and other functionalities used by multiple controllers (e.g. clock,
  pinctrl, ecc) on EN751221 SoC.

properties:
  compatible:
    items:
      - const: econet,en751221-chip-scu
      - const: syscon

  reg:
    maxItems: 1

required:
  - compatible
  - reg

additionalProperties: false

examples:
  - |
    soc {
      #address-cells = <1>;
      #size-cells = <1>;
      syscon@1fa20000 {
        compatible = "econet,en751221-chip-scu", "syscon";
        reg = <0x1fa20000 0x388>;
      };
    };
```

## Documentation/devicetree/bindings/mips/lantiq/soc.yaml
```yaml
# SPDX-License-Identifier: (GPL-2.0-only OR BSD-2-Clause)
%YAML 1.2
---
$id: http://devicetree.org/schemas/mips/lantiq/soc.yaml#
$schema: http://devicetree.org/meta-schemas/core.yaml#

title: Lantiq SoC based Platform

maintainers:
  - Aleksander Jan Bajkowski <olek2@wp.pl>

description:
  Devices with a Lantiq CPU shall have the following properties.

properties:
  $nodename:
    const: "/"
  compatible:
    oneOf:
      - description: Boards with Lantiq Amazon-SE SoC
        items:
          - const: lantiq,ase

      - description: Boards with Lantiq Danube SoC
        items:
          - const: lantiq,danube

      - description: Boards with Lantiq Falcon SoC
        items:
          - const: lantiq,falcon

      - description: Boards with Lantiq Twinpass SoC
        items:
          - const: lantiq,twinpass

      - description: Boards with Lantiq ARX100 SoC
        items:
          - const: lantiq,ar9

      - description: Boards with Lantiq GRX100 SoC
        items:
          - const: lantiq,gr9

      - description: Boards with Lantiq xRX200 SoC
        items:
          - enum:
              - bt,homehub-v5a
          - const: lantiq,vr9

      - description: Boards with Lantiq xRX300 SoC
        items:
          - const: lantiq,ar10

      - description: Boards with Lantiq xRX330 SoC
        items:
          - const: lantiq,grx390

additionalProperties: true

...
```

## Documentation/devicetree/bindings/mips/realtek-rtl.yaml
```yaml
# SPDX-License-Identifier: GPL-2.0-or-later OR BSD-2-Clause
%YAML 1.2
---
$id: http://devicetree.org/schemas/mips/realtek-rtl.yaml#
$schema: http://devicetree.org/meta-schemas/core.yaml#

title: Realtek RTL83xx/93xx SoC series

maintainers:
  - Bert Vermeulen <bert@biot.com>
  - Sander Vanheule <sander@svanheule.net>

properties:
  $nodename:
    const: "/"
  compatible:
    oneOf:
      # RTL8382-based boards
      - items:
          - enum:
              - cisco,sg220-26
              - realtek,RTL9302C
          - const: realtek,rtl8382-soc
          - const: realtek,rtl930x-soc

additionalProperties: true
```

## Documentation/devicetree/bindings/misc/asus,dockram.yaml
```yaml
# SPDX-License-Identifier: (GPL-2.0 OR BSD-2-Clause)
%YAML 1.2
---
$id: http://devicetree.org/schemas/misc/asus,dockram.yaml#
$schema: http://devicetree.org/meta-schemas/core.yaml#

title: Asus Transformer EC DockRAM

maintainers:
  - Svyatoslav Ryhel <clamor95@gmail.com>

description:
  Dedicated i2c device used to provide power related functions of the
  embedded controller used in ASUS Transformer device family.

properties:
  compatible:
    const: asus,dockram

  reg:
    maxItems: 1

required:
  - compatible
  - reg

additionalProperties: false

examples:
  - |
    i2c {
      #address-cells = <1>;
      #size-cells = <0>;

      dockram@17 {
        compatible = "asus,dockram";
        reg = <0x17>;
      };
    };
...
```

## Documentation/devicetree/bindings/misc/brcm,bcm63138-bootlut.yaml
```yaml
# SPDX-License-Identifier: GPL-2.0 OR BSD-2-Clause
%YAML 1.2
---
$id: http://devicetree.org/schemas/misc/brcm,bcm63138-bootlut.yaml#
$schema: http://devicetree.org/meta-schemas/core.yaml#

title: Broadcom BCM63138 Boot Lookup Table

maintainers:
  - William Zhang <william.zhang@broadcom.com>

description: |
  This describes the Boot Lookup Table (BootLUT) region for the BCM63138
  SoC. It is used for secondary CPU initialization.

properties:
  compatible:
    const: brcm,bcm63138-bootlut

  reg:
    maxItems: 1

required:
  - compatible
  - reg

additionalProperties: false

examples:
  - |
    bootlut: bootlut@8000 {
      compatible = "brcm,bcm63138-bootlut";
      reg = <0x8000 0x50>;
    };
...
```

## Documentation/devicetree/bindings/misc/microchip,most-dim2.yaml
```yaml
# SPDX-License-Identifier: GPL-2.0-only OR BSD-2-Clause
%YAML 1.2
---
$id: http://devicetree.org/schemas/misc/microchip,most-dim2.yaml#
$schema: http://devicetree.org/meta-schemas/core.yaml#

title: MediaLB DIM2 Hardware Dependent Module

maintainers:
  - Christian Gromm <christian.gromm@microchip.com>

description:
  The DIM2 is a MediaLB (Media Local Bus) interface controller that
  provides high-speed communication between devices. It supports
  synchronous, asynchronous, control, and isochronous data channels.

properties:
  compatible:
    enum:
      - fsl,imx6q-mlb150
      - renesas,mlp
      - renesas,rcar-gen3-mlp
      - xlnx,axi4-os62420_3pin-1.00.a
      - xlnx,axi4-os62420_6pin-1.00.a

  reg:
    maxItems: 1

  interrupts:
    minItems: 1
    maxItems: 2

  clocks:
    maxItems: 1

  clock-names:
    const: mediaLB_int

required:
  - compatible
  - reg
  - interrupts

additionalProperties: false

examples:
  - |
    mlb: most@2b600000 {
        compatible = "fsl,imx6q-mlb150";
        reg = <0x2b600000 0x4000>;
        interrupts = <0 53 4>, <0 117 4>;
        clocks = <&clks 218>;
        clock-names = "mediaLB_int";
    };
```

## Documentation/devicetree/bindings/misc/nvidia,tegra-config-settings.yaml
```yaml
# SPDX-License-Identifier: (GPL-2.0 OR BSD-2-Clause)
%YAML 1.2
---
$id: http://devicetree.org/schemas/misc/nvidia,tegra-config-settings.yaml#
$schema: http://devicetree.org/meta-schemas/core.yaml#

title: Config properties for a device

description:
  Config setting is the configuration based on chip/board/system
  characterization on interface/controller settings. This is needed for
  - making the controller internal configuration to better perform
  - making the interface to work proper by setting drive strength, slew
    rates etc
  - making the low power leakage.
  There are two types of recommended configuration settings
  - Controller register specific for internal operation of controller.
  - Pad control/Pinmux/pincontrol registers for interfacing.
  These configurations can further be categorized as static and dynamic.
  - Static config does not change until a controller is reset.
  - Dynamic config changes based on mode or condition, controller is
    operating in.

maintainers:
  - Thierry Reding <thierry.reding@gmail.com>

properties:
  $nodename:
    const: configsettings

patternProperties:
  "config-[a-z0-9_]+$":
    description:
      Config node representing properties of a device. Properties of
      each device are listed under a unique subnode and referenced from
      device node.
    type: object
    additionalProperties: false

    patternProperties:
      "^sdhci-[a-z0-9_-]+-cfg$":
        description: Config settings for SDHCI devices.
          SDHCI has configuration based on device speed modes.
          - common is set on all speeds and can be overridden by speed mode.
          - List of speed modes and their config name
            "default", /* MMC_TIMING_LEGACY */
            "sd-mmc-highspeed", /* MMC_TIMING_MMC_HS */
            "sd-mmc-highspeed", /* MMC_TIMING_SD_HS */
            "uhs-sdr12", /* MMC_TIMING_UHS_SDR12 */
            "uhs-sdr25", /* MMC_TIMING_UHS_SDR25 */
            "uhs-sdr50", /* MMC_TIMING_UHS_SDR50 */
            "uhs-sdr104", /* MMC_TIMING_UHS_SDR104 */
            "uhs-ddr52", /* MMC_TIMING_UHS_DDR50 */
            "uhs-ddr52", /* MMC_TIMING_MMC_DDR52 */
            "mmc-hs200", /* MMC_TIMING_MMC_HS200 */
            "mmc-hs400", /* MMC_TIMING_MMC_HS400 */
        type: object
        additionalProperties: false

        properties:
          nvidia,mmc-num-tuning-iter:
            description: Specify DQS trim value for HS400 timing.
            $ref: /schemas/types.yaml#/definitions/uint32
            minimum: 0
            maximum: 0xffff

      "^i2c-[a-z0-9_]+-cfg$":
        description: Config settings for I2C devices.
        type: object
        additionalProperties: false

        properties:
          nvidia,i2c-clk-divisor-hs-mode:
            description: I2C clock divisor for HS mode.
            $ref: /schemas/types.yaml#/definitions/uint32
            minimum: 0
            maximum: 0xffff
          nvidia,i2c-clk-divisor-fs-mode:
            description: I2C clock divisor for FS mode.
            $ref: /schemas/types.yaml#/definitions/uint32
            minimum: 0
            maximum: 0xffff
          nvidia,i2c-hs-sclk-high-period:
            description: I2C high speed sclk high period.
            $ref: /schemas/types.yaml#/definitions/uint32
            minimum: 0
            maximum: 0xffff
          nvidia,i2c-hs-sclk-low-period:
            description: I2C high speed sclk low period.
            $ref: /schemas/types.yaml#/definitions/uint32
            minimum: 0
            maximum: 0xffff
          nvidia,i2c-hs-stop-setup-time:
            description: I2C high speed stop setup time.
            $ref: /schemas/types.yaml#/definitions/uint32
            minimum: 0
            maximum: 0xffff
          nvidia,i2c-hs-start-hold-time:
            description: I2C high speed start hold time.
            $ref: /schemas/types.yaml#/definitions/uint32
            minimum: 0
            maximum: 0xffff
          nvidia,i2c-hs-start-setup-time:
            description: I2C high speed start setup time.
            $ref: /schemas/types.yaml#/definitions/uint32
            minimum: 0
            maximum: 0xffff
          nvidia,i2c-sclk-high-period:
            description: I2C sclk high period.
            $ref: /schemas/types.yaml#/definitions/uint32
            minimum: 0
            maximum: 0xffff
          nvidia,i2c-sclk-low-period:
            description: I2C sclk low period.
            $ref: /schemas/types.yaml#/definitions/uint32
            minimum: 0
            maximum: 0xffff
          nvidia,i2c-bus-free-time:
            description: I2C bus free time.
            $ref: /schemas/types.yaml#/definitions/uint32
            minimum: 0
            maximum: 0xffff
          nvidia,i2c-stop-setup-time:
            description: I2C stop setup time.
            $ref: /schemas/types.yaml#/definitions/uint32
            minimum: 0
            maximum: 0xffff
          nvidia,i2c-start-hold-time:
            description: I2C start hold time.
            $ref: /schemas/types.yaml#/definitions/uint32
            minimum: 0
            maximum: 0xffff

additionalProperties: false

examples:
  - |
    configsettings {
        configi2c1: config-i2c3160000 {
            i2c-common-cfg {
                nvidia,i2c-hs-sclk-high-period = <0x03>;
                nvidia,i2c-hs-sclk-low-period = <0x08>;
            };
            i2c-fast-cfg {
                nvidia,i2c-clk-divisor-fs-mode = <0x3c>;
                nvidia,i2c-sclk-high-period = <0x02>;
            };
            i2c-fastplus-cfg {
                nvidia,i2c-clk-divisor-fs-mode = <0x4f>;
                nvidia,i2c-sclk-high-period = <0x07>;
            };
        };
        configmmc1: config-mmc3400000 {
            sdhci-mmc-hs200-cfg {
                nvidia,mmc-num-tuning-iter = <0x02>;
            };
        };
    };
```
