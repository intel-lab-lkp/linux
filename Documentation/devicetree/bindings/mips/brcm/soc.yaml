## Documentation/devicetree/bindings/misc/ti,j784s4-bist.yaml
```yaml
# SPDX-License-Identifier: (GPL-2.0-only OR BSD-2-Clause)
# Copyright (C) 2024 Texas Instruments Incorporated
%YAML 1.2
---
$id: http://devicetree.org/schemas/misc/ti,j784s4-bist.yaml#
$schema: http://devicetree.org/meta-schemas/core.yaml#

title: Texas Instruments K3 BIST

maintainers:
  - Neha Malcom Francis <n-francis@ti.com>

description:
  The BIST (Built-In Self Test) module is an IP block present in K3 devices
  that support triggering of BIST tests, both PBIST (Memory BIST) and LBIST
  (Logic BIST) on a core. Both tests are destructive in nature. At boot, BIST
  is executed by hardware for the MCU domain automatically as part of HW POST.

properties:
  compatible:
    const: ti,j784s4-bist

  reg:
    minItems: 2
    maxItems: 2

  reg-names:
    items:
      - const: cfg
      - const: ctrl_mmr

  clocks:
    maxItems: 1

  power-domains:
    maxItems: 1

  ti,bist-instance:
    $ref: /schemas/types.yaml#/definitions/uint32
    description:
      the BIST instance in the SoC represented as an integer

required:
  - compatible
  - reg
  - reg-names
  - ti,bist-instance

additionalProperties: false

examples:
  - |
    #include <dt-bindings/soc/ti,sci_pm_domain.h>
    bus {
        #address-cells = <2>;
        #size-cells = <2>;
        bist@33c0000 {
            compatible = "ti,j784s4-bist";
            reg = <0x00 0x033c0000 0x00 0x400>,
            <0x00 0x0010c1a0 0x00 0x01c>;
            reg-names = "cfg", "ctrl_mmr";
            clocks = <&k3_clks 237 7>;
            power-domains = <&k3_pds 237 TI_SCI_PD_EXCLUSIVE>;
            ti,bist-instance = <14>;
        };
    };
```

## Documentation/devicetree/bindings/misc/xlnx,axi-fifo-mm-s-4.1.yaml
```yaml
# SPDX-License-Identifier: (GPL-2.0 OR BSD-2-Clause)
%YAML 1.2
---
$id: http://devicetree.org/schemas/misc/xlnx,axi-fifo-mm-s-4.1.yaml#
$schema: http://devicetree.org/meta-schemas/core.yaml#

title: Xilinx AXI-Stream FIFO v4.1 IP core

description: |
  The Xilinx AXI-Stream FIFO v4.1 IP core has read and write AXI-Stream FIFOs,
  the contents of which can be accessed from the AXI4 memory-mapped interface.
  This is useful for transferring data from a processor into the FPGA fabric.
  The driver creates a character device that can be read/written to with
  standard open/read/write/close operations.

  See Xilinx PG080 document for IP details.

  Currently supports only store-forward mode with a 32-bit AXI4-Lite
  interface.

  DOES NOT support:
    - cut-through mode
    - AXI4 (non-lite)

properties:
  compatible:
    const: xlnx,axi-fifo-mm-s-4.1

  reg:
    maxItems: 1

  interrupts:
    maxItems: 1

  interrupt-names:
    items:
      - const: interrupt

  interrupt-parent:
    $ref: /schemas/types.yaml#/definitions/phandle

  xlnx,axi-str-rxd-protocol:
    const: XIL_AXI_STREAM_ETH_DATA

  xlnx,axi-str-rxd-tdata-width:
    const: 0x20

  xlnx,axi-str-txc-protocol:
    const: XIL_AXI_STREAM_ETH_CTRL

  xlnx,axi-str-txc-tdata-width:
    const: 0x20

  xlnx,axi-str-txd-protocol:
    const: XIL_AXI_STREAM_ETH_DATA

  xlnx,axi-str-txd-tdata-width:
    const: 0x20

  xlnx,axis-tdest-width:
    $ref: /schemas/types.yaml#/definitions/uint32

  xlnx,axis-tid-width:
    $ref: /schemas/types.yaml#/definitions/uint32

  xlnx,axis-tuser-width:
    $ref: /schemas/types.yaml#/definitions/uint32

  xlnx,data-interface-type:
    const: 0x0

  xlnx,has-axis-tdest:
    const: 0x0

  xlnx,has-axis-tid:
    const: 0x0

  xlnx,has-axis-tkeep:
    const: 0x1

  xlnx,has-axis-tstrb:
    const: 0x0

  xlnx,has-axis-tuser:
    const: 0x0

  xlnx,rx-fifo-depth:
    $ref: /schemas/types.yaml#/definitions/uint32

  xlnx,rx-fifo-pe-threshold:
    $ref: /schemas/types.yaml#/definitions/uint32

  xlnx,rx-fifo-pf-threshold:
    $ref: /schemas/types.yaml#/definitions/uint32

  xlnx,s-axi-id-width:
    const: 0x4

  xlnx,s-axi4-data-width:
    const: 0x20

  xlnx,select-xpm:
    const: 0x0

  xlnx,tx-fifo-depth:
    $ref: /schemas/types.yaml#/definitions/uint32

  xlnx,tx-fifo-pe-threshold:
    $ref: /schemas/types.yaml#/definitions/uint32

  xlnx,tx-fifo-pf-threshold:
    $ref: /schemas/types.yaml#/definitions/uint32

  xlnx,use-rx-cut-through:
    const: 0x0

  xlnx,use-rx-data:
    const: 0x1

  xlnx,use-tx-ctrl:
    const: 0x0

  xlnx,use-tx-cut-through:
    const: 0x0

  xlnx,use-tx-data:
    const: 0x1

  xlnx,tx-max-pkt-size:
    $ref: /schemas/types.yaml#/definitions/uint32

  xlnx,rx-min-pkt-size:
    $ref: /schemas/types.yaml#/definitions/uint32

required:
  - compatible
  - reg
  - interrupts
  - interrupt-names
  - interrupt-parent
  - xlnx,axi-str-rxd-protocol
  - xlnx,axi-str-rxd-tdata-width
  - xlnx,axi-str-txc-protocol
  - xlnx,axi-str-txc-tdata-width
  - xlnx,axi-str-txd-protocol
  - xlnx,axi-str-txd-tdata-width
  - xlnx,axis-tdest-width
  - xlnx,axis-tid-width
  - xlnx,axis-tuser-width
  - xlnx,data-interface-type
  - xlnx,has-axis-tdest
  - xlnx,has-axis-tid
  - xlnx,has-axis-tkeep
  - xlnx,has-axis-tstrb
  - xlnx,has-axis-tuser
  - xlnx,rx-fifo-depth
  - xlnx,rx-fifo-pe-threshold
  - xlnx,rx-fifo-pf-threshold
  - xlnx,s-axi-id-width
  - xlnx,s-axi4-data-width
  - xlnx,select-xpm
  - xlnx,tx-fifo-depth
  - xlnx,tx-fifo-pe-threshold
  - xlnx,tx-fifo-pf-threshold
  - xlnx,use-rx-cut-through
  - xlnx,use-rx-data
  - xlnx,use-tx-ctrl
  - xlnx,use-tx-cut-through
  - xlnx,use-tx-data
  - xlnx,tx-max-pkt-size
  - xlnx,rx-min-pkt-size

additionalProperties: false

examples:
  - |
    axi_fifo_mm_s_0: axi_fifo_mm_s@43c00000 {
      compatible = "xlnx,axi-fifo-mm-s-4.1";
      interrupt-names = "interrupt";
      interrupt-parent = <&intc>;
      interrupts = <0 29 4>;
      reg = <0x43c00000 0x10000>;
      xlnx,axi-str-rxd-protocol = "XIL_AXI_STREAM_ETH_DATA";
      xlnx,axi-str-rxd-tdata-width = <0x20>;
      xlnx,axi-str-txc-protocol = "XIL_AXI_STREAM_ETH_CTRL";
      xlnx,axi-str-txc-tdata-width = <0x20>;
      xlnx,axi-str-txd-protocol = "XIL_AXI_STREAM_ETH_DATA";
      xlnx,axi-str-txd-tdata-width = <0x20>;
      xlnx,axis-tdest-width = <0x4>;
      xlnx,axis-tid-width = <0x4>;
      xlnx,axis-tuser-width = <0x4>;
      xlnx,data-interface-type = <0x0>;
      xlnx,has-axis-tdest = <0x0>;
      xlnx,has-axis-tid = <0x0>;
      xlnx,has-axis-tkeep = <0x1>;
      xlnx,has-axis-tstrb = <0x0>;
      xlnx,has-axis-tuser = <0x0>;
      xlnx,rx-fifo-depth = <0x200>;
      xlnx,rx-fifo-pe-threshold = <0x2>;
      xlnx,rx-fifo-pf-threshold = <0x1fb>;
      xlnx,s-axi-id-width = <0x4>;
      xlnx,s-axi4-data-width = <0x20>;
      xlnx,select-xpm = <0x0>;
      xlnx,tx-fifo-depth = <0x8000>;
      xlnx,tx-fifo-pe-threshold = <0x200>;
      xlnx,tx-fifo-pf-threshold = <0x7ffb>;
      xlnx,use-rx-cut-through = <0x0>;
      xlnx,use-rx-data = <0x0>;
      xlnx,use-tx-ctrl = <0x0>;
      xlnx,use-tx-cut-through = <0x0>;
      xlnx,use-tx-data = <0x1>;
      xlnx,tx-max-pkt-size = <257>;
      xlnx,rx-min-pkt-size = <255>;
    };
```

## Documentation/devicetree/bindings/misc/xlnx,axi-fifo-mm-s.yaml
```yaml
# SPDX-License-Identifier: GPL-2.0 OR BSD-2-Clause
%YAML 1.2
---
$id: http://devicetree.org/schemas/misc/xlnx,axi-fifo-mm-s.yaml#
$schema: http://devicetree.org/meta-schemas/core.yaml#

title: Xilinx AXI4-Stream FIFO MM S IP core

maintainers:
  - Daniel <danyboy28sep@gmail.com>

description:
  The Xilinx AXI4-Stream FIFO MM S IP core has read and write AXI-Stream
  FIFOs, the contents of which can be accessed from the AXI4 memory-mapped
  interface. This is useful for transferring data from a processor into
  the FPGA fabric. See Xilinx PG080 for details.

  Currently the Linux driver supports only store-forward mode with a
  32-bit AXI4-Lite interface, and does not support cut-through mode or
  full (non-lite) AXI4.

properties:
  compatible:
    enum:
      - xlnx,axi-fifo-mm-s-4.1
      - xlnx,axi-fifo-mm-s-4.2
      - xlnx,axi-fifo-mm-s-4.3

  reg:
    maxItems: 1

  interrupts:
    maxItems: 1

  interrupt-names:
    const: interrupt

  xlnx,axi-str-rxd-tdata-width:
    $ref: /schemas/types.yaml#/definitions/uint32
    const: 32
    description:
      Width, in bits, of the AXI4-Stream receive data interface. Only 32
      is currently supported by the driver.

  xlnx,axi-str-txd-tdata-width:
    $ref: /schemas/types.yaml#/definitions/uint32
    const: 32
    description:
      Width, in bits, of the AXI4-Stream transmit data interface. Only 32
      is currently supported by the driver.

  xlnx,rx-fifo-depth:
    $ref: /schemas/types.yaml#/definitions/uint32
    description:
      Depth, in 32-bit words, of the receive FIFO.

  xlnx,tx-fifo-depth:
    $ref: /schemas/types.yaml#/definitions/uint32
    description:
      Depth, in 32-bit words, of the transmit FIFO.

  xlnx,use-rx-data:
    $ref: /schemas/types.yaml#/definitions/uint32
    enum: [0, 1]
    description:
      Whether the receive data path is present in this IP core instance.

  xlnx,use-tx-data:
    $ref: /schemas/types.yaml#/definitions/uint32
    enum: [0, 1]
    description:
      Whether the transmit data path is present in this IP core instance.

  # The following properties are generated by the Xilinx IP integrator
  # for this core and may be present in real-world devicetrees, but are
  # not currently read by the Linux driver.
  xlnx,axi-str-rxd-protocol: true
  xlnx,axi-str-txc-protocol: true
  xlnx,axi-str-txc-tdata-width: true
  xlnx,axi-str-txd-protocol: true
  xlnx,axis-tdest-width: true
  xlnx,axis-tid-width: true
  xlnx,axis-tuser-width: true
  xlnx,data-interface-type: true
  xlnx,has-axis-tdest: true
  xlnx,has-axis-tid: true
  xlnx,has-axis-tkeep: true
  xlnx,has-axis-tstrb: true
  xlnx,has-axis-tuser: true
  xlnx,rx-fifo-pe-threshold: true
  xlnx,rx-fifo-pf-threshold: true
  xlnx,s-axi-id-width: true
  xlnx,s-axi4-data-width: true
  xlnx,select-xpm: true
  xlnx,tx-fifo-pe-threshold: true
  xlnx,tx-fifo-pf-threshold: true
  xlnx,use-rx-cut-through: true
  xlnx,use-tx-ctrl: true
  xlnx,use-tx-cut-through: true

required:
  - compatible
  - reg
  - interrupts
  - xlnx,axi-str-rxd-tdata-width
  - xlnx,axi-str-txd-tdata-width
  - xlnx,rx-fifo-depth
  - xlnx,tx-fifo-depth
  - xlnx,use-rx-data
  - xlnx,use-tx-data

additionalProperties: false

examples:
  - |
    fifo@43c00000 {
        compatible = "xlnx,axi-fifo-mm-s-4.1";
        reg = <0x43c00000 0x10000>;
        interrupt-names = "interrupt";
        interrupts = <0 29 4>;
        xlnx,axi-str-rxd-protocol = "XIL_AXI_STREAM_ETH_DATA";
        xlnx,axi-str-rxd-tdata-width = <32>;
        xlnx,axi-str-txc-protocol = "XIL_AXI_STREAM_ETH_CTRL";
        xlnx,axi-str-txc-tdata-width = <32>;
        xlnx,axi-str-txd-protocol = "XIL_AXI_STREAM_ETH_DATA";
        xlnx,axi-str-txd-tdata-width = <32>;
        xlnx,axis-tdest-width = <4>;
        xlnx,axis-tid-width = <4>;
        xlnx,axis-tuser-width = <4>;
        xlnx,data-interface-type = <0>;
        xlnx,has-axis-tdest = <0>;
        xlnx,has-axis-tid = <0>;
        xlnx,has-axis-tkeep = <0>;
        xlnx,has-axis-tstrb = <0>;
        xlnx,has-axis-tuser = <0>;
        xlnx,rx-fifo-depth = <512>;
        xlnx,rx-fifo-pe-threshold = <2>;
        xlnx,rx-fifo-pf-threshold = <507>;
        xlnx,s-axi-id-width = <4>;
        xlnx,s-axi4-data-width = <32>;
        xlnx,select-xpm = <0>;
        xlnx,tx-fifo-depth = <32768>;
        xlnx,tx-fifo-pe-threshold = <512>;
        xlnx,tx-fifo-pf-threshold = <32763>;
        xlnx,use-rx-cut-through = <0>;
        xlnx,use-rx-data = <0>;
        xlnx,use-tx-ctrl = <0>;
        xlnx,use-tx-cut-through = <0>;
        xlnx,use-tx-data = <1>;
    };
```

## Documentation/devicetree/bindings/mmc/atmel,sama5d2-sdhci.yaml
```yaml
# SPDX-License-Identifier: (GPL-2.0-only OR BSD-2-Clause)
%YAML 1.2
---
$id: http://devicetree.org/schemas/mmc/atmel,sama5d2-sdhci.yaml#
$schema: http://devicetree.org/meta-schemas/core.yaml#

title: Atmel SDHCI controller

maintainers:
  - Aubin Constans <aubin.constans@microchip.com>
  - Nicolas Ferre <nicolas.ferre@microchip.com>

description:
  Bindings for the SDHCI controller found in Atmel/Microchip SoCs.

properties:
  compatible:
    oneOf:
      - enum:
          - atmel,sama5d2-sdhci
          - atmel,sama5d3-sdhci
          - atmel,sama5d4-sdhci
          - microchip,sam9x60-sdhci
      - items:
          - enum:
              - microchip,sama7g5-sdhci
          - const: microchip,sam9x60-sdhci

  reg:
    maxItems: 1

  interrupts:
    maxItems: 1

  clocks:
    minItems: 2
    maxItems: 3
    description: |
      The sama5d2 family includes three clocks: `hclock`, `multclk`, and `baseclk`.
      For other families, including sam9x60 and sam9x7, only `hclock` and `multclk` are used.

  clock-names:
    minItems: 2
    maxItems: 3

  microchip,sdcal-inverted:
    type: boolean
    description:
      When present, polarity on the SDCAL SoC pin is inverted.

required:
  - compatible
  - reg
  - interrupts
  - clocks
  - clock-names

allOf:
  - $ref: sdhci-common.yaml#
  - if:
      properties:
        compatible:
          contains:
            enum:
              - atmel,sama5d2-sdhci
    then:
      properties:
        clocks:
          maxItems: 3
        clock-names:
          items:
            - const: hclock
            - const: multclk
            - const: baseclk
    else:
      properties:
        clocks:
          maxItems: 2
        clock-names:
          items:
            - const: hclock
            - const: multclk

unevaluatedProperties: false

examples:
  - |
    #include <dt-bindings/interrupt-controller/irq.h>
    #include <dt-bindings/clock/at91.h>
    mmc@a0000000 {
        compatible = "atmel,sama5d2-sdhci";
        reg = <0xa0000000 0x300>;
        interrupts = <31 IRQ_TYPE_LEVEL_HIGH 0>;
        clocks = <&sdmmc0_hclk>, <&sdmmc0_gclk>, <&main>;
        clock-names = "hclock", "multclk", "baseclk";
        assigned-clocks = <&sdmmc0_gclk>;
        assigned-clock-rates = <480000000>;
    };
```
