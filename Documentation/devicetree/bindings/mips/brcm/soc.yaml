## Documentation/devicetree/bindings/mmc/brcm,sdhci-brcmstb.yaml
```yaml
# SPDX-License-Identifier: (GPL-2.0-only OR BSD-2-Clause)
%YAML 1.2
---
$id: http://devicetree.org/schemas/mmc/brcm,sdhci-brcmstb.yaml#
$schema: http://devicetree.org/meta-schemas/core.yaml#

title: Broadcom BRCMSTB/BMIPS SDHCI Controller

maintainers:
  - Al Cooper <alcooperx@gmail.com>
  - Florian Fainelli <f.fainelli@gmail.com>

properties:
  compatible:
    oneOf:
      - items:
          - enum:
              - brcm,bcm7216-sdhci
          - const: brcm,bcm7445-sdhci
          - const: brcm,sdhci-brcmstb
      - items:
          - enum:
              - brcm,bcm2712-sdhci
              - brcm,bcm74165b0-sdhci
              - brcm,bcm7445-sdhci
              - brcm,bcm7425-sdhci
          - const: brcm,sdhci-brcmstb

  reg:
    minItems: 2
    maxItems: 4

  reg-names:
    minItems: 2
    items:
      - const: host
      - const: cfg
      - const: share       # Optional reg
      - const: flshr_ipis0 # Optional reg

  interrupts:
    minItems: 1
    maxItems: 2

  clocks:
    minItems: 1
    items:
      - description: handle to core clock for the sdhci controller
      - description: handle to improved 150Mhz clock for sdhci controller (Optional clock)

  clock-names:
    minItems: 1
    items:
      - const: sw_sdio
      - const: sdio_freq # Optional clock

  clock-frequency:
    description:
      Maximum operating frequency of sdio_freq sdhci controller clock
    $ref: /schemas/types.yaml#/definitions/uint32
    minimum: 100000000
    maximum: 150000000

  sdhci,auto-cmd12:
    type: boolean
    description: Specifies that controller should use auto CMD12

  hwlocks:
    maxItems: 1

allOf:
  - $ref: mmc-controller.yaml#
  - if:
      properties:
        clock-names:
          contains:
            const: sdio_freq

    then:
      required:
        - clock-frequency

required:
  - compatible
  - reg
  - interrupts
  - clocks
  - clock-names

unevaluatedProperties: false

examples:
  - |
    mmc@84b0000 {
      compatible = "brcm,bcm7216-sdhci",
                   "brcm,bcm7445-sdhci",
                   "brcm,sdhci-brcmstb";
      reg = <0x84b0000 0x260>, <0x84b0300 0x200>;
      reg-names = "host", "cfg";
      sd-uhs-sdr50;
      sd-uhs-ddr50;
      sd-uhs-sdr104;
      sdhci,auto-cmd12;
      interrupts = <0x0 0x26 0x4>;
      clocks = <&scmi_clk 245>;
      clock-names = "sw_sdio";
    };

    mmc@84b1000 {
      compatible = "brcm,bcm7216-sdhci",
                   "brcm,bcm7445-sdhci",
                   "brcm,sdhci-brcmstb";
      reg = <0x84b1000 0x260>, <0x84b1300 0x200>;
      reg-names = "host", "cfg";
      mmc-ddr-1_8v;
      mmc-hs200-1_8v;
      mmc-hs400-1_8v;
      mmc-hs400-enhanced-strobe;
      supports-cqe;
      non-removable;
      bus-width = <0x8>;
      interrupts = <0x0 0x27 0x4>;
      clocks = <&scmi_clk 245>;
      clock-names = "sw_sdio";
    };
  - |
    mmc@84b1000 {
      mmc-ddr-1_8v;
      mmc-hs200-1_8v;
      mmc-hs400-1_8v;
      no-sd;
      no-sdio;
      non-removable;
      bus-width = <0x8>;
      compatible = "brcm,bcm74165b0-sdhci", "brcm,sdhci-brcmstb";
      reg = <0x84b1000 0x260>, <0x84b1300 0x200>,  <0x84b1600 0x10>, <0x84a5404 0x4>;
      reg-names = "host", "cfg", "share", "flshr_ipis0";
      hwlocks = <&hw_lock 0x0>;
      interrupts = <0x1 0x0 0x1f 0x4 0x1b 0x11>;
      clocks = <&scmi_clk 245>;
      clock-names = "sw_sdio";
    };
```

## Documentation/devicetree/bindings/mmc/bst,dwcmshc-sdhci.yaml
```yaml
# SPDX-License-Identifier: (GPL-2.0-only OR BSD-2-Clause)
%YAML 1.2
---
$id: http://devicetree.org/schemas/mmc/bst,dwcmshc-sdhci.yaml#
$schema: http://devicetree.org/meta-schemas/core.yaml#

title: Black Sesame Technologies DWCMSHC SDHCI Controller

maintainers:
  - Ge Gordon <gordon.ge@bst.ai>

allOf:
  - $ref: mmc-controller.yaml#

properties:
  compatible:
    const: bst,c1200-dwcmshc-sdhci

  reg:
    maxItems: 2
    description: |
      Register base addresses and sizes for the SDHCI controller.
      First entry is the core SDHCI registers, second entry is the
      CRM registers.

  interrupts:
    maxItems: 1

  clocks:
    maxItems: 1

  clock-names:
    items:
      - const: core

  memory-region:
    maxItems: 1

  dma-coherent: true

required:
  - compatible
  - reg
  - interrupts
  - clocks
  - clock-names

unevaluatedProperties: false

examples:
  - |
    #include <dt-bindings/interrupt-controller/arm-gic.h>

    mmc@22200000 {
        compatible = "bst,c1200-dwcmshc-sdhci";
        reg = <0x0 0x22200000 0x0 0x1000>,
              <0x0 0x23006000 0x0 0x1000>;
        interrupts = <GIC_SPI 144 IRQ_TYPE_LEVEL_HIGH>;
        clocks = <&clk_mmc>;
        clock-names = "core";
        memory-region = <&mmc0_reserved>;
        max-frequency = <200000000>;
        bus-width = <8>;
        non-removable;
        dma-coherent;
        status = "disabled";
    };
```

## Documentation/devicetree/bindings/mmc/eswin,sdhci-eic7700.yaml
```yaml
# SPDX-License-Identifier: (GPL-2.0-only OR BSD-2-Clause)
%YAML 1.2
---
$id: http://devicetree.org/schemas/mmc/eswin,sdhci-eic7700.yaml#
$schema: http://devicetree.org/meta-schemas/core.yaml#

title: ESWIN EIC7700 SoC SDHCI controller

maintainers:
  - Shuang Liang <liangshuang@eswincomputing.com>
  - Xuyang Dong <dongxuyang@eswincomputing.com>

allOf:
  - $ref: /schemas/mmc/mmc-controller.yaml#

properties:
  compatible:
    const: eswin,eic7700-emmc-sdhci

  reg:
    maxItems: 1
    description: Common configuration registers
  "#address-cells":
    const: 1
  "#size-cells":
    const: 1

  interrupts:
    maxItems: 1

  assigned-clocks:
    maxItems: 1
    description: should contain "core_clk" phandle + clock-specifier pairs.

  assigned-clock-rates:
    maxItems: 1

  clocks:
    minItems: 2
    description: handles to clock for the sdhci controller.

  clock-names:
    minItems: 2
    description: the name of each clock.

  clock-output-names:
    maxItems: 1

  '#clock-cells':
    enum: [0]
    description:
      With this property in place we will export one clock
      representing the Card Clock. These clocks are expected to be
      consumed by our PHY.

  resets:
    description: resets to be used by the controller.

  reset-names:
    description: names of the resets listed in resets property in the same order.

  bus-width:
    enum: [4, 8]
    description: for emmc bus-width is 8, for sdio bus-width is 4.

  eswin,hsp_sp_csr:
    $ref: /schemas/types.yaml#/definitions/phandle-array
    description: hsp_sp_csr regs to be used by the controller.
    items:
      - description: phandle to HSP_SP_CSR register block
      - description: status register offset
      - description: control register offset
      - description: configuration register offset

  eswin,syscrg_csr:
    $ref: /schemas/types.yaml#/definitions/phandle-array
    description: syscrg_csr regs to be used by the controller.
    items:
      - description: phandle to SYS_CRG_CSR register block
      - description: status register offset
      - description: control register offset
      - description: configuration register offset

required:
  - compatible
  - reg
  - interrupts
  - assigned-clocks
  - assigned-clock-rates
  - clocks
  - clock-names
  - clock-output-names
  - resets
  - reset-names
  - bus-width
  - eswin,hsp_sp_csr
  - eswin,syscrg_csr

unevaluatedProperties: false

examples:
  - |

    sdhci_emmc: mmc@50450000 {
      compatible = "eswin,eic7700-emmc-sdhci";
      reg = <0x50450000 0x10000>;
      interrupt-parent = <&plic>;
      interrupts = <79>;
      clocks = <&clock 554>, <&clock 546>;
      clock-names = "clk_xin", "clk_ahb";
      assigned-clocks = <&clock 554>;
      assigned-clock-rates = <200000000>;
      clock-output-names = "emmc_cardclock";
      #clock-cells = <0>;

      resets = <&reset 7 (1 << 6)>,
        <&reset 7 (1 << 3)>,
        <&reset 7 (1 << 19)>,
        <&reset 7 (1 << 23)>;
      reset-names = "txrx_rst", "phy_rst", "prstn", "arstn";

      core-clk-reg = <0x51828160>;
      disable-cqe-dcmd;
      bus-width = <8>;
      non-removable;
      mmc-hs400-1_8v;
      max-frequency = <200000000>;
      eswin,hsp_sp_csr = <&hsp_sp_csr 0x1038 0x508 0x50c>;
      eswin,syscrg_csr = <&sys_crg 0x160 0x148 0x14c>;
      status = "disabled";
    };
```

## Documentation/devicetree/bindings/mmc/hi3798cv200-dw-mshc.yaml
```yaml
# SPDX-License-Identifier: GPL-2.0-only OR BSD-2-Clause
%YAML 1.2
---
$id: http://devicetree.org/schemas/mmc/hi3798cv200-dw-mshc.yaml#
$schema: http://devicetree.org/meta-schemas/core.yaml#

title:
  Hisilicon Hi3798CV200 SoC specific extensions to the Synopsys DWMMC controller

maintainers:
  - Yang Xiwen <forbidden405@outlook.com>

description:
  The Synopsys designware mobile storage host controller is used to interface
  a SoC with storage medium such as eMMC or SD/MMC cards. This file documents
  differences between the core Synopsys dw mshc controller properties described
  by synopsys-dw-mshc.txt and the properties used by the Hisilicon Hi3798CV200
  specific extensions to the Synopsys Designware Mobile Storage Host Controller.

allOf:
  - $ref: synopsys-dw-mshc-common.yaml#

properties:
  compatible:
    enum:
      - hisilicon,hi3798cv200-dw-mshc

  reg:
    maxItems: 1

  interrupts:
    maxItems: 1

  clocks:
    minItems: 4
    maxItems: 4
    description: A list of phandles for the clocks listed in clock-names

  clock-names:
    items:
      - const: ciu
      - const: biu
      - const: ciu-sample
      - const: ciu-drive
    description:
      Apart from the clock-names "biu" and "ciu" two more clocks
      "ciu-drive" and "ciu-sample" are added. They are used to
      control the clock phases, "ciu-sample" is required for tuning
      high speed modes.

required:
  - compatible
  - reg
  - interrupts
  - clocks
  - clock-names

unevaluatedProperties: false

examples:
  - |
    #include <dt-bindings/clock/histb-clock.h>
    #include <dt-bindings/interrupt-controller/arm-gic.h>
    emmc: mmc@9830000 {
      compatible = "hisilicon,hi3798cv200-dw-mshc";
      reg = <0x9830000 0x10000>;
      interrupts = <GIC_SPI 35 IRQ_TYPE_LEVEL_HIGH>;
      clocks = <&crg HISTB_MMC_CIU_CLK>,
               <&crg HISTB_MMC_BIU_CLK>,
               <&crg HISTB_MMC_SAMPLE_CLK>,
               <&crg HISTB_MMC_DRV_CLK>;
      clock-names = "ciu", "biu", "ciu-sample", "ciu-drive";
      resets = <&crg 0xa0 4>;
      reset-names = "reset";
      pinctrl-names = "default";
      pinctrl-0 = <&emmc_pins_1 &emmc_pins_2
                   &emmc_pins_3 &emmc_pins_4>;
      fifo-depth = <256>;
      clock-frequency = <200000000>;
      cap-mmc-highspeed;
      mmc-ddr-1_8v;
      mmc-hs200-1_8v;
      non-removable;
      bus-width = <8>;
      status = "okay";
    };
```

## Documentation/devicetree/bindings/mmc/hisilicon,hi3660-dw-mshc.yaml
```yaml
# SPDX-License-Identifier: (GPL-2.0-only OR BSD-2-Clause)
%YAML 1.2
---
$id: http://devicetree.org/schemas/mmc/hisilicon,hi3660-dw-mshc.yaml#
$schema: http://devicetree.org/meta-schemas/core.yaml#

title: Hisilicon specific extensions to the Synopsys Designware Mobile Storage Host Controller

maintainers:
  - Zhangfei Gao <zhangfei.gao@linaro.org>

description:
  The Synopsys designware mobile storage host controller is used to interface
  a SoC with storage medium such as eMMC or SD/MMC cards. This file documents
  differences between the core Synopsys dw mshc controller properties described
  by synopsys-dw-mshc.txt and the properties used by the Hisilicon specific
  extensions to the Synopsys Designware Mobile Storage Host Controller.

allOf:
  - $ref: /schemas/mmc/synopsys-dw-mshc-common.yaml#

properties:
  compatible:
    oneOf:
      - const: hisilicon,hi3660-dw-mshc
      - items:
          - const: hisilicon,hi3670-dw-mshc
          - const: hisilicon,hi3660-dw-mshc
      - const: hisilicon,hi4511-dw-mshc
      - const: hisilicon,hi6220-dw-mshc
  reg:
    maxItems: 1

  interrupts:
    maxItems: 1

  clocks:
    items:
      - description: card interface unit clock
      - description: bus interface unit clock

  clock-names:
    items:
      - const: ciu
      - const: biu

  hisilicon,peripheral-syscon:
    $ref: /schemas/types.yaml#/definitions/phandle
    description: phandle of syscon used to control peripheral.

required:
  - compatible
  - reg
  - interrupts
  - clocks
  - clock-names

unevaluatedProperties: false

examples:
  - |
    #include <dt-bindings/clock/hi3620-clock.h>

    mmc@fcd03000 {
        compatible = "hisilicon,hi4511-dw-mshc";
        reg = <0xfcd03000 0x1000>;
        interrupts = <0 16 4>;
        #address-cells = <1>;
        #size-cells = <0>;
        clocks = <&mmc_clock HI3620_SD_CIUCLK>, <&clock HI3620_DDRC_PER_CLK>;
        clock-names = "ciu", "biu";
        vmmc-supply = <&ldo12>;
        fifo-depth = <0x100>;
        pinctrl-names = "default";
        pinctrl-0 = <&sd_pmx_pins &sd_cfg_func1 &sd_cfg_func2>;
        bus-width = <4>;
        disable-wp;
        cd-gpios = <&gpio10 3 0>;
        cap-mmc-highspeed;
        cap-sd-highspeed;
    };

  - |
    #include <dt-bindings/clock/hi6220-clock.h>

    soc {
      #address-cells = <2>;
      #size-cells = <2>;

      mmc@f723e000 {
          compatible = "hisilicon,hi6220-dw-mshc";
          bus-width = <0x4>;
          disable-wp;
          cap-sd-highspeed;
          sd-uhs-sdr12;
          sd-uhs-sdr25;
          card-detect-delay = <200>;
          hisilicon,peripheral-syscon = <&ao_ctrl>;
          reg = <0x0 0xf723e000 0x0 0x1000>;
          interrupts = <0x0 0x49 0x4>;
          clocks = <&clock_sys HI6220_MMC1_CIUCLK>,
                   <&clock_sys HI6220_MMC1_CLK>;
          clock-names = "ciu", "biu";
          cd-gpios = <&gpio1 0 1>;
          pinctrl-names = "default", "idle";
          pinctrl-0 = <&sd_pmx_func &sd_clk_cfg_func &sd_cfg_func>;
          pinctrl-1 = <&sd_pmx_idle &sd_clk_cfg_idle &sd_cfg_idle>;
          vqmmc-supply = <&ldo7>;
          vmmc-supply = <&ldo10>;
      };
    };
```
