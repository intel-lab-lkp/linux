## Documentation/devicetree/bindings/pinctrl/microchip,pic32mzda-pinctrl.yaml
```yaml
# SPDX-License-Identifier: (GPL-2.0-only OR BSD-2-Clause)
%YAML 1.2
---
$id: http://devicetree.org/schemas/pinctrl/microchip,pic32mzda-pinctrl.yaml#
$schema: http://devicetree.org/meta-schemas/core.yaml#

title: Microchip PIC32 Pin Controller

maintainers:
  - Linus Walleij <linusw@kernel.org>

description: |
  PIC32 pin configuration node is a node of a group of pins which can be used
  for a specific device or function. This node represents configurations of
  pins, optional function, and optional mux related configuration.

properties:
  compatible:
    const: microchip,pic32mzda-pinctrl

  reg:
    maxItems: 1

  clocks:
    maxItems: 1

  '#address-cells':
    const: 1

  '#size-cells':
    const: 1

patternProperties:
  '^[a-z0-9]+[_-].*$':
    type: object
    description: |
      Pin configuration node with pin muxing and configuration properties.
      Can be either a direct pin configuration node or a container node
      with child pin configuration nodes.

    properties:
      pins:
        description: |
          List of pins to which the configuration applies.
        items:
          type: string
        minItems: 1

      bias-pull-up: true
      bias-pull-down: true
      input-enable: true
      output-low: true
      output-high: true

      microchip,digital:
        description: Enable digital I/O.
        type: boolean

      microchip,analog:
        description: Enable analog I/O.
        type: boolean

    patternProperties:
      '^[a-z]+[0-9]+-[a-z]+$':
        type: object
        description: |
          Child pin configuration node.

        properties:
          pins:
            items:
              type: string
            minItems: 1

          function:
            description: |
              A string containing the name of the function to mux pin.
            enum: [ U2TX, U2RX, U4TX, U4RX ]

          bias-pull-up: true
          bias-pull-down: true
          input-enable: true
          output-low: true
          output-high: true

          microchip,digital:
            description: Enable digital I/O.
            type: boolean

          microchip,analog:
            description: Enable analog I/O.
            type: boolean

        required:
          - pins

        additionalProperties: false

    additionalProperties: false

required:
  - compatible
  - reg
  - clocks

additionalProperties: false

examples:
  - |
    #include <dt-bindings/clock/microchip,pic32-clock.h>

    pic32_pinctrl: pinctrl@1f801400 {
        #address-cells = <1>;
        #size-cells = <1>;
        compatible = "microchip,pic32mzda-pinctrl";
        reg = <0x1f801400 0x400>;
        clocks = <&rootclk PB1CLK>;

        pinctrl_uart2: pinctrl_uart2 {
            uart2-tx {
                pins = "G9";
                function = "U2TX";
                microchip,digital;
                output-low;
            };

            uart2-rx {
                pins = "B0";
                function = "U2RX";
                microchip,digital;
                input-enable;
            };
        };
    };

    uart2: serial@1f822200 {
        compatible = "microchip,pic32mzda-uart";
        reg = <0x1f822200 0x50>;
        pinctrl-names = "default";
        pinctrl-0 = <&pinctrl_uart2>;
    };
```

## Documentation/devicetree/bindings/pinctrl/nuvoton,ma35d1-pinctrl.yaml
```yaml
# SPDX-License-Identifier: (GPL-2.0-only OR BSD-2-Clause)
%YAML 1.2
---
$id: http://devicetree.org/schemas/pinctrl/nuvoton,ma35d1-pinctrl.yaml#
$schema: http://devicetree.org/meta-schemas/core.yaml#

title: Nuvoton MA35D1 pin control and GPIO

maintainers:
  - Shan-Chun Hung <schung@nuvoton.com>

properties:
  compatible:
    enum:
      - nuvoton,ma35d1-pinctrl

  '#address-cells':
    const: 1

  '#size-cells':
    const: 1

  nuvoton,sys:
    $ref: /schemas/types.yaml#/definitions/phandle
    description:
      phandle of the system-management node.

  ranges: true

allOf:
  - $ref: pinctrl.yaml#

required:
  - compatible
  - nuvoton,sys

patternProperties:
  "^gpio@[0-9a-f]+$":
    type: object
    additionalProperties: false
    properties:
      gpio-controller: true

      '#gpio-cells':
        const: 2

      reg:
        maxItems: 1

      clocks:
        maxItems: 1

      interrupt-controller: true

      '#interrupt-cells':
        const: 2

      interrupts:
        description:
          The interrupt outputs to sysirq.
        maxItems: 1

    required:
      - gpio-controller
      - '#gpio-cells'
      - reg
      - clocks
      - interrupt-controller
      - '#interrupt-cells'
      - interrupts

  "^pin-[a-z0-9]+$":
    type: object
    description:
      A pinctrl node should contain at least one subnodes representing the
      pinctrl groups available on the machine. Each subnode will list the
      pins it needs, and how they should be configured, with regard to muxer
      configuration, pullups, drive strength, input enable/disable and input
      schmitt.

    allOf:
      - $ref: pincfg-node.yaml#

    properties:
      bias-disable: true

      bias-pull-down: true

      bias-pull-up: true

      power-source:
        description: |
          Valid arguments are described as below:
          0: power supply of 1.8V
          1: power supply of 3.3V
        enum: [0, 1]

      drive-strength-microamp:
        oneOf:
          - enum: [ 2900, 4400, 5800, 7300, 8600, 10100, 11500, 13000 ]
            description: 1.8V I/O driving strength
          - enum: [ 17100, 25600, 34100, 42800, 48000, 56000, 77000, 82000 ]
            description: 3.3V I/O driving strength

      input-enable: true

      input-schmitt-enable: true

    unevaluatedProperties: false

  "-grp$":
    type: object
    description:
      Pinctrl node's client devices use subnodes for desired pin configuration.
      Client device subnodes use below standard properties.
    properties:
      nuvoton,pins:
        description:
          Each entry consists of 4 parameters and represents the mux and config
          setting for one pin.
        $ref: /schemas/types.yaml#/definitions/uint32-matrix
        minItems: 1
        items:
          items:
            - minimum: 0
              maximum: 13
              description:
                Pin bank.
            - minimum: 0
              maximum: 15
              description:
                Pin bank index.
            - minimum: 0
              maximum: 15
              description:
                Mux 0 means GPIO and mux 1 to 15 means the specific device function.
            - description:
                The phandle of a node contains the generic pinconfig options
                to use as described in pinctrl-bindings.txt.

additionalProperties: false

examples:
  - |
    #include <dt-bindings/interrupt-controller/arm-gic.h>
    #include <dt-bindings/gpio/gpio.h>
    #include <dt-bindings/clock/nuvoton,ma35d1-clk.h>
    #include <dt-bindings/pinctrl/ma35d1-pinfunc.h>

    pinctrl@40040000 {
        compatible = "nuvoton,ma35d1-pinctrl";
        #address-cells = <1>;
        #size-cells = <1>;
        nuvoton,sys = <&sys>;
        ranges = <0 0x40040000 0xc00>;

        gpio@40040000 {
            reg = <0x0 0x40>;
            interrupts = <GIC_SPI 14 IRQ_TYPE_LEVEL_HIGH>;
            clocks = <&clk GPA_GATE>;
            gpio-controller;
            #gpio-cells = <2>;
            interrupt-controller;
            #interrupt-cells = <2>;
        };

        pcfg_default: pin-default {
            slew-rate = <0>;
            input-schmitt-disable;
            bias-disable;
            power-source = <1>;
            drive-strength-microamp = <17100>;
        };

        uart-grp {
            uart11-pins {
                nuvoton,pins = <11 0 2 &pcfg_default>,
                               <11 1 2 &pcfg_default>,
                               <11 2 2 &pcfg_default>,
                               <11 3 2 &pcfg_default>;
            };

            uart12-pins {
                nuvoton,pins = <8 1 2 &pcfg_default>,
                               <8 2 2 &pcfg_default>,
                               <8 3 2 &pcfg_default>;
            };
        };
    };
```

## Documentation/devicetree/bindings/pinctrl/nvidia,tegra268-pinmux-main.yaml
```yaml
# SPDX-License-Identifier: (GPL-2.0-only OR BSD-2-Clause)
%YAML 1.2
---
$id: http://devicetree.org/schemas/pinctrl/nvidia,tegra268-pinmux-main.yaml#
$schema: http://devicetree.org/meta-schemas/core.yaml#

title: NVIDIA Tegra268 Main Pinmux Controller

maintainers:
  - Thierry Reding <thierry.reding@gmail.com>
  - Jon Hunter <jonathanh@nvidia.com>

properties:
  compatible:
    const: nvidia,tegra268-pinmux-main

  reg:
    maxItems: 1

patternProperties:
  "^pinmux(-[a-z0-9-]+)?$":
    type: object

    # pin groups
    additionalProperties:
      $ref: nvidia,tegra268-pinmux-common.yaml

      properties:
        nvidia,pins:
          items:
            enum: [ soc_gpio250_pf0, soc_gpio251_pf1, soc_gpio252_pf2,
                    dp_aux_ch0_hpd_pf3, dp_aux_ch1_hpd_pf4, pwm2_pf7, pwm3_pg0,
                    gen7_i2c_scl_pg1, gen7_i2c_sda_pg2, gen9_i2c_scl_pg3,
                    gen9_i2c_sda_pg4, soc_gpio124_pl0, soc_gpio125_pl1,
                    fan_tach0_pl2, soc_gpio127_pl3, soc_gpio128_pl4,
                    soc_gpio129_pl5, soc_gpio130_pl6, soc_gpio131_pl7,
                    gp_pwm9_pm0, soc_gpio133_pm1, soc_gpio178_pv0,
                    uart4_tx_pv2, uart4_rx_pv3, uart4_rts_n_pv4,
                    uart4_cts_n_pv5, dap2_clk_pv6, dap2_fs_pw1,
                    gen1_i2c_scl_pw2, gen1_i2c_sda_pw3, gen0_i2c_scl_pw4,
                    gen0_i2c_sda_pw5, pwr_i2c_scl_pw6, pwr_i2c_sda_pw7,
                    soc_gpio139_pp1, dap4_sclk_pp6, dap4_dout_pp7,
                    dap4_din_pq0, dap4_fs_pq1, soc_gpio152_pq6,
                    soc_gpio153_pq7, aud_mclk_pr0, soc_gpio155_pr1,
                    dap1_sclk_pr2, dap1_out_pr3, dap1_in_pr4, dap1_fs_pr5,
                    gen11_i2c_scl_pr6, gen11_i2c_sda_pr7, soc_gpio351_ps1,
                    qspi0_sck_pt0, qspi0_cs_n_pt1, qspi0_io0_pt2,
                    qspi0_io1_pt3, qspi0_io2_pt4, qspi0_io3_pt5,
                    soc_gpio192_pt6, soc_gpio270_py0, soc_gpio271_py1,
                    soc_gpio272_py2, soc_gpio273_py3, soc_gpio274_py4,
                    soc_gpio275_py5, soc_gpio276_py6, soc_gpio277_py7,
                    soc_gpio278_pz0, soc_gpio279_pz1, xhalt_trig_pz2,
                    soc_gpio281_pz3, soc_gpio282_pz4, soc_gpio283_pz5,
                    soc_gpio284_pz6, soc_gpio285_pz7, soc_gpio286_pal0,
                    soc_gpio287_pal1, soc_gpio288_pal2, cpu_pwr_req_ph0,
                    gpu_pwr_req_ph1, spi3_sck_ph6, spi3_miso_ph7,
                    spi3_mosi_pj0, spi3_cs0_pj1, spi3_cs3_pj2, uart5_tx_pj3,
                    uart5_rx_pj4, uart5_rts_n_pj5, uart5_cts_n_pj6,
                    spi1_sck_pj7, spi1_miso_pk0, spi1_mosi_pk1, spi1_cs0_pk2,
                    spi1_cs1_pk3, extperiph1_clk_pk4, extperiph2_clk_pk5,
                    gen12_i2c_scl_pk6, gen12_i2c_sda_pk7,
                    drive_cpu_pwr_req_ph0, drive_gpu_pwr_req_ph1,
                    drive_spi3_cs0_pj1, drive_spi3_cs3_pj2,
                    drive_spi3_miso_ph7, drive_spi3_mosi_pj0,
                    drive_spi3_sck_ph6, drive_uart5_cts_n_pj6,
                    drive_uart5_rts_n_pj5, drive_uart5_rx_pj4,
                    drive_uart5_tx_pj3, drive_spi1_cs0_pk2, drive_spi1_cs1_pk3,
                    drive_spi1_miso_pk0, drive_spi1_mosi_pk1,
                    drive_spi1_sck_pj7, drive_extperiph2_clk_pk5,
                    drive_extperiph1_clk_pk4, drive_gen12_i2c_scl_pk6,
                    drive_gen12_i2c_sda_pk7, drive_soc_gpio124_pl0,
                    drive_soc_gpio125_pl1, drive_fan_tach0_pl2,
                    drive_soc_gpio127_pl3, drive_soc_gpio128_pl4,
                    drive_soc_gpio129_pl5, drive_soc_gpio130_pl6,
                    drive_soc_gpio131_pl7, drive_gp_pwm9_pm0,
                    drive_soc_gpio133_pm1, drive_qspi0_cs_n_pt1,
                    drive_qspi0_io0_pt2, drive_qspi0_io1_pt3,
                    drive_qspi0_io2_pt4, drive_qspi0_io3_pt5,
                    drive_qspi0_sck_pt0, drive_soc_gpio192_pt6,
                    drive_soc_gpio139_pp1, drive_dap4_dout_pp7,
                    drive_dap4_sclk_pp6, drive_dap4_din_pq0, drive_dap4_fs_pq1,
                    drive_soc_gpio152_pq6, drive_soc_gpio153_pq7,
                    drive_soc_gpio155_pr1, drive_aud_mclk_pr0,
                    drive_dap1_sclk_pr2, drive_dap1_in_pr4, drive_dap1_out_pr3,
                    drive_dap1_fs_pr5, drive_gen11_i2c_scl_pr6,
                    drive_gen11_i2c_sda_pr7, drive_soc_gpio351_ps1,
                    drive_gen0_i2c_scl_pw4, drive_gen0_i2c_sda_pw5,
                    drive_gen1_i2c_scl_pw2, drive_gen1_i2c_sda_pw3,
                    drive_dap2_fs_pw1, drive_dap2_clk_pv6,
                    drive_soc_gpio178_pv0, drive_uart4_cts_n_pv5,
                    drive_uart4_rts_n_pv4, drive_uart4_rx_pv3,
                    drive_uart4_tx_pv2, drive_pwr_i2c_sda_pw7,
                    drive_pwr_i2c_scl_pw6, drive_soc_gpio250_pf0,
                    drive_soc_gpio251_pf1, drive_soc_gpio252_pf2,
                    drive_dp_aux_ch0_hpd_pf3, drive_dp_aux_ch1_hpd_pf4,
                    drive_pwm2_pf7, drive_pwm3_pg0, drive_gen7_i2c_scl_pg1,
                    drive_gen7_i2c_sda_pg2, drive_gen9_i2c_scl_pg3,
                    drive_gen9_i2c_sda_pg4, drive_soc_gpio270_py0,
                    drive_soc_gpio271_py1, drive_soc_gpio272_py2,
                    drive_soc_gpio273_py3, drive_soc_gpio274_py4,
                    drive_soc_gpio275_py5, drive_soc_gpio276_py6,
                    drive_soc_gpio277_py7, drive_soc_gpio278_pz0,
                    drive_soc_gpio279_pz1, drive_soc_gpio282_pz4,
                    drive_soc_gpio283_pz5, drive_soc_gpio284_pz6,
                    drive_soc_gpio285_pz7, drive_soc_gpio286_pal0,
                    drive_soc_gpio287_pal1, drive_soc_gpio288_pal2,
                    drive_xhalt_trig_pz2, drive_soc_gpio281_pz3, dap2_din_pw0,
                    dap2_dout_pv7, drive_dap2_din_pw0, drive_dap2_dout_pv7 ]

required:
  - compatible
  - reg

additionalProperties: false

examples:
  - |
    #include <dt-bindings/pinctrl/pinctrl-tegra.h>

    pinmux@c281000 {
        compatible = "nvidia,tegra268-pinmux-main";
        reg = <0xc281000 0xc000>;

        pinctrl-names = "default";
        pinctrl-0 = <&state_default>;

        state_default: pinmux-default {
            sdmmc1 {
                nvidia,pins = "spi3_cs0_pj1";
                nvidia,function = "spi3_cs0";
                nvidia,pull = <TEGRA_PIN_PULL_NONE>;
                nvidia,tristate = <TEGRA_PIN_DISABLE>;
                nvidia,enable-input = <TEGRA_PIN_ENABLE>;
            };
        };
    };
```
