## Documentation/devicetree/bindings/pinctrl/nxp,mc33978-pinctrl.yaml
```yaml
# SPDX-License-Identifier: (GPL-2.0-only OR BSD-2-Clause)
%YAML 1.2
---
$id: http://devicetree.org/schemas/pinctrl/nxp,mc33978-pinctrl.yaml#
$schema: http://devicetree.org/meta-schemas/core.yaml#

title: NXP MC33978/MC34978 Pinctrl/GPIO Driver

maintainers:
  - David Jander <david@protonic.nl>
  - Oleksij Rempel <o.rempel@pengutronix.de>

description: |
  Pin control and GPIO driver for the MC33978/MC34978 MSDI device.

  Pin numbering:
  - Pins 0-13: SG0-SG13 (Switch-to-Ground inputs). These pins monitor
    contacts closed to ground and typically require GPIO_ACTIVE_LOW
    flags when used as digital inputs.
  - Pins 14-21: SP0-SP7 (Programmable inputs). These can be configured
    as SG (Switch-to-Ground) or SB (Switch-to-Battery) inputs. SB
    inputs monitor contacts closed to the battery voltage and typically
    require GPIO_ACTIVE_HIGH flags when used as digital inputs.

  Output Emulation:
  The hardware lacks standard push-pull output drivers. Outputs are emulated
  by toggling the programmable wetting current sources (acting as pull-ups or
  pull-downs) and the hardware tri-state registers. Because of this physical
  constraint:
  - Consumers using pins as outputs MUST flag them with GPIO_OPEN_DRAIN or
    GPIO_OPEN_SOURCE in the device tree.
  - Push-pull configurations are physically unsupported.
  - The active polarity depends entirely on the external circuit (e.g., how an
    LED is wired) and must be flagged accordingly by the consumer.

properties:
  compatible:
    enum:
      - nxp,mc33978-pinctrl
      - nxp,mc34978-pinctrl

  gpio-controller: true

  '#gpio-cells':
    const: 2

  ngpios:
    const: 22

patternProperties:
  "^.*-grp$":
    type: object
    $ref: pincfg-node.yaml#
    additionalProperties: false
    description:
      Pin configuration subnodes.
    properties:
      pins: true
      bias-pull-up: true
      bias-pull-down: true
      bias-high-impedance: true

required:
  - compatible
  - gpio-controller
  - '#gpio-cells'

unevaluatedProperties: false

examples:
  - |
    pinctrl {
        compatible = "nxp,mc33978-pinctrl";
        gpio-controller;
        #gpio-cells = <2>;
        ngpios = <22>;

        door-grp {
            pins = "sg0";
            bias-high-impedance;
        };
    };
```

## Documentation/devicetree/bindings/pinctrl/nxp,mc33978.yaml
```yaml
# SPDX-License-Identifier: (GPL-2.0-only OR BSD-2-Clause)
%YAML 1.2
---
$id: http://devicetree.org/schemas/pinctrl/nxp,mc33978.yaml#
$schema: http://devicetree.org/meta-schemas/core.yaml#

title: NXP MC33978/MC34978 Multiple Switch Detection Interface

maintainers:
  - David Jander <david@protonic.nl>
  - Oleksij Rempel <o.rempel@pengutronix.de>

description: |
  The MC33978 and MC34978 are Multiple Switch Detection Interface (MSDI)
  devices with 22 switch inputs, integrated fault detection, and analog
  multiplexer (AMUX) for voltage/temperature monitoring.

  Pin numbering:
  - Pins 0-13: SG0-SG13 (Switch-to-Ground inputs). These pins monitor
    contacts closed to ground and typically require GPIO_ACTIVE_LOW
    flags when used as digital inputs.
  - Pins 14-21: SP0-SP7 (Programmable inputs). These can be configured
    as SG (Switch-to-Ground) or SB (Switch-to-Battery) inputs. SB
    inputs monitor contacts closed to the battery voltage and typically
    require GPIO_ACTIVE_HIGH flags when used as digital inputs.

  Output Emulation:
  The hardware lacks standard push-pull output drivers. Outputs are emulated
  by toggling the programmable wetting current sources (acting as pull-ups
  or pull-downs) and the hardware tri-state registers. Because of this
  physical constraint:
  - Consumers using pins as outputs MUST flag them with GPIO_OPEN_DRAIN or
    GPIO_OPEN_SOURCE in the device tree.
  - Push-pull configurations are physically unsupported.
  - The active polarity depends entirely on the external circuit (e.g., how
    an LED is wired) and must be flagged accordingly by the consumer.

allOf:
  - $ref: /schemas/spi/spi-peripheral-props.yaml#

properties:
  compatible:
    enum:
      - nxp,mc33978
      - nxp,mc34978

  reg:
    maxItems: 1
    description: SPI chip select number

  spi-max-frequency:
    maximum: 8000000
    description: Maximum SPI clock frequency (up to 8 MHz)

  interrupts:
    maxItems: 1
    description:
      INT_B pin interrupt. Active-low, indicates pin state changes or
      fault conditions.

  interrupt-controller: true

  '#interrupt-cells':
    const: 2
    description:
      First cell is the IRQ number (0-21 for pins, 22 for faults).
      Second cell is the trigger type (IRQ_TYPE_* from dt-bindings/interrupt-controller/irq.h).

  '#mux-control-cells':
    const: 0
    description:
      Present if the device AMUX selector is used as a mux provider.
      Consumers (e.g. io-channel-mux) must provide settle-time-us for the
      external ADC sampling path.

  vddq-supply:
    description: Digital supply voltage

  vbatp-supply:
    description: Battery/power supply

  gpio-controller: true

  '#gpio-cells':
    const: 2

  ngpios:
    const: 22

patternProperties:
  '^.*-grp$':
    type: object
    $ref: /schemas/pinctrl/pincfg-node.yaml#
    additionalProperties: false
    description: Pin configuration subnodes.
    properties:
      pins:
        items:
          enum: [sg0, sg1, sg2, sg3, sg4, sg5, sg6, sg7, sg8, sg9,
                 sg10, sg11, sg12, sg13, sp0, sp1, sp2, sp3,
                 sp4, sp5, sp6, sp7]

      bias-pull-up: true
      bias-pull-down: true
      bias-high-impedance: true
      bias-disable: true
      drive-open-drain: true
      drive-open-source: true
      drive-strength:
        enum: [2, 6, 8, 10, 12, 14, 16, 20]

required:
  - compatible
  - reg
  - interrupts
  - interrupt-controller
  - '#interrupt-cells'
  - vddq-supply
  - vbatp-supply
  - gpio-controller
  - '#gpio-cells'

unevaluatedProperties: false

examples:
  - |
    #include <dt-bindings/interrupt-controller/irq.h>
    #include <dt-bindings/gpio/gpio.h>

    spi {
        #address-cells = <1>;
        #size-cells = <0>;

        msdi: gpio@0 {
            compatible = "nxp,mc33978";
            reg = <0>;
            spi-max-frequency = <4000000>;

            interrupt-parent = <&gpiog>;
            interrupts = <9 IRQ_TYPE_LEVEL_LOW>;
            interrupt-controller;
            #interrupt-cells = <2>;

            vddq-supply = <&reg_3v3>;
            vbatp-supply = <&reg_12v>;

            #mux-control-cells = <0>;

            gpio-controller;
            #gpio-cells = <2>;
            ngpios = <22>;

            door-grp {
                pins = "sg0";
                bias-high-impedance;
            };
        };
    };
```

## Documentation/devicetree/bindings/pinctrl/pinctrl-mcp23s08.yaml
```yaml
# SPDX-License-Identifier: GPL-2.0-only
# Copyright 2024 Silicon Signals Pvt. Ltd.
%YAML 1.2
---
$id: http://devicetree.org/schemas/pinctrl/pinctrl-mcp23s08.yaml#
$schema: http://devicetree.org/meta-schemas/core.yaml#

title: Microchip I/O expander with serial interface (I2C/SPI)

maintainers:
  - Himanshu Bhavani <himanshu.bhavani@siliconsignals.io>

description: |
  Microchip MCP23008, MCP23017, MCP23S08, MCP23S17, MCP23S18 GPIO expander
  chips.These chips provide 8 or 16 GPIO pins with either I2C or SPI interface.

properties:
  compatible:
    enum:
      - microchip,mcp23s08
      - microchip,mcp23s17
      - microchip,mcp23s18
      - microchip,mcp23008
      - microchip,mcp23017
      - microchip,mcp23018

  reg:
    maxItems: 1

  gpio-controller: true

  '#gpio-cells':
    const: 2

  interrupt-controller: true

  '#interrupt-cells':
    const: 2

  interrupts:
    maxItems: 1

  reset-gpios:
    description: GPIO specifier for active-low reset pin.
    maxItems: 1

  spi-max-frequency:
    description: Maximum frequency for SPI devices.

  microchip,spi-present-mask:
    description: |
      SPI present mask. Specifies which chips are present on the shared SPI
      chipselect. Each bit in the mask represents one SPI address.
    $ref: /schemas/types.yaml#/definitions/uint8

  microchip,irq-mirror:
    type: boolean
    description: |
      Sets the mirror flag in the IOCON register. Devices with two interrupt
      outputs (these are the devices ending with 17 and those that have 16 IOs)
      have two IO banks IO 0-7 form bank 1 and IO 8-15 are bank 2. These chips
      have two different interrupt outputs One for bank 1 and another for
      bank 2. If irq-mirror is set, both interrupts are generated regardless of
      the bank that an input change occurred on. If it is not set,the interrupt
      are only generated for the bank they belong to.

  microchip,irq-active-high:
    type: boolean
    description: |
      Sets the INTPOL flag in the IOCON register.This configures the IRQ output
      polarity as active high.

  drive-open-drain:
    type: boolean
    description: |
      Sets the ODR flag in the IOCON register. This configures the IRQ output as
      open drain active low.

  pinmux:
    type: object
    properties:
      pins:  
        description: |
          The list of GPIO pins controlled by this node. Each pin name corresponds
          to a physical pin on the GPIO expander.
        items:
          pattern: "^gpio([0-9]|[1][0-5])$"
        maxItems: 16

      bias-pull-up:
        type: boolean
        description: Configures pull-up resistors for the GPIO pins.

    required:
      - pins
      - bias-pull-up

    additionalProperties: false

required:
  - compatible
  - reg
  - gpio-controller
  - '#gpio-cells'

additionalProperties: false

examples:
  - |
    #include <dt-bindings/interrupt-controller/irq.h>
    #include <dt-bindings/gpio/gpio.h>
    
    i2c {
        #address-cells = <1>;
        #size-cells = <0>;
        
        mcp23017: gpio@20 {
            compatible = "microchip,mcp23017";
            reg = <0x20>;
            gpio-controller;
            #gpio-cells = <2>;

            interrupt-parent = <&gpio1>;
            interrupts = <17 IRQ_TYPE_LEVEL_LOW>; // Check this line
            interrupt-controller;
            #interrupt-cells = <2>;

            microchip,irq-mirror;
            pinctrl-names = "default";
            pinctrl-0 = <&pinctrl_i2c_gpio0>, <&gpio21pullups>;
            reset-gpios = <&gpio6 15 GPIO_ACTIVE_LOW>;
            
            gpio21pullups: pinmux {
                pins = "gpio0", "gpio1", "gpio2", "gpio3",
                       "gpio4", "gpio5", "gpio6", "gpio7",
                       "gpio8", "gpio9", "gpio10", "gpio11",
                       "gpio12", "gpio13", "gpio14", "gpio15";
                bias-pull-up;
            };
        };
    };

  - |
    spi {
        #address-cells = <1>;
        #size-cells = <0>;
        
        mcp23s17: gpio@0 {
            compatible = "microchip,mcp23s17";
            reg = <0>;
            gpio-controller;
            #gpio-cells = <2>;
            spi-max-frequency = <1000000>;
```

## Documentation/devicetree/bindings/pinctrl/qcom,hawi-tlmm.yaml
```yaml
# SPDX-License-Identifier: (GPL-2.0-only OR BSD-2-Clause)
%YAML 1.2
---
$id: http://devicetree.org/schemas/pinctrl/qcom,hawi-tlmm.yaml#
$schema: http://devicetree.org/meta-schemas/core.yaml#

title: Qualcomm Technologies, Inc. Hawi TLMM block

maintainers:
  - Mukesh Ojha <mukesh.ojha@oss.qualcomm.com>

description:
  Top Level Mode Multiplexer pin controller in Qualcomm Hawi SoC.

allOf:
  - $ref: /schemas/pinctrl/qcom,tlmm-common.yaml#

properties:
  compatible:
    const: qcom,hawi-tlmm

  reg:
    maxItems: 1

  interrupts:
    maxItems: 1

  gpio-reserved-ranges:
    minItems: 1
    maxItems: 113

  gpio-line-names:
    maxItems: 226

patternProperties:
  "-state$":
    oneOf:
      - $ref: "#/$defs/qcom-hawi-tlmm-state"
      - patternProperties:
          "-pins$":
            $ref: "#/$defs/qcom-hawi-tlmm-state"
        additionalProperties: false

$defs:
  qcom-hawi-tlmm-state:
    type: object
    description:
      Pinctrl node's client devices use subnodes for desired pin configuration.
      Client device subnodes use below standard properties.
    $ref: qcom,tlmm-common.yaml#/$defs/qcom-tlmm-state
    unevaluatedProperties: false

    properties:
      pins:
        description:
          List of gpio pins affected by the properties specified in this
          subnode.
        items:
          oneOf:
            - pattern: "^gpio([0-9]|[1-9][0-9]|1[0-9][0-9]|20[0-9]|21[0-9]|22[0-5])$"
            - enum: [ ufs_reset, sdc2_clk, sdc2_cmd, sdc2_data ]
        minItems: 1
        maxItems: 36

      function:
        description:
          Specify the alternative function to be configured for the specified
          pins.
        enum: [ gpio, aoss_cti, atest_char, atest_usb, audio_ext_mclk,
                audio_ref_clk, cam_mclk, cci_async_in, cci_i2c_scl, cci_i2c_sda,
                cci_timer, coex_espmi_sclk, coex_espmi_sdata, coex_uart1_rx,
                coex_uart1_tx, dbg_out_clk, ddr_bist, ddr_pxi, dp_hot,
                egpio, gcc_gp, gnss_adc, host_rst, i2chub0_se0, i2chub0_se1,
                i2chub0_se2, i2chub0_se3, i2chub0_se4, i2s0_data, i2s0_sck,
                i2s0_ws, i2s1_data, i2s1_sck, i2s1_ws, ibi_i3c, jitter_bist,
                mdp_esync0, mdp_esync1, mdp_esync2, mdp_vsync, mdp_vsync_e,
                mdp_vsync_p, mdp_vsync0_out, mdp_vsync1_out, mdp_vsync2_out,
                mdp_vsync3_out, mdp_vsync5_out, modem_pps_in, modem_pps_out,
                nav_gpio0, nav_gpio1, nav_gpio2, nav_gpio3, nav_gpio4, nav_gpio5,
                nav_rffe, pcie0_clk_req_n, pcie0_rst_n, pcie1_clk_req_n,
                phase_flag, pll_bist_sync, pll_clk_aux, qdss_cti, qlink_enable,
                qlink_request, qlink_wmss, qspi, qspi_clk, qspi_cs, qup1_se0,
                qup1_se1, qup1_se2, qup1_se3, qup1_se4, qup1_se5, qup1_se6,
                qup1_se7, qup2_se0, qup2_se1, qup2_se2, qup2_se3, qup2_se4_l0,
                qup2_se4_l1, qup2_se4_l2, qup2_se4_l3, qup3_se0_l0, qup3_se0_l1,
                qup3_se0_l2, qup3_se0_l3, qup3_se1, qup3_se2, qup3_se3, qup3_se4,
                qup3_se5, qup4_se0, qup4_se1, qup4_se2, qup4_se3_l0, qup4_se3_l1,
                qup4_se3_l2, qup4_se3_l3, qup4_se4_l0, qup4_se4_l1, qup4_se4_l2,
                qup4_se4_l3, rng_rosc, sd_write_protect, sdc4_clk,
                sdc4_cmd, sdc4_data, sys_throttle, tb_trig_sdc, tmess_rng,
                tsense_clm, tsense_pwm, uim0_clk, uim0_data, uim0_present,
                uim0_reset, uim1_clk, uim1_data, uim1_present, uim1_reset,
                usb0_hs, usb_phy, vfr, vsense_trigger_mirnat, wcn_sw_ctrl ]

    required:
      - pins

required:
  - compatible
  - reg

unevaluatedProperties: false

examples:
  - |
    #include <dt-bindings/interrupt-controller/arm-gic.h>

    tlmm: pinctrl@f100000 {
        compatible = "qcom,hawi-tlmm";
        reg = <0x0f100000 0x300000>;
        interrupts = <GIC_ESPI 272 IRQ_TYPE_LEVEL_HIGH>;
        gpio-controller;
        #gpio-cells = <2>;
        gpio-ranges = <&tlmm 0 0 227>;
        interrupt-controller;
        #interrupt-cells = <2>;

        qup-uart7-state {
          pins = "gpio62", "gpio63";
          function = "qup1_se7";
        };
    };
...
```
