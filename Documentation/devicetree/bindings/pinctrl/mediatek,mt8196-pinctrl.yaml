## Documentation/devicetree/bindings/pinctrl/qcom,ipq5210-tlmm.yaml
```yaml
# SPDX-License-Identifier: (GPL-2.0-only OR BSD-2-Clause)
%YAML 1.2
---
$id: http://devicetree.org/schemas/pinctrl/qcom,ipq5210-tlmm.yaml#
$schema: http://devicetree.org/meta-schemas/core.yaml#

title: Qualcomm IPQ5210 TLMM pin controller

maintainers:
  - Bjorn Andersson <andersson@kernel.org>
  - Kathiravan Thirumoorthy <kathiravan.thirumoorthy@oss.qualcomm.com>

description: |
  Top Level Mode Multiplexer pin controller in Qualcomm IPQ5210 SoC.

allOf:
  - $ref: /schemas/pinctrl/qcom,tlmm-common.yaml#

properties:
  compatible:
    const: qcom,ipq5210-tlmm

  reg:
    maxItems: 1

  interrupts:
    maxItems: 1

  gpio-reserved-ranges:
    minItems: 1
    maxItems: 27

  gpio-line-names:
    maxItems: 54

patternProperties:
  "-state$":
    oneOf:
      - $ref: "#/$defs/qcom-ipq5210-tlmm-state"
      - patternProperties:
          "-pins$":
            $ref: "#/$defs/qcom-ipq5210-tlmm-state"
        additionalProperties: false

$defs:
  qcom-ipq5210-tlmm-state:
    type: object
    description:
      Pinctrl node's client devices use subnodes for desired pin configuration.
      Client device subnodes use below standard properties.
    $ref: qcom,tlmm-common.yaml#/$defs/qcom-tlmm-state
    unevaluatedProperties: false

    properties:
      pins:
        description:
          List of gpio pins affected by the properties specified in this
          subnode.
        items:
          pattern: "^gpio([0-9]|[1-4][0-9]|5[0-3])$"
        minItems: 1
        maxItems: 36

      function:
        description:
          Specify the alternative function to be configured for the specified
          pins.

        enum: [ atest_char_start, atest_char_status0, atest_char_status1,
                atest_char_status2, atest_char_status3, atest_tic_en, audio_pri0,
                audio_pri1, audio_pri2, audio_pri3, audio_pri_d0, audio_pri_d1,
                audio_pri_fsync, audio_pri_pclk, audio_sec0, audio_sec1,
                audio_sec2, audio_sec3, audio_sec_d0, audio_sec_d1,
                audio_sec_fsync, audio_sec_pclk, core_voltage_0, cri_trng0,
                cri_trng1, cri_trng2, cri_trng3, dbg_out_clk, dg_out,
                gcc_plltest_bypassnl, gcc_plltest_resetn, gcc_tlmm, gpio, Led00,
                led01, led02, led10, led11, led12, led20, led21, led22,
                mdc_mst, mdc_slv0, mdc_slv1, mdc_slv2, mdio_mst, mdio_slv0,
                mdio_slv1, mdio_slv2, mux_tod_out, pcie0_clk_req_n, pcie0_wake,
                pcie1_clk_req_n, pcie1_wake, pll_test, pon_active_led,
                pon_mux_sel, pon_rx, pon_rx_los, pon_tx, pon_tx_burst,
                pon_tx_dis, pon_tx_fault, pon_tx_sd, gpn_rx_los, gpn_tx_burst,
                gpn_tx_dis, gpn_tx_fault, gpn_tx_sd, pps, pwm_out00, pwm_out01,
                pwm_out02, pwm_out03, pwm_out10, pwm_out11, pwm_out12,
                pwm_out20, pwm_out21, pwm_out22, pwm_out30, pwm_out31,
                pwm_out32, qdss_cti_trig_in_a0, qdss_cti_trig_in_a1,
                qdss_cti_trig_in_b0, qdss_cti_trig_in_b1, qdss_cti_trig_out_a0,
                qdss_cti_trig_out_a1, qdss_cti_trig_out_b0,
                qdss_cti_trig_out_b1, qdss_traceclk_a, qdss_tracectl_a,
                qdss_tracedata_a, qrng_rosc0, qrng_rosc1, qrng_rosc2,
                qspi_data, qspi_clk, qspi_cs_n, qup_se0_l0, qup_se0_l1,
                qup_se0_l2, qup_se0_l3, qup_se0_l4, qup_se0_l5, qup_se1_l0,
                qup_se1_l1, qup_se1_l2, qup_se1_l3, qup_se2_l00, qup_se2_l01,
                qup_se2_l10, qup_se2_l11, qup_se2_l2, qup_se2_l3, qup_se3_l0,
                qup_se3_l1, qup_se3_l2, qup_se3_l3, qup_se4_l0, qup_se4_l1,
                qup_se4_l2, qup_se4_l3, qup_se4_l4, qup_se4_l5, qup_se5_l00,
                qup_se5_l01, qup_se5_l10, qup_se5_l11, qup_se5_l2, qup_se5_l3,
                qup_se5_l4, qup_se5_l5, resout, rx_los00, rx_los01, rx_los10,
                rx_los11, rx_los20, rx_los21, sdc_clk, sdc_cmd, sdc_data,
                tsens_max ]

    required:
      - pins

required:
  - compatible
  - reg

unevaluatedProperties: false

examples:
  - |
    #include <dt-bindings/interrupt-controller/arm-gic.h>

    tlmm: pinctrl@1000000 {
        compatible = "qcom,ipq5210-tlmm";
        reg = <0x01000000 0x300000>;
        gpio-controller;
        #gpio-cells = <0x2>;
        gpio-ranges = <&tlmm 0 0 54>;
        interrupts = <GIC_SPI 31 IRQ_TYPE_LEVEL_HIGH>;
        interrupt-controller;
        #interrupt-cells = <0x2>;

        qup-uart1-default-state {
            tx-pins {
                pins = "gpio39";
                function = "qup_se1_l2";
                drive-strength = <6>;
                bias-pull-down;
            };

            rx-pins {
                pins = "gpio38";
                function = "qup_se1_l3";
                drive-strength = <6>;
                bias-pull-down;
            };
        };

    };
```

## Documentation/devicetree/bindings/pinctrl/renesas,rzt2h-pinctrl.yaml
```yaml
# SPDX-License-Identifier: (GPL-2.0-only OR BSD-2-Clause)
%YAML 1.2
---
$id: http://devicetree.org/schemas/pinctrl/renesas,rzt2h-pinctrl.yaml#
$schema: http://devicetree.org/meta-schemas/core.yaml#

title: Renesas RZ/T2H Pin and GPIO controller

maintainers:
  - Lad Prabhakar <prabhakar.mahadev-lad.rj@bp.renesas.com>

description:
  The Renesas RZ/T2H SoC features a combined Pin and GPIO controller.
  Pin multiplexing and GPIO configuration is performed on a per-pin basis.
  Each port features up to 8 pins, each of them configurable for GPIO function
  (port mode) or in alternate function mode.
  Up to 8 different alternate function modes exist for each single pin.

properties:
  compatible:
    enum:
      - renesas,r9a09g077-pinctrl # RZ/T2H
      - renesas,r9a09g087-pinctrl # RZ/N2H

  reg:
    minItems: 1
    items:
      - description: Non-safety I/O Port base
      - description: Safety I/O Port safety region base
      - description: Safety I/O Port Non-safety region base

  reg-names:
    minItems: 1
    items:
      - const: nsr
      - const: srs
      - const: srn

  gpio-controller: true

  '#gpio-cells':
    const: 2
    description:
      The first cell contains the global GPIO port index, constructed using the
      RZT2H_GPIO() helper macro from <dt-bindings/pinctrl/renesas,r9a09g077-pinctrl.h>
      (e.g. "RZT2H_GPIO(3, 0)" for P03_0). The second cell represents the consumer
      flag. Use the macros defined in include/dt-bindings/gpio/gpio.h.

  gpio-ranges:
    maxItems: 1

  clocks:
    maxItems: 1

  power-domains:
    maxItems: 1

definitions:
  renesas-rzt2h-n2h-pins-node:
    type: object
    allOf:
      - $ref: pincfg-node.yaml#
      - $ref: pinmux-node.yaml#
    properties:
      pinmux:
        description:
          Values are constructed from I/O port number, pin number, and
          alternate function configuration number using the RZT2H_PORT_PINMUX()
          helper macro from <dt-bindings/pinctrl/renesas,r9a09g077-pinctrl.h>.
      pins: true
      phandle: true
      input: true
      input-enable: true
      output-enable: true
    oneOf:
      - required: [pinmux]
      - required: [pins]
    additionalProperties: false

patternProperties:
  # Grouping nodes: allow multiple "-pins" subnodes within a "-group"
  '.*-group$':
    type: object
    description:
      Pin controller client devices can organize pin configuration entries into
      grouping nodes ending in "-group". These group nodes may contain multiple
      child nodes each ending in "-pins" to configure distinct sets of pins.
    additionalProperties: false
    patternProperties:
      '-pins$':
        $ref: '#/definitions/renesas-rzt2h-n2h-pins-node'

  # Standalone "-pins" nodes under client devices or groups
  '-pins$':
    $ref: '#/definitions/renesas-rzt2h-n2h-pins-node'

  '-hog$':
    type: object
    description: GPIO hog node
    properties:
      gpio-hog: true
      gpios: true
      input: true
      output-high: true
      output-low: true
      line-name: true
    required:
      - gpio-hog
      - gpios
    additionalProperties: false

allOf:
  - $ref: pinctrl.yaml#

required:
  - compatible
  - reg
  - reg-names
  - gpio-controller
  - '#gpio-cells'
  - gpio-ranges
  - clocks
  - power-domains

unevaluatedProperties: false

examples:
  - |
    #include <dt-bindings/clock/renesas,r9a09g077-cpg-mssr.h>
    #include <dt-bindings/pinctrl/renesas,r9a09g077-pinctrl.h>

    pinctrl@802c0000 {
        compatible = "renesas,r9a09g077-pinctrl";
        reg = <0x802c0000 0x2000>,
              <0x812c0000 0x2000>,
              <0x802b0000 0x2000>;
        reg-names = "nsr", "srs", "srn";
        clocks = <&cpg CPG_CORE R9A09G077_CLK_PCLKM>;
        gpio-controller;
        #gpio-cells = <2>;
        gpio-ranges = <&pinctrl 0 0 288>;
        power-domains = <&cpg>;

        serial0-pins {
            pinmux = <RZT2H_PORT_PINMUX(38, 0, 1)>, /* Tx */
                     <RZT2H_PORT_PINMUX(38, 1, 1)>; /* Rx */
        };

        sd1-pwr-en-hog {
            gpio-hog;
            gpios = <RZT2H_GPIO(39, 2) 0>;
            output-high;
            line-name = "sd1_pwr_en";
        };

        i2c0-pins {
            pins = "RIIC0_SDA", "RIIC0_SCL";
            input-enable;
        };

        sdhi0_sd_pins: sd0-sd-group {
            sd0-sd-ctrl-pins {
                pinmux = <RZT2H_PORT_PINMUX(12, 0, 0x29)>, /* SD0_CLK */
                         <RZT2H_PORT_PINMUX(12, 1, 0x29)>; /* SD0_CMD */
            };

            sd0-sd-data-pins {
                pinmux = <RZT2H_PORT_PINMUX(12, 0, 0x29)>, /* SD0_CLK */
                         <RZT2H_PORT_PINMUX(12, 1, 0x29)>; /* SD0_CMD */
            };

            sd0-sd-tmp-pins {
                pins = "RIIC0_SDA", "RIIC0_SCL";
                input-enable;
            };
        };
    };
```

## Documentation/devicetree/bindings/pinctrl/rockchip,rmio.yaml
```yaml
# SPDX-License-Identifier: (GPL-2.0-only OR BSD-2-Clause)
%YAML 1.2
---
$id: http://devicetree.org/schemas/pinctrl/rockchip,rmio.yaml#
$schema: http://devicetree.org/meta-schemas/core.yaml#

title: RMIO (Rockchip Matrix I/O) Controller

maintainers:
  - Heiko Stuebner <heiko@sntech.de>

description: |
  The RMIO controller provides a flexible routing matrix that allows mapping
  various internal peripheral functions (UART, SPI, PWM, etc.) to specific
  physical pins. This block is typically a sub-block of the GRF
  (General Register Files) or PMU (Power Management Unit).

properties:
  compatible:
    items:
      - enum:
          - rockchip,rk3506-rmio
      - const: rockchip,rmio

  rockchip,rmio-grf:
    $ref: /schemas/types.yaml#/definitions/phandle
    description:
      The phandle of the syscon node (GRF or PMU) containing the RMIO registers.
      This property is required if the RMIO registers are located in a different
      syscon than the parent pinctrl node.

  rockchip,offset:
    $ref: /schemas/types.yaml#/definitions/uint32
    description:
      The offset of the RMIO configuration registers within the GRF.

  rockchip,pins-num:
    $ref: /schemas/types.yaml#/definitions/uint32
    description:
      The number of physical pins supported by this RMIO instance.
      Used for boundary checking and driver initialization.

patternProperties:
  "^[a-z0-9-]+$":
    type: object
    description:
      Function node grouping multiple groups.

    patternProperties:
      "^[a-z0-9-]+$":
        type: object
        description:
          Group node containing the pinmux configuration.

        properties:
          rockchip,rmio:
            $ref: /schemas/types.yaml#/definitions/uint32-matrix
            description:
              A list of pin-function pairs. The format is <pin_id function_id>.
            minItems: 1
            items:
              items:
                - description: RMIO Pin ID (0 to pins-num - 1)
                  minimum: 0
                  maximum: 31
                - description: Function ID
                  minimum: 0
                  maximum: 98

        required:
          - rockchip,rmio

        additionalProperties: false

    additionalProperties: false

required:
  - compatible
  - rockchip,rmio-grf
  - rockchip,offset
  - rockchip,pins-num

additionalProperties: false

examples:
  - |
    #include <dt-bindings/pinctrl/rockchip,rk3506-rmio.h>

    pinctrl: pinctrl {
        rmio: rmio {
            compatible = "rockchip,rk3506-rmio", "rockchip,rmio";
            rockchip,rmio-grf = <&grf_pmu>;
            rockchip,offset = <0x80>;
            rockchip,pins-num = <32>;

            rmio-uart {
                rmio_pin27_uart1_tx: rmio-pin27-uart1-tx {
                    rockchip,rmio = <27 RMIO_UART1_TX>;
                };

                rmio_pin28_uart1_rx: rmio-pin28-uart1-rx {
                    rockchip,rmio = <28 RMIO_UART1_RX>;
                };
            };
        };
    };
```

## Documentation/devicetree/bindings/pinctrl/st,stm32-pinctrl-hdp.yaml
```yaml
# SPDX-License-Identifier: (GPL-2.0-only OR BSD-2-Clause)
# Copyright (C) STMicroelectronics 2025.
%YAML 1.2
---
$id: http://devicetree.org/schemas/pinctrl/st,stm32-pinctrl-hdp.yaml#
$schema: http://devicetree.org/meta-schemas/core.yaml#

title: STM32 Hardware Debug Port Mux/Config

maintainers:
  - Clément LE GOFFIC <clement.legoffic@foss.st.com>

description: |
  STMicroelectronics's STM32 MPUs integrate a Hardware Debug Port (HDP).
  It allows to output internal signals on SoC's GPIO.

properties:
  compatible:
    const: st,stm32mp-hdp

  reg:
    maxItems: 1

  clocks:
    maxItems: 1

patternProperties:
  '-pins$':
    type: object
    $ref: pinmux-node.yaml#

    properties:
      function:
        enum: [ "0", "1", "2", "3", "4", "5", "6", "7",
                "8", "9", "10", "11", "12", "13", "14",
                "15" ]

      pins:
        enum: [ hdp0, hdp1, hdp2, hdp3, hdp4, hdp5, hdp6, hdp7 ]

    required:
      - function
      - pins

    additionalProperties: false

allOf:
  - $ref: pinctrl.yaml#

required:
  - compatible
  - reg
  - clocks

additionalProperties: false

examples:
  - |
    #include <dt-bindings/clock/stm32mp1-clks.h>
    #include <dt-bindings/pinctrl/stm32mp15-hdp.h>
    //Example 1
    pinctrl@54090000 {
      compatible = "st,stm32mp-hdp";
      reg = <0x54090000 0x400>;
      clocks = <&rcc HDP>;
      pinctrl-names = "default";
      pinctrl-0 = <&hdp2>;
      hdp2-pins {
        function = HDP2_GPOVAL_2;
        pins = "hdp2";
      };
    };
```
