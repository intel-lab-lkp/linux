## Documentation/devicetree/bindings/pinctrl/mediatek,mt8196-pinctrl.yaml
```yaml
# SPDX-License-Identifier: (GPL-2.0-only OR BSD-2-Clause)
%YAML 1.2
---
$id: http://devicetree.org/schemas/pinctrl/mediatek,mt8196-pinctrl.yaml#
$schema: http://devicetree.org/meta-schemas/core.yaml#

title: MediaTek MT8196 Pin Controller

maintainers:
  - Lei Xue <lei.xue@mediatek.com>
  - Cathy Xu <ot_cathy.xu@mediatek.com>

description:
  The MediaTek's MT8196 Pin controller is used to control SoC pins.

properties:
  compatible:
    const: mediatek,mt8196-pinctrl

  gpio-controller: true

  '#gpio-cells':
    description:
      Number of cells in GPIO specifier, should be two. The first cell is the
      pin number, the second cell is used to specify optional parameters which
      are defined in <dt-bindings/gpio/gpio.h>.
    const: 2

  gpio-ranges:
    maxItems: 1

  gpio-line-names: true

  reg:
    items:
      - description: gpio registers base address
      - description: rt group io configuration registers base address
      - description: rm1 group io configuration registers base address
      - description: rm2 group io configuration registers base address
      - description: rb group io configuration registers base address
      - description: bm1 group io configuration registers base address
      - description: bm2 group io configuration registers base address
      - description: bm3 group io configuration registers base address
      - description: lt group io configuration registers base address
      - description: lm1 group io configuration registers base address
      - description: lm2 group io configuration registers base address
      - description: lb1 group io configuration registers base address
      - description: lb2 group io configuration registers base address
      - description: tm1 group io configuration registers base address
      - description: tm2 group io configuration registers base address
      - description: tm3 group io configuration registers base address

  reg-names:
    items:
      - const: iocfg0
      - const: iocfg_rt
      - const: iocfg_rm1
      - const: iocfg_rm2
      - const: iocfg_rb
      - const: iocfg_bm1
      - const: iocfg_bm2
      - const: iocfg_bm3
      - const: iocfg_lt
      - const: iocfg_lm1
      - const: iocfg_lm2
      - const: iocfg_lb1
      - const: iocfg_lb2
      - const: iocfg_tm1
      - const: iocfg_tm2
      - const: iocfg_tm3

  interrupt-controller: true

  '#interrupt-cells':
    const: 2

  interrupts:
    description: The interrupt outputs to sysirq.
    maxItems: 1

# PIN CONFIGURATION NODES
patternProperties:
  '-pins$':
    type: object
    additionalProperties: false

    patternProperties:
      '^pins':
        type: object
        $ref: /schemas/pinctrl/pincfg-node.yaml
        additionalProperties: false
        description:
          A pinctrl node should contain at least one subnode representing the
          pinctrl groups available on the machine. Each subnode will list the
          pins it needs, and how they should be configured, with regard to muxer
          configuration, pullups, drive strength, input enable/disable and input
          schmitt.

        properties:
          pinmux:
            description:
              Integer array, represents gpio pin number and mux setting.
              Supported pin number and mux varies for different SoCs, and are
              defined as macros in arch/arm64/boot/dts/mediatek/mt8196-pinfunc.h
              directly, for this SoC.

          drive-strength:
            enum: [2, 4, 6, 8, 10, 12, 14, 16]

          bias-pull-down:
            oneOf:
              - type: boolean
              - enum: [100, 101, 102, 103]
                description: mt8196 pull down PUPD/R0/R1 type define value.
              - enum: [75000, 5000]
                description: mt8196 pull down RSEL type si unit value(ohm).
            description: |
              For pull down type is normal, it doesn't need add R1R0 define
              and resistance value.
              For pull down type is PUPD/R0/R1 type, it can add R1R0 define to
              set different resistance. It can support "MTK_PUPD_SET_R1R0_00" &
              "MTK_PUPD_SET_R1R0_01" & "MTK_PUPD_SET_R1R0_10" &
              "MTK_PUPD_SET_R1R0_11" define in mt8196.
              For pull down type is PD/RSEL, it can add resistance value(ohm)
              to set different resistance by identifying property
              "mediatek,rsel-resistance-in-si-unit". It can support resistance
              value(ohm) "75000" & "5000" in mt8196.

          bias-pull-up:
            oneOf:
              - type: boolean
              - enum: [100, 101, 102, 103]
                description: mt8196 pull up PUPD/R0/R1 type define value.
              - enum: [1000, 1500, 2000, 3000, 4000, 5000, 75000]
                description: mt8196 pull up RSEL type si unit value(ohm).
            description: |
              For pull up type is normal, it don't need add R1R0 define
              and resistance value.
              For pull up type is PUPD/R0/R1 type, it can add R1R0 define to
              set different resistance. It can support "MTK_PUPD_SET_R1R0_00" &
              "MTK_PUPD_SET_R1R0_01" & "MTK_PUPD_SET_R1R0_10" &
              "MTK_PUPD_SET_R1R0_11" define in mt8196.
              For pull up type is PU/RSEL, it can add resistance value(ohm)
              to set different resistance by identifying property
              "mediatek,rsel-resistance-in-si-unit". It can support resistance
              value(ohm) "1000" & "1500" & "2000" & "3000" & "4000" & "5000" &
              "75000" in mt8196.

          bias-disable: true

          output-high: true

          output-low: true

          input-enable: true

          input-disable: true

          input-schmitt-enable: true

          input-schmitt-disable: true

        required:
          - pinmux

required:
  - compatible
  - reg
  - interrupts
  - interrupt-controller
  - '#interrupt-cells'
  - gpio-controller
  - '#gpio-cells'
  - gpio-ranges

additionalProperties: false

examples:
  - |
    #include "../../../../arch/arm64/boot/dts/mediatek/mt8196-pinfunc.h"
    #include <dt-bindings/interrupt-controller/arm-gic.h>

    pio: pinctrl@10005000 {
        compatible = "mediatek,mt8196-pinctrl";
        reg = <0x1002d000 0x1000>,
              <0x12000000 0x1000>,
              <0x12020000 0x1000>,
              <0x12040000 0x1000>,
              <0x12060000 0x1000>,
              <0x12820000 0x1000>,
              <0x12840000 0x1000>,
              <0x12860000 0x1000>,
              <0x13000000 0x1000>,
              <0x13020000 0x1000>,
              <0x13040000 0x1000>,
              <0x130f0000 0x1000>,
              <0x13110000 0x1000>,
              <0x13800000 0x1000>,
              <0x13820000 0x1000>,
              <0x13860000 0x1000>;
        reg-names = "iocfg0", "iocfg_rt",
                    "iocfg_rm1", "iocfg_rm2", "iocfg_rb",
                    "iocfg_bm1", "iocfg_bm2", "iocfg_bm3",
                    "iocfg_lt", "iocfg_lm1", "iocfg_lm2",
                    "iocfg_lb1", "iocfg_lb2", "iocfg_tm1",
                    "iocfg_tm2", "iocfg_tm3";
        gpio-controller;
        #gpio-cells = <2>;
        gpio-ranges = <&pio 0 0 271>;
        interrupt-controller;
        interrupts = <GIC_SPI 225 IRQ_TYPE_LEVEL_HIGH 0>;
        #interrupt-cells = <2>;

        pio-pins {
            pins {
                pinmux = <PINMUX_GPIO0__FUNC_GPIO0>;
                output-low;
            };
        };

        spi0-pins {
            pins-spi {
                pinmux = <PINMUX_GPIO110__FUNC_SPI1_CLK>,
                         <PINMUX_GPIO111__FUNC_SPI1_CSB>,
                         <PINMUX_GPIO112__FUNC_SPI1_MO>;
                drive-strength = <6>;
            };
            pins-spi-mi {
                pinmux = <PINMUX_GPIO113__FUNC_SPI1_MI>;
                bias-pull-down;
            };
        };

        i2c0-pins {
            pins {
                pinmux = <PINMUX_GPIO99__FUNC_SCL0>,
                         <PINMUX_GPIO100__FUNC_SDA0>;
                bias-disable;
            };
        };
    };
```

## Documentation/devicetree/bindings/pinctrl/microchip,mcp23s08.yaml
```yaml
# SPDX-License-Identifier: GPL-2.0-only
%YAML 1.2
---
$id: http://devicetree.org/schemas/pinctrl/microchip,mcp23s08.yaml#
$schema: http://devicetree.org/meta-schemas/core.yaml#

title: Microchip I/O expander with serial interface (I2C/SPI)

maintainers:
  - Himanshu Bhavani <himanshu.bhavani@siliconsignals.io>

description:
  Microchip MCP23008, MCP23017, MCP23S08, MCP23S17, MCP23S18 GPIO expander
  chips.These chips provide 8 or 16 GPIO pins with either I2C or SPI interface.

allOf:
  - $ref: /schemas/spi/spi-peripheral-props.yaml#

properties:
  compatible:
    enum:
      - microchip,mcp23s08
      - microchip,mcp23s17
      - microchip,mcp23s18
      - microchip,mcp23008
      - microchip,mcp23017
      - microchip,mcp23018

  reg:
    maxItems: 1

  gpio-controller: true

  '#gpio-cells':
    const: 2

  interrupt-controller: true

  '#interrupt-cells':
    const: 2

  interrupts:
    maxItems: 1

  gpio-line-names: true

  reset-gpios:
    description: GPIO specifier for active-low reset pin.
    maxItems: 1

  microchip,spi-present-mask:
    description:
      Multiple SPI chips can share the same SPI chipselect. Set a bit in
      bit0-7 in this mask to 1 if there is a chip connected with the
      corresponding spi address set. For example if you have a chip with
      address 3 connected, you have to set bit3 to 1, which is 0x08. mcp23s08
      chip variant only supports bits 0-3. It is not possible to mix mcp23s08
      and mcp23s17 on the same chipselect. Set at least one bit to 1 for SPI
      chips.
    $ref: /schemas/types.yaml#/definitions/uint8

  microchip,irq-mirror:
    type: boolean
    description:
      Sets the mirror flag in the IOCON register. Devices with two interrupt
      outputs (these are the devices ending with 17 and those that have 16 IOs)
      have two IO banks IO 0-7 form bank 1 and IO 8-15 are bank 2. These chips
      have two different interrupt outputs One for bank 1 and another for
      bank 2. If irq-mirror is set, both interrupts are generated regardless of
      the bank that an input change occurred on. If it is not set,the interrupt
      are only generated for the bank they belong to.

  microchip,irq-active-high:
    type: boolean
    description:
      Sets the INTPOL flag in the IOCON register.This configures the IRQ output
      polarity as active high.

  drive-open-drain:
    type: boolean
    description:
      Sets the ODR flag in the IOCON register. This configures the IRQ output as
      open drain active low.

  pinmux:
    type: object
    properties:
      pins:
        description:
          The list of GPIO pins controlled by this node. Each pin name
          corresponds to a physical pin on the GPIO expander.
        items:
          pattern: '^gpio([0-9]|[1][0-5])$'
        maxItems: 16

      bias-pull-up:
        type: boolean
        description:
          Configures pull-up resistors for the GPIO pins. Absence of this
          property will leave the configuration in its default state.

    required:
      - pins

    additionalProperties: false

required:
  - compatible
  - reg
  - gpio-controller
  - '#gpio-cells'

unevaluatedProperties: false

examples:
  - |
    #include <dt-bindings/interrupt-controller/irq.h>
    #include <dt-bindings/gpio/gpio.h>

    i2c {
        #address-cells = <1>;
        #size-cells = <0>;

        gpio@21 {
            compatible = "microchip,mcp23017";
            reg = <0x21>;
            gpio-controller;
            #gpio-cells = <2>;

            interrupt-parent = <&gpio1>;
            interrupts = <17 IRQ_TYPE_LEVEL_LOW>;
            interrupt-controller;
            #interrupt-cells = <2>;

            microchip,irq-mirror;
            pinctrl-names = "default";
            pinctrl-0 = <&pinctrl_i2c_gpio0>, <&gpiopullups>;
            reset-gpios = <&gpio6 15 GPIO_ACTIVE_LOW>;

            gpiopullups: pinmux {
                pins = "gpio0", "gpio1", "gpio2", "gpio3",
                       "gpio4", "gpio5", "gpio6", "gpio7",
                       "gpio8", "gpio9", "gpio10", "gpio11",
                       "gpio12", "gpio13", "gpio14", "gpio15";
                bias-pull-up;
            };
        };
    };

  - |
    spi {
        #address-cells = <1>;
        #size-cells = <0>;

        gpio@0 {
            compatible = "microchip,mcp23s17";
            reg = <0>;
            gpio-controller;
            #gpio-cells = <2>;
            spi-max-frequency = <1000000>;
            microchip,spi-present-mask = /bits/ 8 <0x01>;
        };
    };

  - |
    /* Multiple chips sharing same SPI CS with gpio-line-names */
    spi {
        #address-cells = <1>;
        #size-cells = <0>;

        gpio@0 {
            compatible = "microchip,mcp23s17";
            reg = <0>;
            gpio-controller;
            #gpio-cells = <2>;
            spi-max-frequency = <10000000>;
            /* Two chips at hardware addresses 0 and 1 */
            microchip,spi-present-mask = /bits/ 8 <0x03>;
            /*
             * Names assigned sequentially in address order.
             * First 16 names for chip at address 0 (GPA0-7, GPB0-7).
             * Next 16 names for chip at address 1 (GPA0-7, GPB0-7).
             */
            gpio-line-names =
                "EXP0_GPA0", "EXP0_GPA1", "EXP0_GPA2", "EXP0_GPA3",
                "EXP0_GPA4", "EXP0_GPA5", "EXP0_GPA6", "EXP0_GPA7",
                "EXP0_GPB0", "EXP0_GPB1", "EXP0_GPB2", "EXP0_GPB3",
                "EXP0_GPB4", "EXP0_GPB5", "EXP0_GPB6", "EXP0_GPB7",
                "EXP1_GPA0", "EXP1_GPA1", "EXP1_GPA2", "EXP1_GPA3",
                "EXP1_GPA4", "EXP1_GPA5", "EXP1_GPA6", "EXP1_GPA7",
                "EXP1_GPB0", "EXP1_GPB1", "EXP1_GPB2", "EXP1_GPB3",
                "EXP1_GPB4", "EXP1_GPB5", "EXP1_GPB6", "EXP1_GPB7";
        };
    };
```
