## Documentation/devicetree/bindings/post-init-supplier.yaml
```yaml
# SPDX-License-Identifier: (GPL-2.0-only OR BSD-2-Clause)
# Copyright (c) 2020, Google LLC. All rights reserved.
%YAML 1.2
---
$id: http://devicetree.org/schemas/post-init-supplier.yaml#
$schema: http://devicetree.org/meta-schemas/core.yaml#

title: Post device initialization supplier

maintainers:
  - Saravana Kannan <saravanak@google.com>

description: |
  This property is used to indicate that the device(s) pointed to by the
  property are not needed for the initialization of the device that lists this
  property. This property is meaningful only when pointing to direct suppliers
  of a device that are pointed to by other properties in the device.

  A device can list its suppliers in devicetree using one or more of the
  standard devicetree bindings. By default, it would be safe to assume the
  supplier device can be initialized before the consumer device is initialized.

  However, that assumption cannot be made when there are cyclic dependencies
  between devices. Since each device is a supplier (directly or indirectly) of
  the others in the cycle, there is no guaranteed safe order for initializing
  the devices in a cycle. We can try to initialize them in an arbitrary order
  and eventually successfully initialize all of them, but that doesn't always
  work well.

  For example, say,
  * The device tree has the following cyclic dependency X -> Y -> Z -> X (where
    -> denotes "depends on").
  * But X is not needed to fully initialize Z (X might be needed only when a
    specific functionality is requested post initialization).

  If all the other -> are mandatory initialization dependencies, then trying to
  initialize the devices in a loop (or arbitrarily) will always eventually end
  up with the devices being initialized in the order Z, Y and X.

  However, if Y is an optional supplier for X (where X provides limited
  functionality when Y is not initialized and providing its services), then
  trying to initialize the devices in a loop (or arbitrarily) could end up with
  the devices being initialized in the following order:

  * Z, Y and X - All devices provide full functionality
  * Z, X and Y - X provides partial functionality
  * X, Z and Y - X provides partial functionality

  However, we always want to initialize the devices in the order Z, Y and X
  since that provides the full functionality without interruptions.

  One alternate option that might be suggested is to have the driver for X
  notice that Y became available at a later point and adjust the functionality
  it provides. However, other userspace applications could have started using X
  with the limited functionality before Y was available and it might not be
  possible to transparently transition X or the users of X to full
  functionality while X is in use.

  Similarly, when it comes to suspend (resume) ordering, it's unclear which
  device in a dependency cycle needs to be suspended/resumed first and trying
  arbitrary orders can result in system crashes or instability.

  Explicitly calling out which link in a cycle needs to be broken when
  determining the order, simplifies things a lot, improves efficiency, makes
  the behavior more deterministic and maximizes the functionality that can be
  provided without interruption.

  This property is used to provide this additional information between devices
  in a cycle by telling which supplier(s) is not needed for initializing the
  device that lists this property.

  In the example above, Z would list X as a post-init-supplier and the
  initialization dependency would become X -> Y -> Z -/-> X. So the best order
  to initialize them become clear: Z, Y and then X.

select: true
properties:
  post-init-supplier:
    # One or more suppliers can be marked as post initialization supplier
    description:
      List of phandles to suppliers that are not needed for initializing or
      resuming this device.
    $ref: /schemas/types.yaml#/definitions/phandle-array
      items:
        maxItems: 1

examples:
  - |
    gcc: clock-controller@1000 {
        compatible = "vendor,soc4-gcc", "vendor,soc1-gcc";
        reg = <0x1000 0x80>;
        clocks = <&dispcc 0x1>
        #clock-cells = <1>;
        post-init-supplier = <&dispcc>;
    };
    dispcc: clock-controller@2000 {
        compatible = "vendor,soc4-dispcc", "vendor,soc1-dispcc";
        reg = <0x2000 0x80>;
        clocks = <&gcc 0xdd>
        #clock-cells = <1>;
    };
```

## Documentation/devicetree/bindings/power/marvell,pxa1908-power-controller.yaml
```yaml
# SPDX-License-Identifier: (GPL-2.0-only OR BSD-2-Clause)
%YAML 1.2
---
$id: http://devicetree.org/schemas/power/marvell,pxa1908-power-controller.yaml#
$schema: http://devicetree.org/meta-schemas/core.yaml#

title: Marvell PXA1908 Power Domain Controller

maintainers:
  - Duje Mihanović <duje@dujemihanovic.xyz>

description: |
  The Marvell PXA1908 SoC includes multiple power domains which can be powered
  on/off to save power when different IP cores are not in use.

properties:
  $nodename:
    pattern: '^power-controller$'

  compatible:
    const: marvell,pxa1908-power-controller

  '#power-domain-cells':
    const: 1

  '#address-cells':
    const: 1

  '#size-cells':
    const: 0

patternProperties:
  "^power-domain@[0-9a-f]+$":
    type: object

    description: |
      Represents a power domain within the power controller node as documented
      in Documentation/devicetree/bindings/power/power-domain.yaml.

    properties:
      reg:
        description: |
          Power domain index. Valid values are defined in:
              "include/dt-bindings/power/marvell,pxa1908-power.h"
        maxItems: 1

      clocks:
        description: |
          A number of phandles to clocks that need to be enabled during domain
          power up.

      '#power-domain-cells':
        const: 0

    required:
      - reg

    unevaluatedProperties: false

required:
  - compatible

additionalProperties: false

examples:
  - |
    #include <dt-bindings/power/marvell,pxa1908-power.h>

    clock-controller@d4282800 {
      compatible = "marvell,pxa1908-apmu", "simple-mfd", "syscon";
      reg = <0xd4282800 0x400>;
      #clock-cells = <1>;

      power-controller {
        compatible = "marvell,pxa1908-power-controller";
        #address-cells = <1>;
        #size-cells = <0>;
        #power-domain-cells = <1>;

        power-domain@PXA1908_POWER_DOMAIN_VPU {
          reg = <PXA1908_POWER_DOMAIN_VPU>;
          #power-domain-cells = <0>;
        };

        power-domain@PXA1908_POWER_DOMAIN_GPU {
          reg = <PXA1908_POWER_DOMAIN_GPU>;
          #power-domain-cells = <0>;
        };

        power-domain@PXA1908_POWER_DOMAIN_GPU2D {
          reg = <PXA1908_POWER_DOMAIN_GPU2D>;
          #power-domain-cells = <0>;
        };

        power-domain@PXA1908_POWER_DOMAIN_DSI {
          reg = <PXA1908_POWER_DOMAIN_DSI>;
          #power-domain-cells = <0>;
        };

        power-domain@PXA1908_POWER_DOMAIN_ISP {
          reg = <PXA1908_POWER_DOMAIN_ISP>;
          #power-domain-cells = <0>;
        };
      };
    };
```

## Documentation/devicetree/bindings/power/mediatek,mt8189-power-controller.yaml
```yaml
# SPDX-License-Identifier: (GPL-2.0-only OR BSD-2-Clause)
%YAML 1.2
---
$id: http://devicetree.org/schemas/power/mediatek,mt8189-power-controller.yaml#
$schema: http://devicetree.org/meta-schemas/core.yaml#

title: MediaTek Power Domains Controller for MT8189

maintainers:
  - Qiqi Wang <qiqi.wang@mediatek.com>

description: |
  MediaTek processors include support for multiple power domains which can be
  powered up/down by software based on different application scenes to save power.

  IP cores belonging to a power domain should contain a 'power-domains'
  property that is a phandle for SCPSYS node representing the domain.

properties:
  $nodename:
    pattern: '^power-controller(@[0-9a-f]+)?$'

  compatible:
    enum:
      - mediatek,mt8189-scpsys

  '#power-domain-cells':
    const: 1

  reg:
    description: physical base address and size of the power-controller's register area.

  infra-infracfg-ao-reg-bus:
    $ref: /schemas/types.yaml#/definitions/phandle
    description: phandle to the device containing the infracfg register range.

  emicfg-ao-mem:
    $ref: /schemas/types.yaml#/definitions/phandle
    description: phandle to the device containing the emicfg register range.

  vlpcfg-reg-bus:
    $ref: /schemas/types.yaml#/definitions/phandle
    description: phandle to the device containing the vlpcfg (very low power config) register range.

  clocks:
    description: |
      A number of phandles to clocks that need to be enabled during domain
      power-up sequencing.

  clock-names:
    description: |
      List of names of clocks, in order to match the power-up sequencing
      for each power domain we need to group the clocks by name. BASIC
      clocks need to be enabled before enabling the corresponding power
      domain, and should not have a '-' in their name (i.e mm, mfg, venc).
      SUSBYS clocks need to be enabled before releasing the bus protection,
      and should contain a '-' in their name (i.e mm-0, isp-0, cam-0).

      In order to follow properly the power-up sequencing, the clocks must
      be specified by order, adding first the BASIC clocks followed by the
      SUSBSYS clocks.

  domain-supply:
    description: domain regulator supply.

required:
  - compatible
  - reg

additionalProperties: false

examples:
  - |
    #include <dt-bindings/clock/mt8189-clk.h>
    #include <dt-bindings/power/mt8189-power.h>

    soc {
        #address-cells = <2>;
        #size-cells = <2>;
        scpsys: power-controller@1c001000 {
            compatible = "mediatek,mt8189-scpsys";
            reg = <0 0x1c001000 0 0x1000>;
            #power-domain-cells = <1>;
            infra-infracfg-ao-reg-bus = <&infracfg_ao_clk>;
            emicfg-ao-mem = <&emicfg_ao_mem_clk>;
            vlpcfg-reg-bus = <&vlpcfg_reg_bus_clk>;
            clocks = /* MFG */
                <&topckgen_clk CLK_TOP_MFG_REF_SEL>,
                <&apmixedsys_clk CLK_APMIXED_MFGPLL>;
            clock-names = "mfg", "mfg_top";
            mfg0-supply = <&mt6359_vproc1_buck_reg>;
            mfg1-supply = <&mt6359_vsram_proc1_ldo_reg>;
        };
    };
```

## Documentation/devicetree/bindings/power/mediatek,mt8196-power-controller.yaml
```yaml
# SPDX-License-Identifier: (GPL-2.0-only OR BSD-2-Clause)
%YAML 1.2
---
$id: http://devicetree.org/schemas/power/mediatek,mt8196-power-controller.yaml#
$schema: http://devicetree.org/meta-schemas/core.yaml#

title: Mediatek MT8196 Power Domains Controller

maintainers:
  - Guangjie Song <guangjie.song@mediatek.com>

description: |
  Mediatek processors include support for multiple power domains which can be
  powered up/down by software based on different application scenes to save power.

properties:
  $nodename:
    pattern: '^power-controller(@[0-9a-f]+)?$'

  compatible:
    enum:
      - mediatek,mt8196-scpsys
      - mediatek,mt8196-hfrpsys

  '#power-domain-cells':
    const: 1

  reg:
    description: Address range of the power controller.

  clocks:
    description: |
      A number of phandles to clocks that need to be enabled during domain
      power-up sequencing.

  clock-names:
    description: |
      List of names of clock.

  domain-supply:
    description: domain regulator supply.

  spm:
    $ref: /schemas/types.yaml#/definitions/phandle
    description: phandle to the device containing the spm register range.

  mmpc:
    $ref: /schemas/types.yaml#/definitions/phandle
    description: phandle to the device containing the mmpc register range.

  vote-regmap:
    $ref: /schemas/types.yaml#/definitions/phandle
    description: phandle to the device containing the vote register range.

  mm-vote-regmap:
    $ref: /schemas/types.yaml#/definitions/phandle
    description: phandle to the device containing the mm-vote register range.

required:
  - compatible

additionalProperties: false

examples:
  - |
    #include <dt-bindings/power/mt8196-power.h>

    scpsys: power-controller@1c004000 {
      compatible = "mediatek,mt8196-scpsys", "syscon";
      reg = <0 0x1c004000 0 0x1000>;
      #power-domain-cells = <1>;
      spm = <&scpsys_bus>;
      vote-regmap = <&vote>;
    };
```

## Documentation/devicetree/bindings/power/pd-samsung.yaml
```yaml
# SPDX-License-Identifier: GPL-2.0
%YAML 1.2
---
$id: http://devicetree.org/schemas/power/pd-samsung.yaml#
$schema: http://devicetree.org/meta-schemas/core.yaml#

title: Samsung Exynos SoC Power Domains

maintainers:
  - Krzysztof Kozlowski <krzk@kernel.org>

description: |+
  Exynos processors include support for multiple power domains which are used
  to gate power to one or more peripherals on the processor.

properties:
  compatible:
    enum:
      - google,gs101-pd
      - samsung,exynos4210-pd
      - samsung,exynos5433-pd

  reg:
    maxItems: 1

  clocks:
    deprecated: true
    maxItems: 1

  clock-names:
    deprecated: true
    maxItems: 1

  domain-supply:
    description: domain regulator supply.

  label:
    description:
      Human readable string with domain name. Will be visible in userspace
      to let user to distinguish between multiple domains in SoC.

  "#power-domain-cells":
    const: 0

  power-domains:
    maxItems: 1

  samsung,dtzpc:
    $ref: /schemas/types.yaml#/definitions/phandle
    description:
      Distributed TrustZone Protection Control (DTZPC) node.

required:
  - compatible
  - "#power-domain-cells"
  - reg

allOf:
  - $ref: power-domain.yaml#
  - if:
      not:
        properties:
          compatible:
            contains:
              const: google,gs101-pd
    then:
      properties:
        samsung,dtzpc: false

unevaluatedProperties: false

examples:
  - |
    lcd0_pd: power-domain@10023c80 {
        compatible = "samsung,exynos4210-pd";
        reg = <0x10023c80 0x20>;
        #power-domain-cells = <0>;
        label = "LCD0";
    };

    mfc_pd: power-domain@10044060 {
        compatible = "samsung,exynos4210-pd";
        reg = <0x10044060 0x20>;
        #power-domain-cells = <0>;
        label = "MFC";
    };

    power-domain@2080 {
        compatible = "google,gs101-pd";
        reg = <0x2080 0x80>;
        #power-domain-cells = <0>;
        label = "hsi0";
        domain-supply = <&ldo7m>;
        samsung,dtzpc = <&dtzpc_hsi0>;
    };
```

## Documentation/devicetree/bindings/power/power-controller.yaml
```yaml
# SPDX-License-Identifier: (GPL-2.0-only OR BSD-2-Clause)
%YAML 1.2
---
$id: http://devicetree.org/schemas/power/power-controller.yaml#
$schema: http://devicetree.org/meta-schemas/core.yaml#

title: Generic System Power Control Capability

maintainers:
  - Rafael J. Wysocki <rafael@kernel.org>
  - Ulf Hansson <ulf.hansson@linaro.org>

description: |
  Power-management integrated circuits or miscellaneous hardware components
  are sometimes able to control the system power. The device driver associated
  with these components might need to define this capability, which tells the
  kernel that it can be used to switch off the system. The corresponding device
  must have the standard property "system-power-controller" in its device node. This
  property marks the device as able to control the system power.

  In order to test if this property is found programmatically, use the helper
  function "of_device_is_system_power_controller" from of.h.

properties:
  system-power-controller:
    type: boolean
    description:
      Indicates that this device can be used to control the system power.

additionalProperties: true
```
