## Documentation/devicetree/bindings/pinctrl/ti,tac5x1x-pinctrl.yaml
```yaml
# SPDX-License-Identifier: GPL-2.0-only OR BSD-2-Clause
%YAML 1.2
---
$id: http://devicetree.org/schemas/pinctrl/ti,tac5x1x-pinctrl.yaml#
$schema: http://devicetree.org/meta-schemas/core.yaml#

title: TI TAC5x1x Pin Controller

maintainers:
  - Niranjan H Y <niranjan.hy@ti.com>

description: |
  The TAC5x1x devices have 5 configurable pins that can be used for GPIO
  or alternate functions like PDM (Pulse Density Modulation) and interrupt
  generation. A subset of pins can be present in any variant of the HW.

  This binding is used as a child node of the main TAC5x1x MFD device
  described in Documentation/devicetree/bindings/mfd/ti,tac5x1x.yaml

  Pin capabilities:
  - GPIO1, GPIO2: Bidirectional, configurable as GPIO, PDM clock, or IRQ output
  - GPO1: Output only, configurable as GPIO, PDM clock, or IRQ output.
          Some variants use different name GPO1A.
  - GPI1: Input only, configurable as GPIO or PDM data input
          Some variants use different name GPI1A.
  - GPI2A: Input only, configurable as GPIO or PDM data input

properties:
  compatible:
    const: ti,tac5x1x-pinctrl

  gpio-controller: true

  '#gpio-cells':
    const: 2
    description: |
      First cell is the pin number (0-4 corresponding to GPIO1, GPIO2, GPO1, GPI1, GPI2A)
      Second cell is flags (GPIO_ACTIVE_HIGH or GPIO_ACTIVE_LOW)

  gpio-ranges:
    maxItems: 1
    description: GPIO range mapping to pin controller

  gpio-line-names:
    minItems: 1
    maxItems: 5
    description: Names for the GPIO lines

patternProperties:
  '-state$':
    type: object
    description: Pin configuration state
    $ref: /schemas/pinctrl/pinmux-node.yaml#

    patternProperties:
      '^.*$':
        type: object
        $ref: /schemas/pinctrl/pincfg-node.yaml#

        properties:
          groups:
            description: Pin groups to configure
            items:
              enum:
                - gpio1
                - gpio2
                - gpo1
                - gpi1
                - gpi2a
                - pdm_gpio1_gpio2
                - pdm_gpio1_gpi1
                - pdm_gpio1_gpi2a
                - pdm_gpio2_gpio1
                - pdm_gpio2_gpi1
                - pdm_gpio2_gpi2a
                - pdm_gpo1_gpio1
                - pdm_gpo1_gpio2
                - pdm_gpo1_gpi1
                - pdm_gpo1_gpi2a

          function:
            description: Function to assign
            enum:
              - gpio
              - pdm
              - irq

          drive-push-pull:
            type: boolean
            description: Enable push-pull drive mode

          drive-open-drain:
            type: boolean
            description: Enable open-drain drive mode

          drive-open-source:
            type: boolean
            description: Enable open-source drive mode

          bias-pull-up:
            type: boolean
            description: Enable pull-up bias

          bias-pull-down:
            type: boolean
            description: Enable pull-down bias

          bias-high-impedance:
            type: boolean
            description: Set pin to high impedance

          input-enable:
            type: boolean
            description: Enable input buffer

          output-enable:
            type: boolean
            description: Enable output buffer

        required:
          - groups
          - function

        additionalProperties: false

    additionalProperties: false

required:
  - compatible
  - gpio-controller
  - '#gpio-cells'

additionalProperties: false

examples:
  - |
    pinctrl {
        compatible = "ti,tac5x1x-pinctrl";
        gpio-controller;
        #gpio-cells = <2>;
        gpio-ranges = <&pinctrl 0 0 5>;
        gpio-line-names = "GPIO1", "GPIO2", "GPO1", "GPI1", "GPI2A";

        default_state: default-state {
            pdm_config {
                groups = "pdm_gpo1_gpi1";
                function = "pdm";
                drive-push-pull;
            };

            gpio_config {
                groups = "gpio1", "gpio2";
                function = "gpio";
                bias-pull-up;
            };

            irq_config {
                groups = "gpo1";
                function = "irq";
                drive-open-drain;
            };
        };
    };
```

## Documentation/devicetree/bindings/pinctrl/ultrarisc,dp1000-pinctrl.yaml
```yaml
# SPDX-License-Identifier: (GPL-2.0-only OR BSD-2-Clause)
%YAML 1.2
---
$id: http://devicetree.org/schemas/pinctrl/ultrarisc,dp1000-pinctrl.yaml#
$schema: http://devicetree.org/meta-schemas/core.yaml#

title: UltraRISC DP1000 Pin Controller

maintainers:
  - Jia Wang <wangjia@ultrarisc.com>

description: |
  UltraRISC RISC-V SoC DP1000 pin controller.
  The controller manages ports A, B, C, D and LPC. Ports A-D default to
  GPIO and provide additional SPI, UART, I2C, and PWM mux functions.
  LPC pins default to the LPC interface and can be muxed to eSPI.
  All pins also support pin configuration, including drive strength,
  pull-up, and pull-down settings.

properties:
  compatible:
    const: ultrarisc,dp1000-pinctrl

  reg:
    items:
      - description: pin controller registers

required:
  - compatible
  - reg

patternProperties:
  '.*-pins$':
    type: object
    unevaluatedProperties: false
    allOf:
      - $ref: /schemas/pinctrl/pincfg-node.yaml#
      - $ref: /schemas/pinctrl/pinmux-node.yaml#
      - if:
          properties:
            pins:
              contains:
                pattern: '^LPC([0-9]|1[0-2])$'
        then:
          properties:
            function:
              enum:
                - lpc
                - espi

    properties:
      pins:
        description: List of pins affected by this state node.
        minItems: 1
        uniqueItems: true
        items:
          type: string
          oneOf:
            - pattern: '^PA([0-9]|1[0-5])$'
            - pattern: '^PB[0-7]$'
            - pattern: '^PC[0-7]$'
            - pattern: '^PD[0-7]$'
            - pattern: '^LPC([0-9]|1[0-2])$'

      function:
        description: |
          Mux function to select for the listed pins. Supported functions
          depend on the selected pins and match the DP1000 hardware mux
          table.
        enum:
          - gpio
          - i2c0
          - i2c1
          - i2c2
          - i2c3
          - pwm0
          - pwm1
          - pwm2
          - pwm3
          - spi0
          - spi1
          - uart0
          - uart1
          - uart2
          - uart3
          - lpc
          - espi

      bias-disable: true
      bias-high-impedance: true
      bias-pull-up: true
      bias-pull-down: true

      drive-strength:
        description: Output drive strength in mA.
        enum: [20, 27, 33, 40]

    required:
      - pins
      - function

unevaluatedProperties: false

examples:
  - |
    soc {
      #address-cells = <2>;
      #size-cells = <2>;

      pinctrl@11081000 {
        compatible = "ultrarisc,dp1000-pinctrl";
        reg = <0x0 0x11081000 0x0 0x1000>;

        i2c0-pins {
          pins = "PA12", "PA13";
          function = "i2c0";
          bias-pull-up;
          drive-strength = <33>;
        };

        uart0-pins {
          pins = "PA8", "PA9";
          function = "uart0";
          bias-pull-up;
          drive-strength = <33>;
        };
      };
    };
```

## Documentation/devicetree/bindings/platform/lenovo,thinkpad-t14s-ec.yaml
```yaml
# SPDX-License-Identifier: (GPL-2.0-only OR BSD-2-Clause)
%YAML 1.2
---
$id: http://devicetree.org/schemas/platform/lenovo,thinkpad-t14s-ec.yaml#
$schema: http://devicetree.org/meta-schemas/core.yaml#

title: Lenovo Thinkpad T14s Embedded Controller.

maintainers:
  - Sebastian Reichel <sre@kernel.org>

description:
  The Qualcomm Snapdragon-based Lenovo Thinkpad T14s has an Embedded Controller
  (EC) which handles things such as keyboard backlight, LEDs or non-standard keys.
  This binding describes the interface, on an I2C bus, to this EC.

properties:
  compatible:
    const: lenovo,thinkpad-t14s-ec

  reg:
    const: 0x28

  interrupts:
    maxItems: 1

required:
  - compatible
  - reg
  - interrupts

additionalProperties: false

examples:
  - |+
    #include <dt-bindings/interrupt-controller/irq.h>
    i2c1 {
        clock-frequency = <400000>;

        #address-cells = <1>;
        #size-cells = <0>;

        embedded-controller@28 {
            compatible = "lenovo,thinkpad-t14s-ec";
            reg = <0x28>;
            interrupts-extended = <&tlmm 66 IRQ_TYPE_LEVEL_LOW>;
        };
    };
...
```

## Documentation/devicetree/bindings/post-init-providers.yaml
```yaml
# SPDX-License-Identifier: (GPL-2.0-only OR BSD-2-Clause)
# Copyright (c) 2020, Google LLC. All rights reserved.
%YAML 1.2
---
$id: http://devicetree.org/schemas/post-init-providers.yaml#
$schema: http://devicetree.org/meta-schemas/core.yaml#

title: Post device initialization providers

maintainers:
  - Saravana Kannan <saravanak@google.com>

description: |
  This property is used to indicate that the device(s) pointed to by the
  property are not needed for the initialization of the device that lists this
  property. This property does not make a device (that's previously not a
  provider) into a provider. It simply downgrades an existing provider to a
  post device initialization provider.

  A device can list its providers in devicetree using one or more of the
  standard devicetree bindings. By default, it is assumed that the provider
  device can be initialized before the consumer device is initialized.

  However, that assumption cannot be made when there are cyclic dependencies
  between devices. Since each device is a provider (directly or indirectly) of
  the others in the cycle, there is no guaranteed safe order for initializing
  the devices in a cycle. We can try to initialize them in an arbitrary order
  and eventually successfully initialize all of them, but that doesn't always
  work well.

  For example, say,
  * The device tree has the following cyclic dependency X -> Y -> Z -> X (where
    -> denotes "depends on").
  * But X is not needed to fully initialize Z (X might be needed only when a
    specific functionality is requested post initialization).

  If all the other -> are mandatory initialization dependencies, then trying to
  initialize the devices in a loop (or arbitrarily) will always eventually end
  up with the devices being initialized in the order Z, Y and X.

  However, if Y is an optional provider for X (where X provides limited
  functionality when Y is not initialized and providing its services), then
  trying to initialize the devices in a loop (or arbitrarily) could end up with
  the devices being initialized in the following order:

  * Z, Y and X - All devices provide full functionality
  * Z, X and Y - X provides partial functionality
  * X, Z and Y - X provides partial functionality

  However, we always want to initialize the devices in the order Z, Y and X
  since that provides the full functionality without interruptions.

  One alternate option that might be suggested is to have the driver for X
  notice that Y became available at a later point and adjust the functionality
  it provides. However, other userspace applications could have started using X
  with the limited functionality before Y was available and it might not be
  possible to transparently transition X or the users of X to full
  functionality while X is in use.

  Similarly, when it comes to suspend (resume) ordering, it's unclear which
  device in a dependency cycle needs to be suspended/resumed first and trying
  arbitrary orders can result in system crashes or instability.

  Explicitly calling out which link in a cycle needs to be broken when
  determining the order, simplifies things a lot, improves efficiency, makes
  the behavior more deterministic and maximizes the functionality that can be
  provided without interruption.

  This property is used to provide this additional information between devices
  in a cycle by telling which provider(s) is not needed for initializing the
  device that lists this property.

  In the example above, Z would list X as a post-init-providers and the
  initialization dependency would become X -> Y -> Z -/-> X. So the best order
  to initialize them becomes clear: Z, Y and then X.

select: true

properties:
  post-init-providers:
    # One or more providers can be marked as post initialization provider
    description:
      List of phandles to providers that are not needed for initializing or
      resuming this device.
    $ref: /schemas/types.yaml#/definitions/phandle-array
    items:
      maxItems: 1

additionalProperties: true

examples:
  - |
    gcc: clock-controller@1000 {
        compatible = "vendor,soc4-gcc", "vendor,soc1-gcc";
        reg = <0x1000 0x80>;
        clocks = <&dispcc 0x1>;
        #clock-cells = <1>;
        post-init-providers = <&dispcc>;
    };
    dispcc: clock-controller@2000 {
        compatible = "vendor,soc4-dispcc", "vendor,soc1-dispcc";
        reg = <0x2000 0x80>;
        clocks = <&gcc 0xdd>;
        #clock-cells = <1>;
    };
```
