## Documentation/devicetree/bindings/serial/cortina,cs7542-uart.yaml
```yaml
# SPDX-License-Identifier: (GPL-2.0-only OR BSD-2-Clause)
%YAML 1.2
---
$id: http://devicetree.org/schemas/serial/cortina,cs7542-uart.yaml#
$schema: http://devicetree.org/meta-schemas/core.yaml#

title: Cortina UART

maintainers:
  - Fil Dunsky <filipp.dunsky@gmail.com>

description:
  The UART found in the Cortina Systems CS7542 (Goldengate G2) SoC. It has
  transmit and receive FIFOs and a 24-bit baud rate divider running from the
  peripheral (APB) clock. Other SoCs with the same block, the rest of the
  CS75xx family and the Cortina Access parts, are to be added with their own
  compatible string and "cortina,cs7542-uart" as the fallback.

allOf:
  - $ref: serial.yaml#

properties:
  compatible:
    const: cortina,cs7542-uart

  reg:
    maxItems: 1

  interrupts:
    maxItems: 1

  clocks:
    maxItems: 1

required:
  - compatible
  - reg
  - interrupts
  - clocks

unevaluatedProperties: false

examples:
  - |
    #include <dt-bindings/interrupt-controller/arm-gic.h>

    serial@f0070110 {
        compatible = "cortina,cs7542-uart";
        reg = <0xf0070110 0x30>;
        interrupts = <GIC_SPI 6 IRQ_TYPE_LEVEL_HIGH>;
        clocks = <&apb_clk>;
    };
```

## Documentation/devicetree/bindings/serial/cortina-access,serial.yaml
```yaml
# SPDX-License-Identifier: GPL-2.0-only OR BSD-2-Clause
%YAML 1.2
---
$id: http://devicetree.org/schemas/serial/cortina-access,serial.yaml#
$schema: http://devicetree.org/meta-schemas/core.yaml#

title: Cortina-Access UART controller

maintainers:
  - Jason Li <jason.li@cortina-access.com>

allOf:
  - $ref: serial.yaml#

properties:
  compatible:
    const: cortina-access,serial

  reg:
    maxItems: 1

  interrupts:
    maxItems: 1

  clocks:
    maxItems: 1

required:
  - compatible
  - reg
  - interrupts
  - clocks

unevaluatedProperties: false

examples:
  - |
    #include <dt-bindings/interrupt-controller/irq.h>
    #include <dt-bindings/interrupt-controller/arm-gic.h>

    serial@f4329188 {
        compatible = "cortina-access,serial";
        reg = <0 0xf4329188 0 0x30>;
        interrupts = <GIC_SPI 4 IRQ_TYPE_LEVEL_HIGH>;
        clocks = <&apb_pclk>;
    };
```

## Documentation/devicetree/bindings/serial/esp,esp32-uart.yaml
```yaml
# SPDX-License-Identifier: GPL-2.0-only OR BSD-2-Clause

%YAML 1.2
---
$id: http://devicetree.org/schemas/serial/esp,esp32-uart.yaml#
$schema: http://devicetree.org/meta-schemas/core.yaml#

title: ESP32 UART controller

maintainers:
  - Max Filippov <jcmvbkbc@gmail.com>

description: |
  ESP32 UART controller is a part of ESP32 SoC series.

properties:
  compatible:
    oneOf:
      - description: UART controller for the ESP32 SoC
        const: esp,esp32-uart
      - description: UART controller for the ESP32S3 SoC
        const: esp,esp32s3-uart

  reg:
    maxItems: 1

  interrupts:
    maxItems: 1

  clocks:
    maxItems: 1

required:
  - compatible
  - reg
  - interrupts
  - clocks

additionalProperties: false

examples:
  - |
    serial0: serial@60000000 {
            compatible = "esp,esp32s3-uart";
            reg = <0x60000000 0x80>;
            interrupts = <27 1 0>;
            clocks = <&serial_clk>;
    };
```

## Documentation/devicetree/bindings/serial/fsl,mcf-uart.yaml
```yaml
# SPDX-License-Identifier: (GPL-2.0-only OR BSD-2-Clause)
%YAML 1.2
---
$id: http://devicetree.org/schemas/serial/fsl-mcf-uart.yaml#
$schema: http://devicetree.org/meta-schemas/core.yaml#

title: Freescale ColdFire UART

maintainers:
  - Greg Ungerer <gerg@linux-m68k.org>

allof:
  - $ref: serial.yaml#

properties:
  compatible:
    const: fsl,mcf-uart

  reg:
    maxItems: 1

  interrupts:
    maxItems: 1

  clocks:
    maxItems: 1

required:
  - compatible
  - reg
  - interrupts
  - clocks

unevaluatedProperties: false

examples:
  - |
    uart0: serial@fc060000 {
        compatible = "fsl,mcf-uart";
        reg = <0xfc060000 0x80>;
        interrupts = <90>;
        clocks = <&coreclk>;
    };
```

## Documentation/devicetree/bindings/serial/google,goldfish-tty.yaml
```yaml
# SPDX-License-Identifier: (GPL-2.0-only OR BSD-2-Clause)
%YAML 1.2
---
$id: http://devicetree.org/schemas/serial/google,goldfish-tty.yaml#
$schema: http://devicetree.org/meta-schemas/core.yaml#

title: Google Goldfish TTY

maintainers:
  - Kuan-Wei Chiu <visitorckw@gmail.com>

description:
  Android goldfish TTY device generated by Android emulator.

properties:
  compatible:
    const: google,goldfish-tty

  reg:
    maxItems: 1

  interrupts:
    maxItems: 1

required:
  - compatible
  - reg
  - interrupts

additionalProperties: false

examples:
  - |
    serial@1f004000 {
        compatible = "google,goldfish-tty";
        reg = <0x1f004000 0x1000>;
        interrupts = <0xc>;
    };
```

## Documentation/devicetree/bindings/serial/loongson,ls2k0500-uart.yaml
```yaml
# SPDX-License-Identifier: (GPL-2.0-only OR BSD-2-Clause)
%YAML 1.2
---
$id: http://devicetree.org/schemas/loongson,ls2k0500-uart.yaml#
$schema: http://devicetree.org/meta-schemas/core.yaml#

title: Loongson UART controller

maintainers:
  - Haowei Zheng <zhenghaowei@loongson.cn>
  - Binbin Zhou <zhoubinbin@loongson.cn>

allOf:
  - $ref: serial.yaml

properties:
  compatible:
    oneOf:
      - enum:
          - loongson,ls2k0500-uart
          - loongson,ls2k1500-uart
      - items:
          - enum:
              - loongson,ls2k1000-uart
          - const: loongson,ls2k0500-uart
      - items:
          - enum:
              - loongson,ls3a5000-uart
              - loongson,ls3a6000-uart
              - loongson,ls2k2000-uart
          - const: loongson,ls2k1500-uart

  reg:
    maxItems: 1

  interrupts:
    maxItems: 1

  clock-frequency: true

required:
  - compatible
  - reg
  - interrupts
  - clock-frequency

unevaluatedProperties: false

examples:
  - |
    #include <dt-bindings/interrupt-controller/irq.h>
    #include <dt-bindings/clock/loongson,ls2k-clk.h>

    serial@1fe20000 {
        compatible = "loongson,ls2k1000-uart", "loongson,ls2k0500-uart";
        reg = <0x1fe20000 0x10>;
        clock-frequency = <125000000>;
        interrupt-parent = <&liointc0>;
        interrupts = <0x0 IRQ_TYPE_LEVEL_HIGH>;
    };
```

## Documentation/devicetree/bindings/serial/loongson,ls7a-uart.yaml
```yaml
# SPDX-License-Identifier: (GPL-2.0-only OR BSD-2-Clause)
%YAML 1.2
---
$id: http://devicetree.org/schemas/loongson,ls7a-uart.yaml#
$schema: http://devicetree.org/meta-schemas/core.yaml#

title: Loongson UART

maintainers:
  - Haowei Zheng <zhenghaowei@loongson.cn>

properties:
  compatible:
    const: loongson,ls7a-uart

  reg:
    maxItems: 1

  interrupts:
    maxItems: 1

  clocks:
    maxItems: 1

  fractional-division:
    description: Enables fractional-N division. Currently,
      only LS2K1500 and LS2K2000 support this feature.

  rts-invert:
    description: Inverts the RTS value in the MCR register.
      This should be used on Loongson-3 series CPUs, Loongson-2K
      series CPUs, and Loongson LS7A bridge chips.

  dtr-invert:
    description: Inverts the DTR value in the MCR register.
      This should be used on Loongson-3 series CPUs, Loongson-2K
      series CPUs, and Loongson LS7A bridge chips.

  cts-invert:
    description: Inverts the CTS value in the MSR register.
      This should be used on Loongson-2K0500, Loongson-2K1000,
      and Loongson LS7A bridge chips.

  dsr-invert:
    description: Inverts the DSR value in the MSR register.
      This should be used on Loongson-2K0500, Loongson-2K1000,
      and Loongson LS7A bridge chips.

required:
  - compatible
  - reg
  - interrupts
  - clocks

allOf:
  - $ref: serial.yaml

unevaluatedProperties: false

examples:
  - |
    #include <dt-bindings/interrupt-controller/irq.h>
    #include <dt-bindings/clock/loongson,ls2k-clk.h>

    serial@1fe001e0 {
        compatible = "loongson,ls7a-uart";
        reg = <0x0 0x1fe001e0 0x0 0x10>;
        clock-frequency = <100000000>;
        interrupt-parent = <&liointc>;
        interrupts = <10 IRQ_TYPE_LEVEL_HIGH>;
        fractional-division;
        rts-invert;
        dtr-invert;
    };
```

## Documentation/devicetree/bindings/serial/maxim,max310x.yaml
```yaml
# SPDX-License-Identifier: (GPL-2.0-only OR BSD-2-Clause)
%YAML 1.2
---
$id: http://devicetree.org/schemas/serial/maxim,max310x.yaml#
$schema: http://devicetree.org/meta-schemas/core.yaml#

title: Maxim MAX310X Advanced Universal Asynchronous Receiver-Transmitter (UART)

maintainers:
  - Hugo Villeneuve <hvilleneuve@dimonoff.com>

properties:
  compatible:
    enum:
      - maxim,max3107
      - maxim,max3108
      - maxim,max3109
      - maxim,max14830

  reg:
    maxItems: 1

  interrupts:
    maxItems: 1

  clocks:
    maxItems: 1

  clock-names:
    enum:
      - xtal # External crystal
      - osc  # External clock source

  gpio-controller: true

  "#gpio-cells":
    const: 2

  gpio-line-names:
    minItems: 1
    maxItems: 16

  "#address-cells":
    const: 1

  "#size-cells":
    const: 0

patternProperties:
  "^serial@[0-3]$":
    type: object
    description:
      A single UART channel of a multi-channel variant. Describe the
      channel's RS-485 wiring here with the standard properties from
      /schemas/serial/rs485.yaml#; being a serial node, the channel may
      also host a serial slave device. Single-channel variants have no
      such subnode - their settings stay on the chip node.

    allOf:
      - $ref: /schemas/serial/serial.yaml#
      - $ref: /schemas/serial/rs485.yaml#

    properties:
      reg:
        description: UART channel number on the chip.
        maximum: 3

    required:
      - reg

    unevaluatedProperties: false

required:
  - compatible
  - reg
  - interrupts
  - clocks
  - clock-names

allOf:
  - $ref: /schemas/spi/spi-peripheral-props.yaml#
  - $ref: /schemas/serial/serial.yaml#
  - $ref: /schemas/serial/rs485.yaml#

  # max3107 and max3108 are single-channel parts: there are no
  # addressable channel subnodes, so RS-485 stays on the chip node.
  - if:
      properties:
        compatible:
          contains:
            enum:
              - maxim,max3107
              - maxim,max3108
    then:
      properties:
        "#address-cells": false
        "#size-cells": false
      patternProperties:
        "^serial@[0-3]$": false

  # max3109 has two UART channels: 0 and 1.
  - if:
      properties:
        compatible:
          contains:
            const: maxim,max3109
    then:
      patternProperties:
        "^serial@[23]$": false

unevaluatedProperties: false

examples:
  - |
    #include <dt-bindings/interrupt-controller/irq.h>
    i2c {
        #address-cells = <1>;
        #size-cells = <0>;

        serial@2c {
            compatible = "maxim,max3107";
            reg = <0x2c>;
            clocks = <&xtal4m>;
            clock-names = "xtal";
            interrupt-parent = <&gpio3>;
            interrupts = <7 IRQ_TYPE_LEVEL_LOW>;
            gpio-controller;
            #gpio-cells = <2>;
            rs485-rts-active-low;
            linux,rs485-enabled-at-boot-time;
        };
    };

  - |
    #include <dt-bindings/interrupt-controller/irq.h>
    spi {
        #address-cells = <1>;
        #size-cells = <0>;

        serial@0 {
            compatible = "maxim,max14830";
            reg = <0>;
            spi-max-frequency = <26000000>;
            clocks = <&xtal4m>;
            clock-names = "xtal";
            interrupt-parent = <&gpio3>;
            interrupts = <7 IRQ_TYPE_LEVEL_LOW>;
            gpio-controller;
            #gpio-cells = <2>;
            #address-cells = <1>;
            #size-cells = <0>;

            serial@0 {
                reg = <0>;
                rs485-rts-active-low;
                linux,rs485-enabled-at-boot-time;
            };

            serial@2 {
                reg = <2>;
                rs485-rts-active-low;
            };
        };
    };
```

## Documentation/devicetree/bindings/serial/qcom,sa8255p-geni-uart.yaml
```yaml
# SPDX-License-Identifier: (GPL-2.0-only OR BSD-2-Clause)
%YAML 1.2
---
$id: http://devicetree.org/schemas/serial/qcom,sa8255p-geni-uart.yaml#
$schema: http://devicetree.org/meta-schemas/core.yaml#

title: Qualcomm Geni based QUP UART interface

maintainers:
  - Praveen Talari <quic_ptalari@quicinc.com>

allOf:
  - $ref: /schemas/serial/serial.yaml#

properties:
  compatible:
    enum:
      - qcom,sa8255p-geni-uart
      - qcom,sa8255p-geni-debug-uart

  interrupts:
    minItems: 1
    items:
      - description: UART core irq
      - description: Wakeup irq (RX GPIO)

  power-domains:
    minItems: 2
    maxItems: 2

  power-domain-names:
    items:
      - const: power
      - const: perf

  reg:
    maxItems: 1

required:
  - compatible
  - interrupts
  - reg
  - power-domains
  - power-domain-names

unevaluatedProperties: false

examples:
  - |
    #include <dt-bindings/interrupt-controller/arm-gic.h>

    serial@990000 {
        compatible = "qcom,sa8255p-geni-uart";
        reg = <0x990000 0x4000>;
        interrupts = <GIC_SPI 531 IRQ_TYPE_LEVEL_HIGH>;
        power-domains = <&scmi0_pd 0>, <&scmi0_dvfs 0>;
        power-domain-names = "power", "perf";
    };
...
```

## Documentation/devicetree/bindings/serial/ti,pruss-uart.yaml
```yaml
# SPDX-License-Identifier: (GPL-2.0-only OR BSD-2-Clause)
%YAML 1.2
---
$id: http://devicetree.org/schemas/serial/ti,pruss-uart.yaml#
$schema: http://devicetree.org/meta-schemas/core.yaml#

title: TI PRUSS serial UART

maintainers:
  - Bin Liu <b-liu@ti.com>

description: |
  The PRU-ICSS module has a serial UART peripheral, which is based on
  industry standard TL16C550, with 16-bytes TX/RX FIFOs.

allOf:
  - $ref: /schemas/serial.yaml#

properties:
  compatible:
    items:
      - const: ti,pruss-uart

  reg:
    maxItems: 1

  clocks:
    maxItems: 1

  interrupts:
    maxItems: 1
    description: |
      PRU UART interrupt mappings, containing an entry of 3 cell-values.
      The first is the PRU System Event ID for PRU UART Interrupt Request.
      The second is the PRU interrupt channel ID.
      The third is the PRU host interrupt ID.

required:
  - compatible
  - reg
  - clocks
  - interrupts

additionalProperties: true

examples:
  - |
    pruss_uart: serial@28000 {
        compatible = "ti,pruss-uart";
        reg = <0x28000 0x40>;
        clocks = <&k3_clks 81 13>;
        interrupt-parent = <&pruss_intc>;
        interrupts = <6 4 4>;
    };
```

## Documentation/devicetree/bindings/serial/via,vt8500-uart.yaml
```yaml
# SPDX-License-Identifier: (GPL-2.0-only OR BSD-2-Clause)

%YAML 1.2
---
$id: http://devicetree.org/schemas/serial/via,vt8500-uart.yaml#
$schema: http://devicetree.org/meta-schemas/core.yaml#

title: VIA VT8500 and WonderMedia WM8xxx UART Controller

maintainers:
  - Greg Kroah-Hartman <gregkh@linuxfoundation.org>
  - Jiri Slaby <jirislaby@kernel.org>
  - Kanak Shilledar <kanakshilledar111@protonmail.com>

allOf:
  - $ref: serial.yaml

properties:
  compatible:
    enum:
      - via,vt8500-uart
      - wm,wm8880-uart

    description: |
      Should be "via,vt8500-uart" (for VIA/WonderMedia chips up to and
      including WM8850/WM8950), or "wm,wm8880-uart" (for WM8880 and later)

  clocks:
    maxItems: 1

  interrupts:
    maxItems: 1

  reg:
    maxItems: 1

required:
  - compatible
  - clocks
  - interrupts
  - reg

unevaluatedProperties: false

examples:
  - |
    serial@d8200000 {
        compatible = "via,vt8500-uart";
        reg = <0xd8200000 0x1040>;
        interrupts = <32>;
        clocks = <&clkuart0>;
    };
```
