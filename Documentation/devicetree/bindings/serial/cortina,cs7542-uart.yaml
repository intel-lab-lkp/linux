## Documentation/devicetree/bindings/soc/ambarella/ambarella,cv75-sec-scratchpad.yaml
```yaml
# SPDX-License-Identifier: GPL-2.0-only OR BSD-2-Clause
%YAML 1.2
---
$id: http://devicetree.org/schemas/soc/ambarella/ambarella,cv75-sec-scratchpad.yaml#
$schema: http://devicetree.org/meta-schemas/core.yaml#

title: Ambarella CV75 Secure Scratchpad Registers

maintainers:
  - Long Zhao <longzhao@ambarella.com>

description:
  The secure scratchpad block contains shared system registers used by
  other Ambarella SoC blocks through syscon regmap lookups.

allOf:
  - $ref: /schemas/mfd/syscon-common.yaml#

properties:
  compatible:
    items:
      - const: ambarella,cv75-sec-scratchpad
      - const: syscon

  reg:
    maxItems: 1

required:
  - compatible
  - reg

unevaluatedProperties: false

examples:
  - |
    scratchpad@e002e000 {
        compatible = "ambarella,cv75-sec-scratchpad", "syscon";
        reg = <0xe002e000 0x1000>;
    };
```

## Documentation/devicetree/bindings/soc/amd/amd.yaml
```yaml
# SPDX-License-Identifier: (GPL-2.0-only OR BSD-2-Clause)
%YAML 1.2
---
$id: http://devicetree.org/schemas/soc/amd/amd.yaml#
$schema: http://devicetree.org/meta-schemas/core.yaml#

title: AMD Platforms

maintainers:
  - Michal Simek <michal.simek@amd.com>

description: |
  AMD boards with MicroBlaze V SOC

properties:
  $nodename:
    const: '/'
  compatible:
    oneOf:
      - description: AMD MicroBlaze V
        items:
          - const: amd,mbv

additionalProperties: true

...
```

## Documentation/devicetree/bindings/soc/aspeed/aspeed,ast2600-espi.yaml
```yaml
# SPDX-License-Identifier: (GPL-2.0-only OR BSD-2-Clause)
# Copyright (c) 2026 Aspeed Technology Inc.
%YAML 1.2
---
$id: http://devicetree.org/schemas/soc/aspeed/aspeed,ast2600-espi.yaml#
$schema: http://devicetree.org/meta-schemas/core.yaml#

title: ASPEED AST2600 eSPI Controller

maintainers:
  - Yun-Hsuan Chung <yh_chung@aspeedtech.com>
  - Ryan Chen <ryan_chen@aspeedtech.com>

description: |
  The ASPEED AST2600 BMC SoC provides an Enhanced Serial Peripheral
  Interface (eSPI) controller used for host-BMC communication.

  The controller supports the eSPI channels used for peripheral,
  virtual wire, out-of-band, and flash communication.

properties:
  compatible:
    const: aspeed,ast2600-espi

  reg:
    maxItems: 1

  interrupts:
    maxItems: 1
    description:
      Interrupt from the GIC for the eSPI controller.

  clocks:
    maxItems: 1

  resets:
    maxItems: 1

  pinctrl-names:
    const: default

  pinctrl-0:
    maxItems: 1

  aspeed,flash-dma-mode:
    type: boolean
    description:
      Enable DMA support for eSPI flash channel

required:
  - compatible
  - reg
  - interrupts
  - clocks
  - resets
  - pinctrl-names
  - pinctrl-0

additionalProperties: false

examples:
  - |
    #include <dt-bindings/interrupt-controller/arm-gic.h>
    #include <dt-bindings/clock/aspeed-clock.h>
    espi: espi@1e6ee000 {
        compatible = "aspeed,ast2600-espi";
        reg = <0x1e6ee000 0x1000>;
        interrupts = <GIC_SPI 42 IRQ_TYPE_LEVEL_HIGH>;
        clocks = <&syscon ASPEED_CLK_GATE_ESPICLK>;
        resets = <&syscon 57>;
        pinctrl-names = "default";
        pinctrl-0 = <&pinctrl_espi_default>;
        aspeed,flash-dma-mode;
    };
```

## Documentation/devicetree/bindings/soc/aspeed/aspeed,pcie-cfg.yaml
```yaml
# SPDX-License-Identifier: (GPL-2.0-only OR BSD-2-Clause)
%YAML 1.2
---
$id: http://devicetree.org/schemas/soc/aspeed/aspeed,pcie-cfg.yaml#
$schema: http://devicetree.org/meta-schemas/core.yaml#

title: ASPEED PCIe Configuration

maintainers:
  - Jacky Chou <jacky_chou@aspeedtech.com>

description: |
  The ASPEED PCIe configuration syscon block provides a set of registers shared
  by multiple PCIe-related devices within the SoC. This node represents the
  common configuration space that allows these devices to coordinate and manage
  shared PCIe settings, including address mapping, control, and status
  registers. The syscon interface enables for various PCIe devices to access
  and modify these shared registers in a consistent and centralized manner.

properties:
  compatible:
    items:
      - enum:
          - aspeed,pcie-cfg
      - const: syscon

  reg:
    maxItems: 1

required:
  - compatible
  - reg

additionalProperties: false

examples:
  - |
    syscon@1e770000 {
      compatible = "aspeed,pcie-cfg", "syscon";
      reg = <0x1e770000 0x80>;
    };
```

## Documentation/devicetree/bindings/soc/aspeed/aspeed,pcie-phy.yaml
```yaml
# SPDX-License-Identifier: (GPL-2.0-only OR BSD-2-Clause)
%YAML 1.2
---
$id: http://devicetree.org/schemas/soc/aspeed/aspeed,pcie-phy.yaml#
$schema: http://devicetree.org/meta-schemas/core.yaml#

title: ASPEED PCIe PHY

maintainers:
  - Jacky Chou <jacky_chou@aspeedtech.com>

description:
  The ASPEED PCIe PHY provides the physical layer interface for PCIe
  controllers in the SoC. This node represents the register block for the PCIe
  PHY, which is typically accessed by PCIe Root Complex or Endpoint drivers
  via syscon. It is used to configure and get the status of the PCIe PHY
  hardware, including power management, link training, and other PHY-specific
  operations.

properties:
  compatible:
    items:
      - enum:
          - aspeed,pcie-phy
      - const: syscon

  reg:
    maxItems: 1

  "#phy-cells":
    const: 0

required:
  - compatible
  - reg

additionalProperties: false

examples:
  - |
    syscon@1e6ed200 {
      compatible = "aspeed,pcie-phy", "syscon";
      reg = <0x1e6ed200 0x100>;
    };
```

## Documentation/devicetree/bindings/soc/bcm/raspberrypi,bcm2835-power.yaml
```yaml
# SPDX-License-Identifier: (GPL-2.0-only OR BSD-2-Clause)
%YAML 1.2
---
$id: http://devicetree.org/schemas/soc/bcm/raspberrypi,bcm2835-power.yaml#
$schema: http://devicetree.org/meta-schemas/core.yaml#

title: Broadcom BCM2835 power domain driver

maintainers:
  - Alexander Aring <alex.aring@gmail.com>
  - Eric Anholt <eric@anholt.net>

description:
  The Raspberry Pi power domain driver manages power for various subsystems
  in the Raspberry Pi BCM2835 SoC.

properties:
  compatible:
    enum:
      - raspberrypi,bcm2835-power

  firmware:
    $ref: /schemas/types.yaml#/definitions/phandle

  '#power-domain-cells':
    const: 1

required:
  - compatible
  - firmware
  - "#power-domain-cells"

unevaluatedProperties: false

examples:
  - |
    power: power {
      compatible = "raspberrypi,bcm2835-power";
      firmware = <&firmware>;
      #power-domain-cells = <1>;
    };
```

## Documentation/devicetree/bindings/soc/cix/cix,sky1-audss-cru.yaml
```yaml
# SPDX-License-Identifier: (GPL-2.0-only OR BSD-2-Clause)
%YAML 1.2
---
$id: http://devicetree.org/schemas/soc/cix/cix,sky1-audss-cru.yaml#
$schema: http://devicetree.org/meta-schemas/core.yaml#

title: Cix Sky1 audio subsystem clock reset unit (CRU)

maintainers:
  - Joakim Zhang <joakim.zhang@cixtech.com>

description: |
  The Cix Sky1 audio subsystem (AUDSS) Clock Reset Unit (CRU) groups clock
  mux/divider/gate and software reset control into one MMIO register block.

  This binding describes the syscon/MFD parent. Board DTS must instantiate
  a cix,sky1-audss-cru node with a reg property; clock and reset providers
  are child nodes without their own reg ranges:

    - cix,sky1-audss-clock (see cix,sky1-audss-clock.yaml)
    - cix,sky1-audss-reset (see cix,sky1-audss-reset.yaml)

properties:
  compatible:
    items:
      - const: cix,sky1-audss-cru
      - const: simple-mfd
      - const: syscon

  reg:
    maxItems: 1

  clock-controller:
    $ref: /schemas/clock/cix,sky1-audss-clock.yaml#
    unevaluatedProperties: false

  reset-controller:
    $ref: /schemas/reset/cix,sky1-audss-reset.yaml#
    unevaluatedProperties: false

required:
  - compatible
  - reg

additionalProperties: false

examples:
  - |
    #include <dt-bindings/clock/cix,sky1.h>
    #include <dt-bindings/reset/cix,sky1-s5-system-control.h>

    cru: syscon@7110000 {
        compatible = "cix,sky1-audss-cru", "simple-mfd", "syscon";
        reg = <0x7110000 0x10000>;

        audss_clk: clock-controller {
            compatible = "cix,sky1-audss-clock";
            power-domains = <&smc_devpd 0>;
            #clock-cells = <1>;
            clocks = <&scmi_clk CLK_TREE_AUDIO_CLK0>, <&scmi_clk CLK_TREE_AUDIO_CLK1>,
                     <&scmi_clk CLK_TREE_AUDIO_CLK2>, <&scmi_clk CLK_TREE_AUDIO_CLK3>,
                     <&scmi_clk CLK_TREE_AUDIO_CLK4>, <&scmi_clk CLK_TREE_AUDIO_CLK5>;
            clock-names = "audio_clk0", "audio_clk1", "audio_clk2",
                          "audio_clk3", "audio_clk4", "audio_clk5";
            resets = <&src SKY1_AUDIO_HIFI5_NOC_RESET_N>;
        };

        audss_rst: reset-controller {
            compatible = "cix,sky1-audss-reset";
            #reset-cells = <1>;
        };
    };
```

## Documentation/devicetree/bindings/soc/cix/cix,sky1-system-control.yaml
```yaml
# SPDX-License-Identifier: GPL-2.0-only OR BSD-2-Clause
%YAML 1.2
---
$id: http://devicetree.org/schemas/soc/cix/cix,sky1-system-control.yaml#
$schema: http://devicetree.org/meta-schemas/core.yaml#

title: Cix Sky1 SoC system control register region

maintainers:
  - Gary Yang <gary.yang@cixtech.com>

description:
  An wide assortment of registers of the system controller on Sky1 SoC,
  including resets, usb, wakeup sources and so on.

properties:
  compatible:
    items:
      - enum:
          - cix,sky1-system-control
          - cix,sky1-s5-system-control
          - cix,sky1-audss-system-control
      - const: syscon

  reg:
    maxItems: 1

  '#reset-cells':
    const: 1

  power-domains:
    maxItems: 1

  resets:
    maxItems: 1

  clock-controller:
    type: object
    properties:
      compatible:
        const: cix,sky1-audss-clock
    required:
      - compatible
    additionalProperties: true

allOf:
  - if:
      properties:
        compatible:
          contains:
            const: cix,sky1-audss-system-control
    then:
      required:
        - clock-controller
        - power-domains
        - resets
    else:
      properties:
        clock-controller: false
        power-domains: false
        resets: false

required:
  - compatible
  - reg

additionalProperties: false

examples:
  - |
    syscon@4160000 {
      compatible = "cix,sky1-system-control", "syscon";
      reg = <0x4160000 0x100>;
      #reset-cells = <1>;
    };
  - |
    audss_syscon: system-controller@7110000 {
        compatible = "cix,sky1-audss-system-control", "syscon";
        reg = <0x7110000 0x10000>;
        power-domains = <&smc_devpd 0>;
        resets = <&s5_syscon 31>;
        #reset-cells = <1>;

        clock-controller {
            compatible = "cix,sky1-audss-clock";
            #clock-cells = <1>;
            clocks = <&scmi_clk 0>, <&scmi_clk 2>, <&scmi_clk 4>, <&scmi_clk 5>;
            clock-names = "x8k", "x11k", "sys", "48m";
        };
    };
```

## Documentation/devicetree/bindings/soc/cix/cix,sky1-system-controller.yaml
```yaml
# SPDX-License-Identifier: GPL-2.0-only OR BSD-2-Clause
%YAML 1.2
---
$id: http://devicetree.org/schemas/soc/cix/cix,sky1-system-controller.yaml#
$schema: http://devicetree.org/meta-schemas/core.yaml#

title: Cix Sky1 SoC system controller register region

maintainers:
  - Gary Yang <gary.yang@cixtech.com>

description:
  An wide assortment of registers of the system controller on Sky1 SoC,
  including resets and usb.

properties:
  compatible:
    items:
      - enum:
          - cix,sky1-system-controller
          - cix,sky1-s5-system-controller
      - const: syscon
      - const: simple-mfd

  reg:
    maxItems: 1

patternProperties:
  "^reset(-controller)?$":
    type: object
    $ref: /schemas/reset/cix,sky1-rst.yaml#

required:
  - compatible
  - reg

additionalProperties: false

examples:
  - |
    syscon@16000000 {
      compatible = "cix,sky1-s5-system-controller", "syscon", "simple-mfd";
      reg = <0x16000000 0x1000>;
      reset-controller {
        compatible = "cix,sky1-rst";
        #reset-cells = <1>;
      };
    };
```

## Documentation/devicetree/bindings/soc/fsl/cpm_qe/fsl,mpc8323-qe-pario-bank.yaml
```yaml
# SPDX-License-Identifier: (GPL-2.0-only OR BSD-2-Clause)
%YAML 1.2
---
$id: http://devicetree.org/schemas/soc/fsl/cpm_qe/fsl,mpc8323-qe-pario-bank.yaml#
$schema: http://devicetree.org/meta-schemas/core.yaml#

title: Freescale QUICC Engine Parallel I/O (QE PARIO) GPIO Bank

maintainers:
  - Christophe Leroy <christophe.leroy@csgroup.eu>

description:
  Bindings for the Freescale QUICC Engine Parallel I/O (PARIO) GPIO controller.

properties:
  compatible:
    items:
      - enum:
          - fsl,chip-qe-pario-bank
      - const: fsl,mpc8323-qe-pario-bank

  reg:
    maxItems: 1
    description: Offset to the register set and its length.

  gpio-controller: true

  '#gpio-cells':
    const: 2

required:
  - compatible
  - reg
  - gpio-controller
  - '#gpio-cells'

additionalProperties: false

examples:
  - |
    qe_pio_a: gpio-controller@1400 {
        compatible = "fsl,mpc8360-qe-pario-bank", "fsl,mpc8323-qe-pario-bank";
        reg = <0x1400 0x18>;
        gpio-controller;
        #gpio-cells = <2>;
    };

    qe_pio_e: gpio-controller@1460 {
        compatible = "fsl,mpc8360-qe-pario-bank", "fsl,mpc8323-qe-pario-bank";
        reg = <0x1460 0x18>;
        gpio-controller;
        #gpio-cells = <2>;
    };
```

## Documentation/devicetree/bindings/soc/fsl/cpm_qe/fsl,qe-ports-ic.yaml
```yaml
# SPDX-License-Identifier: (GPL-2.0-only OR BSD-2-Clause)

title: Freescale QUICC Engine I/O Ports Interrupt Controller

maintainers:
  - name: Christophe Leroy
    email: christophe.leroy@csgroup.eu

description: |
  Interrupt controller for the QUICC Engine I/O ports found on some
  Freescale/NXP PowerQUICC and QorIQ SoCs.

properties:
  compatible:
    enum:
      - fsl,mpc8323-qe-ports-ic
      - fsl,mpc8360-qe-ports-ic
      - fsl,mpc8568-qe-ports-ic

  reg:
    description: Base address and size of the QE I/O Ports Interrupt Controller registers.
    minItems: 1
    maxItems: 1

  interrupt-controller:
    type: boolean
    description: Indicates this node is an interrupt controller.

  '#address-cells':
    const: 0
    description: Must be 0.

  '#interrupt-cells':
    const: 1
    description: Number of cells to encode an interrupt specifier.

  interrupts:
    minItems: 1
    maxItems: 1
    description: Interrupt line to which the QE I/O Ports controller is connected.

  interrupt-parent:
    description: Phandle to the parent interrupt controller.

required:
  - compatible
  - reg
  - interrupt-controller
  - '#address-cells'
  - '#interrupt-cells'
  - interrupts
  - interrupt-parent

examples:
  - |
    interrupt-controller@c00 {
      interrupt-controller;
      compatible = "fsl,mpc8323-qe-ports-ic";
      #address-cells = <0>;
      #interrupt-cells = <1>;
      reg = <0xc00 0x18>;
      interrupts = <74 0x8>;
      interrupt-parent = <&ipic>;
```
