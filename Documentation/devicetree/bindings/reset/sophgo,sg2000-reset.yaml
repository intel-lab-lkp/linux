## Documentation/devicetree/bindings/riscv/worlds.yaml
```yaml
# SPDX-License-Identifier: (GPL-2.0 OR MIT)
%YAML 1.2
---
$id: http://devicetree.org/schemas/riscv/worlds.yaml#
$schema: http://devicetree.org/meta-schemas/core.yaml#

title: RISC-V Worlds Extension

maintainers:
  - Yu-Chien Peter Lin <peter.lin@sifive.com>

description: |
  The RISC-V Worlds ISA extension, as described in the RISC-V Privileged
  Specification, adds World ID tagging for context isolation.

  This binding describes the system-wide Worlds configuration for the /cpus node
  and is used alongside per-hart Worlds-related properties such as riscv,pmwid in
  the RISC-V CPU binding and Worlds-related ISA extensions enumerated via
  riscv,isa-extensions.

select:
  properties:
    $nodename:
      pattern: "^cpus$"

properties:
  riscv,nworlds:
    $ref: /schemas/types.yaml#/definitions/uint32
    description: |
      Number of World IDs (WIDs) supported by the platform. This is a system-wide
      property that describes the total number of isolation contexts available.
      Hardware components such as the WorldGuard Checker use this to determine
      the valid range of WID values.
    minimum: 2
    maximum: 64

  sifive,trustedwid:
    $ref: /schemas/types.yaml#/definitions/uint32
    maximum: 31
    description: |
      The World ID (WID) designated as the trusted WID for this platform.
      Transactions tagged with this WID are authorized to access and configure
      WorldGuard blocks, including wgCheckers and wgMarkers.

additionalProperties: true

examples:
  - |
    // Example: System with 4 World IDs
    cpus {
        #address-cells = <1>;
        #size-cells = <0>;
        timebase-frequency = <1000000>;
        riscv,nworlds = <4>;
        sifive,trustedwid = <3>;

        cpu@0 {
            device_type = "cpu";
            reg = <0>;
            compatible = "sifive,bullet0", "riscv";
            riscv,isa-base = "rv64i";
            riscv,isa-extensions = "i", "m", "a", "f", "d", "c";
            riscv,pmwid = <0>;

            interrupt-controller {
                #interrupt-cells = <1>;
                compatible = "riscv,cpu-intc";
                interrupt-controller;
            };
        };

        cpu@1 {
            device_type = "cpu";
            reg = <1>;
            compatible = "sifive,bullet0", "riscv";
            riscv,isa-base = "rv64i";
            riscv,isa-extensions = "i", "m", "a", "f", "d", "c";
            riscv,pmwid = <1>;

            interrupt-controller {
                #interrupt-cells = <1>;
                compatible = "riscv,cpu-intc";
                interrupt-controller;
            };
        };
    };
```

## Documentation/devicetree/bindings/rng/timeriomem-rng.yaml
```yaml
# SPDX-License-Identifier: (GPL-2.0-only OR BSD-2-Clause)
%YAML 1.2
---
$id: http://devicetree.org/schemas/rng/timeriomem-rng.yaml#
$schema: http://devicetree.org/meta-schemas/core.yaml#

title: Timer IOMEM Hardware Random Number Generator

description: |
  This binding covers platforms that have a single IO memory address which
  provides periodic random data.  The driver reads from the address at a
  fixed interval, returning a configurable-width value masked to the desired
  bits.

maintainers:
  - Alexander Clouter <alex@digriz.org.uk>

properties:
  compatible:
    enum:
      - timeriomem_rng

  reg:
    maxItems: 1

  period:
    $ref: /schemas/types.yaml#/definitions/uint32
    description:
      Interval in microseconds between reads.  New random data is expected to
      be available at this rate.

  quality:
    $ref: /schemas/types.yaml#/definitions/uint32
    default: 0
    description:
      Estimated entropy per 1024 bits of data, in the same scale as the
      kernel's hwrng core (0-1024).

  width:
    $ref: /schemas/types.yaml#/definitions/uint32
    default: 32
    enum: [8, 16, 32]
    description:
      Access width in bits.  Determines whether the read is performed as
      an 8-bit, 16-bit, or 32-bit bus access.

  mask:
    $ref: /schemas/types.yaml#/definitions/uint32
    default: 0xFFFFFFFF
    description:
      Mask applied to the value read from the register.  Bits set to 0 in
      the mask are cleared in the output data.  Default (no mask) passes
      all bits through.

required:
  - compatible
  - reg
  - period

additionalProperties: false

examples:
  - |
    rng@f0001000 {
        compatible = "timeriomem_rng";
        reg = <0xf0001000 0x4>;
        period = <100000>;
    };

    rng@f0002000 {
        compatible = "timeriomem_rng";
        reg = <0xf0002000 0x1>;
        period = <50000>;
        width = <8>;
        mask = <0xFF>;
    };
```

## Documentation/devicetree/bindings/rng/timeriomem_rng.yaml
```yaml
# SPDX-License-Identifier: GPL-2.0-only
%YAML 1.2
---
$id: http://devicetree.org/schemas/rng/timeriomem_rng.yaml#
$schema: http://devicetree.org/meta-schemas/core.yaml#

title: Timer IOMEM hardware random number generator

description: |
  A device that provides random data via a single memory-mapped IO register.
  A new value becomes available at a fixed interval.

maintainers:
  - Krzysztof Kozlowski <krzk@kernel.org>

properties:
  compatible:
    const: timeriomem_rng

  reg:
    maxItems: 1
    description:
      Base address to sample from.  Must be aligned to the configured access
      width (1, 2, or 4 bytes) and at least that wide.

  period:
    $ref: /schemas/types.yaml#/definitions/uint32
    description:
      Interval in microseconds between random value updates.

  quality:
    $ref: /schemas/types.yaml#/definitions/uint32
    default: 0
    description:
      Estimated number of bits of true entropy per 1024 bits read from the
      device.  Defaults to zero which causes the kernel's default quality to
      be used instead.  Note that the default quality is usually zero which
      disables using this RNG to automatically fill the kernel's entropy
      pool.

  reg-io-width:
    $ref: /schemas/types.yaml#/definitions/uint32
    default: 4
    enum: [1, 2, 4]
    description:
      Access width in bytes.  Determines whether the read is performed as
      an 8-bit, 16-bit, or 32-bit bus access.

  mask:
    $ref: /schemas/types.yaml#/definitions/uint32
    default: 0xFFFFFFFF
    description:
      Mask applied to the value read from the register.  Bits set to 0 in
      the mask are cleared in the output data.  Default (no mask) passes
      all bits through.

required:
  - compatible
  - reg
  - period

additionalProperties: false

examples:
  - |
    rng@44 {
        compatible = "timeriomem_rng";
        reg = <0x44 0x01>;
        period = <50000>;
        reg-io-width = <1>;
        mask = <0xFF>;
    };
```

## Documentation/devicetree/bindings/rng/vmgenid.yaml
```yaml
# SPDX-License-Identifier: (GPL-2.0-only OR BSD-2-Clause)
%YAML 1.2
---
$id: http://devicetree.org/schemas/rng/vmgenid.yaml#
$schema: http://devicetree.org/meta-schemas/core.yaml#

title: Virtual Machine Generation Counter ID device

maintainers:
  - Jason A. Donenfeld <Jason@zx2c4.com>

description:
  Firmwares or hypervisors can use this devicetree to describe
  interrupts and the shared resources to inject a Virtual Machine Generation
  counter.

properties:
  compatible:
    const: linux,vmgenctr

  "#interrupt-cells":
    const: 3
    description: |
      The 1st cell is the interrupt type.
      The 2nd cell contains the interrupt number for the interrupt type.
      The 3rd cell is for trigger type and level flags.

  interrupt-controller: true

  reg:
    description: |
      specifies the base physical address and
      size of the regions in memory which holds the VMGenID counter.
    maxItems: 1

  interrupts:
    description: |
      interrupt used to notify that a new VMGenID counter is available.
      The interrupt should be Edge triggered.
    maxItems: 1

required:
  - compatible
  - reg
  - interrupts

additionalProperties: false

examples:
  - |
    rng@80000000 {
      compatible = "linux,vmgenctr";
      reg = <0x80000000 0x1000>;
      interrupts = <0x00 0x23 0x01>;
    };

...
```

## Documentation/devicetree/bindings/rtc/abracon,abx80x.yaml
```yaml
# SPDX-License-Identifier: GPL-2.0-only OR BSD-2-Clause
%YAML 1.2
---
$id: http://devicetree.org/schemas/rtc/abracon,abx80x.yaml#
$schema: http://devicetree.org/meta-schemas/core.yaml#

title: Abracon ABX80X I2C ultra low power RTC/alarm chip

maintainers:
  - Laurent Pinchart <laurent.pinchart@ideasonboard.com>

description:
  The Abracon ABX80X family consists of the ab0801, ab0803, ab0804, ab0805,
  ab1801, ab1803, ab1804 and ab1805. The ab0805 is the superset of ab080x and
  the ab1805 is the superset of ab180x.

properties:
  compatible:
    enum:
      - abracon,abx80x    # Enables chip auto-detection
      - abracon,ab0801
      - abracon,ab0803
      - abracon,ab0804
      - abracon,ab0805
      - abracon,ab1801
      - abracon,ab1803
      - abracon,ab1804
      - abracon,ab1805
      - microcrystal,rv1805

  reg:
    maxItems: 1

  interrupts:
    maxItems: 1

  abracon,tc-diode:
    description:
      Select the series diode configuration for the trickle charger, between a
      standard diode (0.6V) and a Schottky diode (0.3V).
    enum: [standard, schottky]

  abracon,tc-resistor:
    $ref: /schemas/types.yaml#/definitions/uint32
    description:
      Select the series output resistor value for the tricker charger, in kOhm.
    enum: [0, 3, 6, 11]

dependentRequired:
  abracon,tc-diode: ["abracon,tc-resistor"]
  abracon,tc-resistor: ["abracon,tc-diode"]

required:
  - compatible
  - reg

allOf:
  - $ref: rtc.yaml#
  - if:
      properties:
        compatible:
          not:
            contains:
              enum:
                - abracon,ab0804
                - abracon,ab1804
                - abracon,ab0805
                - abracon,ab1805
    then:
      properties:
        abracon,tc-diode: false
        abracon,tc-resistor: false

unevaluatedProperties: false

examples:
  - |
    i2c {
        #address-cells = <1>;
        #size-cells = <0>;

        rtc@69 {
            compatible = "abracon,ab1805";
            reg = <0x69>;
            abracon,tc-diode = "schottky";
            abracon,tc-resistor = <3>;
        };
    };
...
```

## Documentation/devicetree/bindings/rtc/adi,max313xx.yaml
```yaml
# SPDX-License-Identifier: GPL-2.0-only OR BSD-2-Clause
# Copyright 2022 Analog Devices Inc.
%YAML 1.2
---
$id: http://devicetree.org/schemas/rtc/adi,max313xx.yaml#
$schema: http://devicetree.org/meta-schemas/core.yaml#

title: Analog Devices MAX313XX series I2C RTCs

maintainers:
  - Antoniu Miclaus <antoniu.miclaus@analog.com>
  - Chris Packham <chris.packham@alliedtelesis.co.nz>

description: Analog Devices MAX313XX series I2C RTCs.

properties:
  compatible:
    enum:
      - adi,max31328
      - adi,max31329
      - adi,max31331
      - adi,max31334
      - adi,max31335
      - adi,max31341
      - adi,max31342
      - adi,max31343

  reg:
    description: I2C address of the RTC
    items:
      - enum: [0x68, 0x69]

  interrupts:
    description:
      Alarm1 interrupt line of the RTC. Some of the RTCs have two interrupt
      lines and alarm1 interrupt muxing depends on the clockin/clockout
      configuration.
    maxItems: 1

  "#clock-cells":
    description:
      RTC can be used as a clock source through its clock output pin when
      supplied.
    const: 0

  clocks:
    description:
      RTC uses this clock for clock input when supplied. Clock has to provide
      one of these four frequencies - 1Hz, 50Hz, 60Hz or 32.768kHz.
    maxItems: 1

  adi,tc-diode:
    description:
      Select the diode configuration for the trickle charger.
      schottky - Schottky diode in series.
      standard+schottky - standard diode + Schottky diode in series.
    enum: [schottky, standard+schottky]

  trickle-resistor-ohms:
    description:
      Selected resistor for trickle charger. Should be specified if trickle
      charger should be enabled.
    enum: [3000, 6000, 11000]

required:
  - compatible
  - reg

allOf:
  - $ref: rtc.yaml#
  - if:
      properties:
        compatible:
          contains:
            enum:
              - adi,max31328
              - adi,max31342

    then:
      properties:
        aux-voltage-chargeable: false
        trickle-resistor-ohms: false

  - if:
      properties:
        compatible:
          contains:
            enum:
              - adi,max31328
              - adi,max31331
              - adi,max31334
              - adi,max31335
              - adi,max31343

    then:
      properties:
        clocks: false

  - if:
      properties:
        compatible:
          contains:
            enum:
              - adi,max31341
              - adi,max31342

    then:
      properties:
        reg:
          items:
            - const: 0x69

    else:
      properties:
        reg:
          items:
            - const: 0x68

unevaluatedProperties: false

examples:
  - |
    #include <dt-bindings/interrupt-controller/irq.h>
    i2c {
        #address-cells = <1>;
        #size-cells = <0>;

        rtc@68 {
            reg = <0x68>;
            compatible = "adi,max31329";
            clocks = <&clkin>;
            interrupt-parent = <&gpio>;
            interrupts = <26 IRQ_TYPE_EDGE_FALLING>;
            aux-voltage-chargeable = <1>;
            trickle-resistor-ohms = <6000>;
            adi,tc-diode = "schottky";
        };
    };
  - |
    #include <dt-bindings/interrupt-controller/irq.h>
    i2c {
        #address-cells = <1>;
        #size-cells = <0>;

        rtc@68 {
            compatible = "adi,max31335";
            reg = <0x68>;
            pinctrl-0 = <&rtc_nint_pins>;
            interrupts-extended = <&gpio1 16 IRQ_TYPE_LEVEL_HIGH>;
            aux-voltage-chargeable = <1>;
            trickle-resistor-ohms = <6000>;
            adi,tc-diode = "schottky";
        };
    };
  - |
    #include <dt-bindings/interrupt-controller/irq.h>
    i2c {
        #address-cells = <1>;
        #size-cells = <0>;

        rtc@68 {
            reg = <0x68>;
            compatible = "adi,max31331";
            #clock-cells = <0>;
        };
    };
...
```

## Documentation/devicetree/bindings/rtc/amlogic,amlogic-rtc.yaml
```yaml
# SPDX-License-Identifier: (GPL-2.0-only OR BSD-2-Clause)
# Copyright (C) 2024 Amlogic, Inc. All rights reserved
%YAML 1.2
---
$id: http://devicetree.org/schemas/rtc/amlogic,amlogic-rtc.yaml#
$schema: http://devicetree.org/meta-schemas/core.yaml#

title: Amlogic Real Time Clock controller include a4, a5

maintainers:
  - Yiting Deng <yiting.deng@amlogic.com>
  - Xianwei Zhao <xianwei.zhao@amlogic.com>

description:
  The Amlogic new chips used RTC module.

allOf:
  - $ref: rtc.yaml#

properties:
  compatible:
    enum:
      - amlogic,a4-rtc
      - amlogic,a5-rtc

  reg:
    maxItems: 1

  clocks:
    items:
      - description: RTC clock source, available 24M or 32K crystal
          oscillator source. when using 24M, need to divide 24M into 32K.
      - description: RTC module accesses the clock of the apb bus.

  clock-names:
    items:
      - const: rtc_osc
      - const: rtc_sys_clk

  interrupts:
    maxItems: 1

required:
  - compatible
  - interrupts
  - reg
  - clocks
  - clock-names

additionalProperties: false

examples:
  - |
    #include <dt-bindings/interrupt-controller/arm-gic.h>
    apb {
        #address-cells = <2>;
        #size-cells = <2>;

        rtc: rtc@8e600 {
            compatible = "amlogic,a4-rtc";
            interrupts = <GIC_SPI 131 IRQ_TYPE_EDGE_RISING>;
            reg = <0x0 0x8e600 0x0 0x38>;
            clocks = <&xtal_32k>, <&clkc_periphs 1>;
            clock-names = "rtc_osc", "rtc_sys_clk";
        };
    };
```
