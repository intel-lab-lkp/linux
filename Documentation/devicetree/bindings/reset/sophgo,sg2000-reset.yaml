## Documentation/devicetree/bindings/rtc/cnxt,cx92755-rtc.yaml
```yaml
# SPDX-License-Identifier: (GPL-2.0 OR BSD-2-Clause)
%YAML 1.2
---
$id: http://devicetree.org/schemas/rtc/cnxt,cx92755-rtc.yaml#
$schema: http://devicetree.org/meta-schemas/core.yaml#

title: Conexant Digicolor Real Time Clock Controller

maintainers:
  - Javier Carrasco <javier.carrasco.cruz@gmail.com>

properties:
  compatible:
    const: cnxt,cx92755-rtc

  reg:
    description:
      Base address and length of the register region.
    maxItems: 1

  interrupts:
    maxItems: 1

required:
  - compatible
  - reg
  - interrupts

additionalProperties: false

examples:
  - |
    rtc@f0000c30 {
        compatible = "cnxt,cx92755-rtc";
        reg = <0xf0000c30 0x18>;
        interrupts = <25>;
    };
```

## Documentation/devicetree/bindings/rtc/epson,rx6110.yaml
```yaml
# SPDX-License-Identifier: (GPL-2.0-only OR BSD-2-Clause)
%YAML 1.2
---
$id: http://devicetree.org/schemas/rtc/epson,rx6110.yaml#
$schema: http://devicetree.org/meta-schemas/core.yaml#

title: Epson RX6110 Real Time Clock

description: |
  The Epson RX6110 can be used with SPI or I2C busses.
  The kind of bus depends on the SPISEL pin and can not be
  configured via software.

maintainers:
  - Alexandre Belloni <alexandre.belloni@bootlin.com>

properties:
  compatible:
    const: epson,rx6110

  reg:
    maxItems: 1

  # SPI-specific properties
  spi-cs-high:
    type: boolean
    description: RX6110 needs chipselect high

  spi-cpha:
    type: boolean
    description: RX6110 works with SPI shifted clock phase

  spi-cpol:
    type: boolean
    description: RX6110 works with SPI inverse clock polarity

required:
  - compatible
  - reg

additionalProperties: false

examples:
  # I2C mode
  - |
    i2c {
      #address-cells = <1>;
      #size-cells = <0>;

      rtc1: rtc@32 {
        compatible = "epson,rx6110";
        reg = <0x32>;
      };
    };

  # SPI mode
  - |
    spi {
      #address-cells = <1>;
      #size-cells = <0>;

      rtc2: rtc@3 {
        compatible = "epson,rx6110";
        reg = <3>;
        spi-cs-high;
        spi-cpha;
        spi-cpol;
      };
    };
```

## Documentation/devicetree/bindings/rtc/epson,rx8111.yaml
```yaml
# SPDX-License-Identifier: (GPL-2.0-only OR BSD-2-Clause)
%YAML 1.2
---
$id: http://devicetree.org/schemas/rtc/epson,rx8111.yaml#
$schema: http://devicetree.org/meta-schemas/core.yaml#

title: Epson RX8111 Real-Time Clock

maintainers:
  - Waqar Hameed <waqar.hameed@axis.com>

description: |
  RTC with timestamp functionality.

  https://support.epson.biz/td/api/doc_check.php?dl=app_RX8111CE&lang=en

properties:
  compatible:
    const: epson,rx8111

  reg:
    const: 0x32

required:
  - compatible
  - reg

additionalProperties: false

examples:
  - |
    i2c {
        #address-cells = <1>;
        #size-cells = <0>;

        rtc@32 {
            compatible = "epson,rx8111";
            reg = <0x32>;
        };
    };
...
```

## Documentation/devicetree/bindings/rtc/epson,rx8900.yaml
```yaml
# SPDX-License-Identifier: (GPL-2.0-only OR BSD-2-Clause)
%YAML 1.2
---
$id: http://devicetree.org/schemas/rtc/epson,rx8900.yaml#
$schema: http://devicetree.org/meta-schemas/core.yaml#

title: EPSON RX8900 / Microcrystal RV8803 Real-Time Clock

maintainers:
  - Marek Vasut <marex@denx.de>

properties:
  compatible:
    enum:
      - epson,rx8803
      - epson,rx8804
      - epson,rx8900
      - epson,rx8901
      - microcrystal,rv8803

  reg:
    maxItems: 1

  epson,vdet-disable:
    type: boolean
    description: |
      Disable voltage detector. Should be set if no backup battery is used.

  trickle-diode-disable: true

  wakeup-source: true

  tamper:
    description: Subnode for tamper configuration. This
      subnode is only available for epson,rx8901.
    type: object
    additionalProperties: false
    properties:
      buffer-mode:
        description: Set the buffer mode to inhibit (0) or overwrite (1).
        minimum: 0
        maximum: 1
    patternProperties:
      "^evin-[0-3]$":
        $ref: /schemas/types.yaml#/definitions/uint32-array
        minItems: 3
        maxItems: 3
        description: |
          Event input pin configuration.
          The configuration is an array of tree values and contains
          "pull-resistore", "trigger" and "filter".
          For a detaild description, see epson-rx8901 datasheet.

allOf:
  - $ref: rtc.yaml#
  - if:
      properties:
        compatible:
          contains:
            enum:
              - epson,rx8901
    then:
      properties:
        tamper: true
    else:
      # property is not allowed:
      properties:
        tamper: false

required:
  - compatible
  - reg

additionalProperties: false

examples:
  - |
    i2c {
        #address-cells = <1>;
        #size-cells = <0>;

        rtc@32 {
            compatible = "epson,rx8900";
            reg = <0x32>;
            epson,vdet-disable;
            trickle-diode-disable;
        };
    };
```

## Documentation/devicetree/bindings/rtc/maxim,mcp795.yaml
```yaml
# SPDX-License-Identifier: GPL-2.0-only OR BSD-2-Clause
%YAML 1.2
---
$id: http://devicetree.org/schemas/rtc/maxim,mcp795.yaml#
$schema: http://devicetree.org/meta-schemas/core.yaml#

title: Maxim MCP795 SPI Serial Real Time Clock

allOf:
  - $ref: rtc.yaml#

maintainers:
  - Josef Gajdusek <atx@atx.name>

properties:
  compatible:
    enum:
      - maxim,mcp795

  reg:
    maxItems: 1

required:
  - compatible
  - reg

additionalProperties: false

examples:
  - |
    rtc@0 {
        compatible = "maxim,mcp795";
        reg = <0>;
    };
...
```

## Documentation/devicetree/bindings/rtc/maxim-ds1302.yaml
```yaml
# SPDX-License-Identifier: (GPL-2.0-only OR BSD-2-Clause)
%YAML 1.2
---
$id: http://devicetree.org/schemas/rtc/maxim-ds1302.yaml#
$schema: http://devicetree.org/meta-schemas/core.yaml#

title: Maxim/Dallas Semiconductor DS-1302 RTC

maintainers:
  - Alexandre Belloni <alexandre.belloni@bootlin.com>
  - Sergey Yanovich <ynvich@gmail.com>

description: |
  Simple device which could be used to store date/time between reboots.

  The device uses the standard MicroWire half-duplex transfer timing.
  Master output is set on low clock and sensed by the RTC on the rising
  edge. Master input is set by the RTC on the trailing edge and is sensed
  by the master on low clock.

properties:
  compatible:
    items:
      - const: maxim,ds1302

  reg:
    maxItems: 1

  spi-max-frequency:
    $ref: /schemas/types.yaml#/definitions/uint32
    description: DS-1302 has 500 kHz if powered at 2.2V, and 2MHz if powered at 5V
    enum:
      - 500000
      - 2000000

  spi-3wire: true

  spi-lsb-first: true

  spi-cs-high: true

required:
  - compatible
  - reg
  - spi-max-frequency
  - spi-3wire
  - spi-lsb-first
  - spi-cs-high

additionalProperties: false
```

## Documentation/devicetree/bindings/rtc/mediatek,mt6685-rtc.yaml
```yaml
# SPDX-License-Identifier: GPL-2.0-only OR BSD-2-Clause
%YAML 1.2
---
$id: http://devicetree.org/schemas/rtc/mediatek,mt6685-rtc.yaml#
$schema: http://devicetree.org/meta-schemas/core.yaml#

title: MediaTek MT6685 PM/Clock IC Real Time Clock

allOf:
  - $ref: rtc.yaml#

maintainers:
  - AngeloGioacchino Del Regno <angelogioacchino.delregno@collabora.com>

properties:
  compatible:
    const: mediatek,mt6685-rtc

  reg:
    maxItems: 1

  interrupts:
    maxItems: 1

  clocks:
    maxItems: 1

required:
  - compatible
  - reg
  - interrupts

unevaluatedProperties: false
```

## Documentation/devicetree/bindings/rtc/moxa,moxart-rtc.yaml
```yaml
# SPDX-License-Identifier: (GPL-2.0-only OR BSD-2-Clause)
%YAML 1.2
---
$id: http://devicetree.org/schemas/rtc/moxa,moxart-rtc.yaml#
$schema: http://devicetree.org/meta-schemas/core.yaml#

title: MOXA ART Real-time Clock

maintainers:
  - Serban-Pascu Robert <robyserbanpascu06@gmail.com>

properties:
  compatible:
    const: moxa,moxart-rtc

  rtc-sclk-gpios:
    maxItems: 1
    description: GPIO line for the RTC clock signal.

  rtc-data-gpios:
    maxItems: 1
    description: GPIO line for the RTC data signal.

  rtc-reset-gpios:
    maxItems: 1
    description: GPIO line for the RTC reset signal.

required:
  - compatible
  - rtc-sclk-gpios
  - rtc-data-gpios
  - rtc-reset-gpios

additionalProperties: false

examples:
  - |
    rtc {
        compatible = "moxa,moxart-rtc";
        rtc-sclk-gpios = <&gpio 5 0>;
        rtc-data-gpios = <&gpio 6 0>;
        rtc-reset-gpios = <&gpio 7 0>;
    };
```
