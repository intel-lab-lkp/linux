## Documentation/devicetree/bindings/reset/sophgo,sg2000-reset.yaml
```yaml
# SPDX-License-Identifier: (GPL-2.0 OR BSD-2-Clause)
%YAML 1.2
---
$id: http://devicetree.org/schemas/reset/sophgo,sg2000-reset.yaml#
$schema: http://devicetree.org/meta-schemas/core.yaml#

title: Sophgo SG2000 SoC Reset Controller

maintainers:
  - Chen Wang <unicorn_wang@outlook.com>

properties:
  compatible:
    const: sophgo,sg2000-reset

  reg:
    maxItems: 1

  "#reset-cells":
    const: 1

required:
  - compatible
  - reg
  - "#reset-cells"

additionalProperties: false

examples:
  - |
    rstgen: reset-controller@3003000 {
        compatible = "sophgo,sg2000-reset";
        reg = <0x3003000 0x28>;
        #reset-cells = <1>;
    };
```

## Documentation/devicetree/bindings/reset/syna,sl261x-reset.yaml
```yaml
# SPDX-License-Identifier: (GPL-2.0 OR BSD-2-Clause)
# Copyright (C) 2026 Synaptics Incorporated
%YAML 1.2
---
$id: http://devicetree.org/schemas/reset/syna,sl261x-reset.yaml#
$schema: http://devicetree.org/meta-schemas/core.yaml#

title: Synaptics SL261X reset controller

maintainers:
  - Jisheng Zhang <jszhang@kernel.org>

description: The reset controller node must be a sub-node of the chip
  controller node on SL261X SoCs.

properties:
  compatible:
    enum:
      - syna,sl261x-soc-reset
      - syna,sl261x-system-reset

  "#reset-cells":
    const: 1

required:
  - compatible
  - "#reset-cells"

additionalProperties: false

examples:
  - |
    chip: chip-control@f7e10000 {
        reg = <0xf7e10000 0x1000>;

        chip_rst: reset {
            compatible = "syna,sl261x-soc-reset";
            #reset-cells = <1>;
        };
    };
```

## Documentation/devicetree/bindings/reset/thead,th1520-reset.yaml
```yaml
# SPDX-License-Identifier: (GPL-2.0-only OR BSD-2-Clause)
%YAML 1.2
---
$id: http://devicetree.org/schemas/reset/thead,th1520-reset.yaml#
$schema: http://devicetree.org/meta-schemas/core.yaml#

title: T-HEAD TH1520 SoC Reset Controller

description:
  The T-HEAD TH1520 reset controller is a hardware block that asserts/deasserts
  resets for SoC subsystems.

maintainers:
  - Michal Wilczynski <m.wilczynski@samsung.com>

properties:
  compatible:
    oneOf:
      - enum:
          - thead,th1520-reset-vo
      - const: thead,th1520-reset
        deprecated: true

  reg:
    maxItems: 1

  "#reset-cells":
    const: 1

required:
  - compatible
  - reg
  - "#reset-cells"

additionalProperties: false

examples:
  - |
    reset-controller@ffef528000 {
        compatible = "thead,th1520-reset-vo";
        reg = <0xef528000 0x1000>;
        #reset-cells = <1>;
    };
```

## Documentation/devicetree/bindings/reset/ti,am64-rst.yaml
```yaml
# SPDX-License-Identifier: (GPL-2.0-only OR BSD-2-Clause)
%YAML 1.2
---
$id: http://devicetree.org/schemas/reset/ti,am64-rst.yaml#
$schema: http://devicetree.org/meta-schemas/core.yaml#

title: Texas Instruments K3 Multicore SoC platforms reset module

maintainers:
  - Alexander Sverdlin <alexander.sverdlin@gmail.com>

description: |
  Texas Instruments (ARM64) K3 Multicore SoC platforms reset module is present
  on AM64x and newer members of the K3 family and consists of the RST_CTRL,
  RST_STAT, RST_SRC and RST_MAGIC_WORD registers.

properties:
  $nodename:
    pattern: "^rst@[0-9a-f]+$"

  compatible:
    items:
      - const: ti,am64-rst

  reg:
    maxItems: 1

required:
  - compatible
  - reg

additionalProperties: false

examples:
  - |
    rst@43018170 {
        compatible = "ti,am64-rst";
        reg = <0x43018170 0x10>;
    };
```

## Documentation/devicetree/bindings/reset/toshiba,tc9564-reset.yaml
```yaml
# SPDX-License-Identifier: (GPL-2.0-only OR BSD-2-Clause)
%YAML 1.2
---
$id: http://devicetree.org/schemas/reset/toshiba,tc9564-reset.yaml#
$schema: http://devicetree.org/meta-schemas/core.yaml#

title: Toshiba TC9564 Reset Controller

maintainers:
  - Alex Elder <elder@riscstar.com>
  - Daniel Thompson <daniel@riscstar.com>

description:
  The Toshiba TC9564 is an SoC accessed by a host system through the
  upstream PCIe port on the PCIe switch it implements.  The switch
  includes an embedded PCIe endpoint that provides access to various
  SoC peripherals (including a reset controller) via its BARs.

  A total of 13 resets are implemented, though two of these are not
  controllable.  Access to the reset controller relies on PCIe being
  functional, so the PCIe reset is assumed to be deasserted.  Similarly,
  the PCIe controller relies on I2C, so the I2C reset is also assumed
  to be deasserted.

  Reset ids are defined in <dt-bindings/reset/toshiba,tc9564.h>.

  The reset controller uses registers within the same page as a
  clock controller, so both devices are defined as children of a
  "config" syscon.

properties:
  compatible:
    const: toshiba,tc9564-reset

  "#reset-cells":
    const: 1

required:
  - compatible
  - "#reset-cells"

unevaluatedProperties: false

examples:
  - |
    #include <dt-bindings/reset/toshiba,tc9564.h>

    syscon@0 {
        compatible = "syscon", "simple-mfd";
        reg = <0x0 0x2000>;

        reset {
            compatible = "toshiba,tc9564-reset";
            #reset-cells = <1>;
        };
    };
```

## Documentation/devicetree/bindings/riscv/gf.yaml
```yaml
# SPDX-License-Identifier: (GPL-2.0-only OR BSD-2-Clause)
%YAML 1.2
---
$id: http://devicetree.org/schemas/riscv/gf.yaml#
$schema: http://devicetree.org/meta-schemas/core.yaml#

title: GlobalFoundries MIPS SoC-based boards

maintainers:
  - Djordje Todorovic <djordje.todorovic@htecgroup.com>
  - Aleksa Paunovic <aleksa.paunovic@htecgroup.com>

description:
  GlobalFoundries MIPS SoC-based boards

properties:
  $nodename:
    const: '/'
  compatible:
    oneOf:
      - description: Boston FPGA development board with a MIPS P8700 bitfile
        items:
          - const: gf,mips-p8700-boston

additionalProperties: true

...
```

## Documentation/devicetree/bindings/riscv/riscv,cbqri.yaml
```yaml
# SPDX-License-Identifier: GPL-2.0-only OR BSD-2-Clause
%YAML 1.2
---
$id: http://devicetree.org/schemas/riscv/riscv,cbqri.yaml#
$schema: http://devicetree.org/meta-schemas/core.yaml#

title: RISC-V Capacity and Bandwidth Register Interface (CBQRI) controller

description: |
  The RISC-V CBQRI specification defines capacity-controller and
  bandwidth-controller register blocks that allow cache capacity and memory
  bandwidth to be allocated to resource control IDs (RCIDs) and monitored per
  monitoring counter ID (MCID):
  https://github.com/riscv-non-isa/riscv-cbqri/blob/main/riscv-cbqri.pdf

  The register interface is architected, so a CBQRI controller is described by
  a generic "riscv,cbqri-capacity-controller" or "riscv,cbqri-bandwidth-controller"
  compatible. A device-specific compatible should be listed as the first entry
  so a driver can apply integration-specific behavior (for example, the cache
  level the controller backs).

  A single controller register block may implement resource allocation and/or
  usage monitoring: a capacity controller can allocate cache capacity to RCIDs
  and monitor capacity usage per MCID, and a bandwidth controller likewise for
  memory bandwidth. The allocation and monitoring register sets live in the
  same block, and which of them a controller actually implements is discovered
  at runtime from its capabilities register. The compatible therefore names the
  controller type only; it does not distinguish allocation-only, monitoring-only
  or combined controllers, and no property declares monitoring support.

maintainers:
  - Drew Fustini <fustini@kernel.org>

properties:
  compatible:
    oneOf:
      - items:
          - description: Tenstorrent Ascalon Shared Cache
            const: tenstorrent,ascalon-sc-cbqri
          - const: riscv,cbqri-capacity-controller
      - enum:
          - riscv,cbqri-capacity-controller
          - riscv,cbqri-bandwidth-controller

  reg:
    maxItems: 1
    description:
      The CBQRI controller register block.

  riscv,cbqri-rcid:
    $ref: /schemas/types.yaml#/definitions/uint32
    description:
      The maximum number of RCIDs the controller supports. RCIDs are the
      resource-control IDs that allocation operations target.

  riscv,cbqri-mcid:
    $ref: /schemas/types.yaml#/definitions/uint32
    description:
      The maximum number of MCIDs the controller supports. MCIDs are the
      monitoring-counter IDs that usage-monitoring operations target; present
      on controllers that implement monitoring.

  riscv,cbqri-cache:
    $ref: /schemas/types.yaml#/definitions/phandle
    description:
      Phandle to the cache node whose capacity this controller allocates.
      Applies to capacity controllers that back a CPU cache; the cache level
      and the harts sharing the cache are taken from that node's cache
      topology.

required:
  - compatible
  - reg

allOf:
  # The Ascalon SC is a fixed cache capacity-allocation controller: the driver
  # cannot register it without the RCID count and the cache it backs.
  - if:
      properties:
        compatible:
          contains:
            const: tenstorrent,ascalon-sc-cbqri
    then:
      required:
        - riscv,cbqri-rcid
        - riscv,cbqri-cache

additionalProperties: false

examples:
  - |
    l2_cache: l2-cache {
        compatible = "cache";
        cache-level = <2>;
        cache-unified;
        cache-size = <0xc00000>;
        cache-sets = <512>;
        cache-block-size = <64>;
    };

    cache-controller@a21a00c0 {
        compatible = "tenstorrent,ascalon-sc-cbqri",
                     "riscv,cbqri-capacity-controller";
        reg = <0xa21a00c0 0xf40>;
        riscv,cbqri-rcid = <16>;
        riscv,cbqri-cache = <&l2_cache>;
    };

...
```

## Documentation/devicetree/bindings/riscv/riscv,trace-component.yaml
```yaml
# SPDX-License-Identifier: (GPL-2.0-only OR BSD-2-Clause)
%YAML 1.2
---
$id: http://devicetree.org/schemas/riscv/riscv,trace-component.yaml#
$schema: http://devicetree.org/meta-schemas/core.yaml#

title: RISC-V Trace Component

maintainers:
  - Anup Patel <anup@brainfault.org>

description:
  The RISC-V trace control interface specification standard memory mapped
  components (or devices) which support both the RISC-V efficient trace
  (E-trace) protocol and the RISC-V Nexus-based trace (N-trace) protocol.
  The RISC-V trace components have implementation specific directed acyclic
  graph style interdependency where output of one component serves as input
  to another component and certain components (such as funnel) can take inputs
  from multiple components. While the type and version of a RISC-V trace component
  can be discovered from it's IMPL memory mapped register, specific compatible strings
  are used for pre-ratified trace components.

properties:
  compatible:
    oneOf:
      - items:
          - enum:
              - qemu,trace-component
          - const: riscv,trace-component
      - items:
          - const: sifive,trace-encoder0
        description: SiFive Pre-ratified Encoder Trace Component
      - items:
          - const: sifive,trace-funnel0
        description: SiFive Pre-ratified Funnel Trace Component

  reg:
    maxItems: 1

  cpus:
    maxItems: 1
    description:
      phandle to the cpu to which the RISC-V trace component is bound.

  in-ports:
    $ref: /schemas/graph.yaml#/properties/ports
    patternProperties:
      '^port(@[0-7])?$':
        description: Input connections from RISC-V trace component
        $ref: /schemas/graph.yaml#/properties/port

  out-ports:
    $ref: /schemas/graph.yaml#/properties/ports
    patternProperties:
      '^port(@[0-7])?$':
        description: Output connections from RISC-V trace component
        $ref: /schemas/graph.yaml#/properties/port

required:
  - compatible
  - reg

anyOf:
  - required: [ in-ports ]
  - required: [ out-ports ]

unevaluatedProperties: false

examples:
  - |
    // Example 1 (Per-hart encoder and ramsink components):

    trace@c000000 {
      compatible = "qemu,trace-component", "riscv,trace-component";
      reg = <0xc000000 0x1000>;
      cpus = <&CPU0>;

      out-ports {
        port {
          CPU0_ENCODER_OUTPUT: endpoint {
            remote-endpoint = <&CPU0_RAMSINK_INPUT>;
          };
        };
      };
    };

    trace@c001000 {
      compatible = "qemu,trace-component", "riscv,trace-component";
      reg = <0xc001000 0x1000>;
      cpus = <&CPU0>;

      in-ports {
        port {
          CPU0_RAMSINK_INPUT: endpoint {
          };
        };
      };
    };

    trace@c002000 {
      compatible = "qemu,trace-component", "riscv,trace-component";
      reg = <0xc002000 0x1000>;
      cpus = <&CPU1>;

      out-ports {
        port {
          CPU1_ENCODER_OUTPUT: endpoint {
            remote-endpoint = <&CPU1_RAMSINK_INPUT>;
          };
        };
      };
    };

    trace@c003000 {
      compatible = "qemu,trace-component", "riscv,trace-component";
      reg = <0xc003000 0x1000>;
      cpus = <&CPU1>;

      in-ports {
        port {
          CPU1_RAMSINK_INPUT: endpoint {
          };
        };
      };
    };

  - |
    // Example 2: SiFive trace encoder and funnel connection
    encoder-0@2000000 {
        compatible = "sifive,trace-encoder0";
        reg = <0x2000000 0x1000>;
        cpus = <&CPU0>;

        out-ports {
            port {
                encoder0_out: endpoint {
                  remote-endpoint = <&funnel_in0>;
                };
            };
        };
    };

    encoder-1@2001000 {
        compatible = "sifive,trace-encoder0";
        reg = <0x2001000 0x1000>;
        cpus = <&CPU1>;

        out-ports {
            port {
                encoder1_out: endpoint {
                  remote-endpoint = <&funnel_in1>;
                };
            };
        };
    };

    funnel-0@2002000 {
        compatible = "sifive,trace-funnel0";
        reg = <0x2002000 0x1000>;

        in-ports {
            #address-cells = <1>;
            #size-cells = <0>;
            port@0 {
                reg = <0x0>;
                funnel_in0: endpoint {
                    remote-endpoint = <&encoder0_out>;
                };
            };

            port@1 {
                reg = <0x1>;
                funnel_in1: endpoint {
                    remote-endpoint = <&encoder1_out>;
                };
            };
        };
    };
...
```

## Documentation/devicetree/bindings/riscv/tenstorrent.yaml
```yaml
# SPDX-License-Identifier: (GPL-2.0-only OR BSD-2-Clause)
%YAML 1.2
---
$id: http://devicetree.org/schemas/riscv/tenstorrent.yaml#
$schema: http://devicetree.org/meta-schemas/core.yaml#

title: Tenstorrent SoC-based boards

maintainers:
  - Drew Fustini <dfustini@tenstorrent.com>
  - Joel Stanley <jms@tenstorrent.com>

description:
  Tenstorrent SoC-based boards

properties:
  $nodename:
    const: '/'
  compatible:
    oneOf:
      - description: Tenstorrent Blackhole A0 PCIe card
        items:
          - const: tenstorrent,blackhole-a0-card
          - const: tenstorrent,blackhole-a0

additionalProperties: true

...
```

## Documentation/devicetree/bindings/riscv/ultrarisc.yaml
```yaml
# SPDX-License-Identifier: (GPL-2.0-only OR BSD-2-Clause)
%YAML 1.2
---
$id: http://devicetree.org/schemas/riscv/ultrarisc.yaml#
$schema: http://devicetree.org/meta-schemas/core.yaml#

title: UltraRISC SoC-based boards

maintainers:
  - Jia Wang <wangjia@ultrarisc.com>

description:
  UltraRISC DP1000 SoC-based boards

properties:
  $nodename:
    const: '/'
  compatible:
    oneOf:
      - items:
          - enum:
              - rongda,m0
              - milkv,titan
          - const: ultrarisc,dp1000

additionalProperties: true
...
```
