## net/pon/Kconfig
```kconfig
# SPDX-License-Identifier: GPL-2.0-only
#
# PON subsystem configuration
#
config PON
	tristate "Passive Optical Network (PON) device support"
	depends on NET
	help
	  Enable kernel support for PON (GPON / XG(S)-PON) ONU devices: the
	  netlink configuration family (which also carries the OMCI
	  management channel to a userspace OMCI stack) and per GEM port
	  virtual devices.

	  To compile this as a module, choose M here: the module will be
	  called pon.

	  If unsure, say N.
```

## net/smc/Kconfig
```kconfig
# SPDX-License-Identifier: GPL-2.0-only
config SMC
	tristate "SMC socket protocol family"
	depends on INET && INFINIBAND
	help
	  SMC-R provides a "sockets over RDMA" solution making use of
	  RDMA over Converged Ethernet (RoCE) technology to upgrade
	  AF_INET TCP connections transparently.
	  The Linux implementation of the SMC-R solution is designed as
	  a separate socket family SMC.

	  Select this option if you want to run SMC socket applications

config SMC_DIAG
	tristate "SMC: socket monitoring interface"
	depends on SMC
	help
	  Support for SMC socket monitoring interface used by tools such as
	  smcss.

	  if unsure, say Y.

config SMC_LO
	bool "SMC_LO: virtual loopback-ism for SMC"
	depends on SMC
	default n
	help
	  SMC_LO provides a kind of virtual ISM device called loopback-ism
	  for SMC-D to upgrade AF_INET TCP connections whose ends share the
	  same kernel.
	  loopback-ism is a software-implemented simulation device that does
	  not depend on a specific architecture or hardware.

	  if unsure, say N.
```

## net/unix/Kconfig
```kconfig
# SPDX-License-Identifier: GPL-2.0-only
#
# Unix Domain Sockets
#

config UNIX
	bool "Unix domain sockets"
	help
	  If you say Y here, you will include support for Unix domain sockets;
	  sockets are the standard Unix mechanism for establishing and
	  accessing network connections.  Many commonly used programs such as
	  the X Window system and syslog use these sockets even if your
	  machine is not connected to any network.  Unless you are working on
	  an embedded system or something similar, you therefore definitely
	  want to say Y here.

	  Say Y unless you know what you are doing.

config UNIX_ABSTRACT
	bool "UNIX: abstract sockets"
	depends on UNIX
	default y
	help
	  Support for "abstract" sockets (those not bound to a path).
	  These have been used in the past, but they can also represent
	  a security risk because anyone can bind to any abstract
	  socket.  If you disable this option, programs can still bind
	  to abstract sockets, but any attempt to connect to one fails
	  with -ECONNREFUSED.

config	AF_UNIX_OOB
	bool "UNIX: out-of-bound messages"
	depends on UNIX
	default y
	help
	  Support for MSG_OOB in UNIX domain sockets. If unsure, say Y.

config UNIX_DIAG
	tristate "UNIX: socket monitoring interface"
	depends on UNIX
	default n
	help
	  Support for UNIX socket monitoring interface used by the ss tool.
	  If unsure, say Y.
```

## scripts/kconfig/tests/conditional_dep/Kconfig
```kconfig
# SPDX-License-Identifier: GPL-2.0
# Test Kconfig file for conditional dependencies.

config FOO
    bool "FOO symbol"

config BAR
    bool "BAR symbol"

config TEST_BASIC
    bool "Test basic conditional dependency"
    depends on FOO if BAR
    default y

config TEST_COMPLEX
    bool "Test complex conditional dependency"
    depends on (FOO && BAR) if (FOO || BAR)
    default y

config BAZ
    tristate "BAZ symbol"

config TEST_OPTIONAL
    tristate "Test simple optional dependency"
    depends on BAZ if BAZ
    default y
```

## scripts/kconfig/tests/warn_changed_input/Kconfig
```kconfig
# SPDX-License-Identifier: GPL-2.0

config DEP
	bool "DEP"
	help
	  Test dependency symbol for Kconfig warning coverage.
	  This is used by the warn_changed_input selftest.
	  It intentionally stays unset in the input fragment.
	  The test checks how dependent user input is adjusted.

config A
	bool "A"
	depends on DEP
	help
	  Test bool symbol for changed-input diagnostics.
	  The input fragment requests this symbol as built-in.
	  The unmet dependency on DEP forces the final value to n.
	  The warning should report that downgrade.

config NUM
	int "NUM"
	range 10 20
	help
	  Test integer symbol for changed-input diagnostics.
	  The input fragment requests a value outside the allowed range.
	  Kconfig resolves it to the constrained in-range value.
	  The warning should report that adjustment.
```

## scripts/kconfig/tests/warn_dead_default/Kconfig
```kconfig
# SPDX-License-Identifier: GPL-2.0

config A
	bool

config B
	bool

config UNCONDITIONAL
	int
	default 1
	default 2

config CONDITIONAL
	int
	default 1 if A
	default 2 if A
	default 3 if B

config CONDITIONAL_COMMUTATIVE
	int
	default 1 if A && B
	default 2 if B && A

config CONTROL
	int
	default 1 if A
	default 2 if B
	default 3

choice
	prompt "test choice"
	default C
	default D

	config C
		bool "C"
	config D
		bool "D"
endchoice
```

## security/clavis/Kconfig
```kconfig
config SECURITY_CLAVIS
	bool "Clavis keyring"
	depends on SECURITY
	select SYSTEM_DATA_VERIFICATION
	select CRYPTO_SHA256
	help
	  Enable the clavis keyring. This keyring shall contain a single asymmetric key.
	  This key shall be linked to a key already contained in one of the system
	  keyrings (builtin, secondary, or platform).  One way to add this key
	  is during boot by passing in the asymmetric key id within the "clavis=" boot
	  param.  This keyring is required by the Clavis LSM.

config SECURITY_CLAVIS_ACL_LIST
	string "Clavis ACL list to preload into the clavis keyring"
	depends on SECURITY_CLAVIS
	help
	  If set, this option should be the file name of a list of clavis ACL
	  entries. This will be included into a C wrapper to incorporate the
	  acl list into the kernel. The file contents must be in the following
	  format: <two digit key usage number>:<subject key id>.  If more than
	  one entry is added, add a carriage return after each entry.

config SECURITY_CLAVIS_KUNIT_TEST
	bool "KUnit tests for Clavis" if !KUNIT_ALL_TESTS
	depends on SECURITY_CLAVIS && KUNIT
	default KUNIT_ALL_TESTS
	select SYSTEM_BLACKLIST_KEYRING
	select SYSTEM_REVOCATION_LIST
	help
	  Build KUnit tests for Clavis.

	  See the KUnit documentation in Documentation/dev-tools/kunit

	  Run all KUnit tests for Clavis with:
	  ./tools/testing/kunit/kunit.py run --kunitconfig security/clavis

	  If you are unsure how to answer this question, answer N.
```

## security/hornet/Kconfig
```kconfig
# SPDX-License-Identifier: GPL-2.0-only
config SECURITY_HORNET
	bool "Hornet support"
	depends on SECURITY
	default n
	help
	  This selects Hornet.
	  Further information can be found in
	  Documentation/admin-guide/LSM/Hornet.rst.

	  If you are unsure how to answer this question, answer N.
```

## security/rust_lsm/Kconfig
```kconfig
# SPDX-License-Identifier: GPL-2.0
config SECURITY_RUST_LSM
	bool "Rust LSM sample"
	depends on SECURITY && RUST
	help
	  A minimal Linux Security Module written in Rust that demonstrates
	  the kernel::lsm abstractions.  It logs file_open, task_alloc, and
	  task_free events via pr_info().

	  This module serves as a reference implementation and compile-test
	  vehicle for the Rust LSM abstraction layer.  It imposes no policy
	  — all hook implementations return 0 (allow) after logging.

	  If unsure, say N.
```

## sound/airoha/Kconfig
```kconfig
# SPDX-License-Identifier: GPL-2.0-only

config SND_AN7581_PCM
	tristate "PCM support for Airoha AN7581 chip"
	help
	  This adds PCM driver for Airoha AN7581 boards
	  that can be used with other codecs.
	  Select Y if you have such device.
	  If unsure select "N".
```

## sound/pci/quantum/Kconfig
```kconfig
config SND_QUANTUM
	tristate "PreSonus Quantum PCI sound driver"
	depends on SND_PCI
	select SND_PCM
	select SND_RAWMIDI
	help
	  Say Y or M here to include support for PreSonus Quantum series
	  PCI over Thunderbolt sound cards.

	  The supported devices are professional audio interfaces with
	  multichannel playback and capture, raw MIDI, sample-rate control,
	  and clock-source control.

	  This driver is independent and is not affiliated with PreSonus
	  or Fender. Later Quantum-branded USB interfaces are not supported
	  by this driver, as they use a different hardware architecture.

	  To compile this driver as a module, choose M here: the module
	  will be called snd-quantum.
```

## sound/soc/airoha/Kconfig
```kconfig
# SPDX-License-Identifier: GPL-2.0-only

config SND_SOC_AN7581_PCM
	tristate "PCM support for Airoha AN7581 chip"
	depends on ARCH_AIROHA || COMPILE_TEST
	help
	  This adds PCM driver for Airoha AN7581 boards
	  that can be used with other codecs.
	  Select Y if you have such device.
	  If unsure select "N".
```

## sound/soc/starfive/Kconfig
```kconfig
# SPDX-License-Identifier: GPL-2.0-only
config SND_SOC_STARFIVE
	tristate "Audio support for StarFive SoC"
	depends on COMPILE_TEST || ARCH_STARFIVE
	help
	  Say Y or M if you want to add support for codecs attached to
	  the Starfive SoCs' Audio interfaces. You will also need to
	  select the audio interfaces to support below.

config SND_SOC_JH7110_PWMDAC
	tristate "JH7110 PWM-DAC device driver"
	depends on HAVE_CLK && SND_SOC_STARFIVE
	select SND_SOC_GENERIC_DMAENGINE_PCM
	select SND_SOC_SPDIF
	help
	 Say Y or M if you want to add support for StarFive JH7110
	 PWM-DAC driver.

config SND_SOC_JH7110_TDM
	tristate "JH7110 TDM device driver"
	depends on HAVE_CLK && SND_SOC_STARFIVE
	select SND_SOC_GENERIC_DMAENGINE_PCM
	help
	  Say Y or M if you want to add support for StarFive TDM driver.

config SND_SOC_JH8100_CADENCE_I2S
        tristate "Cadence I2S Controller Device Driver for StarFive JH8100 SoC"
	depends on HAVE_CLK && SND_SOC_STARFIVE
        select SND_SOC_GENERIC_DMAENGINE_PCM
        help
         Say Y or M if you want to add support for I2S driver for the
         StarFive JH8100 Cadence Multi-Channel I2S Controller device.


config SND_SOC_JH8100_CADENCE_I2S_PCM
        bool "PCM PIO extension for CDNS I2S driver on the StarFive JH8100 SoC"
        depends on SND_SOC_JH8100_CADENCE_I2S
        help
         Say Y or N if you want to add a custom ALSA extension that registers
         a PCM and uses PIO to transfer data.
         This functionality is specially suited for I2S devices that don't have
         DMA support.
```

## sound/usb/jockey3/Kconfig
```kconfig
# SPDX-License-Identifier: GPL-2.0-only
config SND_USB_JOCKEY3
	tristate "Reloop Jockey 3 support"
	select SND_PCM
	select SND_RAWMIDI
	help
	  Say Y here to include support for the Reloop Jockey 3 DJ controllers.
	  These devices utilize a non-standard, proprietary Ploytec USB
	  protocol.

	  Supported devices:

	    * Reloop Jockey 3 Master Edition
	    * Reloop Jockey 3 Remix

	  To compile this driver as a module, choose M here: the module
	  will be called snd-reloop-jockey3.

config SND_USB_JOCKEY3_REFERENCE_CODEC
	bool "Use portable reference codec implementation"
	depends on SND_USB_JOCKEY3
	depends on EXPERT
	help
	  The Jockey 3 driver normally uses an architecture-optimized
	  bit-packing codec (separate 32-bit and 64-bit variants) to convert
	  between ALSA's S24_3LE sample format and the Ploytec wire format.
	  This is the default on all architectures.

	  Say Y to build the driver with the portable reference
	  implementation instead. It is much slower, and is intended as a
	  readable definition of the wire format and as a fallback on
	  architectures where the optimized codec has not been exercised.

	  If unsure, say N.

config SND_USB_JOCKEY3_CODEC_KUNIT_TEST
	bool "KUnit tests for the Ploytec codec" if !KUNIT_ALL_TESTS
	depends on SND_USB_JOCKEY3
	depends on KUNIT
	depends on KUNIT=y || SND_USB_JOCKEY3=m
	default KUNIT_ALL_TESTS
	help
	  Enable KUnit tests for the Ploytec bit-plane encoder and decoder.
	  The tests validate whichever codec variant the build selected
	  against a declarative description of the wire format, and prove
	  the mapping is a complete bit permutation.

	  Because the codec functions are internal to the driver, the tests
	  are linked into the snd-reloop-jockey3 module itself rather than
	  built separately.

	  KUnit tests run during boot and output the results to the debug
	  log in TAP format (https://testanything.org/). Only useful for
	  kernel devs running KUnit test harness and are not for inclusion
	  into a production build.

	  For more information on KUnit and unit tests in general, refer
	  to the KUnit documentation in Documentation/dev-tools/kunit/.

	  If unsure, say N.
```

## virt/kvm/Kconfig.debug
```kconfig
# SPDX-License-Identifier: GPL-2.0-only

config KVM_MMIO_TEST
       bool "Enable kvm mmio testing"
       depends on KVM
       depends on KVM_MMIO
       default n
       help
         Enable testing for kvm mmio. This is a test-only mmio device that
         stores writes in a buffer and returns the buffered data on a read.
         
         This is useful for testing the kvm mmio emulation code. Enabling
         this does not run any tests, just builds in the support for the test
         device into the kernel.

         If unsure, say N.
```
