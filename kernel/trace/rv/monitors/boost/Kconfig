## kernel/trace/rv/monitors/boost/Kconfig
```kconfig
# SPDX-License-Identifier: GPL-2.0-only
#
config RV_MON_BOOST
	depends on RV
	depends on RV_MON_DEADLINE
	default y
	select HA_MON_EVENTS_ID
	bool "boost monitor"
	help
	  Monitor to ensure tasks associated to a server (e.g. fair tasks) run
	  either independently or boosted in a timely manner.
	  This monitor is part of the deadline monitors collection.

	  For further information, see:
	    Documentation/trace/rv/monitor_deadline.rst
```

## kernel/trace/rv/monitors/deadline/Kconfig
```kconfig
config RV_MON_DEADLINE
	depends on RV
	bool "deadline monitor"
	help
	  auto-generated
```

## kernel/trace/rv/monitors/laxity/Kconfig
```kconfig
# SPDX-License-Identifier: GPL-2.0-only
#
config RV_MON_LAXITY
	depends on RV
	depends on RV_MON_DEADLINE
	default y
	select HA_MON_EVENTS_ID
	bool "laxity monitor"
	help
	  Monitor to ensure deferrable servers go to a zero-laxity wait unless
	  already running and run in starvation cases.

	  For further information, see:
	    Documentation/trace/rv/monitor_deadline.rst
```

## kernel/trace/rv/monitors/nrp/Kconfig
```kconfig
# SPDX-License-Identifier: GPL-2.0-only
#
config RV_MON_NRP
	depends on RV
	depends on RV_MON_SCHED
	default y
	select DA_MON_EVENTS_ID
	bool "nrp monitor"
	help
	  Monitor to ensure preemption requires need resched.
	  This monitor is part of the sched monitors collection.

	  For further information, see:
	    Documentation/trace/rv/monitor_sched.rst
```

## kernel/trace/rv/monitors/opid/Kconfig
```kconfig
# SPDX-License-Identifier: GPL-2.0-only
#
config RV_MON_OPID
	depends on RV
	depends on IRQSOFF_TRACER
	depends on PREEMPT_TRACER
	depends on RV_MON_SCHED
	default y
	select DA_MON_EVENTS_IMPLICIT
	bool "opid monitor"
	help
	  Monitor to ensure operations like wakeup and need resched occur with
	  interrupts and preemption disabled or during IRQs, where preemption
	  may not be disabled explicitly.

	  For further information, see:
	    Documentation/trace/rv/monitor_sched.rst
```

## kernel/trace/rv/monitors/rts/Kconfig
```kconfig
# SPDX-License-Identifier: GPL-2.0-only
#
config RV_MON_RTS
	depends on RV
	select RV_LTL_MONITOR
	depends on RV_MON_RTAPP
	default y
	select LTL_MON_EVENTS_CPU
	bool "rts monitor"
	help
	  Add support for RTS (real-time scheduling) monitor which validates
	  that real-time-priority tasks are scheduled before SCHED_OTHER tasks.

	  This monitor may report an error if RT throttling or deadline server
	  is enabled.

	  Say Y if you are debugging or testing a real-time system.
```

## kernel/trace/rv/monitors/sched/Kconfig
```kconfig
# SPDX-License-Identifier: GPL-2.0-only
#
config RV_MON_SCHED
	depends on RV
	select DA_MON_EVENTS_IMPLICIT
	select RV_MON_TSS
	select RV_MON_SCO
	select RV_MON_SNROC
	select RV_MON_SCPD if PREEMPT_TRACER
	select RV_MON_SNEP if PREEMPT_TRACER
	select RV_MON_SNCID if IRQSOFF_TRACER
	bool "sched monitor"
	help
	  Collection of monitors to check the scheduler behaves according to specifications.
	  Enable this to enable all scheduler specification supported by the current kernel.

	  For further information, see:
	    Documentation/trace/rv/monitor_sched.rst
```

## kernel/trace/rv/monitors/srs/Kconfig
```kconfig
# SPDX-License-Identifier: GPL-2.0-only
#
config RV_MON_SRS
	depends on RV
	depends on RV_MON_SCHED
	default y
	select DA_MON_EVENTS_ID
	bool "srs monitor"
	help
	  Monitor to describe conditions for different types of task switch.
	  This monitor enforces rules such as preempt after setting need
	  for reschedule and suspend after setting a task to sleepable.
	  This monitor is part of the sched monitors collection.

	  For further information, see:
	    Documentation/trace/rv/monitor_sched.rst
```

## kernel/trace/rv/monitors/stall/Kconfig
```kconfig
# SPDX-License-Identifier: GPL-2.0-only
#
config RV_MON_STALL
	depends on RV
	# XXX: add dependencies if there
	select HA_MON_EVENTS_ID
	bool "stall monitor"
	help
	  auto-generated
```

## kernel/trace/rv/monitors/sts/Kconfig
```kconfig
# SPDX-License-Identifier: GPL-2.0-only
#
config RV_MON_STS
	depends on RV
	depends on IRQSOFF_TRACER
	depends on RV_MON_SCHED
	default y
	select DA_MON_EVENTS_IMPLICIT
	bool "sts monitor"
	help
	  Monitor to ensure relationships between scheduler and switches
	   * each call to the scheduler implies a switch
	   * switches only happen inside the scheduler
	   * switches happen with interrupt disabled
	  This monitor is part of the sched monitors collection.

	  For further information, see:
	    Documentation/trace/rv/monitor_sched.rst
```

## kernel/trace/rv/monitors/throttle/Kconfig
```kconfig
# SPDX-License-Identifier: GPL-2.0-only
#
config RV_MON_THROTTLE
	depends on RV
	depends on HAVE_SYSCALL_TRACEPOINTS
	depends on RV_MON_DEADLINE
	default y
	select HA_MON_EVENTS_ID
	bool "throttle monitor"
	help
	  Monitor to ensure dl entities are throttled when they use up their runtime.
	  This monitor is part of the deadline monitors collection.

	  For further information, see:
	    Documentation/trace/rv/monitor_deadline.rst
```

## kernel/trace/rv/monitors/tlob/Kconfig
```kconfig
# SPDX-License-Identifier: GPL-2.0-only
#
config RV_MON_TLOB
	bool "tlob monitor"
	depends on RV && UPROBES && HIGH_RES_TIMERS
	select HA_MON_EVENTS_ID
	select RV_UPROBE
	help
	  Enable the tlob (task latency over budget) hybrid-automaton RV
	  monitor.  tlob tracks per-task elapsed wall-clock time across a
	  user-delimited code section and emits error_env_tlob when the
	  elapsed time exceeds a configurable per-invocation budget.

config TLOB_KUNIT_TEST
	tristate "KUnit tests for tlob monitor" if !KUNIT_ALL_TESTS
	depends on RV_MON_TLOB && KUNIT
	default KUNIT_ALL_TESTS
	help
	  Enable KUnit unit tests for the tlob RV monitor.  The tests
	  cover the uprobe-line parser (tlob_parse_uprobe_line) and the
	  remove-line parser (tlob_parse_remove_line), verifying valid,
	  invalid, and out-of-range inputs without requiring a running kernel.
```

## kernel/trace/rv/monitors/wakeup/Kconfig
```kconfig
# SPDX-License-Identifier: GPL-2.0-only
#
config RV_MON_WAKEUP
	depends on RV
	depends on RV_MON_RTAPP
	depends on HAVE_SYSCALL_TRACEPOINTS
	select TRACE_IRQFLAGS
	default y
	select LTL_MON_EVENTS_ID
	bool "wakeup monitor"
	help
	  This monitor detects a lower-priority task waking up a
	  higher-priority task. The RV_MON_SLEEP monitor already
	  detects this case, but this monitor detects in the context
	  of the waking task instead. This and RV_MON_SLEEP can be
	  enabled together to get the stacktrace of both the waking
	  task and the woken task.
```

## lib/bench/Kconfig
```kconfig
# SPDX-License-Identifier: GPL-2.0-only
config BENCH_PAGE_POOL
	tristate "bench page pool"
	depends on PAGE_POOL
```

## lib/vdso/Kconfig
```kconfig
# SPDX-License-Identifier: GPL-2.0

config VDSO_DATASTORE
	bool

config GENERIC_GETTIMEOFDAY
	bool
	select VDSO_DATASTORE
	select VDSO_CHECK
	help
	  This is a generic implementation of gettimeofday vdso.
	  Each architecture that enables this feature has to
	  provide the fallback implementation.

config GENERIC_VDSO_OVERFLOW_PROTECT
	bool
	help
	  Select to add multiplication overflow protection to the VDSO
	  time getter functions for the price of an extra conditional
	  in the hotpath.

config VDSO_GETRANDOM
	bool
	select VDSO_DATASTORE
	select VDSO_CHECK
	help
	  Selected by architectures that support vDSO getrandom().

config VDSO_CHECK
	bool
	help
	  Selected for architectures that are supported by the 'vdsocheck' progam.
```

## lib/vdso_kernel/Kconfig
```kconfig
# SPDX-License-Identifier: GPL-2.0

config GENERIC_VDSO_DATA_STORE
	bool
	depends on HAVE_GENERIC_VDSO
	help
	  Selected by architectures that use the generic vDSO data store.
```

## mm/damon/modules/Kconfig
```kconfig
# SPDX-License-Identifier: GPL-2.0

menu "DAMON ready-to-use modules"

config DAMON_PRDM
	tristate "Build proactive reclamation DAMON-based module"
	depends on DAMON && DAMON_VADDR && m
	default n
	help
	  This builds DAMON module for access-aware proactive reclamation of
	  multiple processes.

	  The module receives pids, monitor access to the virtual address space
	  of these processes, find memory regions that not accessed, and
	  proactively reclaim the regions.

	  If unsure, say N.

endmenu
```

## mm/kstackwatch/Kconfig
```kconfig
config KSTACKWATCH
	bool "Kernel Stack Watch"
	depends on HAVE_HW_BREAKPOINT && KPROBES && FPROBE && STACKTRACE
	help
	  A lightweight real-time debugging tool to detect stack corruption
	  and abnormal stack usage patterns in the kernel. It monitors stack
	  boundaries and detects overwrites in real time using hardware
	  breakpoints and probe-based instrumentation.

	  This feature is intended for kernel developers or advanced users
	  diagnosing rare stack overflow or memory corruption bugs. It may
	  introduce minor overhead during runtime monitoring.

	  If unsure, say N.

config KSTACKWATCH_PROFILING
	bool "KStackWatch profiling"
	depends on KSTACKWATCH
	help
	  Measure probe latency and overhead in KStackWatch. It records
	  entry/exit probe times (ns and cycles) and shows statistics when
	  stopping. Useful for performance tuning, not for production use.

	  If unsure, say N.

config KSTACKWATCH_TEST
	tristate "KStackWatch Test Module"
	depends on KSTACKWATCH
	help
	  This module provides controlled stack corruption scenarios to verify
	  the functionality of KStackWatch. It is useful for development and
	  validation of KStackWatch mechanism.

	  If unsure, say N.
```

## mm/kwatch/Kconfig
```kconfig
config KWATCH
	tristate "Kernel Watch Framework"
	depends on PERF_EVENTS && HAVE_HW_BREAKPOINT && DEBUG_FS
	depends on HAVE_REINSTALL_HW_BREAKPOINT
	depends on KPROBES && KRETPROBES
	depends on STACKTRACE
	help
	  A generalized hardware-assisted memory monitor utility.
	  It provides a low-overhead, real-time trigger mechanism to monitor
	  kernel memory safely in atomic contexts using hardware breakpoints.

	  KWatch is designed to catch silent memory corruptions, stack
	  overwrites, and complex Heisenbugs by synchronously trapping the
	  exact instruction causing the illegal access.

	  If unsure, say N.

config KWATCH_KUNIT_TEST
	bool "KUnit tests for KWatch" if !KUNIT_ALL_TESTS
	# Built into the kwatch module, so it must be y; a bool cannot be
	# enabled when KWATCH is a module (KWATCH=m would force it off).
	depends on KWATCH=y && KUNIT
	default KUNIT_ALL_TESTS
	help
	  Enable KUnit tests for the KWatch kernel module.
	  This suite tests the core parsing logic, the pointer-chasing
	  finite state machine, and edge cases involving complex watchpoint
	  expressions. If unsure, say N.
```

## net/Kconfig.debug
```kconfig
# SPDX-License-Identifier: GPL-2.0-only

config NET_DEV_REFCNT_TRACKER
	bool "Enable net device refcount tracking"
	depends on DEBUG_KERNEL && STACKTRACE_SUPPORT && NET
	select REF_TRACKER
	default n
	help
	  Enable debugging feature to track device references.
	  This adds memory and cpu costs.

config NET_NS_REFCNT_TRACKER
	bool "Enable networking namespace refcount tracking"
	depends on DEBUG_KERNEL && STACKTRACE_SUPPORT && NET
	select REF_TRACKER
	default n
	help
	  Enable debugging feature to track netns references.
	  This adds memory and cpu costs.

config DEBUG_NET
	bool "Add generic networking debug"
	depends on DEBUG_KERNEL && NET
	help
	  Enable extra sanity checks in networking.
	  This is mostly used by fuzzers, but is safe to select.

config FAIL_SKB_FORCE_REALLOC
	bool "Fault-injection capability forcing skb to reallocate"
	depends on FAULT_INJECTION && DEBUG_NET
	default n
	help
	  Provide fault-injection capability that forces the skb to be
	  reallocated, caughting possible invalid pointers to the skb.

	  For more information, check
	  Documentation/dev-tools/fault-injection/fault-injection.rst
```

## net/can/j1939/Kconfig
```kconfig
# SPDX-License-Identifier: GPL-2.0
#
# SAE J1939 network layer core configuration
#

config CAN_J1939
	tristate "SAE J1939"
	depends on CAN
	help
	  SAE J1939
	  Say Y to have in-kernel support for j1939 socket type. This
	  allows communication according to SAE j1939.
	  The relevant parts in kernel are
	  SAE j1939-21 (datalink & transport protocol)
	  & SAE j1939-81 (network management).

config CAN_J1939_KUNIT_TEST
	tristate "KUnit tests for CAN J1939 sockets" if !KUNIT_ALL_TESTS
	depends on KUNIT && CAN_J1939
	default KUNIT_ALL_TESTS
	help
	  This builds unit tests for the J1939 socket utility functions.

	  For more information on KUnit and unit tests in general, please refer
	  to the KUnit documentation in Documentation/dev-tools/kunit/.

	  If unsure, say N.
```

## net/gn/Kconfig
```kconfig
config GN
    tristate "Enable GeoNetworking support"
    default y
    select LLC
```

## net/homa/Kconfig
```kconfig
# SPDX-License-Identifier: BSD-2-Clause
#
# Homa transport protocol
#

menuconfig HOMA
	tristate "The Homa transport protocol"

	help
	Homa is a network transport protocol for communication within
	a datacenter. It provides significantly lower latency than TCP,
	particularly for workloads containing a mixture of large and small
	messages operating at high network utilization. For more information
	see the homa(7) man page or checkout the Homa Wiki at
	https://homa-transport.atlassian.net/wiki/spaces/HOMA/overview.

	If unsure, say N.
```

## net/ism/Kconfig
```kconfig
# SPDX-License-Identifier: GPL-2.0
config ISM
	tristate "ISM support"
	default n
	help
	  Internal Shared Memory (ISM)
	  A communication method that uses common physical memory for
	  synchronous direct access into a remote buffer.

	  Select this option to provide the abstraction layer between
	  ISM devices and ISM users like the SMC protocol.

	  To compile as a module choose M. The module name is ism.
	  If unsure, choose N.

config ISM_LO
	bool "intra-OS shortcut with loopback-ism"
	depends on ISM
	default n
	help
	  ISM_LO enables the creation of an Emulated-ISM device named
	  loopback-ism which can be used for transferring data
	  when communication occurs within the same OS. This helps in
	  convenient testing of ISM clients, since loopback-ism is
	  independent of architecture or hardware.

	  if unsure, say N.
```

## net/llc/Kconfig
```kconfig
# SPDX-License-Identifier: GPL-2.0-only
config LLC
	tristate

config LLC2
	tristate "ANSI/IEEE 802.2 LLC type 2 Support"
	select LLC
	help
	  This is a Logical Link Layer type 2, connection oriented support.
	  Select this if you want to have support for PF_LLC sockets.

config LLC2_CONN_KUNIT_TEST
	bool "KUnit tests for the LLC type 2 connection state machine" if !KUNIT_ALL_TESTS
	depends on KUNIT=y && LLC2=y
	default KUNIT_ALL_TESTS
	help
	  This builds the KUnit tests for the LLC type 2 connection state
	  machine, covering the bounds of the state transition tables and the
	  handling of events delivered to an out of service connection.

	  For more information on KUnit and unit tests in general, please refer
	  to the KUnit documentation in Documentation/dev-tools/kunit/.

	  If unsure, say N.
```
